ASAP2_VERSION 1 41
/begin PROJECT ETAS_ES910 "Generated by ETAS from INTECRIO V4.7.0.1005 integration project"
/begin HEADER "" VERSION "" PROJECT_NO Y /end HEADER
/begin MODULE INTECRIO_MERGED "Generated by ETAS INTECRIO V4.7.0.1005 for M/C interface ETARGET"
/begin MOD_PAR "" VERSION "" ADDR_EPK 0x0 EPK "" SUPPLIER "ETAS GmbH" CUSTOMER "" CUSTOMER_NO "" USER "" PHONE_NO "" ECU "NO_ECU" CPU_TYPE "MPC750" NO_OF_INTERFACES 1 /end MOD_PAR
/begin MOD_COMMON "Common definitions" BYTE_ORDER MSB_FIRST ALIGNMENT_BYTE 1 ALIGNMENT_WORD 2 ALIGNMENT_LONG 4 ALIGNMENT_FLOAT32_IEEE 4 ALIGNMENT_FLOAT64_IEEE 8 /end MOD_COMMON
/begin IF_DATA E_TARGET
 /begin SOURCE "Timer_Inv" 0 3000 QP_BLOB 38 /end SOURCE
 /begin SOURCE "SWT_CAN1_AP_BMS_AIRs_State" 0 1000 QP_BLOB 1 /end SOURCE
 /begin SOURCE "SWT_CAN1_AP_BMS_BatteryTemperatures" 0 1000 QP_BLOB 2 /end SOURCE
 /begin SOURCE "SWT_CAN1_AP_BMS_ChargerParameters" 0 1000 QP_BLOB 3 /end SOURCE
 /begin SOURCE "SWT_CAN1_AP_BMS_Current_SOC" 0 1000 QP_BLOB 4 /end SOURCE
 /begin SOURCE "SWT_CAN1_AP_BMS_Current_SOC_SOH1" 0 1000 QP_BLOB 6 /end SOURCE
 /begin SOURCE "SWT_CAN1_AP_BMS_Current_SOC_SOH" 0 1000 QP_BLOB 5 /end SOURCE
 /begin SOURCE "SWT_CAN1_AP_BMS_OnBoardTemperatures1" 0 1000 QP_BLOB 8 /end SOURCE
 /begin SOURCE "SWT_CAN1_AP_BMS_OnBoardTemperatures" 0 1000 QP_BLOB 7 /end SOURCE
 /begin SOURCE "SWT_CAN1_AP_BMS_StateAndFailReport" 0 1000 QP_BLOB 9 /end SOURCE
 /begin SOURCE "SWT_CAN1_AP_BMS_Voltages" 0 1000 QP_BLOB 10 /end SOURCE
 /begin SOURCE "SWT_CAN1_AP_DASH_CustomMode" 0 1000 QP_BLOB 11 /end SOURCE
 /begin SOURCE "SWT_CAN1_AP_DASH_EnableDrive" 0 1000 QP_BLOB 12 /end SOURCE
 /begin SOURCE "SWT_CAN1_AP_DASH_Mode" 0 1000 QP_BLOB 13 /end SOURCE
 /begin SOURCE "SWT_CAN1_AP_DASH_PrechargeRequest" 0 1000 QP_BLOB 14 /end SOURCE
 /begin SOURCE "SWT_CAN1_AP_DASH_TorqueLockOn" 0 1000 QP_BLOB 15 /end SOURCE
 /begin SOURCE "SWT_CAN1_AP_Inverter_L_Tx" 0 1000 QP_BLOB 16 /end SOURCE
 /begin SOURCE "SWT_CAN1_AP_Inverter_R_Tx" 0 1000 QP_BLOB 17 /end SOURCE
 /begin SOURCE "SWT_CAN1_AP_SHUTDOWN_State" 0 1000 QP_BLOB 18 /end SOURCE
 /begin SOURCE "SWT_CAN1_NM_BMS_Keep_Alive" 0 1000 QP_BLOB 19 /end SOURCE
 /begin SOURCE "SWT_CAN1_NM_DASH_Keep_Alive" 0 1000 QP_BLOB 20 /end SOURCE
 /begin SOURCE "SWT_CAN1_NM_SHUTDOWN_Keep_Alive" 0 1000 QP_BLOB 21 /end SOURCE
 /begin SOURCE "SWT_CAN2_AP_ACCEL_F_Data" 0 1000 QP_BLOB 22 /end SOURCE
 /begin SOURCE "SWT_CAN2_AP_ACCEL_R_Data2" 0 1000 QP_BLOB 24 /end SOURCE
 /begin SOURCE "SWT_CAN2_AP_ACCEL_R_Data" 0 1000 QP_BLOB 23 /end SOURCE
 /begin SOURCE "SWT_CAN2_AP_ADCAN_Data1" 0 1000 QP_BLOB 25 /end SOURCE
 /begin SOURCE "SWT_CAN2_AP_ADCAN_Data2" 0 1000 QP_BLOB 26 /end SOURCE
 /begin SOURCE "SWT_CAN2_AP_ELIPSE_VelAngular" 0 1000 QP_BLOB 27 /end SOURCE
 /begin SOURCE "SWT_CAN2_AP_ELIPSE_VelBody" 0 1000 QP_BLOB 28 /end SOURCE
 /begin SOURCE "SWT_CAN2_AP_LV_Derivation_LVData" 0 1000 QP_BLOB 29 /end SOURCE
 /begin SOURCE "SWT_CAN2_NM_ACCEL_F_Keep_Alive" 0 1000 QP_BLOB 30 /end SOURCE
 /begin SOURCE "SWT_CAN2_NM_ACCEL_R_Keep_Alive" 0 1000 QP_BLOB 31 /end SOURCE
 /begin SOURCE "SWT_CAN2_NM_ADCAN_Keep_Alive" 0 1000 QP_BLOB 32 /end SOURCE
 /begin SOURCE "SWT_CAN2_NM_LV_Derivation_Keep_Alive" 0 1000 QP_BLOB 33 /end SOURCE
 /begin SOURCE "Sync_25ms" 0 25000 QP_BLOB 34 /end SOURCE
 /begin SOURCE "Timer_1000ms" 0 1000000 QP_BLOB 35 /end SOURCE
 /begin SOURCE "Timer_100ms" 0 100000 QP_BLOB 36 /end SOURCE
 /begin SOURCE "Timer_25ms" 0 25000 QP_BLOB 37 /end SOURCE
 /begin TP_BLOB /* Program identifier */ 1692418403 /* HW target identifier */ 0x6 /* Skip flag */ 0 /* Skip to link */ 2 /* Loader identifier */ 0x02000001 /end TP_BLOB
/end IF_DATA
/begin MEASUREMENT Accel_Data_ETR07.Accel_Data_ETR07_B.AccDataConversionFX.Gain "" FLOAT64_IEEE Accel_Data_ETR07_CM_double 0 0 -1.7e+308 1.7e+308 ECU_ADDRESS 0x0 DISPLAY_IDENTIFIER Accel_Data_ETR07.Acc_Data_Conversion_F_X.Gain.Gain /end MEASUREMENT
/begin MEASUREMENT Accel_Data_ETR07.Accel_Data_ETR07_B.AccDataConversionFY.Gain "" FLOAT64_IEEE Accel_Data_ETR07_CM_double 0 0 -1.7e+308 1.7e+308 ECU_ADDRESS 0x0 DISPLAY_IDENTIFIER Accel_Data_ETR07.Acc_Data_Conversion_F_Y.Gain.Gain /end MEASUREMENT
/begin MEASUREMENT Accel_Data_ETR07.Accel_Data_ETR07_B.AccDataConversionFZ.Gain "" FLOAT64_IEEE Accel_Data_ETR07_CM_double 0 0 -1.7e+308 1.7e+308 ECU_ADDRESS 0x0 DISPLAY_IDENTIFIER Accel_Data_ETR07.Acc_Data_Conversion_F_Z.Gain.Gain /end MEASUREMENT
/begin MEASUREMENT Accel_Data_ETR07.Accel_Data_ETR07_B.AccDataConversionRX.Gain "" FLOAT64_IEEE Accel_Data_ETR07_CM_double 0 0 -1.7e+308 1.7e+308 ECU_ADDRESS 0x0 DISPLAY_IDENTIFIER Accel_Data_ETR07.Acc_Data_Conversion_R_X.Gain.Gain /end MEASUREMENT
/begin MEASUREMENT Accel_Data_ETR07.Accel_Data_ETR07_B.AccDataConversionRY.Gain "" FLOAT64_IEEE Accel_Data_ETR07_CM_double 0 0 -1.7e+308 1.7e+308 ECU_ADDRESS 0x0 DISPLAY_IDENTIFIER Accel_Data_ETR07.Acc_Data_Conversion_R_Y.Gain.Gain /end MEASUREMENT
/begin MEASUREMENT Accel_Data_ETR07.Accel_Data_ETR07_B.AccDataConversionRZ.Gain "" FLOAT64_IEEE Accel_Data_ETR07_CM_double 0 0 -1.7e+308 1.7e+308 ECU_ADDRESS 0x0 DISPLAY_IDENTIFIER Accel_Data_ETR07.Acc_Data_Conversion_R_Z.Gain.Gain /end MEASUREMENT
/begin MEASUREMENT Accel_Data_ETR07.Accel_Data_ETR07_B.LowPass.Gain "" FLOAT64_IEEE Accel_Data_ETR07_CM_double 0 0 -1.7e+308 1.7e+308 ECU_ADDRESS 0x0 DISPLAY_IDENTIFIER Accel_Data_ETR07.Low_Pass.Gain.Gain /end MEASUREMENT
/begin MEASUREMENT Accel_Data_ETR07.Accel_Data_ETR07_B.LowPass1.Gain "" FLOAT64_IEEE Accel_Data_ETR07_CM_double 0 0 -1.7e+308 1.7e+308 ECU_ADDRESS 0x0 DISPLAY_IDENTIFIER Accel_Data_ETR07.Low_Pass1.Gain.Gain /end MEASUREMENT
/begin MEASUREMENT Accel_Data_ETR07.Accel_Data_ETR07_B.LowPass2.Gain "" FLOAT64_IEEE Accel_Data_ETR07_CM_double 0 0 -1.7e+308 1.7e+308 ECU_ADDRESS 0x0 DISPLAY_IDENTIFIER Accel_Data_ETR07.Low_Pass2.Gain.Gain /end MEASUREMENT
/begin MEASUREMENT Accel_Data_ETR07.Accel_Data_ETR07_DW.A "" FLOAT64_IEEE Accel_Data_ETR07_CM_double 0 0 -1.7e+308 1.7e+308 ECU_ADDRESS 0x0 DISPLAY_IDENTIFIER Accel_Data_ETR07.Gyro_Data_Conversion_R_Z.Data_Store_Memory.A /end MEASUREMENT
/begin MEASUREMENT Accel_Data_ETR07.Accel_Data_ETR07_DW.A_f "" FLOAT64_IEEE Accel_Data_ETR07_CM_double 0 0 -1.7e+308 1.7e+308 ECU_ADDRESS 0x0 DISPLAY_IDENTIFIER Accel_Data_ETR07.Gyro_Data_Conversion_F_Z.Data_Store_Memory.A_f /end MEASUREMENT
/begin MEASUREMENT Accel_Data_ETR07.Accel_Data_ETR07_U.ACCEL_F_X "" FLOAT64_IEEE Accel_Data_ETR07_CM_double 0 0 -1.7e+308 1.7e+308 ECU_ADDRESS 0x0 DISPLAY_IDENTIFIER Accel_Data_ETR07.ACCEL_F_X /end MEASUREMENT
/begin MEASUREMENT Accel_Data_ETR07.Accel_Data_ETR07_U.ACCEL_F_Y "" FLOAT64_IEEE Accel_Data_ETR07_CM_double 0 0 -1.7e+308 1.7e+308 ECU_ADDRESS 0x0 DISPLAY_IDENTIFIER Accel_Data_ETR07.ACCEL_F_Y /end MEASUREMENT
/begin MEASUREMENT Accel_Data_ETR07.Accel_Data_ETR07_U.ACCEL_F_Z "" FLOAT64_IEEE Accel_Data_ETR07_CM_double 0 0 -1.7e+308 1.7e+308 ECU_ADDRESS 0x0 DISPLAY_IDENTIFIER Accel_Data_ETR07.ACCEL_F_Z /end MEASUREMENT
/begin MEASUREMENT Accel_Data_ETR07.Accel_Data_ETR07_U.ACCEL_R_X "" FLOAT64_IEEE Accel_Data_ETR07_CM_double 0 0 -1.7e+308 1.7e+308 ECU_ADDRESS 0x0 DISPLAY_IDENTIFIER Accel_Data_ETR07.ACCEL_R_X /end MEASUREMENT
/begin MEASUREMENT Accel_Data_ETR07.Accel_Data_ETR07_U.ACCEL_R_Y "" FLOAT64_IEEE Accel_Data_ETR07_CM_double 0 0 -1.7e+308 1.7e+308 ECU_ADDRESS 0x0 DISPLAY_IDENTIFIER Accel_Data_ETR07.ACCEL_R_Y /end MEASUREMENT
/begin MEASUREMENT Accel_Data_ETR07.Accel_Data_ETR07_U.ACCEL_R_Z "" FLOAT64_IEEE Accel_Data_ETR07_CM_double 0 0 -1.7e+308 1.7e+308 ECU_ADDRESS 0x0 DISPLAY_IDENTIFIER Accel_Data_ETR07.ACCEL_R_Z /end MEASUREMENT
/begin MEASUREMENT Accel_Data_ETR07.Accel_Data_ETR07_U.Gyroscope_F "" FLOAT64_IEEE Accel_Data_ETR07_CM_double 0 0 -1.7e+308 1.7e+308 ECU_ADDRESS 0x0 DISPLAY_IDENTIFIER Accel_Data_ETR07.Gyroscope_F /end MEASUREMENT
/begin MEASUREMENT Accel_Data_ETR07.Accel_Data_ETR07_U.Gyroscope_R "" FLOAT64_IEEE Accel_Data_ETR07_CM_double 0 0 -1.7e+308 1.7e+308 ECU_ADDRESS 0x0 DISPLAY_IDENTIFIER Accel_Data_ETR07.Gyroscope_R /end MEASUREMENT
/begin MEASUREMENT Accel_Data_ETR07.Accel_Data_ETR07_Y.Accel_F_X_SI "" FLOAT64_IEEE Accel_Data_ETR07_CM_double 0 0 -1.7e+308 1.7e+308 ECU_ADDRESS 0x0 DISPLAY_IDENTIFIER Accel_Data_ETR07.Accel_F_X_SI /end MEASUREMENT
/begin MEASUREMENT Accel_Data_ETR07.Accel_Data_ETR07_Y.Accel_F_Y_SI "" FLOAT64_IEEE Accel_Data_ETR07_CM_double 0 0 -1.7e+308 1.7e+308 ECU_ADDRESS 0x0 DISPLAY_IDENTIFIER Accel_Data_ETR07.Accel_F_Y_SI /end MEASUREMENT
/begin MEASUREMENT Accel_Data_ETR07.Accel_Data_ETR07_Y.Accel_F_Z_SI "" FLOAT64_IEEE Accel_Data_ETR07_CM_double 0 0 -1.7e+308 1.7e+308 ECU_ADDRESS 0x0 DISPLAY_IDENTIFIER Accel_Data_ETR07.Accel_F_Z_SI /end MEASUREMENT
/begin MEASUREMENT Accel_Data_ETR07.Accel_Data_ETR07_Y.Accel_R_X_SI "" FLOAT64_IEEE Accel_Data_ETR07_CM_double 0 0 -1.7e+308 1.7e+308 ECU_ADDRESS 0x0 DISPLAY_IDENTIFIER Accel_Data_ETR07.Accel_R_X_SI /end MEASUREMENT
/begin MEASUREMENT Accel_Data_ETR07.Accel_Data_ETR07_Y.Accel_R_Y_SI "" FLOAT64_IEEE Accel_Data_ETR07_CM_double 0 0 -1.7e+308 1.7e+308 ECU_ADDRESS 0x0 DISPLAY_IDENTIFIER Accel_Data_ETR07.Accel_R_Y_SI /end MEASUREMENT
/begin MEASUREMENT Accel_Data_ETR07.Accel_Data_ETR07_Y.Accel_R_Z_SI "" FLOAT64_IEEE Accel_Data_ETR07_CM_double 0 0 -1.7e+308 1.7e+308 ECU_ADDRESS 0x0 DISPLAY_IDENTIFIER Accel_Data_ETR07.Accel_R_Z_SI /end MEASUREMENT
/begin MEASUREMENT Accel_Data_ETR07.Accel_Data_ETR07_Y.Gyro_F_Z_Deg "" FLOAT64_IEEE Accel_Data_ETR07_CM_double 0 0 -1.7e+308 1.7e+308 ECU_ADDRESS 0x0 DISPLAY_IDENTIFIER Accel_Data_ETR07.Gyro_F_Z_Deg /end MEASUREMENT
/begin MEASUREMENT Accel_Data_ETR07.Accel_Data_ETR07_Y.Gyro_R_Z_Deg "" FLOAT64_IEEE Accel_Data_ETR07_CM_double 0 0 -1.7e+308 1.7e+308 ECU_ADDRESS 0x0 DISPLAY_IDENTIFIER Accel_Data_ETR07.Gyro_R_Z_Deg /end MEASUREMENT
/begin MEASUREMENT Accel_Data_ETR07.Accel_Data_ETR07_Y.Rate_F_Z_Degs2 "" FLOAT64_IEEE Accel_Data_ETR07_CM_double 0 0 -1.7e+308 1.7e+308 ECU_ADDRESS 0x0 DISPLAY_IDENTIFIER Accel_Data_ETR07.Rate_F_Z_Deg_s2 /end MEASUREMENT
/begin MEASUREMENT Accel_Data_ETR07.Accel_Data_ETR07_Y.Rate_R_Z_Degs "" FLOAT64_IEEE Accel_Data_ETR07_CM_double 0 0 -1.7e+308 1.7e+308 ECU_ADDRESS 0x0 DISPLAY_IDENTIFIER Accel_Data_ETR07.Rate_R_Z_Deg_s /end MEASUREMENT
/begin MEASUREMENT Car_State_ETR07.Car_State_ETR07_B.Merge "" FLOAT64_IEEE Car_State_ETR07_CM_double 0 0 -1.7e+308 1.7e+308 ECU_ADDRESS 0x0 DISPLAY_IDENTIFIER Car_State_ETR07.AIRS_Request.Merge.Merge /end MEASUREMENT
/begin MEASUREMENT Car_State_ETR07.Car_State_ETR07_DW.A "" FLOAT64_IEEE Car_State_ETR07_CM_double 0 0 -1.7e+308 1.7e+308 ECU_ADDRESS 0x0 DISPLAY_IDENTIFIER Car_State_ETR07.CurrentPathDisconnection_Detection.Data_Store_Memory.A /end MEASUREMENT
/begin MEASUREMENT Car_State_ETR07.Car_State_ETR07_U.AIRs_State "" FLOAT64_IEEE Car_State_ETR07_CM_double 0 0 -1.7e+308 1.7e+308 ECU_ADDRESS 0x0 DISPLAY_IDENTIFIER Car_State_ETR07.AIRs_State /end MEASUREMENT
/begin MEASUREMENT Car_State_ETR07.Car_State_ETR07_U.Accumulator_Voltage "" FLOAT64_IEEE Car_State_ETR07_CM_double 0 0 -1.7e+308 1.7e+308 ECU_ADDRESS 0x0 DISPLAY_IDENTIFIER Car_State_ETR07.Accumulator_Voltage /end MEASUREMENT
/begin MEASUREMENT Car_State_ETR07.Car_State_ETR07_U.BMSerror_CANDisconnection "" FLOAT64_IEEE Car_State_ETR07_CM_double 0 0 -1.7e+308 1.7e+308 ECU_ADDRESS 0x0 DISPLAY_IDENTIFIER Car_State_ETR07.BMSerror_CANDisconnection /end MEASUREMENT
/begin MEASUREMENT Car_State_ETR07.Car_State_ETR07_U.BMSerror_CurrentSensDisc "" FLOAT64_IEEE Car_State_ETR07_CM_double 0 0 -1.7e+308 1.7e+308 ECU_ADDRESS 0x0 DISPLAY_IDENTIFIER Car_State_ETR07.BMSerror_CurrentSensDisc /end MEASUREMENT
/begin MEASUREMENT Car_State_ETR07.Car_State_ETR07_U.BMSerror_NTCDisconnection "" FLOAT64_IEEE Car_State_ETR07_CM_double 0 0 -1.7e+308 1.7e+308 ECU_ADDRESS 0x0 DISPLAY_IDENTIFIER Car_State_ETR07.BMSerror_NTCDisconnection /end MEASUREMENT
/begin MEASUREMENT Car_State_ETR07.Car_State_ETR07_U.BMSerror_OverTemperature "" FLOAT64_IEEE Car_State_ETR07_CM_double 0 0 -1.7e+308 1.7e+308 ECU_ADDRESS 0x0 DISPLAY_IDENTIFIER Car_State_ETR07.BMSerror_OverTemperature /end MEASUREMENT
/begin MEASUREMENT Car_State_ETR07.Car_State_ETR07_U.BMSerror_OverVoltage "" FLOAT64_IEEE Car_State_ETR07_CM_double 0 0 -1.7e+308 1.7e+308 ECU_ADDRESS 0x0 DISPLAY_IDENTIFIER Car_State_ETR07.BMSerror_OverVoltage /end MEASUREMENT
/begin MEASUREMENT Car_State_ETR07.Car_State_ETR07_U.BMSerror_UnderTemperature "" FLOAT64_IEEE Car_State_ETR07_CM_double 0 0 -1.7e+308 1.7e+308 ECU_ADDRESS 0x0 DISPLAY_IDENTIFIER Car_State_ETR07.BMSerror_UnderTemperature /end MEASUREMENT
/begin MEASUREMENT Car_State_ETR07.Car_State_ETR07_U.BMSerror_UnderVoltage "" FLOAT64_IEEE Car_State_ETR07_CM_double 0 0 -1.7e+308 1.7e+308 ECU_ADDRESS 0x0 DISPLAY_IDENTIFIER Car_State_ETR07.BMSerror_UnderVoltage /end MEASUREMENT
/begin MEASUREMENT Car_State_ETR07.Car_State_ETR07_U.Critical_CAN_Disconnection "" FLOAT64_IEEE Car_State_ETR07_CM_double 0 0 -1.7e+308 1.7e+308 ECU_ADDRESS 0x0 DISPLAY_IDENTIFIER Car_State_ETR07.Critical_CAN_Disconnection /end MEASUREMENT
/begin MEASUREMENT Car_State_ETR07.Car_State_ETR07_U.DashPrechargeRequest "" FLOAT64_IEEE Car_State_ETR07_CM_double 0 0 -1.7e+308 1.7e+308 ECU_ADDRESS 0x0 DISPLAY_IDENTIFIER Car_State_ETR07.PrechargeRequest /end MEASUREMENT
/begin MEASUREMENT Car_State_ETR07.Car_State_ETR07_U.EnableDrive "" FLOAT64_IEEE Car_State_ETR07_CM_double 0 0 -1.7e+308 1.7e+308 ECU_ADDRESS 0x0 DISPLAY_IDENTIFIER Car_State_ETR07.EnableDrive_Order /end MEASUREMENT
/begin MEASUREMENT Car_State_ETR07.Car_State_ETR07_U.InvertersMinDCBus "" FLOAT64_IEEE Car_State_ETR07_CM_double 0 0 -1.7e+308 1.7e+308 ECU_ADDRESS 0x0 DISPLAY_IDENTIFIER Car_State_ETR07.InvertersMinDCBus /end MEASUREMENT
/begin MEASUREMENT Car_State_ETR07.Car_State_ETR07_U.InvertersSubscribed "" FLOAT64_IEEE Car_State_ETR07_CM_double 0 0 -1.7e+308 1.7e+308 ECU_ADDRESS 0x0 DISPLAY_IDENTIFIER Car_State_ETR07.InvertersSubscribed /end MEASUREMENT
/begin MEASUREMENT Car_State_ETR07.Car_State_ETR07_U.Lock "" FLOAT64_IEEE Car_State_ETR07_CM_double 0 0 -1.7e+308 1.7e+308 ECU_ADDRESS 0x0 DISPLAY_IDENTIFIER Car_State_ETR07.Torque_LockON /end MEASUREMENT
/begin MEASUREMENT Car_State_ETR07.Car_State_ETR07_U.Shutdown_BMS "" FLOAT64_IEEE Car_State_ETR07_CM_double 0 0 -1.7e+308 1.7e+308 ECU_ADDRESS 0x0 DISPLAY_IDENTIFIER Car_State_ETR07.Shutdown_BMS /end MEASUREMENT
/begin MEASUREMENT Car_State_ETR07.Car_State_ETR07_U.Shutdown_BOTS "" FLOAT64_IEEE Car_State_ETR07_CM_double 0 0 -1.7e+308 1.7e+308 ECU_ADDRESS 0x0 DISPLAY_IDENTIFIER Car_State_ETR07.Shutdown_BOTS /end MEASUREMENT
/begin MEASUREMENT Car_State_ETR07.Car_State_ETR07_U.Shutdown_BSPD "" FLOAT64_IEEE Car_State_ETR07_CM_double 0 0 -1.7e+308 1.7e+308 ECU_ADDRESS 0x0 DISPLAY_IDENTIFIER Car_State_ETR07.Shutdown_BSPD /end MEASUREMENT
/begin MEASUREMENT Car_State_ETR07.Car_State_ETR07_U.Shutdown_HVBOX "" FLOAT64_IEEE Car_State_ETR07_CM_double 0 0 -1.7e+308 1.7e+308 ECU_ADDRESS 0x0 DISPLAY_IDENTIFIER Car_State_ETR07.Shutdown_HVBOX /end MEASUREMENT
/begin MEASUREMENT Car_State_ETR07.Car_State_ETR07_U.Shutdown_HVD "" FLOAT64_IEEE Car_State_ETR07_CM_double 0 0 -1.7e+308 1.7e+308 ECU_ADDRESS 0x0 DISPLAY_IDENTIFIER Car_State_ETR07.Shutdown_HVD /end MEASUREMENT
/begin MEASUREMENT Car_State_ETR07.Car_State_ETR07_U.Shutdown_Inertia "" FLOAT64_IEEE Car_State_ETR07_CM_double 0 0 -1.7e+308 1.7e+308 ECU_ADDRESS 0x0 DISPLAY_IDENTIFIER Car_State_ETR07.Shutdown_Inertia /end MEASUREMENT
/begin MEASUREMENT Car_State_ETR07.Car_State_ETR07_U.Shutdown_InverterLIntck "" FLOAT64_IEEE Car_State_ETR07_CM_double 0 0 -1.7e+308 1.7e+308 ECU_ADDRESS 0x0 DISPLAY_IDENTIFIER Car_State_ETR07.Shutdown_InverterLIntck /end MEASUREMENT
/begin MEASUREMENT Car_State_ETR07.Car_State_ETR07_U.Shutdown_InverterRIntck "" FLOAT64_IEEE Car_State_ETR07_CM_double 0 0 -1.7e+308 1.7e+308 ECU_ADDRESS 0x0 DISPLAY_IDENTIFIER Car_State_ETR07.Shutdown_InverterRIntck /end MEASUREMENT
/begin MEASUREMENT Car_State_ETR07.Car_State_ETR07_U.Shutdown_PackageIntck "" FLOAT64_IEEE Car_State_ETR07_CM_double 0 0 -1.7e+308 1.7e+308 ECU_ADDRESS 0x0 DISPLAY_IDENTIFIER Car_State_ETR07.Shutdown_PackageIntck /end MEASUREMENT
/begin MEASUREMENT Car_State_ETR07.Car_State_ETR07_U.Shutdown_SetaCockpit "" FLOAT64_IEEE Car_State_ETR07_CM_double 0 0 -1.7e+308 1.7e+308 ECU_ADDRESS 0x0 DISPLAY_IDENTIFIER Car_State_ETR07.Shutdown_SetaCockpit /end MEASUREMENT
/begin MEASUREMENT Car_State_ETR07.Car_State_ETR07_U.Shutdown_SetaLeft "" FLOAT64_IEEE Car_State_ETR07_CM_double 0 0 -1.7e+308 1.7e+308 ECU_ADDRESS 0x0 DISPLAY_IDENTIFIER Car_State_ETR07.Shutdown_SetaLeft /end MEASUREMENT
/begin MEASUREMENT Car_State_ETR07.Car_State_ETR07_U.Shutdown_SetaRight "" FLOAT64_IEEE Car_State_ETR07_CM_double 0 0 -1.7e+308 1.7e+308 ECU_ADDRESS 0x0 DISPLAY_IDENTIFIER Car_State_ETR07.Shutdown_SetaRight /end MEASUREMENT
/begin MEASUREMENT Car_State_ETR07.Car_State_ETR07_U.Shutdown_TSMPIntck "" FLOAT64_IEEE Car_State_ETR07_CM_double 0 0 -1.7e+308 1.7e+308 ECU_ADDRESS 0x0 DISPLAY_IDENTIFIER Car_State_ETR07.Shutdown_TSMPIntck /end MEASUREMENT
/begin MEASUREMENT Car_State_ETR07.Car_State_ETR07_U.Shutdown_TSMS "" FLOAT64_IEEE Car_State_ETR07_CM_double 0 0 -1.7e+308 1.7e+308 ECU_ADDRESS 0x0 DISPLAY_IDENTIFIER Car_State_ETR07.Shutdown_TSMS /end MEASUREMENT
/begin MEASUREMENT Car_State_ETR07.Car_State_ETR07_Y.AIRs_Request "" FLOAT64_IEEE Car_State_ETR07_CM_double 0 0 -1.7e+308 1.7e+308 ECU_ADDRESS 0x0 DISPLAY_IDENTIFIER Car_State_ETR07.AIRs_Request /end MEASUREMENT
/begin MEASUREMENT Car_State_ETR07.Car_State_ETR07_Y.Car_OK "" UBYTE Car_State_ETR07_CM_boolean 0 0 0 1 ECU_ADDRESS 0x0 DISPLAY_IDENTIFIER Car_State_ETR07.Car_OK /end MEASUREMENT
/begin MEASUREMENT Car_State_ETR07.Car_State_ETR07_Y.Car_State "" FLOAT64_IEEE Car_State_ETR07_CM_double 0 0 -1.7e+308 1.7e+308 ECU_ADDRESS 0x0 DISPLAY_IDENTIFIER Car_State_ETR07.Car_State /end MEASUREMENT
/begin MEASUREMENT Car_State_ETR07.Car_State_ETR07_Y.CurrentPathDisconnectionFlag "" FLOAT64_IEEE Car_State_ETR07_CM_double 0 0 -1.7e+308 1.7e+308 ECU_ADDRESS 0x0 DISPLAY_IDENTIFIER Car_State_ETR07.CurrentPathDisconnectionFlag /end MEASUREMENT
/begin MEASUREMENT Car_State_ETR07.Car_State_ETR07_Y.InvertersAction "" FLOAT64_IEEE Car_State_ETR07_CM_double 0 0 -1.7e+308 1.7e+308 ECU_ADDRESS 0x0 DISPLAY_IDENTIFIER Car_State_ETR07.InvertersAction /end MEASUREMENT
/begin MEASUREMENT Car_State_ETR07.Car_State_ETR07_Y.PrechargeAssert "" FLOAT64_IEEE Car_State_ETR07_CM_double 0 0 -1.7e+308 1.7e+308 ECU_ADDRESS 0x0 DISPLAY_IDENTIFIER Car_State_ETR07.PrechargeAssert /end MEASUREMENT
/begin MEASUREMENT Car_State_ETR07.Car_State_ETR07_Y.Precharge_Percentage "" FLOAT64_IEEE Car_State_ETR07_CM_double 0 0 -1.7e+308 1.7e+308 ECU_ADDRESS 0x0 DISPLAY_IDENTIFIER Car_State_ETR07.Precharge_Percentage /end MEASUREMENT
/begin MEASUREMENT Car_State_ETR07.Car_State_ETR07_Y.Precharge_Voltage "" FLOAT64_IEEE Car_State_ETR07_CM_double 0 0 -1.7e+308 1.7e+308 ECU_ADDRESS 0x0 DISPLAY_IDENTIFIER Car_State_ETR07.Precharge_Voltage /end MEASUREMENT
/begin MEASUREMENT Car_State_ETR07.Car_State_ETR07_Y.ShutdownClosed "" FLOAT64_IEEE Car_State_ETR07_CM_double 0 0 -1.7e+308 1.7e+308 ECU_ADDRESS 0x0 DISPLAY_IDENTIFIER Car_State_ETR07.ShutdownClosed /end MEASUREMENT
/begin MEASUREMENT Car_State_ETR07.Car_State_ETR07_Y.TorqueEnable "" FLOAT64_IEEE Car_State_ETR07_CM_double 0 0 -1.7e+308 1.7e+308 ECU_ADDRESS 0x0 DISPLAY_IDENTIFIER Car_State_ETR07.TorqueEnable /end MEASUREMENT
/begin MEASUREMENT Car_State_ETR07.Car_State_ETR07_Y.errors "" FLOAT64_IEEE Car_State_ETR07_CM_double 0 0 -1.7e+308 1.7e+308 ECU_ADDRESS 0x0 DISPLAY_IDENTIFIER Car_State_ETR07.errors /end MEASUREMENT
/begin MEASUREMENT Disconnections_ETR07.Disconnections_ETR07_B.Merge "" FLOAT64_IEEE Disconnections_ETR07_CM_double 0 0 -1.7e+308 1.7e+308 ECU_ADDRESS 0x0 DISPLAY_IDENTIFIER Disconnections_ETR07.ECU_Disconections.LifeCheck_BMS.Merge.Merge /end MEASUREMENT
/begin MEASUREMENT Disconnections_ETR07.Disconnections_ETR07_B.Merge_b "" FLOAT64_IEEE Disconnections_ETR07_CM_double 0 0 -1.7e+308 1.7e+308 ECU_ADDRESS 0x0 DISPLAY_IDENTIFIER Disconnections_ETR07.ECU_Disconections.LifeCheck_AccFront.Merge.Merge_b /end MEASUREMENT
/begin MEASUREMENT Disconnections_ETR07.Disconnections_ETR07_B.Merge_d "" FLOAT64_IEEE Disconnections_ETR07_CM_double 0 0 -1.7e+308 1.7e+308 ECU_ADDRESS 0x0 DISPLAY_IDENTIFIER Disconnections_ETR07.ECU_Disconections.LifeCheck_AccRear.Merge.Merge_d /end MEASUREMENT
/begin MEASUREMENT Disconnections_ETR07.Disconnections_ETR07_B.Merge_f "" FLOAT64_IEEE Disconnections_ETR07_CM_double 0 0 -1.7e+308 1.7e+308 ECU_ADDRESS 0x0 DISPLAY_IDENTIFIER Disconnections_ETR07.ECU_Disconections.Life_check4.Merge.Merge_f /end MEASUREMENT
/begin MEASUREMENT Disconnections_ETR07.Disconnections_ETR07_B.Merge_h "" FLOAT64_IEEE Disconnections_ETR07_CM_double 0 0 -1.7e+308 1.7e+308 ECU_ADDRESS 0x0 DISPLAY_IDENTIFIER Disconnections_ETR07.ECU_Disconections.LifeCheck_Dash.Merge.Merge_h /end MEASUREMENT
/begin MEASUREMENT Disconnections_ETR07.Disconnections_ETR07_B.Merge_he "" FLOAT64_IEEE Disconnections_ETR07_CM_double 0 0 -1.7e+308 1.7e+308 ECU_ADDRESS 0x0 DISPLAY_IDENTIFIER Disconnections_ETR07.ECU_Disconections.LifeCheck_ADCAN.Merge.Merge_he /end MEASUREMENT
/begin MEASUREMENT Disconnections_ETR07.Disconnections_ETR07_B.Merge_j "" FLOAT64_IEEE Disconnections_ETR07_CM_double 0 0 -1.7e+308 1.7e+308 ECU_ADDRESS 0x0 DISPLAY_IDENTIFIER Disconnections_ETR07.ECU_Disconections.LifeCheck_Shutdown.Merge.Merge_j /end MEASUREMENT
/begin MEASUREMENT Disconnections_ETR07.Disconnections_ETR07_DW.A "" FLOAT64_IEEE Disconnections_ETR07_CM_double 0 0 -1.7e+308 1.7e+308 ECU_ADDRESS 0x0 DISPLAY_IDENTIFIER Disconnections_ETR07.Counter.Data_Store_Memory.A /end MEASUREMENT
/begin MEASUREMENT Disconnections_ETR07.Disconnections_ETR07_DW.Last_alive "" FLOAT64_IEEE Disconnections_ETR07_CM_double 0 0 -1.7e+308 1.7e+308 ECU_ADDRESS 0x0 DISPLAY_IDENTIFIER Disconnections_ETR07.Pedal_Box_Disconnections__Noise_.Life_check3.Data_Store_Memory.Last_alive /end MEASUREMENT
/begin MEASUREMENT Disconnections_ETR07.Disconnections_ETR07_DW.Last_alive_a "" FLOAT64_IEEE Disconnections_ETR07_CM_double 0 0 -1.7e+308 1.7e+308 ECU_ADDRESS 0x0 DISPLAY_IDENTIFIER Disconnections_ETR07.ECU_Disconections.LifeCheck_AccFront.Data_Store_Memory.Last_alive_a /end MEASUREMENT
/begin MEASUREMENT Disconnections_ETR07.Disconnections_ETR07_DW.Last_alive_ar "" FLOAT64_IEEE Disconnections_ETR07_CM_double 0 0 -1.7e+308 1.7e+308 ECU_ADDRESS 0x0 DISPLAY_IDENTIFIER Disconnections_ETR07.ECU_Disconections.LifeCheck_ADCAN.Data_Store_Memory.Last_alive_ar /end MEASUREMENT
/begin MEASUREMENT Disconnections_ETR07.Disconnections_ETR07_DW.Last_alive_c "" FLOAT64_IEEE Disconnections_ETR07_CM_double 0 0 -1.7e+308 1.7e+308 ECU_ADDRESS 0x0 DISPLAY_IDENTIFIER Disconnections_ETR07.Pedal_Box_Disconnections__Noise_.Life_check2.Data_Store_Memory.Last_alive_c /end MEASUREMENT
/begin MEASUREMENT Disconnections_ETR07.Disconnections_ETR07_DW.Last_alive_c0 "" FLOAT64_IEEE Disconnections_ETR07_CM_double 0 0 -1.7e+308 1.7e+308 ECU_ADDRESS 0x0 DISPLAY_IDENTIFIER Disconnections_ETR07.ECU_Disconections.LifeCheck_BMS.Data_Store_Memory.Last_alive_c0 /end MEASUREMENT
/begin MEASUREMENT Disconnections_ETR07.Disconnections_ETR07_DW.Last_alive_g "" FLOAT64_IEEE Disconnections_ETR07_CM_double 0 0 -1.7e+308 1.7e+308 ECU_ADDRESS 0x0 DISPLAY_IDENTIFIER Disconnections_ETR07.Pedal_Box_Disconnections__Noise_.Life_check1.Data_Store_Memory.Last_alive_g /end MEASUREMENT
/begin MEASUREMENT Disconnections_ETR07.Disconnections_ETR07_DW.Last_alive_gx "" FLOAT64_IEEE Disconnections_ETR07_CM_double 0 0 -1.7e+308 1.7e+308 ECU_ADDRESS 0x0 DISPLAY_IDENTIFIER Disconnections_ETR07.ECU_Disconections.LifeCheck_AccRear.Data_Store_Memory.Last_alive_gx /end MEASUREMENT
/begin MEASUREMENT Disconnections_ETR07.Disconnections_ETR07_DW.Last_alive_j "" FLOAT64_IEEE Disconnections_ETR07_CM_double 0 0 -1.7e+308 1.7e+308 ECU_ADDRESS 0x0 DISPLAY_IDENTIFIER Disconnections_ETR07.ECU_Disconections.LifeCheck_Shutdown.Data_Store_Memory.Last_alive_j /end MEASUREMENT
/begin MEASUREMENT Disconnections_ETR07.Disconnections_ETR07_DW.Last_alive_je "" FLOAT64_IEEE Disconnections_ETR07_CM_double 0 0 -1.7e+308 1.7e+308 ECU_ADDRESS 0x0 DISPLAY_IDENTIFIER Disconnections_ETR07.ECU_Disconections.Life_check4.Data_Store_Memory.Last_alive_je /end MEASUREMENT
/begin MEASUREMENT Disconnections_ETR07.Disconnections_ETR07_DW.Last_alive_l "" FLOAT64_IEEE Disconnections_ETR07_CM_double 0 0 -1.7e+308 1.7e+308 ECU_ADDRESS 0x0 DISPLAY_IDENTIFIER Disconnections_ETR07.Gyro_Disconnections__Noise_.Life_check6.Data_Store_Memory.Last_alive_l /end MEASUREMENT
/begin MEASUREMENT Disconnections_ETR07.Disconnections_ETR07_DW.Last_alive_m "" FLOAT64_IEEE Disconnections_ETR07_CM_double 0 0 -1.7e+308 1.7e+308 ECU_ADDRESS 0x0 DISPLAY_IDENTIFIER Disconnections_ETR07.Gyro_Disconnections__Noise_.Life_check8.Data_Store_Memory.Last_alive_m /end MEASUREMENT
/begin MEASUREMENT Disconnections_ETR07.Disconnections_ETR07_DW.Last_alive_o "" FLOAT64_IEEE Disconnections_ETR07_CM_double 0 0 -1.7e+308 1.7e+308 ECU_ADDRESS 0x0 DISPLAY_IDENTIFIER Disconnections_ETR07.ECU_Disconections.LifeCheck_Dash.Data_Store_Memory.Last_alive_o /end MEASUREMENT
/begin MEASUREMENT Disconnections_ETR07.Disconnections_ETR07_DW.Tot_Errors "" FLOAT64_IEEE Disconnections_ETR07_CM_double 0 0 -1.7e+308 1.7e+308 ECU_ADDRESS 0x0 DISPLAY_IDENTIFIER Disconnections_ETR07.Pedal_Box_Disconnections__Noise_.Life_check3.Data_Store_Memory1.Tot_Errors /end MEASUREMENT
/begin MEASUREMENT Disconnections_ETR07.Disconnections_ETR07_DW.Tot_Errors_h "" FLOAT64_IEEE Disconnections_ETR07_CM_double 0 0 -1.7e+308 1.7e+308 ECU_ADDRESS 0x0 DISPLAY_IDENTIFIER Disconnections_ETR07.Gyro_Disconnections__Noise_.Life_check6.Data_Store_Memory1.Tot_Errors_h /end MEASUREMENT
/begin MEASUREMENT Disconnections_ETR07.Disconnections_ETR07_DW.Tot_Errors_j "" FLOAT64_IEEE Disconnections_ETR07_CM_double 0 0 -1.7e+308 1.7e+308 ECU_ADDRESS 0x0 DISPLAY_IDENTIFIER Disconnections_ETR07.Pedal_Box_Disconnections__Noise_.Life_check2.Data_Store_Memory1.Tot_Errors_j /end MEASUREMENT
/begin MEASUREMENT Disconnections_ETR07.Disconnections_ETR07_DW.Tot_Errors_k "" FLOAT64_IEEE Disconnections_ETR07_CM_double 0 0 -1.7e+308 1.7e+308 ECU_ADDRESS 0x0 DISPLAY_IDENTIFIER Disconnections_ETR07.Pedal_Box_Disconnections__Noise_.Life_check1.Data_Store_Memory1.Tot_Errors_k /end MEASUREMENT
/begin MEASUREMENT Disconnections_ETR07.Disconnections_ETR07_DW.Tot_Errors_m "" FLOAT64_IEEE Disconnections_ETR07_CM_double 0 0 -1.7e+308 1.7e+308 ECU_ADDRESS 0x0 DISPLAY_IDENTIFIER Disconnections_ETR07.Gyro_Disconnections__Noise_.Life_check8.Data_Store_Memory1.Tot_Errors_m /end MEASUREMENT
/begin MEASUREMENT Disconnections_ETR07.Disconnections_ETR07_U.ADCAN_Alive "" FLOAT64_IEEE Disconnections_ETR07_CM_double 0 0 -1.7e+308 1.7e+308 ECU_ADDRESS 0x0 DISPLAY_IDENTIFIER Disconnections_ETR07.ADCAN_Alive /end MEASUREMENT
/begin MEASUREMENT Disconnections_ETR07.Disconnections_ETR07_U.APPS1_Bits "" FLOAT64_IEEE Disconnections_ETR07_CM_double 0 0 -1.7e+308 1.7e+308 ECU_ADDRESS 0x0 DISPLAY_IDENTIFIER Disconnections_ETR07.APPS1_Bits /end MEASUREMENT
/begin MEASUREMENT Disconnections_ETR07.Disconnections_ETR07_U.APPS2_Bits "" FLOAT64_IEEE Disconnections_ETR07_CM_double 0 0 -1.7e+308 1.7e+308 ECU_ADDRESS 0x0 DISPLAY_IDENTIFIER Disconnections_ETR07.APPS2_Bits /end MEASUREMENT
/begin MEASUREMENT Disconnections_ETR07.Disconnections_ETR07_U.Accel_F_Alive "" FLOAT64_IEEE Disconnections_ETR07_CM_double 0 0 -1.7e+308 1.7e+308 ECU_ADDRESS 0x0 DISPLAY_IDENTIFIER Disconnections_ETR07.Accel_F_Alive /end MEASUREMENT
/begin MEASUREMENT Disconnections_ETR07.Disconnections_ETR07_U.Accel_R_Alive "" FLOAT64_IEEE Disconnections_ETR07_CM_double 0 0 -1.7e+308 1.7e+308 ECU_ADDRESS 0x0 DISPLAY_IDENTIFIER Disconnections_ETR07.Accel_R_Alive /end MEASUREMENT
/begin MEASUREMENT Disconnections_ETR07.Disconnections_ETR07_U.BMS_Alive "" FLOAT64_IEEE Disconnections_ETR07_CM_double 0 0 -1.7e+308 1.7e+308 ECU_ADDRESS 0x0 DISPLAY_IDENTIFIER Disconnections_ETR07.BMS_Alive /end MEASUREMENT
/begin MEASUREMENT Disconnections_ETR07.Disconnections_ETR07_U.BrakeSensor_Bits "" FLOAT64_IEEE Disconnections_ETR07_CM_double 0 0 -1.7e+308 1.7e+308 ECU_ADDRESS 0x0 DISPLAY_IDENTIFIER Disconnections_ETR07.BrakeSensor_Bits /end MEASUREMENT
/begin MEASUREMENT Disconnections_ETR07.Disconnections_ETR07_U.Dash_Alive "" FLOAT64_IEEE Disconnections_ETR07_CM_double 0 0 -1.7e+308 1.7e+308 ECU_ADDRESS 0x0 DISPLAY_IDENTIFIER Disconnections_ETR07.Dash_Alive /end MEASUREMENT
/begin MEASUREMENT Disconnections_ETR07.Disconnections_ETR07_U.Gyroscope_F "" FLOAT64_IEEE Disconnections_ETR07_CM_double 0 0 -1.7e+308 1.7e+308 ECU_ADDRESS 0x0 DISPLAY_IDENTIFIER Disconnections_ETR07.Gyroscope_F /end MEASUREMENT
/begin MEASUREMENT Disconnections_ETR07.Disconnections_ETR07_U.Gyroscope_R "" FLOAT64_IEEE Disconnections_ETR07_CM_double 0 0 -1.7e+308 1.7e+308 ECU_ADDRESS 0x0 DISPLAY_IDENTIFIER Disconnections_ETR07.Gyroscope_R /end MEASUREMENT
/begin MEASUREMENT Disconnections_ETR07.Disconnections_ETR07_U.LV_Derivation_Alive "" FLOAT64_IEEE Disconnections_ETR07_CM_double 0 0 -1.7e+308 1.7e+308 ECU_ADDRESS 0x0 DISPLAY_IDENTIFIER Disconnections_ETR07.LV_Derivation_Alive /end MEASUREMENT
/begin MEASUREMENT Disconnections_ETR07.Disconnections_ETR07_U.Shutdown_Alive "" FLOAT64_IEEE Disconnections_ETR07_CM_double 0 0 -1.7e+308 1.7e+308 ECU_ADDRESS 0x0 DISPLAY_IDENTIFIER Disconnections_ETR07.Shutdown_Alive /end MEASUREMENT
/begin MEASUREMENT Disconnections_ETR07.Disconnections_ETR07_U.SteeringSensor_Bits "" FLOAT64_IEEE Disconnections_ETR07_CM_double 0 0 -1.7e+308 1.7e+308 ECU_ADDRESS 0x0 DISPLAY_IDENTIFIER Disconnections_ETR07.SteeringSensor_Bits /end MEASUREMENT
/begin MEASUREMENT Disconnections_ETR07.Disconnections_ETR07_U.Susp_F_L_Bits "" FLOAT64_IEEE Disconnections_ETR07_CM_double 0 0 -1.7e+308 1.7e+308 ECU_ADDRESS 0x0 DISPLAY_IDENTIFIER Disconnections_ETR07.Susp_F_L_Bits /end MEASUREMENT
/begin MEASUREMENT Disconnections_ETR07.Disconnections_ETR07_U.Susp_F_R_Bits "" FLOAT64_IEEE Disconnections_ETR07_CM_double 0 0 -1.7e+308 1.7e+308 ECU_ADDRESS 0x0 DISPLAY_IDENTIFIER Disconnections_ETR07.Susp_F_R_Bits /end MEASUREMENT
/begin MEASUREMENT Disconnections_ETR07.Disconnections_ETR07_U.Susp_R_L_Bits "" FLOAT64_IEEE Disconnections_ETR07_CM_double 0 0 -1.7e+308 1.7e+308 ECU_ADDRESS 0x0 DISPLAY_IDENTIFIER Disconnections_ETR07.Susp_R_L_Bits /end MEASUREMENT
/begin MEASUREMENT Disconnections_ETR07.Disconnections_ETR07_U.Susp_R_R_Bits "" FLOAT64_IEEE Disconnections_ETR07_CM_double 0 0 -1.7e+308 1.7e+308 ECU_ADDRESS 0x0 DISPLAY_IDENTIFIER Disconnections_ETR07.Susp_R_R_Bits /end MEASUREMENT
/begin MEASUREMENT Disconnections_ETR07.Disconnections_ETR07_Y.CounterOut "" FLOAT64_IEEE Disconnections_ETR07_CM_double 0 0 -1.7e+308 1.7e+308 ECU_ADDRESS 0x0 DISPLAY_IDENTIFIER Disconnections_ETR07.CounterOut /end MEASUREMENT
/begin MEASUREMENT Disconnections_ETR07.Disconnections_ETR07_Y.CriticalDisconnection "" UBYTE Disconnections_ETR07_CM_uint8 0 0 0.0 255.0 ECU_ADDRESS 0x0 DISPLAY_IDENTIFIER Disconnections_ETR07.CriticalDisconnection /end MEASUREMENT
/begin MEASUREMENT Disconnections_ETR07.Disconnections_ETR07_Y.Critical_CAN_Disconnection "" UBYTE Disconnections_ETR07_CM_boolean 0 0 0 1 ECU_ADDRESS 0x0 DISPLAY_IDENTIFIER Disconnections_ETR07.Critical_CAN_Disconnection /end MEASUREMENT
/begin MEASUREMENT Disconnections_ETR07.Disconnections_ETR07_Y.Critical_Signal_Disconnection "" UBYTE Disconnections_ETR07_CM_boolean 0 0 0 1 ECU_ADDRESS 0x0 DISPLAY_IDENTIFIER Disconnections_ETR07.Critical_Signal_Disconnection /end MEASUREMENT
/begin MEASUREMENT Disconnections_ETR07.Disconnections_ETR07_Y.Disconnection_ADCAN "" FLOAT64_IEEE Disconnections_ETR07_CM_double 0 0 -1.7e+308 1.7e+308 ECU_ADDRESS 0x0 DISPLAY_IDENTIFIER Disconnections_ETR07.Disconnection_ADCAN /end MEASUREMENT
/begin MEASUREMENT Disconnections_ETR07.Disconnections_ETR07_Y.Disconnection_APPS1 "" FLOAT64_IEEE Disconnections_ETR07_CM_double 0 0 -1.7e+308 1.7e+308 ECU_ADDRESS 0x0 DISPLAY_IDENTIFIER Disconnections_ETR07.Disconnection_APPS1 /end MEASUREMENT
/begin MEASUREMENT Disconnections_ETR07.Disconnections_ETR07_Y.Disconnection_APPS2 "" FLOAT64_IEEE Disconnections_ETR07_CM_double 0 0 -1.7e+308 1.7e+308 ECU_ADDRESS 0x0 DISPLAY_IDENTIFIER Disconnections_ETR07.Disconnection_APPS2 /end MEASUREMENT
/begin MEASUREMENT Disconnections_ETR07.Disconnections_ETR07_Y.Disconnection_Accel_F "" FLOAT64_IEEE Disconnections_ETR07_CM_double 0 0 -1.7e+308 1.7e+308 ECU_ADDRESS 0x0 DISPLAY_IDENTIFIER Disconnections_ETR07.Disconnection_Accel_F /end MEASUREMENT
/begin MEASUREMENT Disconnections_ETR07.Disconnections_ETR07_Y.Disconnection_Accel_R "" FLOAT64_IEEE Disconnections_ETR07_CM_double 0 0 -1.7e+308 1.7e+308 ECU_ADDRESS 0x0 DISPLAY_IDENTIFIER Disconnections_ETR07.Disconnection_Accel_R /end MEASUREMENT
/begin MEASUREMENT Disconnections_ETR07.Disconnections_ETR07_Y.Disconnection_BMS "" FLOAT64_IEEE Disconnections_ETR07_CM_double 0 0 -1.7e+308 1.7e+308 ECU_ADDRESS 0x0 DISPLAY_IDENTIFIER Disconnections_ETR07.Disconnection_BMS /end MEASUREMENT
/begin MEASUREMENT Disconnections_ETR07.Disconnections_ETR07_Y.Disconnection_Brake_Sensor "" FLOAT64_IEEE Disconnections_ETR07_CM_double 0 0 -1.7e+308 1.7e+308 ECU_ADDRESS 0x0 DISPLAY_IDENTIFIER Disconnections_ETR07.Disconnection_Brake_Sensor /end MEASUREMENT
/begin MEASUREMENT Disconnections_ETR07.Disconnections_ETR07_Y.Disconnection_DashBoard "" FLOAT64_IEEE Disconnections_ETR07_CM_double 0 0 -1.7e+308 1.7e+308 ECU_ADDRESS 0x0 DISPLAY_IDENTIFIER Disconnections_ETR07.Disconnection_DashBoard /end MEASUREMENT
/begin MEASUREMENT Disconnections_ETR07.Disconnections_ETR07_Y.Disconnection_Gyroscope_F "" FLOAT64_IEEE Disconnections_ETR07_CM_double 0 0 -1.7e+308 1.7e+308 ECU_ADDRESS 0x0 DISPLAY_IDENTIFIER Disconnections_ETR07.Disconnection_Gyroscope_F /end MEASUREMENT
/begin MEASUREMENT Disconnections_ETR07.Disconnections_ETR07_Y.Disconnection_Gyroscope_R "" FLOAT64_IEEE Disconnections_ETR07_CM_double 0 0 -1.7e+308 1.7e+308 ECU_ADDRESS 0x0 DISPLAY_IDENTIFIER Disconnections_ETR07.Disconnection_Gyroscope_R /end MEASUREMENT
/begin MEASUREMENT Disconnections_ETR07.Disconnections_ETR07_Y.Disconnection_LV_Derivation "" FLOAT64_IEEE Disconnections_ETR07_CM_double 0 0 -1.7e+308 1.7e+308 ECU_ADDRESS 0x0 DISPLAY_IDENTIFIER Disconnections_ETR07.Disconnection_LV_Derivation /end MEASUREMENT
/begin MEASUREMENT Disconnections_ETR07.Disconnections_ETR07_Y.Disconnection_Shutdown "" FLOAT64_IEEE Disconnections_ETR07_CM_double 0 0 -1.7e+308 1.7e+308 ECU_ADDRESS 0x0 DISPLAY_IDENTIFIER Disconnections_ETR07.Disconnection_Shutdown /end MEASUREMENT
/begin MEASUREMENT Disconnections_ETR07.Disconnections_ETR07_Y.Disconnection_SteeringSensor "" UBYTE Disconnections_ETR07_CM_uint8 0 0 0.0 255.0 ECU_ADDRESS 0x0 DISPLAY_IDENTIFIER Disconnections_ETR07.Disconnection_SteeringSensor /end MEASUREMENT
/begin MEASUREMENT Disconnections_ETR07.Disconnections_ETR07_Y.Disconnection_Susp_F_L "" UBYTE Disconnections_ETR07_CM_uint8 0 0 0.0 255.0 ECU_ADDRESS 0x0 DISPLAY_IDENTIFIER Disconnections_ETR07.Disconnection_Susp_F_L /end MEASUREMENT
/begin MEASUREMENT Disconnections_ETR07.Disconnections_ETR07_Y.Disconnection_Susp_F_R "" UBYTE Disconnections_ETR07_CM_uint8 0 0 0.0 255.0 ECU_ADDRESS 0x0 DISPLAY_IDENTIFIER Disconnections_ETR07.Disconnection_Susp_F_R /end MEASUREMENT
/begin MEASUREMENT Disconnections_ETR07.Disconnections_ETR07_Y.Disconnection_Susp_R_L "" FLOAT64_IEEE Disconnections_ETR07_CM_double 0 0 -1.7e+308 1.7e+308 ECU_ADDRESS 0x0 DISPLAY_IDENTIFIER Disconnections_ETR07.Disconnection_Susp_R_L /end MEASUREMENT
/begin MEASUREMENT Disconnections_ETR07.Disconnections_ETR07_Y.Disconnection_Susp_R_R "" UBYTE Disconnections_ETR07_CM_uint8 0 0 0.0 255.0 ECU_ADDRESS 0x0 DISPLAY_IDENTIFIER Disconnections_ETR07.Disconnection_Susp_R_R /end MEASUREMENT
/begin MEASUREMENT Disconnections_ETR07.Disconnections_ETR07_Y.TV_mode "" FLOAT64_IEEE Disconnections_ETR07_CM_double 0 0 -1.7e+308 1.7e+308 ECU_ADDRESS 0x0 DISPLAY_IDENTIFIER Disconnections_ETR07.TV_mode /end MEASUREMENT
/begin MEASUREMENT inverters_action_ETR07.inverters_action_ETR07_B.Merge "" UBYTE inverters_action_ETR07_CM_boolean 0 0 0 1 ECU_ADDRESS 0x0 DISPLAY_IDENTIFIER inverters_action_ETR07.Merge.Merge /end MEASUREMENT
/begin MEASUREMENT inverters_action_ETR07.inverters_action_ETR07_B.Merge2 "" UBYTE inverters_action_ETR07_CM_uint8 0 0 0.0 255.0 ECU_ADDRESS 0x0 DISPLAY_IDENTIFIER inverters_action_ETR07.Subsystem9.Merge2.Merge2 /end MEASUREMENT
/begin MEASUREMENT inverters_action_ETR07.inverters_action_ETR07_B.Merge2_p "" UBYTE inverters_action_ETR07_CM_uint8 0 0 0.0 255.0 ECU_ADDRESS 0x0 DISPLAY_IDENTIFIER inverters_action_ETR07.Subsystem10.Merge2.Merge2_p /end MEASUREMENT
/begin MEASUREMENT inverters_action_ETR07.inverters_action_ETR07_B.subscribed "" UBYTE inverters_action_ETR07_CM_boolean 0 0 0 1 ECU_ADDRESS 0x0 DISPLAY_IDENTIFIER inverters_action_ETR07.Subsystem9.Unsubscribe__Subscribe.subscribed_.subscribed /end MEASUREMENT
/begin MEASUREMENT inverters_action_ETR07.inverters_action_ETR07_B.subscribed_b "" UBYTE inverters_action_ETR07_CM_boolean 0 0 0 1 ECU_ADDRESS 0x0 DISPLAY_IDENTIFIER inverters_action_ETR07.Subsystem10.Unsubscribe__Subscribe.subscribed_.subscribed_b /end MEASUREMENT
/begin MEASUREMENT inverters_action_ETR07.inverters_action_ETR07_DW.EnumerationCounter "" FLOAT64_IEEE inverters_action_ETR07_CM_double 0 0 -1.7e+308 1.7e+308 ECU_ADDRESS 0x0 DISPLAY_IDENTIFIER inverters_action_ETR07.Subsystem10.Data_Store_Memory2.EnumerationCounter /end MEASUREMENT
/begin MEASUREMENT inverters_action_ETR07.inverters_action_ETR07_DW.EnumerationCounter_m "" FLOAT64_IEEE inverters_action_ETR07_CM_double 0 0 -1.7e+308 1.7e+308 ECU_ADDRESS 0x0 DISPLAY_IDENTIFIER inverters_action_ETR07.Subsystem9.Data_Store_Memory2.EnumerationCounter_m /end MEASUREMENT
/begin MEASUREMENT inverters_action_ETR07.inverters_action_ETR07_DW.LastAction "" FLOAT64_IEEE inverters_action_ETR07_CM_double 0 0 -1.7e+308 1.7e+308 ECU_ADDRESS 0x0 DISPLAY_IDENTIFIER inverters_action_ETR07.Subsystem10.Data_Store_Memory1.LastAction /end MEASUREMENT
/begin MEASUREMENT inverters_action_ETR07.inverters_action_ETR07_DW.LastAction_k "" FLOAT64_IEEE inverters_action_ETR07_CM_double 0 0 -1.7e+308 1.7e+308 ECU_ADDRESS 0x0 DISPLAY_IDENTIFIER inverters_action_ETR07.Subsystem9.Data_Store_Memory1.LastAction_k /end MEASUREMENT
/begin MEASUREMENT inverters_action_ETR07.inverters_action_ETR07_U.InvertersAction "" FLOAT64_IEEE inverters_action_ETR07_CM_double 0 0 -1.7e+308 1.7e+308 ECU_ADDRESS 0x0 DISPLAY_IDENTIFIER inverters_action_ETR07.InvertersAction /end MEASUREMENT
/begin MEASUREMENT inverters_action_ETR07.inverters_action_ETR07_U.current_L "" FLOAT64_IEEE inverters_action_ETR07_CM_double 0 0 -1.7e+308 1.7e+308 ECU_ADDRESS 0x0 DISPLAY_IDENTIFIER inverters_action_ETR07.current_L /end MEASUREMENT
/begin MEASUREMENT inverters_action_ETR07.inverters_action_ETR07_U.current_R "" FLOAT64_IEEE inverters_action_ETR07_CM_double 0 0 -1.7e+308 1.7e+308 ECU_ADDRESS 0x0 DISPLAY_IDENTIFIER inverters_action_ETR07.current_R /end MEASUREMENT
/begin MEASUREMENT inverters_action_ETR07.inverters_action_ETR07_Y.Inverter_L_RegID "" UBYTE inverters_action_ETR07_CM_uint8 0 0 0.0 255.0 ECU_ADDRESS 0x0 DISPLAY_IDENTIFIER inverters_action_ETR07.Inverter_L_RegID /end MEASUREMENT
/begin MEASUREMENT inverters_action_ETR07.inverters_action_ETR07_Y.Inverter_L_b15tob8 "" UBYTE inverters_action_ETR07_CM_uint8 0 0 0.0 255.0 ECU_ADDRESS 0x0 DISPLAY_IDENTIFIER inverters_action_ETR07.Inverter_L_b15tob8 /end MEASUREMENT
/begin MEASUREMENT inverters_action_ETR07.inverters_action_ETR07_Y.Inverter_L_b7tob0 "" UBYTE inverters_action_ETR07_CM_uint8 0 0 0.0 255.0 ECU_ADDRESS 0x0 DISPLAY_IDENTIFIER inverters_action_ETR07.Inverter_L_b7tob0 /end MEASUREMENT
/begin MEASUREMENT inverters_action_ETR07.inverters_action_ETR07_Y.Inverter_R_RegID "" UBYTE inverters_action_ETR07_CM_uint8 0 0 0.0 255.0 ECU_ADDRESS 0x0 DISPLAY_IDENTIFIER inverters_action_ETR07.Inverter_R_RegID /end MEASUREMENT
/begin MEASUREMENT inverters_action_ETR07.inverters_action_ETR07_Y.Inverter_R_b15tob8 "" UBYTE inverters_action_ETR07_CM_uint8 0 0 0.0 255.0 ECU_ADDRESS 0x0 DISPLAY_IDENTIFIER inverters_action_ETR07.Inverter_R_b15tob8 /end MEASUREMENT
/begin MEASUREMENT inverters_action_ETR07.inverters_action_ETR07_Y.Inverter_R_b7tob0 "" UBYTE inverters_action_ETR07_CM_uint8 0 0 0.0 255.0 ECU_ADDRESS 0x0 DISPLAY_IDENTIFIER inverters_action_ETR07.Inverter_R_b7tob0 /end MEASUREMENT
/begin MEASUREMENT inverters_action_ETR07.inverters_action_ETR07_Y.InvertersSubscribed "" UBYTE inverters_action_ETR07_CM_boolean 0 0 0 1 ECU_ADDRESS 0x0 DISPLAY_IDENTIFIER inverters_action_ETR07.InvertersSubscribed /end MEASUREMENT
/begin MEASUREMENT Inverters_Data_ETR07.Inverters_Data_ETR07_U.Inv_L_RegID_M235_Inv_L_DCBus "" FLOAT64_IEEE Inverters_Data_ETR07_CM_double 0 0 -1.7e+308 1.7e+308 ECU_ADDRESS 0x0 DISPLAY_IDENTIFIER Inverters_Data_ETR07.Inv_L_RegID_M235_Inv_L_DCBus /end MEASUREMENT
/begin MEASUREMENT Inverters_Data_ETR07.Inverters_Data_ETR07_U.Inv_L_RegID_M32_Inv_L_Iactual "" FLOAT64_IEEE Inverters_Data_ETR07_CM_double 0 0 -1.7e+308 1.7e+308 ECU_ADDRESS 0x0 DISPLAY_IDENTIFIER Inverters_Data_ETR07.Inv_L_RegID_M32_Inv_L_Iactual /end MEASUREMENT
/begin MEASUREMENT Inverters_Data_ETR07.Inverters_Data_ETR07_U.Inv_L_RegID_M38_Inv_L_Icommand "" FLOAT64_IEEE Inverters_Data_ETR07_CM_double 0 0 -1.7e+308 1.7e+308 ECU_ADDRESS 0x0 DISPLAY_IDENTIFIER Inverters_Data_ETR07.Inv_L_RegID_M38_Inv_L_Icommand /end MEASUREMENT
/begin MEASUREMENT Inverters_Data_ETR07.Inverters_Data_ETR07_U.Inv_L_RegID_M39_Inv_L_Iq "" FLOAT64_IEEE Inverters_Data_ETR07_CM_double 0 0 -1.7e+308 1.7e+308 ECU_ADDRESS 0x0 DISPLAY_IDENTIFIER Inverters_Data_ETR07.Inv_L_RegID_M39_Inv_L_Iq /end MEASUREMENT
/begin MEASUREMENT Inverters_Data_ETR07.Inverters_Data_ETR07_U.Inv_L_RegID_M48_Inv_L_Speed "" FLOAT64_IEEE Inverters_Data_ETR07_CM_double 0 0 -1.7e+308 1.7e+308 ECU_ADDRESS 0x0 DISPLAY_IDENTIFIER Inverters_Data_ETR07.Inv_L_RegID_M48_Inv_L_Speed /end MEASUREMENT
/begin MEASUREMENT Inverters_Data_ETR07.Inverters_Data_ETR07_U.Inv_L_RegID_M73_Inv_L_TempMotor "" FLOAT64_IEEE Inverters_Data_ETR07_CM_double 0 0 -1.7e+308 1.7e+308 ECU_ADDRESS 0x0 DISPLAY_IDENTIFIER Inverters_Data_ETR07.Inv_L_RegID_M73_Inv_L_TempMotor /end MEASUREMENT
/begin MEASUREMENT Inverters_Data_ETR07.Inverters_Data_ETR07_U.Inv_L_RegID_M74_Inv_L_TempIGBT "" FLOAT64_IEEE Inverters_Data_ETR07_CM_double 0 0 -1.7e+308 1.7e+308 ECU_ADDRESS 0x0 DISPLAY_IDENTIFIER Inverters_Data_ETR07.Inv_L_RegID_M74_Inv_L_TempIGBT /end MEASUREMENT
/begin MEASUREMENT Inverters_Data_ETR07.Inverters_Data_ETR07_U.Inv_R_RegID_M235_Inv_R_DCBus "" FLOAT64_IEEE Inverters_Data_ETR07_CM_double 0 0 -1.7e+308 1.7e+308 ECU_ADDRESS 0x0 DISPLAY_IDENTIFIER Inverters_Data_ETR07.Inv_R_RegID_M235_Inv_R_DCBus /end MEASUREMENT
/begin MEASUREMENT Inverters_Data_ETR07.Inverters_Data_ETR07_U.Inv_R_RegID_M32_Inv_R_Iactual "" FLOAT64_IEEE Inverters_Data_ETR07_CM_double 0 0 -1.7e+308 1.7e+308 ECU_ADDRESS 0x0 DISPLAY_IDENTIFIER Inverters_Data_ETR07.Inv_R_RegID_M32_Inv_R_Iactual /end MEASUREMENT
/begin MEASUREMENT Inverters_Data_ETR07.Inverters_Data_ETR07_U.Inv_R_RegID_M38_Inv_R_Icommand "" FLOAT64_IEEE Inverters_Data_ETR07_CM_double 0 0 -1.7e+308 1.7e+308 ECU_ADDRESS 0x0 DISPLAY_IDENTIFIER Inverters_Data_ETR07.Inv_R_RegID_M38_Inv_R_Icommand /end MEASUREMENT
/begin MEASUREMENT Inverters_Data_ETR07.Inverters_Data_ETR07_U.Inv_R_RegID_M39_Inv_R_Iq "" FLOAT64_IEEE Inverters_Data_ETR07_CM_double 0 0 -1.7e+308 1.7e+308 ECU_ADDRESS 0x0 DISPLAY_IDENTIFIER Inverters_Data_ETR07.Inv_R_RegID_M39_Inv_R_Iq /end MEASUREMENT
/begin MEASUREMENT Inverters_Data_ETR07.Inverters_Data_ETR07_U.Inv_R_RegID_M48_Inv_R_Speed "" FLOAT64_IEEE Inverters_Data_ETR07_CM_double 0 0 -1.7e+308 1.7e+308 ECU_ADDRESS 0x0 DISPLAY_IDENTIFIER Inverters_Data_ETR07.Inv_R_RegID_M48_Inv_R_Speed /end MEASUREMENT
/begin MEASUREMENT Inverters_Data_ETR07.Inverters_Data_ETR07_U.Inv_R_RegID_M73_Inv_R_TempMotor "" FLOAT64_IEEE Inverters_Data_ETR07_CM_double 0 0 -1.7e+308 1.7e+308 ECU_ADDRESS 0x0 DISPLAY_IDENTIFIER Inverters_Data_ETR07.Inv_R_RegID_M73_Inv_R_TempMotor /end MEASUREMENT
/begin MEASUREMENT Inverters_Data_ETR07.Inverters_Data_ETR07_U.Inv_R_RegID_M74_Inv_R_TempIGBT "" FLOAT64_IEEE Inverters_Data_ETR07_CM_double 0 0 -1.7e+308 1.7e+308 ECU_ADDRESS 0x0 DISPLAY_IDENTIFIER Inverters_Data_ETR07.Inv_R_RegID_M74_Inv_R_TempIGBT /end MEASUREMENT
/begin MEASUREMENT Inverters_Data_ETR07.Inverters_Data_ETR07_U.Torque_L "" FLOAT64_IEEE Inverters_Data_ETR07_CM_double 0 0 -1.7e+308 1.7e+308 ECU_ADDRESS 0x0 DISPLAY_IDENTIFIER Inverters_Data_ETR07.Torque_L /end MEASUREMENT
/begin MEASUREMENT Inverters_Data_ETR07.Inverters_Data_ETR07_U.Torque_R "" FLOAT64_IEEE Inverters_Data_ETR07_CM_double 0 0 -1.7e+308 1.7e+308 ECU_ADDRESS 0x0 DISPLAY_IDENTIFIER Inverters_Data_ETR07.Torque_R /end MEASUREMENT
/begin MEASUREMENT Inverters_Data_ETR07.Inverters_Data_ETR07_Y.Inv_L_Iactual "" FLOAT64_IEEE Inverters_Data_ETR07_CM_double 0 0 -1.7e+308 1.7e+308 ECU_ADDRESS 0x0 DISPLAY_IDENTIFIER Inverters_Data_ETR07.Inv_L_Iactual /end MEASUREMENT
/begin MEASUREMENT Inverters_Data_ETR07.Inverters_Data_ETR07_Y.Inv_L_Icommand "" FLOAT64_IEEE Inverters_Data_ETR07_CM_double 0 0 -1.7e+308 1.7e+308 ECU_ADDRESS 0x0 DISPLAY_IDENTIFIER Inverters_Data_ETR07.Inv_L_Icommand /end MEASUREMENT
/begin MEASUREMENT Inverters_Data_ETR07.Inverters_Data_ETR07_Y.Inv_L_Iq "" FLOAT64_IEEE Inverters_Data_ETR07_CM_double 0 0 -1.7e+308 1.7e+308 ECU_ADDRESS 0x0 DISPLAY_IDENTIFIER Inverters_Data_ETR07.Inv_L_Iq /end MEASUREMENT
/begin MEASUREMENT Inverters_Data_ETR07.Inverters_Data_ETR07_Y.Inv_L_Speed "" FLOAT64_IEEE Inverters_Data_ETR07_CM_double 0 0 -1.7e+308 1.7e+308 ECU_ADDRESS 0x0 DISPLAY_IDENTIFIER Inverters_Data_ETR07.Inv_L_Speed /end MEASUREMENT
/begin MEASUREMENT Inverters_Data_ETR07.Inverters_Data_ETR07_Y.Inv_L_TempIGBT "" FLOAT64_IEEE Inverters_Data_ETR07_CM_double 0 0 -1.7e+308 1.7e+308 ECU_ADDRESS 0x0 DISPLAY_IDENTIFIER Inverters_Data_ETR07.Inv_L_TempIGBT /end MEASUREMENT
/begin MEASUREMENT Inverters_Data_ETR07.Inverters_Data_ETR07_Y.Inv_L_TempMotor "" FLOAT64_IEEE Inverters_Data_ETR07_CM_double 0 0 -1.7e+308 1.7e+308 ECU_ADDRESS 0x0 DISPLAY_IDENTIFIER Inverters_Data_ETR07.Inv_L_TempMotor /end MEASUREMENT
/begin MEASUREMENT Inverters_Data_ETR07.Inverters_Data_ETR07_Y.Inv_L_VdcBus "" FLOAT64_IEEE Inverters_Data_ETR07_CM_double 0 0 -1.7e+308 1.7e+308 ECU_ADDRESS 0x0 DISPLAY_IDENTIFIER Inverters_Data_ETR07.Inv_L_VdcBus /end MEASUREMENT
/begin MEASUREMENT Inverters_Data_ETR07.Inverters_Data_ETR07_Y.Inv_R_Iactual "" FLOAT64_IEEE Inverters_Data_ETR07_CM_double 0 0 -1.7e+308 1.7e+308 ECU_ADDRESS 0x0 DISPLAY_IDENTIFIER Inverters_Data_ETR07.Inv_R_Iactual /end MEASUREMENT
/begin MEASUREMENT Inverters_Data_ETR07.Inverters_Data_ETR07_Y.Inv_R_Icommand "" FLOAT64_IEEE Inverters_Data_ETR07_CM_double 0 0 -1.7e+308 1.7e+308 ECU_ADDRESS 0x0 DISPLAY_IDENTIFIER Inverters_Data_ETR07.Inv_R_Icommand /end MEASUREMENT
/begin MEASUREMENT Inverters_Data_ETR07.Inverters_Data_ETR07_Y.Inv_R_Iq "" FLOAT64_IEEE Inverters_Data_ETR07_CM_double 0 0 -1.7e+308 1.7e+308 ECU_ADDRESS 0x0 DISPLAY_IDENTIFIER Inverters_Data_ETR07.Inv_R_Iq /end MEASUREMENT
/begin MEASUREMENT Inverters_Data_ETR07.Inverters_Data_ETR07_Y.Inv_R_Speed "" FLOAT64_IEEE Inverters_Data_ETR07_CM_double 0 0 -1.7e+308 1.7e+308 ECU_ADDRESS 0x0 DISPLAY_IDENTIFIER Inverters_Data_ETR07.Inv_R_Speed /end MEASUREMENT
/begin MEASUREMENT Inverters_Data_ETR07.Inverters_Data_ETR07_Y.Inv_R_TempIGBT "" FLOAT64_IEEE Inverters_Data_ETR07_CM_double 0 0 -1.7e+308 1.7e+308 ECU_ADDRESS 0x0 DISPLAY_IDENTIFIER Inverters_Data_ETR07.Inv_R_TempIGBT /end MEASUREMENT
/begin MEASUREMENT Inverters_Data_ETR07.Inverters_Data_ETR07_Y.Inv_R_TempMotor "" FLOAT64_IEEE Inverters_Data_ETR07_CM_double 0 0 -1.7e+308 1.7e+308 ECU_ADDRESS 0x0 DISPLAY_IDENTIFIER Inverters_Data_ETR07.Inv_R_TempMotor /end MEASUREMENT
/begin MEASUREMENT Inverters_Data_ETR07.Inverters_Data_ETR07_Y.Inv_R_VdcBus "" FLOAT64_IEEE Inverters_Data_ETR07_CM_double 0 0 -1.7e+308 1.7e+308 ECU_ADDRESS 0x0 DISPLAY_IDENTIFIER Inverters_Data_ETR07.Inv_R_VdcBus /end MEASUREMENT
/begin MEASUREMENT Inverters_Data_ETR07.Inverters_Data_ETR07_Y.InvertersMinDCBus "" FLOAT64_IEEE Inverters_Data_ETR07_CM_double 0 0 -1.7e+308 1.7e+308 ECU_ADDRESS 0x0 DISPLAY_IDENTIFIER Inverters_Data_ETR07.InvertersMinDCBus /end MEASUREMENT
/begin MEASUREMENT Inverters_Data_ETR07.Inverters_Data_ETR07_Y.Mech_Power "" FLOAT64_IEEE Inverters_Data_ETR07_CM_double 0 0 -1.7e+308 1.7e+308 ECU_ADDRESS 0x0 DISPLAY_IDENTIFIER Inverters_Data_ETR07.Mech_Power /end MEASUREMENT
/begin MEASUREMENT Inverters_Data_ETR07.Inverters_Data_ETR07_Y.RL_rads "" FLOAT64_IEEE Inverters_Data_ETR07_CM_double 0 0 -1.7e+308 1.7e+308 ECU_ADDRESS 0x0 DISPLAY_IDENTIFIER Inverters_Data_ETR07.RL_rads /end MEASUREMENT
/begin MEASUREMENT Inverters_Data_ETR07.Inverters_Data_ETR07_Y.RR_rads "" FLOAT64_IEEE Inverters_Data_ETR07_CM_double 0 0 -1.7e+308 1.7e+308 ECU_ADDRESS 0x0 DISPLAY_IDENTIFIER Inverters_Data_ETR07.RR_rads /end MEASUREMENT
/begin MEASUREMENT Inverters_Data_ETR07.Inverters_Data_ETR07_Y.Speed "" FLOAT64_IEEE Inverters_Data_ETR07_CM_double 0 0 -1.7e+308 1.7e+308 ECU_ADDRESS 0x0 DISPLAY_IDENTIFIER Inverters_Data_ETR07.Speed /end MEASUREMENT
/begin MEASUREMENT Inverters_Data_ETR07.Inverters_Data_ETR07_Y.Temp_IGBT "" FLOAT64_IEEE Inverters_Data_ETR07_CM_double 0 0 -1.7e+308 1.7e+308 ECU_ADDRESS 0x0 DISPLAY_IDENTIFIER Inverters_Data_ETR07.Temp_IGBT /end MEASUREMENT
/begin MEASUREMENT Inverters_Data_ETR07.Inverters_Data_ETR07_Y.Temp_Motors "" FLOAT64_IEEE Inverters_Data_ETR07_CM_double 0 0 -1.7e+308 1.7e+308 ECU_ADDRESS 0x0 DISPLAY_IDENTIFIER Inverters_Data_ETR07.Temp_Motors /end MEASUREMENT
/begin MEASUREMENT Inverters_Data_ETR07.Inverters_Data_ETR07_Y.Vel_RL_kmh "" FLOAT64_IEEE Inverters_Data_ETR07_CM_double 0 0 -1.7e+308 1.7e+308 ECU_ADDRESS 0x0 DISPLAY_IDENTIFIER Inverters_Data_ETR07.Vel_RL_kmh /end MEASUREMENT
/begin MEASUREMENT Inverters_Data_ETR07.Inverters_Data_ETR07_Y.Vel_RR_kmh "" FLOAT64_IEEE Inverters_Data_ETR07_CM_double 0 0 -1.7e+308 1.7e+308 ECU_ADDRESS 0x0 DISPLAY_IDENTIFIER Inverters_Data_ETR07.Vel_RR_kmh /end MEASUREMENT
/begin MEASUREMENT LVD_Data_ETR07.LVD_Data_ETR07_DW.Previous_IN "" FLOAT64_IEEE LVD_Data_ETR07_CM_double 0 0 -1.7e+308 1.7e+308 ECU_ADDRESS 0x0 DISPLAY_IDENTIFIER LVD_Data_ETR07.Low_Pass.Data_Store_Memory.Previous_IN /end MEASUREMENT
/begin MEASUREMENT LVD_Data_ETR07.LVD_Data_ETR07_DW.Previous_OUT "" FLOAT64_IEEE LVD_Data_ETR07_CM_double 0 0 -1.7e+308 1.7e+308 ECU_ADDRESS 0x0 DISPLAY_IDENTIFIER LVD_Data_ETR07.Low_Pass.Data_Store_Memory1.Previous_OUT /end MEASUREMENT
/begin MEASUREMENT LVD_Data_ETR07.LVD_Data_ETR07_U.LVBattery_Voltage_Bits "" FLOAT64_IEEE LVD_Data_ETR07_CM_double 0 0 -1.7e+308 1.7e+308 ECU_ADDRESS 0x0 DISPLAY_IDENTIFIER LVD_Data_ETR07.LVBattery_Voltage_Bits /end MEASUREMENT
/begin MEASUREMENT LVD_Data_ETR07.LVD_Data_ETR07_Y.LVbattery_Voltage "" FLOAT64_IEEE LVD_Data_ETR07_CM_double 0 0 -1.7e+308 1.7e+308 ECU_ADDRESS 0x0 DISPLAY_IDENTIFIER LVD_Data_ETR07.LVbattery_Voltage /end MEASUREMENT
/begin MEASUREMENT Pedals_Susp_Sensors_ETR07.Pedals_Susp_Sensors_ETR07_U.APPS1_Bits "" FLOAT64_IEEE Pedals_Susp_Sensors_ETR07_CM_double 0 0 -1.7e+308 1.7e+308 ECU_ADDRESS 0x0 DISPLAY_IDENTIFIER Pedals_Susp_Sensors_ETR07.APPS1_Bits /end MEASUREMENT
/begin MEASUREMENT Pedals_Susp_Sensors_ETR07.Pedals_Susp_Sensors_ETR07_U.APPS2_Bits "" FLOAT64_IEEE Pedals_Susp_Sensors_ETR07_CM_double 0 0 -1.7e+308 1.7e+308 ECU_ADDRESS 0x0 DISPLAY_IDENTIFIER Pedals_Susp_Sensors_ETR07.APPS2_Bits /end MEASUREMENT
/begin MEASUREMENT Pedals_Susp_Sensors_ETR07.Pedals_Susp_Sensors_ETR07_U.BrakeSensor_Bits "" FLOAT64_IEEE Pedals_Susp_Sensors_ETR07_CM_double 0 0 -1.7e+308 1.7e+308 ECU_ADDRESS 0x0 DISPLAY_IDENTIFIER Pedals_Susp_Sensors_ETR07.BrakeSensor_Bits /end MEASUREMENT
/begin MEASUREMENT Pedals_Susp_Sensors_ETR07.Pedals_Susp_Sensors_ETR07_U.Susp_F_L_Bits "" FLOAT64_IEEE Pedals_Susp_Sensors_ETR07_CM_double 0 0 -1.7e+308 1.7e+308 ECU_ADDRESS 0x0 DISPLAY_IDENTIFIER Pedals_Susp_Sensors_ETR07.Susp_F_L_Bits /end MEASUREMENT
/begin MEASUREMENT Pedals_Susp_Sensors_ETR07.Pedals_Susp_Sensors_ETR07_U.Susp_F_R_Bits "" FLOAT64_IEEE Pedals_Susp_Sensors_ETR07_CM_double 0 0 -1.7e+308 1.7e+308 ECU_ADDRESS 0x0 DISPLAY_IDENTIFIER Pedals_Susp_Sensors_ETR07.Susp_F_R_Bits /end MEASUREMENT
/begin MEASUREMENT Pedals_Susp_Sensors_ETR07.Pedals_Susp_Sensors_ETR07_U.Susp_R_L_Bits "" FLOAT64_IEEE Pedals_Susp_Sensors_ETR07_CM_double 0 0 -1.7e+308 1.7e+308 ECU_ADDRESS 0x0 DISPLAY_IDENTIFIER Pedals_Susp_Sensors_ETR07.Susp_R_L_Bits /end MEASUREMENT
/begin MEASUREMENT Pedals_Susp_Sensors_ETR07.Pedals_Susp_Sensors_ETR07_U.Susp_R_R_Bits "" FLOAT64_IEEE Pedals_Susp_Sensors_ETR07_CM_double 0 0 -1.7e+308 1.7e+308 ECU_ADDRESS 0x0 DISPLAY_IDENTIFIER Pedals_Susp_Sensors_ETR07.Susp_R_R_Bits /end MEASUREMENT
/begin MEASUREMENT Pedals_Susp_Sensors_ETR07.Pedals_Susp_Sensors_ETR07_Y.APPS1_Value "" FLOAT64_IEEE Pedals_Susp_Sensors_ETR07_CM_double 0 0 -1.7e+308 1.7e+308 ECU_ADDRESS 0x0 DISPLAY_IDENTIFIER Pedals_Susp_Sensors_ETR07.APPS1_Value /end MEASUREMENT
/begin MEASUREMENT Pedals_Susp_Sensors_ETR07.Pedals_Susp_Sensors_ETR07_Y.APPS2_Value "" FLOAT64_IEEE Pedals_Susp_Sensors_ETR07_CM_double 0 0 -1.7e+308 1.7e+308 ECU_ADDRESS 0x0 DISPLAY_IDENTIFIER Pedals_Susp_Sensors_ETR07.APPS2_Value /end MEASUREMENT
/begin MEASUREMENT Pedals_Susp_Sensors_ETR07.Pedals_Susp_Sensors_ETR07_Y.BrakeLight_Control "" FLOAT64_IEEE Pedals_Susp_Sensors_ETR07_CM_double 0 0 -1.7e+308 1.7e+308 ECU_ADDRESS 0x0 DISPLAY_IDENTIFIER Pedals_Susp_Sensors_ETR07.BrakeLight_Control /end MEASUREMENT
/begin MEASUREMENT Pedals_Susp_Sensors_ETR07.Pedals_Susp_Sensors_ETR07_Y.BrakeSensor_Value "" FLOAT64_IEEE Pedals_Susp_Sensors_ETR07_CM_double 0 0 -1.7e+308 1.7e+308 ECU_ADDRESS 0x0 DISPLAY_IDENTIFIER Pedals_Susp_Sensors_ETR07.BrakeSensor_Value /end MEASUREMENT
/begin MEASUREMENT Pedals_Susp_Sensors_ETR07.Pedals_Susp_Sensors_ETR07_Y.SUSP_F_L "" FLOAT64_IEEE Pedals_Susp_Sensors_ETR07_CM_double 0 0 -1.7e+308 1.7e+308 ECU_ADDRESS 0x0 DISPLAY_IDENTIFIER Pedals_Susp_Sensors_ETR07.SUSP_F_L /end MEASUREMENT
/begin MEASUREMENT Pedals_Susp_Sensors_ETR07.Pedals_Susp_Sensors_ETR07_Y.SUSP_F_R "" FLOAT64_IEEE Pedals_Susp_Sensors_ETR07_CM_double 0 0 -1.7e+308 1.7e+308 ECU_ADDRESS 0x0 DISPLAY_IDENTIFIER Pedals_Susp_Sensors_ETR07.SUSP_F_R /end MEASUREMENT
/begin MEASUREMENT Pedals_Susp_Sensors_ETR07.Pedals_Susp_Sensors_ETR07_Y.SUSP_R_L "" FLOAT64_IEEE Pedals_Susp_Sensors_ETR07_CM_double 0 0 -1.7e+308 1.7e+308 ECU_ADDRESS 0x0 DISPLAY_IDENTIFIER Pedals_Susp_Sensors_ETR07.SUSP_R_L /end MEASUREMENT
/begin MEASUREMENT Pedals_Susp_Sensors_ETR07.Pedals_Susp_Sensors_ETR07_Y.SUSP_R_R "" FLOAT64_IEEE Pedals_Susp_Sensors_ETR07_CM_double 0 0 -1.7e+308 1.7e+308 ECU_ADDRESS 0x0 DISPLAY_IDENTIFIER Pedals_Susp_Sensors_ETR07.SUSP_R_R /end MEASUREMENT
/begin MEASUREMENT Racing_Mode_ETR07.Racing_Mode_ETR07_B.Apps_Sat_Dwn.Gain "" FLOAT64_IEEE Racing_Mode_ETR07_CM_double 0 0 -1.7e+308 1.7e+308 ECU_ADDRESS 0x0 DISPLAY_IDENTIFIER Racing_Mode_ETR07.Custom_Dash__11_.Apps_Sat_Dwn.Gain.Gain /end MEASUREMENT
/begin MEASUREMENT Racing_Mode_ETR07.Racing_Mode_ETR07_B.Apps_Sat_Up.Gain "" FLOAT64_IEEE Racing_Mode_ETR07_CM_double 0 0 -1.7e+308 1.7e+308 ECU_ADDRESS 0x0 DISPLAY_IDENTIFIER Racing_Mode_ETR07.Custom_Dash__11_.Apps_Sat_Up.Gain.Gain /end MEASUREMENT
/begin MEASUREMENT Racing_Mode_ETR07.Racing_Mode_ETR07_B.CKF_Initial.Gain "" FLOAT64_IEEE Racing_Mode_ETR07_CM_double 0 0 -1.7e+308 1.7e+308 ECU_ADDRESS 0x0 DISPLAY_IDENTIFIER Racing_Mode_ETR07.Custom_Dash__11_.CKF_Initial.Gain.Gain /end MEASUREMENT
/begin MEASUREMENT Racing_Mode_ETR07.Racing_Mode_ETR07_B.Cte_CKF.Gain "" FLOAT64_IEEE Racing_Mode_ETR07_CM_double 0 0 -1.7e+308 1.7e+308 ECU_ADDRESS 0x0 DISPLAY_IDENTIFIER Racing_Mode_ETR07.Custom_Dash__11_.Cte_CKF.Gain.Gain /end MEASUREMENT
/begin MEASUREMENT Racing_Mode_ETR07.Racing_Mode_ETR07_B.Cte_SKF.Gain "" FLOAT64_IEEE Racing_Mode_ETR07_CM_double 0 0 -1.7e+308 1.7e+308 ECU_ADDRESS 0x0 DISPLAY_IDENTIFIER Racing_Mode_ETR07.Custom_Dash__11_.Cte_SKF.Gain.Gain /end MEASUREMENT
/begin MEASUREMENT Racing_Mode_ETR07.Racing_Mode_ETR07_B.K_Reduction_P.Gain "" FLOAT64_IEEE Racing_Mode_ETR07_CM_double 0 0 -1.7e+308 1.7e+308 ECU_ADDRESS 0x0 DISPLAY_IDENTIFIER Racing_Mode_ETR07.Custom_Dash__11_.K_Reduction_P.Gain.Gain /end MEASUREMENT
/begin MEASUREMENT Racing_Mode_ETR07.Racing_Mode_ETR07_B.K_Reduction_Temperature.Gain "" FLOAT64_IEEE Racing_Mode_ETR07_CM_double 0 0 -1.7e+308 1.7e+308 ECU_ADDRESS 0x0 DISPLAY_IDENTIFIER Racing_Mode_ETR07.Custom_Dash__11_.K_Reduction_Temperature.Gain.Gain /end MEASUREMENT
/begin MEASUREMENT Racing_Mode_ETR07.Racing_Mode_ETR07_B.Max_Regenerative_Torque.In1 "" FLOAT64_IEEE Racing_Mode_ETR07_CM_double 0 0 -1.7e+308 1.7e+308 ECU_ADDRESS 0x0 DISPLAY_IDENTIFIER Racing_Mode_ETR07.Custom_Dash__11_.Max_Regenerative_Torque.In1.In1 /end MEASUREMENT
/begin MEASUREMENT Racing_Mode_ETR07.Racing_Mode_ETR07_B.Merge "" FLOAT64_IEEE Racing_Mode_ETR07_CM_double 0 0 -1.7e+308 1.7e+308 ECU_ADDRESS 0x0 DISPLAY_IDENTIFIER Racing_Mode_ETR07.Merge.Merge ARRAY_SIZE 10 /end MEASUREMENT
/begin MEASUREMENT Racing_Mode_ETR07.Racing_Mode_ETR07_B.Power_Limit.In1 "" FLOAT64_IEEE Racing_Mode_ETR07_CM_double 0 0 -1.7e+308 1.7e+308 ECU_ADDRESS 0x0 DISPLAY_IDENTIFIER Racing_Mode_ETR07.Custom_Dash__11_.Power_Limit.In1.In1 /end MEASUREMENT
/begin MEASUREMENT Racing_Mode_ETR07.Racing_Mode_ETR07_B.SKF_Initial.Gain "" FLOAT64_IEEE Racing_Mode_ETR07_CM_double 0 0 -1.7e+308 1.7e+308 ECU_ADDRESS 0x0 DISPLAY_IDENTIFIER Racing_Mode_ETR07.Custom_Dash__11_.SKF_Initial.Gain.Gain /end MEASUREMENT
/begin MEASUREMENT Racing_Mode_ETR07.Racing_Mode_ETR07_U.CustomMode_Data "" FLOAT64_IEEE Racing_Mode_ETR07_CM_double 0 0 -1.7e+308 1.7e+308 ECU_ADDRESS 0x0 DISPLAY_IDENTIFIER Racing_Mode_ETR07.CustomMode_Data /end MEASUREMENT
/begin MEASUREMENT Racing_Mode_ETR07.Racing_Mode_ETR07_U.CustomMode_Identifier "" FLOAT64_IEEE Racing_Mode_ETR07_CM_double 0 0 -1.7e+308 1.7e+308 ECU_ADDRESS 0x0 DISPLAY_IDENTIFIER Racing_Mode_ETR07.CustomMode_Identifier /end MEASUREMENT
/begin MEASUREMENT Racing_Mode_ETR07.Racing_Mode_ETR07_U.RacingMode "" UBYTE Racing_Mode_ETR07_CM_uint8 0 0 0.0 255.0 ECU_ADDRESS 0x0 DISPLAY_IDENTIFIER Racing_Mode_ETR07.RacingMode /end MEASUREMENT
/begin MEASUREMENT Racing_Mode_ETR07.Racing_Mode_ETR07_Y.VDC_Apps_Sat_Down "" FLOAT64_IEEE Racing_Mode_ETR07_CM_double 0 0 -1.7e+308 1.7e+308 ECU_ADDRESS 0x0 DISPLAY_IDENTIFIER Racing_Mode_ETR07.VDC_Apps_Sat_Down /end MEASUREMENT
/begin MEASUREMENT Racing_Mode_ETR07.Racing_Mode_ETR07_Y.VDC_Apps_Sat_Up "" FLOAT64_IEEE Racing_Mode_ETR07_CM_double 0 0 -1.7e+308 1.7e+308 ECU_ADDRESS 0x0 DISPLAY_IDENTIFIER Racing_Mode_ETR07.VDC_Apps_Sat_Up /end MEASUREMENT
/begin MEASUREMENT Racing_Mode_ETR07.Racing_Mode_ETR07_Y.VDC_CKF_Initial "" FLOAT64_IEEE Racing_Mode_ETR07_CM_double 0 0 -1.7e+308 1.7e+308 ECU_ADDRESS 0x0 DISPLAY_IDENTIFIER Racing_Mode_ETR07.VDC_CKF_Initial /end MEASUREMENT
/begin MEASUREMENT Racing_Mode_ETR07.Racing_Mode_ETR07_Y.VDC_Cte_CKF "" FLOAT64_IEEE Racing_Mode_ETR07_CM_double 0 0 -1.7e+308 1.7e+308 ECU_ADDRESS 0x0 DISPLAY_IDENTIFIER Racing_Mode_ETR07.VDC_Cte_CKF /end MEASUREMENT
/begin MEASUREMENT Racing_Mode_ETR07.Racing_Mode_ETR07_Y.VDC_Cte_SKF "" FLOAT64_IEEE Racing_Mode_ETR07_CM_double 0 0 -1.7e+308 1.7e+308 ECU_ADDRESS 0x0 DISPLAY_IDENTIFIER Racing_Mode_ETR07.VDC_Cte_SKF /end MEASUREMENT
/begin MEASUREMENT Racing_Mode_ETR07.Racing_Mode_ETR07_Y.VDC_K_Reduction_P "" FLOAT64_IEEE Racing_Mode_ETR07_CM_double 0 0 -1.7e+308 1.7e+308 ECU_ADDRESS 0x0 DISPLAY_IDENTIFIER Racing_Mode_ETR07.VDC_K_Reduction_P /end MEASUREMENT
/begin MEASUREMENT Racing_Mode_ETR07.Racing_Mode_ETR07_Y.VDC_K_Reduction_Temperature "" FLOAT64_IEEE Racing_Mode_ETR07_CM_double 0 0 -1.7e+308 1.7e+308 ECU_ADDRESS 0x0 DISPLAY_IDENTIFIER Racing_Mode_ETR07.VDC_K_Reduction_Temperature /end MEASUREMENT
/begin MEASUREMENT Racing_Mode_ETR07.Racing_Mode_ETR07_Y.VDC_Max_Regenerative_Torque "" FLOAT64_IEEE Racing_Mode_ETR07_CM_double 0 0 -1.7e+308 1.7e+308 ECU_ADDRESS 0x0 DISPLAY_IDENTIFIER Racing_Mode_ETR07.VDC_Max_Regenerative_Torque /end MEASUREMENT
/begin MEASUREMENT Racing_Mode_ETR07.Racing_Mode_ETR07_Y.VDC_Power_Limit "" FLOAT64_IEEE Racing_Mode_ETR07_CM_double 0 0 -1.7e+308 1.7e+308 ECU_ADDRESS 0x0 DISPLAY_IDENTIFIER Racing_Mode_ETR07.VDC_Power_Limit /end MEASUREMENT
/begin MEASUREMENT Racing_Mode_ETR07.Racing_Mode_ETR07_Y.VDC_SKF_Initial "" FLOAT64_IEEE Racing_Mode_ETR07_CM_double 0 0 -1.7e+308 1.7e+308 ECU_ADDRESS 0x0 DISPLAY_IDENTIFIER Racing_Mode_ETR07.VDC_SKF_Initial /end MEASUREMENT
/begin MEASUREMENT Racing_Mode_ETR07.Racing_Mode_ETR07_Y.Workshop_Mode_Enable "" UBYTE Racing_Mode_ETR07_CM_boolean 0 0 0 1 ECU_ADDRESS 0x0 DISPLAY_IDENTIFIER Racing_Mode_ETR07.Workshop_Mode_Enable /end MEASUREMENT
/begin MEASUREMENT Synchronism_ETR07.Synchronism_ETR07_DW.counter "" FLOAT64_IEEE Synchronism_ETR07_CM_double 0 0 -1.7e+308 1.7e+308 ECU_ADDRESS 0x0 DISPLAY_IDENTIFIER Synchronism_ETR07.Counter.Data_Store_Memory.counter /end MEASUREMENT
/begin MEASUREMENT Synchronism_ETR07.Synchronism_ETR07_Y.Sync_CAN1 "" FLOAT64_IEEE Synchronism_ETR07_CM_double 0 0 -1.7e+308 1.7e+308 ECU_ADDRESS 0x0 DISPLAY_IDENTIFIER Synchronism_ETR07.Sync_CAN1 /end MEASUREMENT
/begin MEASUREMENT Synchronism_ETR07.Synchronism_ETR07_Y.Sync_CAN2 "" FLOAT64_IEEE Synchronism_ETR07_CM_double 0 0 -1.7e+308 1.7e+308 ECU_ADDRESS 0x0 DISPLAY_IDENTIFIER Synchronism_ETR07.Sync_CAN2 /end MEASUREMENT
/begin CHARACTERISTIC Accel_Data_ETR07.Accel_Data_ETR07_P.CycleTime_Gain "" VALUE 0x0 SCALAR_FLOAT64_IEEE 3.5e+305 Accel_Data_ETR07_CM_double -1.7e+308 1.7e+308 DISPLAY_IDENTIFIER Accel_Data_ETR07.Gyro_Data_Conversion_F_Z.Cycle_Time.Gain /end CHARACTERISTIC
/begin CHARACTERISTIC Accel_Data_ETR07.Accel_Data_ETR07_P.CycleTime_Gain_h "" VALUE 0x0 SCALAR_FLOAT64_IEEE 3.5e+305 Accel_Data_ETR07_CM_double -1.7e+308 1.7e+308 DISPLAY_IDENTIFIER Accel_Data_ETR07.Gyro_Data_Conversion_R_Z.Cycle_Time.Gain /end CHARACTERISTIC
/begin CHARACTERISTIC Accel_Data_ETR07.Accel_Data_ETR07_P.DataStoreMemory_InitialValue "" VALUE 0x0 SCALAR_FLOAT64_IEEE 3.5e+305 Accel_Data_ETR07_CM_double -1.7e+308 1.7e+308 DISPLAY_IDENTIFIER Accel_Data_ETR07.Gyro_Data_Conversion_F_Z.Data_Store_Memory.InitialValue /end CHARACTERISTIC
/begin CHARACTERISTIC Accel_Data_ETR07.Accel_Data_ETR07_P.DataStoreMemory_InitialValue_m "" VALUE 0x0 SCALAR_FLOAT64_IEEE 3.5e+305 Accel_Data_ETR07_CM_double -1.7e+308 1.7e+308 DISPLAY_IDENTIFIER Accel_Data_ETR07.Gyro_Data_Conversion_R_Z.Data_Store_Memory.InitialValue /end CHARACTERISTIC
/begin CHARACTERISTIC Accel_Data_ETR07.Accel_Data_ETR07_P.ExperimentalOffset_Value "" VALUE 0x0 SCALAR_FLOAT64_IEEE 3.5e+305 Accel_Data_ETR07_CM_double -1.7e+308 1.7e+308 DISPLAY_IDENTIFIER Accel_Data_ETR07.Gyro_Data_Conversion_F_Z.Experimental_Offset.Value /end CHARACTERISTIC
/begin CHARACTERISTIC Accel_Data_ETR07.Accel_Data_ETR07_P.ExperimentalOffset_Value_e "" VALUE 0x0 SCALAR_FLOAT64_IEEE 3.5e+305 Accel_Data_ETR07_CM_double -1.7e+308 1.7e+308 DISPLAY_IDENTIFIER Accel_Data_ETR07.Gyro_Data_Conversion_R_Z.Experimental_Offset.Value /end CHARACTERISTIC
/begin CHARACTERISTIC Accel_Data_ETR07.Accel_Data_ETR07_P.Gain2_Gain "" VALUE 0x0 SCALAR_FLOAT64_IEEE 3.5e+305 Accel_Data_ETR07_CM_double -1.7e+308 1.7e+308 DISPLAY_IDENTIFIER Accel_Data_ETR07.Gain2.Gain /end CHARACTERISTIC
/begin CHARACTERISTIC Accel_Data_ETR07.Accel_Data_ETR07_P.Gain4_Gain "" VALUE 0x0 SCALAR_FLOAT64_IEEE 3.5e+305 Accel_Data_ETR07_CM_double -1.7e+308 1.7e+308 DISPLAY_IDENTIFIER Accel_Data_ETR07.Gain4.Gain /end CHARACTERISTIC
/begin CHARACTERISTIC Accel_Data_ETR07.Accel_Data_ETR07_P.RpsLSB_Value "" VALUE 0x0 SCALAR_FLOAT64_IEEE 3.5e+305 Accel_Data_ETR07_CM_double -1.7e+308 1.7e+308 DISPLAY_IDENTIFIER Accel_Data_ETR07.Gyro_Data_Conversion_R_Z.Rps__LSB.Value /end CHARACTERISTIC
/begin CHARACTERISTIC Accel_Data_ETR07.Accel_Data_ETR07_P.sbit_Value "" VALUE 0x0 SCALAR_FLOAT64_IEEE 3.5e+305 Accel_Data_ETR07_CM_double -1.7e+308 1.7e+308 DISPLAY_IDENTIFIER Accel_Data_ETR07.Gyro_Data_Conversion_F_Z.___s___bit.Value /end CHARACTERISTIC
/begin CHARACTERISTIC Car_State_ETR07.Car_State_ETR07_P.CompareToConstant_const "" VALUE 0x0 SCALAR_FLOAT64_IEEE 3.5e+305 Car_State_ETR07_CM_double -1.7e+308 1.7e+308 DISPLAY_IDENTIFIER Car_State_ETR07.CarOK_Checks.Compare_To_Constant.Constant.Value /end CHARACTERISTIC
/begin CHARACTERISTIC Car_State_ETR07.Car_State_ETR07_P.Constant_Value "" VALUE 0x0 SCALAR_FLOAT64_IEEE 3.5e+305 Car_State_ETR07_CM_double -1.7e+308 1.7e+308 DISPLAY_IDENTIFIER Car_State_ETR07.AIRS_Request.Precharge.Constant.Value /end CHARACTERISTIC
/begin CHARACTERISTIC Car_State_ETR07.Car_State_ETR07_P.Constant_Value_f "" VALUE 0x0 SCALAR_FLOAT64_IEEE 3.5e+305 Car_State_ETR07_CM_double -1.7e+308 1.7e+308 DISPLAY_IDENTIFIER Car_State_ETR07.CurrentPathDisconnection_Detection.OK_or_latch.OK.Constant.Value /end CHARACTERISTIC
/begin CHARACTERISTIC Car_State_ETR07.Car_State_ETR07_P.Constant_Value_fl "" VALUE 0x0 SCALAR_FLOAT64_IEEE 3.5e+305 Car_State_ETR07_CM_double -1.7e+308 1.7e+308 DISPLAY_IDENTIFIER Car_State_ETR07.CarOK_Checks.Compare_To_Zero2.Constant.Value /end CHARACTERISTIC
/begin CHARACTERISTIC Car_State_ETR07.Car_State_ETR07_P.Constant_Value_k "" VALUE 0x0 SCALAR_FLOAT64_IEEE 3.5e+305 Car_State_ETR07_CM_double -1.7e+308 1.7e+308 DISPLAY_IDENTIFIER Car_State_ETR07.AIRS_Request.Tancar_Airs.Constant.Value /end CHARACTERISTIC
/begin CHARACTERISTIC Car_State_ETR07.Car_State_ETR07_P.Constant_Value_kb "" VALUE 0x0 SCALAR_FLOAT64_IEEE 3.5e+305 Car_State_ETR07_CM_double -1.7e+308 1.7e+308 DISPLAY_IDENTIFIER Car_State_ETR07.CarOK_Checks.Compare_To_Zero1.Constant.Value /end CHARACTERISTIC
/begin CHARACTERISTIC Car_State_ETR07.Car_State_ETR07_P.DataStoreMemory_InitialValue "" VALUE 0x0 SCALAR_FLOAT64_IEEE 3.5e+305 Car_State_ETR07_CM_double -1.7e+308 1.7e+308 DISPLAY_IDENTIFIER Car_State_ETR07.CurrentPathDisconnection_Detection.Data_Store_Memory.InitialValue /end CHARACTERISTIC
/begin CHARACTERISTIC Car_State_ETR07.Car_State_ETR07_P.Gain_Gain "" VALUE 0x0 SCALAR_FLOAT64_IEEE 3.5e+305 Car_State_ETR07_CM_double -1.7e+308 1.7e+308 DISPLAY_IDENTIFIER Car_State_ETR07.PrechargeAssert_Conditions.Gain.Gain /end CHARACTERISTIC
/begin CHARACTERISTIC Car_State_ETR07.Car_State_ETR07_P.IfDCBUSnotbits_Gain "" VALUE 0x0 SCALAR_FLOAT64_IEEE 3.5e+305 Car_State_ETR07_CM_double -1.7e+308 1.7e+308 DISPLAY_IDENTIFIER Car_State_ETR07.Precharge_Info.If_DC_BUS_not_bits.Gain /end CHARACTERISTIC
/begin CHARACTERISTIC Car_State_ETR07.Car_State_ETR07_P.Merge_InitialOutput "" VALUE 0x0 SCALAR_FLOAT64_IEEE 3.5e+305 Car_State_ETR07_CM_double -1.7e+308 1.7e+308 DISPLAY_IDENTIFIER Car_State_ETR07.AIRS_Request.Merge.InitialOutput /end CHARACTERISTIC
/begin CHARACTERISTIC Car_State_ETR07.Car_State_ETR07_P.Saturation_LowerSat "" VALUE 0x0 SCALAR_FLOAT64_IEEE 3.5e+305 Car_State_ETR07_CM_double -1.7e+308 1.7e+308 DISPLAY_IDENTIFIER Car_State_ETR07.Precharge_Info.Saturation.LowerLimit /end CHARACTERISTIC
/begin CHARACTERISTIC Car_State_ETR07.Car_State_ETR07_P.Saturation_UpperSat "" VALUE 0x0 SCALAR_FLOAT64_IEEE 3.5e+305 Car_State_ETR07_CM_double -1.7e+308 1.7e+308 DISPLAY_IDENTIFIER Car_State_ETR07.Precharge_Info.Saturation.UpperLimit /end CHARACTERISTIC
/begin CHARACTERISTIC Disconnections_ETR07.Disconnections_ETR07_P.Constant2_Value "" VALUE 0x0 SCALAR_FLOAT64_IEEE 3.5e+305 Disconnections_ETR07_CM_double -1.7e+308 1.7e+308 DISPLAY_IDENTIFIER Disconnections_ETR07.Constant2.Value /end CHARACTERISTIC
/begin CHARACTERISTIC Disconnections_ETR07.Disconnections_ETR07_P.Constant_Value "" VALUE 0x0 SCALAR_FLOAT64_IEEE 3.5e+305 Disconnections_ETR07_CM_double -1.7e+308 1.7e+308 DISPLAY_IDENTIFIER Disconnections_ETR07.Subsystem.VDC_2018_Complete.Constant.Value /end CHARACTERISTIC
/begin CHARACTERISTIC Disconnections_ETR07.Disconnections_ETR07_P.Constant_Value_c "" VALUE 0x0 SCALAR_FLOAT64_IEEE 3.5e+305 Disconnections_ETR07_CM_double -1.7e+308 1.7e+308 DISPLAY_IDENTIFIER Disconnections_ETR07.Counter.Constant.Value /end CHARACTERISTIC
/begin CHARACTERISTIC Disconnections_ETR07.Disconnections_ETR07_P.Constant_Value_d "" VALUE 0x0 SCALAR_FLOAT64_IEEE 3.5e+305 Disconnections_ETR07_CM_double -1.7e+308 1.7e+308 DISPLAY_IDENTIFIER Disconnections_ETR07.Signal_Disconnections.Compare_To_Zero2.Constant.Value /end CHARACTERISTIC
/begin CHARACTERISTIC Disconnections_ETR07.Disconnections_ETR07_P.Constant_Value_e "" VALUE 0x0 SCALAR_FLOAT64_IEEE 3.5e+305 Disconnections_ETR07_CM_double -1.7e+308 1.7e+308 DISPLAY_IDENTIFIER Disconnections_ETR07.Subsystem.Rigid_Axle.Constant.Value /end CHARACTERISTIC
/begin CHARACTERISTIC Disconnections_ETR07.Disconnections_ETR07_P.Constant_Value_h "" VALUE 0x0 SCALAR_FLOAT64_IEEE 3.5e+305 Disconnections_ETR07_CM_double -1.7e+308 1.7e+308 DISPLAY_IDENTIFIER Disconnections_ETR07.Subsystem.VDC_without_Longitudinal.Constant.Value /end CHARACTERISTIC
/begin CHARACTERISTIC Disconnections_ETR07.Disconnections_ETR07_P.Constant_Value_i "" VALUE 0x0 SCALAR_FLOAT64_IEEE 3.5e+305 Disconnections_ETR07_CM_double -1.7e+308 1.7e+308 DISPLAY_IDENTIFIER Disconnections_ETR07.Constant.Value /end CHARACTERISTIC
/begin CHARACTERISTIC Disconnections_ETR07.Disconnections_ETR07_P.Constant_Value_ic "" VALUE 0x0 SCALAR_FLOAT64_IEEE 3.5e+305 Disconnections_ETR07_CM_double -1.7e+308 1.7e+308 DISPLAY_IDENTIFIER Disconnections_ETR07.Signal_Disconnections.Compare_To_Zero.Constant.Value /end CHARACTERISTIC
/begin CHARACTERISTIC Disconnections_ETR07.Disconnections_ETR07_P.Constant_Value_l "" VALUE 0x0 SCALAR_FLOAT64_IEEE 3.5e+305 Disconnections_ETR07_CM_double -1.7e+308 1.7e+308 DISPLAY_IDENTIFIER Disconnections_ETR07.Signal_Disconnections.Compare_To_Zero1.Constant.Value /end CHARACTERISTIC
/begin CHARACTERISTIC Disconnections_ETR07.Disconnections_ETR07_P.Constant_Value_m "" VALUE 0x0 SCALAR_FLOAT64_IEEE 3.5e+305 Disconnections_ETR07_CM_double -1.7e+308 1.7e+308 DISPLAY_IDENTIFIER Disconnections_ETR07.Subsystem.Steering_TV_2017_without_TC.Constant.Value /end CHARACTERISTIC
/begin CHARACTERISTIC Disconnections_ETR07.Disconnections_ETR07_P.Constant_Value_o "" VALUE 0x0 SCALAR_FLOAT64_IEEE 3.5e+305 Disconnections_ETR07_CM_double -1.7e+308 1.7e+308 DISPLAY_IDENTIFIER Disconnections_ETR07.Signal_Disconnections.Compare_To_Zero4.Constant.Value /end CHARACTERISTIC
/begin CHARACTERISTIC Disconnections_ETR07.Disconnections_ETR07_P.DataStoreMemory1_InitialValue "" VALUE 0x0 SCALAR_FLOAT64_IEEE 3.5e+305 Disconnections_ETR07_CM_double -1.7e+308 1.7e+308 DISPLAY_IDENTIFIER Disconnections_ETR07.Pedal_Box_Disconnections__Noise_.Life_check3.Data_Store_Memory1.InitialValue /end CHARACTERISTIC
/begin CHARACTERISTIC Disconnections_ETR07.Disconnections_ETR07_P.DataStoreMemory1_InitialValue_b "" VALUE 0x0 SCALAR_FLOAT64_IEEE 3.5e+305 Disconnections_ETR07_CM_double -1.7e+308 1.7e+308 DISPLAY_IDENTIFIER Disconnections_ETR07.Pedal_Box_Disconnections__Noise_.Life_check1.Data_Store_Memory1.InitialValue /end CHARACTERISTIC
/begin CHARACTERISTIC Disconnections_ETR07.Disconnections_ETR07_P.DataStoreMemory1_InitialValue_c "" VALUE 0x0 SCALAR_FLOAT64_IEEE 3.5e+305 Disconnections_ETR07_CM_double -1.7e+308 1.7e+308 DISPLAY_IDENTIFIER Disconnections_ETR07.Gyro_Disconnections__Noise_.Life_check8.Data_Store_Memory1.InitialValue /end CHARACTERISTIC
/begin CHARACTERISTIC Disconnections_ETR07.Disconnections_ETR07_P.DataStoreMemory1_InitialValue_d "" VALUE 0x0 SCALAR_FLOAT64_IEEE 3.5e+305 Disconnections_ETR07_CM_double -1.7e+308 1.7e+308 DISPLAY_IDENTIFIER Disconnections_ETR07.Pedal_Box_Disconnections__Noise_.Life_check2.Data_Store_Memory1.InitialValue /end CHARACTERISTIC
/begin CHARACTERISTIC Disconnections_ETR07.Disconnections_ETR07_P.DataStoreMemory1_InitialValue_m "" VALUE 0x0 SCALAR_FLOAT64_IEEE 3.5e+305 Disconnections_ETR07_CM_double -1.7e+308 1.7e+308 DISPLAY_IDENTIFIER Disconnections_ETR07.Gyro_Disconnections__Noise_.Life_check6.Data_Store_Memory1.InitialValue /end CHARACTERISTIC
/begin CHARACTERISTIC Disconnections_ETR07.Disconnections_ETR07_P.DataStoreMemory_InitialValue "" VALUE 0x0 SCALAR_FLOAT64_IEEE 3.5e+305 Disconnections_ETR07_CM_double -1.7e+308 1.7e+308 DISPLAY_IDENTIFIER Disconnections_ETR07.ECU_Disconections.LifeCheck_BMS.Data_Store_Memory.InitialValue /end CHARACTERISTIC
/begin CHARACTERISTIC Disconnections_ETR07.Disconnections_ETR07_P.DataStoreMemory_InitialValue_b "" VALUE 0x0 SCALAR_FLOAT64_IEEE 3.5e+305 Disconnections_ETR07_CM_double -1.7e+308 1.7e+308 DISPLAY_IDENTIFIER Disconnections_ETR07.ECU_Disconections.LifeCheck_ADCAN.Data_Store_Memory.InitialValue /end CHARACTERISTIC
/begin CHARACTERISTIC Disconnections_ETR07.Disconnections_ETR07_P.DataStoreMemory_InitialValue_ba "" VALUE 0x0 SCALAR_FLOAT64_IEEE 3.5e+305 Disconnections_ETR07_CM_double -1.7e+308 1.7e+308 DISPLAY_IDENTIFIER Disconnections_ETR07.Gyro_Disconnections__Noise_.Life_check8.Data_Store_Memory.InitialValue /end CHARACTERISTIC
/begin CHARACTERISTIC Disconnections_ETR07.Disconnections_ETR07_P.DataStoreMemory_InitialValue_c "" VALUE 0x0 SCALAR_FLOAT64_IEEE 3.5e+305 Disconnections_ETR07_CM_double -1.7e+308 1.7e+308 DISPLAY_IDENTIFIER Disconnections_ETR07.Pedal_Box_Disconnections__Noise_.Life_check3.Data_Store_Memory.InitialValue /end CHARACTERISTIC
/begin CHARACTERISTIC Disconnections_ETR07.Disconnections_ETR07_P.DataStoreMemory_InitialValue_d "" VALUE 0x0 SCALAR_FLOAT64_IEEE 3.5e+305 Disconnections_ETR07_CM_double -1.7e+308 1.7e+308 DISPLAY_IDENTIFIER Disconnections_ETR07.ECU_Disconections.LifeCheck_AccFront.Data_Store_Memory.InitialValue /end CHARACTERISTIC
/begin CHARACTERISTIC Disconnections_ETR07.Disconnections_ETR07_P.DataStoreMemory_InitialValue_f "" VALUE 0x0 SCALAR_FLOAT64_IEEE 3.5e+305 Disconnections_ETR07_CM_double -1.7e+308 1.7e+308 DISPLAY_IDENTIFIER Disconnections_ETR07.ECU_Disconections.LifeCheck_AccRear.Data_Store_Memory.InitialValue /end CHARACTERISTIC
/begin CHARACTERISTIC Disconnections_ETR07.Disconnections_ETR07_P.DataStoreMemory_InitialValue_j "" VALUE 0x0 SCALAR_FLOAT64_IEEE 3.5e+305 Disconnections_ETR07_CM_double -1.7e+308 1.7e+308 DISPLAY_IDENTIFIER Disconnections_ETR07.Counter.Data_Store_Memory.InitialValue /end CHARACTERISTIC
/begin CHARACTERISTIC Disconnections_ETR07.Disconnections_ETR07_P.DataStoreMemory_InitialValue_jc "" VALUE 0x0 SCALAR_FLOAT64_IEEE 3.5e+305 Disconnections_ETR07_CM_double -1.7e+308 1.7e+308 DISPLAY_IDENTIFIER Disconnections_ETR07.Pedal_Box_Disconnections__Noise_.Life_check1.Data_Store_Memory.InitialValue /end CHARACTERISTIC
/begin CHARACTERISTIC Disconnections_ETR07.Disconnections_ETR07_P.DataStoreMemory_InitialValue_k "" VALUE 0x0 SCALAR_FLOAT64_IEEE 3.5e+305 Disconnections_ETR07_CM_double -1.7e+308 1.7e+308 DISPLAY_IDENTIFIER Disconnections_ETR07.ECU_Disconections.LifeCheck_Dash.Data_Store_Memory.InitialValue /end CHARACTERISTIC
/begin CHARACTERISTIC Disconnections_ETR07.Disconnections_ETR07_P.DataStoreMemory_InitialValue_kg "" VALUE 0x0 SCALAR_FLOAT64_IEEE 3.5e+305 Disconnections_ETR07_CM_double -1.7e+308 1.7e+308 DISPLAY_IDENTIFIER Disconnections_ETR07.Pedal_Box_Disconnections__Noise_.Life_check2.Data_Store_Memory.InitialValue /end CHARACTERISTIC
/begin CHARACTERISTIC Disconnections_ETR07.Disconnections_ETR07_P.DataStoreMemory_InitialValue_ks "" VALUE 0x0 SCALAR_FLOAT64_IEEE 3.5e+305 Disconnections_ETR07_CM_double -1.7e+308 1.7e+308 DISPLAY_IDENTIFIER Disconnections_ETR07.ECU_Disconections.Life_check4.Data_Store_Memory.InitialValue /end CHARACTERISTIC
/begin CHARACTERISTIC Disconnections_ETR07.Disconnections_ETR07_P.DataStoreMemory_InitialValue_m "" VALUE 0x0 SCALAR_FLOAT64_IEEE 3.5e+305 Disconnections_ETR07_CM_double -1.7e+308 1.7e+308 DISPLAY_IDENTIFIER Disconnections_ETR07.Gyro_Disconnections__Noise_.Life_check6.Data_Store_Memory.InitialValue /end CHARACTERISTIC
/begin CHARACTERISTIC Disconnections_ETR07.Disconnections_ETR07_P.DataStoreMemory_InitialValue_o "" VALUE 0x0 SCALAR_FLOAT64_IEEE 3.5e+305 Disconnections_ETR07_CM_double -1.7e+308 1.7e+308 DISPLAY_IDENTIFIER Disconnections_ETR07.ECU_Disconections.LifeCheck_Shutdown.Data_Store_Memory.InitialValue /end CHARACTERISTIC
/begin CHARACTERISTIC Disconnections_ETR07.Disconnections_ETR07_P.Merge_InitialOutput "" VALUE 0x0 SCALAR_FLOAT64_IEEE 3.5e+305 Disconnections_ETR07_CM_double -1.7e+308 1.7e+308 DISPLAY_IDENTIFIER Disconnections_ETR07.ECU_Disconections.LifeCheck_BMS.Merge.InitialOutput /end CHARACTERISTIC
/begin CHARACTERISTIC Disconnections_ETR07.Disconnections_ETR07_P.Merge_InitialOutput_a "" VALUE 0x0 SCALAR_FLOAT64_IEEE 3.5e+305 Disconnections_ETR07_CM_double -1.7e+308 1.7e+308 DISPLAY_IDENTIFIER Disconnections_ETR07.ECU_Disconections.LifeCheck_ADCAN.Merge.InitialOutput /end CHARACTERISTIC
/begin CHARACTERISTIC Disconnections_ETR07.Disconnections_ETR07_P.Merge_InitialOutput_b "" VALUE 0x0 SCALAR_FLOAT64_IEEE 3.5e+305 Disconnections_ETR07_CM_double -1.7e+308 1.7e+308 DISPLAY_IDENTIFIER Disconnections_ETR07.ECU_Disconections.LifeCheck_Dash.Merge.InitialOutput /end CHARACTERISTIC
/begin CHARACTERISTIC Disconnections_ETR07.Disconnections_ETR07_P.Merge_InitialOutput_l "" VALUE 0x0 SCALAR_FLOAT64_IEEE 3.5e+305 Disconnections_ETR07_CM_double -1.7e+308 1.7e+308 DISPLAY_IDENTIFIER Disconnections_ETR07.ECU_Disconections.LifeCheck_Shutdown.Merge.InitialOutput /end CHARACTERISTIC
/begin CHARACTERISTIC Disconnections_ETR07.Disconnections_ETR07_P.Merge_InitialOutput_m "" VALUE 0x0 SCALAR_FLOAT64_IEEE 3.5e+305 Disconnections_ETR07_CM_double -1.7e+308 1.7e+308 DISPLAY_IDENTIFIER Disconnections_ETR07.ECU_Disconections.LifeCheck_AccFront.Merge.InitialOutput /end CHARACTERISTIC
/begin CHARACTERISTIC Disconnections_ETR07.Disconnections_ETR07_P.Merge_InitialOutput_o "" VALUE 0x0 SCALAR_FLOAT64_IEEE 3.5e+305 Disconnections_ETR07_CM_double -1.7e+308 1.7e+308 DISPLAY_IDENTIFIER Disconnections_ETR07.ECU_Disconections.Life_check4.Merge.InitialOutput /end CHARACTERISTIC
/begin CHARACTERISTIC Disconnections_ETR07.Disconnections_ETR07_P.Merge_InitialOutput_p "" VALUE 0x0 SCALAR_FLOAT64_IEEE 3.5e+305 Disconnections_ETR07_CM_double -1.7e+308 1.7e+308 DISPLAY_IDENTIFIER Disconnections_ETR07.ECU_Disconections.LifeCheck_AccRear.Merge.InitialOutput /end CHARACTERISTIC
/begin CHARACTERISTIC inverters_action_ETR07.inverters_action_ETR07_P.Constant_Value "" VALUE 0x0 SCALAR_UBYTE 255.0 inverters_action_ETR07_CM_uint8 0.0 255.0 DISPLAY_IDENTIFIER inverters_action_ETR07.Subsystem10.Unsubscribe__Subscribe.Constant.Value /end CHARACTERISTIC
/begin CHARACTERISTIC inverters_action_ETR07.inverters_action_ETR07_P.Constant_Value_m "" VALUE 0x0 SCALAR_UBYTE 255.0 inverters_action_ETR07_CM_uint8 0.0 255.0 DISPLAY_IDENTIFIER inverters_action_ETR07.Subsystem9.Unsubscribe__Subscribe.Constant.Value /end CHARACTERISTIC
/begin CHARACTERISTIC inverters_action_ETR07.inverters_action_ETR07_P.DataStoreMemory1_InitialValue "" VALUE 0x0 SCALAR_FLOAT64_IEEE 3.5e+305 inverters_action_ETR07_CM_double -1.7e+308 1.7e+308 DISPLAY_IDENTIFIER inverters_action_ETR07.Subsystem10.Data_Store_Memory1.InitialValue /end CHARACTERISTIC
/begin CHARACTERISTIC inverters_action_ETR07.inverters_action_ETR07_P.DataStoreMemory1_InitialValue_m "" VALUE 0x0 SCALAR_FLOAT64_IEEE 3.5e+305 inverters_action_ETR07_CM_double -1.7e+308 1.7e+308 DISPLAY_IDENTIFIER inverters_action_ETR07.Subsystem9.Data_Store_Memory1.InitialValue /end CHARACTERISTIC
/begin CHARACTERISTIC inverters_action_ETR07.inverters_action_ETR07_P.DataStoreMemory2_InitialValue "" VALUE 0x0 SCALAR_FLOAT64_IEEE 3.5e+305 inverters_action_ETR07_CM_double -1.7e+308 1.7e+308 DISPLAY_IDENTIFIER inverters_action_ETR07.Subsystem10.Data_Store_Memory2.InitialValue /end CHARACTERISTIC
/begin CHARACTERISTIC inverters_action_ETR07.inverters_action_ETR07_P.DataStoreMemory2_InitialValue_c "" VALUE 0x0 SCALAR_FLOAT64_IEEE 3.5e+305 inverters_action_ETR07_CM_double -1.7e+308 1.7e+308 DISPLAY_IDENTIFIER inverters_action_ETR07.Subsystem9.Data_Store_Memory2.InitialValue /end CHARACTERISTIC
/begin CHARACTERISTIC inverters_action_ETR07.inverters_action_ETR07_P.Delay_DelayLength "" VALUE 0x0 SCALAR_ULONG 4294967295.0 inverters_action_ETR07_CM_uint32 0.0 4294967295.0 DISPLAY_IDENTIFIER inverters_action_ETR07.Subsystem10.edge_detection.Delay.DelayLength /end CHARACTERISTIC
/begin CHARACTERISTIC inverters_action_ETR07.inverters_action_ETR07_P.Delay_DelayLength_h "" VALUE 0x0 SCALAR_ULONG 4294967295.0 inverters_action_ETR07_CM_uint32 0.0 4294967295.0 DISPLAY_IDENTIFIER inverters_action_ETR07.Subsystem9.edge_detection.Delay.DelayLength /end CHARACTERISTIC
/begin CHARACTERISTIC inverters_action_ETR07.inverters_action_ETR07_P.Delay_InitialCondition "" VALUE 0x0 SCALAR_FLOAT64_IEEE 3.5e+305 inverters_action_ETR07_CM_double -1.7e+308 1.7e+308 DISPLAY_IDENTIFIER inverters_action_ETR07.Subsystem10.edge_detection.Delay.InitialCondition /end CHARACTERISTIC
/begin CHARACTERISTIC inverters_action_ETR07.inverters_action_ETR07_P.Delay_InitialCondition_o "" VALUE 0x0 SCALAR_FLOAT64_IEEE 3.5e+305 inverters_action_ETR07_CM_double -1.7e+308 1.7e+308 DISPLAY_IDENTIFIER inverters_action_ETR07.Subsystem9.edge_detection.Delay.InitialCondition /end CHARACTERISTIC
/begin CHARACTERISTIC inverters_action_ETR07.inverters_action_ETR07_P.Merge_InitialOutput "" VALUE 0x0 SCALAR_UBYTE 1.0 inverters_action_ETR07_CM_boolean 0 1 DISPLAY_IDENTIFIER inverters_action_ETR07.Merge.InitialOutput /end CHARACTERISTIC
/begin CHARACTERISTIC inverters_action_ETR07.inverters_action_ETR07_P.TimeInterval_Value "" VALUE 0x0 SCALAR_UBYTE 255.0 inverters_action_ETR07_CM_uint8 0.0 255.0 DISPLAY_IDENTIFIER inverters_action_ETR07.Subsystem10.Unsubscribe__Subscribe.Subscribe.Time_Interval.Value /end CHARACTERISTIC
/begin CHARACTERISTIC inverters_action_ETR07.inverters_action_ETR07_P.TimeInterval_Value_d "" VALUE 0x0 SCALAR_UBYTE 255.0 inverters_action_ETR07_CM_uint8 0.0 255.0 DISPLAY_IDENTIFIER inverters_action_ETR07.Subsystem9.Unsubscribe__Subscribe.Subscribe.Time_Interval.Value /end CHARACTERISTIC
/begin CHARACTERISTIC inverters_action_ETR07.inverters_action_ETR07_P._Value "" VALUE 0x0 SCALAR_UBYTE 1.0 inverters_action_ETR07_CM_boolean 0 1 DISPLAY_IDENTIFIER inverters_action_ETR07.Subsystem10.Unsubscribe__Subscribe.Subscribe._.Value /end CHARACTERISTIC
/begin CHARACTERISTIC inverters_action_ETR07.inverters_action_ETR07_P.subscribed_InitialOutput "" VALUE 0x0 SCALAR_UBYTE 1.0 inverters_action_ETR07_CM_boolean 0 1 DISPLAY_IDENTIFIER inverters_action_ETR07.Subsystem10.Unsubscribe__Subscribe.subscribed_.InitialOutput /end CHARACTERISTIC
/begin CHARACTERISTIC inverters_action_ETR07.inverters_action_ETR07_P.subscribed_InitialOutput_k "" VALUE 0x0 SCALAR_UBYTE 1.0 inverters_action_ETR07_CM_boolean 0 1 DISPLAY_IDENTIFIER inverters_action_ETR07.Subsystem9.Unsubscribe__Subscribe.subscribed_.InitialOutput /end CHARACTERISTIC
/begin CHARACTERISTIC inverters_action_ETR07.inverters_action_ETR07_P.u_Value "" VALUE 0x0 SCALAR_UBYTE 1.0 inverters_action_ETR07_CM_boolean 0 1 DISPLAY_IDENTIFIER inverters_action_ETR07.Subsystem9.Unsubscribe__Subscribe.Subscribe.1.Value /end CHARACTERISTIC
/begin CHARACTERISTIC Inverters_Data_ETR07.Inverters_Data_ETR07_P.A1_Value "" VALUE 0x0 SCALAR_FLOAT64_IEEE 3.5e+305 Inverters_Data_ETR07_CM_double -1.7e+308 1.7e+308 DISPLAY_IDENTIFIER Inverters_Data_ETR07.Subsystem4.A1.Value /end CHARACTERISTIC
/begin CHARACTERISTIC Inverters_Data_ETR07.Inverters_Data_ETR07_P.A1_Value_e "" VALUE 0x0 SCALAR_FLOAT64_IEEE 3.5e+305 Inverters_Data_ETR07_CM_double -1.7e+308 1.7e+308 DISPLAY_IDENTIFIER Inverters_Data_ETR07.Subsystem5.A1.Value /end CHARACTERISTIC
/begin CHARACTERISTIC Inverters_Data_ETR07.Inverters_Data_ETR07_P.B1_Value "" VALUE 0x0 SCALAR_FLOAT64_IEEE 3.5e+305 Inverters_Data_ETR07_CM_double -1.7e+308 1.7e+308 DISPLAY_IDENTIFIER Inverters_Data_ETR07.Subsystem4.B1.Value /end CHARACTERISTIC
/begin CHARACTERISTIC Inverters_Data_ETR07.Inverters_Data_ETR07_P.B1_Value_i "" VALUE 0x0 SCALAR_FLOAT64_IEEE 3.5e+305 Inverters_Data_ETR07_CM_double -1.7e+308 1.7e+308 DISPLAY_IDENTIFIER Inverters_Data_ETR07.Subsystem5.B1.Value /end CHARACTERISTIC
/begin CHARACTERISTIC Inverters_Data_ETR07.Inverters_Data_ETR07_P.Bitct_Value "" VALUE 0x0 SCALAR_FLOAT64_IEEE 3.5e+305 Inverters_Data_ETR07_CM_double -1.7e+308 1.7e+308 DISPLAY_IDENTIFIER Inverters_Data_ETR07.IL1.Bit_ct.Value /end CHARACTERISTIC
/begin CHARACTERISTIC Inverters_Data_ETR07.Inverters_Data_ETR07_P.Bitct_Value_h "" VALUE 0x0 SCALAR_FLOAT64_IEEE 3.5e+305 Inverters_Data_ETR07_CM_double -1.7e+308 1.7e+308 DISPLAY_IDENTIFIER Inverters_Data_ETR07.IL.Bit_ct.Value /end CHARACTERISTIC
/begin CHARACTERISTIC Inverters_Data_ETR07.Inverters_Data_ETR07_P.C1_Value "" VALUE 0x0 SCALAR_FLOAT64_IEEE 3.5e+305 Inverters_Data_ETR07_CM_double -1.7e+308 1.7e+308 DISPLAY_IDENTIFIER Inverters_Data_ETR07.Subsystem4.C1.Value /end CHARACTERISTIC
/begin CHARACTERISTIC Inverters_Data_ETR07.Inverters_Data_ETR07_P.C1_Value_d "" VALUE 0x0 SCALAR_FLOAT64_IEEE 3.5e+305 Inverters_Data_ETR07_CM_double -1.7e+308 1.7e+308 DISPLAY_IDENTIFIER Inverters_Data_ETR07.Subsystem6.C1.Value /end CHARACTERISTIC
/begin CHARACTERISTIC Inverters_Data_ETR07.Inverters_Data_ETR07_P.C1_Value_n "" VALUE 0x0 SCALAR_FLOAT64_IEEE 3.5e+305 Inverters_Data_ETR07_CM_double -1.7e+308 1.7e+308 DISPLAY_IDENTIFIER Inverters_Data_ETR07.Subsystem5.C1.Value /end CHARACTERISTIC
/begin CHARACTERISTIC Inverters_Data_ETR07.Inverters_Data_ETR07_P.C1_Value_n0 "" VALUE 0x0 SCALAR_FLOAT64_IEEE 3.5e+305 Inverters_Data_ETR07_CM_double -1.7e+308 1.7e+308 DISPLAY_IDENTIFIER Inverters_Data_ETR07.Subsystem7.C1.Value /end CHARACTERISTIC
/begin CHARACTERISTIC Inverters_Data_ETR07.Inverters_Data_ETR07_P.Constant1_Value "" VALUE 0x0 SCALAR_FLOAT64_IEEE 3.5e+305 Inverters_Data_ETR07_CM_double -1.7e+308 1.7e+308 DISPLAY_IDENTIFIER Inverters_Data_ETR07.Subsystem4.Constant1.Value /end CHARACTERISTIC
/begin CHARACTERISTIC Inverters_Data_ETR07.Inverters_Data_ETR07_P.Constant1_Value_e "" VALUE 0x0 SCALAR_FLOAT64_IEEE 3.5e+305 Inverters_Data_ETR07_CM_double -1.7e+308 1.7e+308 DISPLAY_IDENTIFIER Inverters_Data_ETR07.Subsystem5.Constant1.Value /end CHARACTERISTIC
/begin CHARACTERISTIC Inverters_Data_ETR07.Inverters_Data_ETR07_P.D1_Value "" VALUE 0x0 SCALAR_FLOAT64_IEEE 3.5e+305 Inverters_Data_ETR07_CM_double -1.7e+308 1.7e+308 DISPLAY_IDENTIFIER Inverters_Data_ETR07.Subsystem4.D1.Value /end CHARACTERISTIC
/begin CHARACTERISTIC Inverters_Data_ETR07.Inverters_Data_ETR07_P.D1_Value_d "" VALUE 0x0 SCALAR_FLOAT64_IEEE 3.5e+305 Inverters_Data_ETR07_CM_double -1.7e+308 1.7e+308 DISPLAY_IDENTIFIER Inverters_Data_ETR07.Subsystem6.D1.Value /end CHARACTERISTIC
/begin CHARACTERISTIC Inverters_Data_ETR07.Inverters_Data_ETR07_P.D1_Value_f "" VALUE 0x0 SCALAR_FLOAT64_IEEE 3.5e+305 Inverters_Data_ETR07_CM_double -1.7e+308 1.7e+308 DISPLAY_IDENTIFIER Inverters_Data_ETR07.Subsystem5.D1.Value /end CHARACTERISTIC
/begin CHARACTERISTIC Inverters_Data_ETR07.Inverters_Data_ETR07_P.D1_Value_j "" VALUE 0x0 SCALAR_FLOAT64_IEEE 3.5e+305 Inverters_Data_ETR07_CM_double -1.7e+308 1.7e+308 DISPLAY_IDENTIFIER Inverters_Data_ETR07.Subsystem7.D1.Value /end CHARACTERISTIC
/begin CHARACTERISTIC Inverters_Data_ETR07.Inverters_Data_ETR07_P.Diameterm_Gain "" VALUE 0x0 SCALAR_FLOAT64_IEEE 3.5e+305 Inverters_Data_ETR07_CM_double -1.7e+308 1.7e+308 DISPLAY_IDENTIFIER Inverters_Data_ETR07.Subsystem2.Wheel.Diameter_[m].Gain /end CHARACTERISTIC
/begin CHARACTERISTIC Inverters_Data_ETR07.Inverters_Data_ETR07_P.Diameterm_Gain_p "" VALUE 0x0 SCALAR_FLOAT64_IEEE 3.5e+305 Inverters_Data_ETR07_CM_double -1.7e+308 1.7e+308 DISPLAY_IDENTIFIER Inverters_Data_ETR07.Subsystem1.Wheel.Diameter_[m].Gain /end CHARACTERISTIC
/begin CHARACTERISTIC Inverters_Data_ETR07.Inverters_Data_ETR07_P.Gain_Gain "" VALUE 0x0 SCALAR_FLOAT64_IEEE 3.5e+305 Inverters_Data_ETR07_CM_double -1.7e+308 1.7e+308 DISPLAY_IDENTIFIER Inverters_Data_ETR07.Subsystem2.Transmission.Gain.Gain /end CHARACTERISTIC
/begin CHARACTERISTIC Inverters_Data_ETR07.Inverters_Data_ETR07_P.Gain_Gain_a "" VALUE 0x0 SCALAR_FLOAT64_IEEE 3.5e+305 Inverters_Data_ETR07_CM_double -1.7e+308 1.7e+308 DISPLAY_IDENTIFIER Inverters_Data_ETR07.Subsystem1.Transmission.Gain.Gain /end CHARACTERISTIC
/begin CHARACTERISTIC Inverters_Data_ETR07.Inverters_Data_ETR07_P.Gain_Gain_e "" VALUE 0x0 SCALAR_FLOAT64_IEEE 3.5e+305 Inverters_Data_ETR07_CM_double -1.7e+308 1.7e+308 DISPLAY_IDENTIFIER Inverters_Data_ETR07.Subsystem.Gain.Gain /end CHARACTERISTIC
/begin CHARACTERISTIC Inverters_Data_ETR07.Inverters_Data_ETR07_P.Gain_Gain_f "" VALUE 0x0 SCALAR_FLOAT64_IEEE 3.5e+305 Inverters_Data_ETR07_CM_double -1.7e+308 1.7e+308 DISPLAY_IDENTIFIER Inverters_Data_ETR07.Subsystem3.Gain.Gain /end CHARACTERISTIC
/begin CHARACTERISTIC Inverters_Data_ETR07.Inverters_Data_ETR07_P.Gain_Gain_m "" VALUE 0x0 SCALAR_FLOAT64_IEEE 3.5e+305 Inverters_Data_ETR07_CM_double -1.7e+308 1.7e+308 DISPLAY_IDENTIFIER Inverters_Data_ETR07.Average.Gain.Gain /end CHARACTERISTIC
/begin CHARACTERISTIC Inverters_Data_ETR07.Inverters_Data_ETR07_P.MaxRPM_Value "" VALUE 0x0 SCALAR_FLOAT64_IEEE 3.5e+305 Inverters_Data_ETR07_CM_double -1.7e+308 1.7e+308 DISPLAY_IDENTIFIER Inverters_Data_ETR07.IL1.Max_RPM.Value /end CHARACTERISTIC
/begin CHARACTERISTIC Inverters_Data_ETR07.Inverters_Data_ETR07_P.MaxRPM_Value_m "" VALUE 0x0 SCALAR_FLOAT64_IEEE 3.5e+305 Inverters_Data_ETR07_CM_double -1.7e+308 1.7e+308 DISPLAY_IDENTIFIER Inverters_Data_ETR07.IL.Max_RPM.Value /end CHARACTERISTIC
/begin CHARACTERISTIC Inverters_Data_ETR07.Inverters_Data_ETR07_P.conversionratio1_Gain "" VALUE 0x0 SCALAR_FLOAT64_IEEE 3.5e+305 Inverters_Data_ETR07_CM_double -1.7e+308 1.7e+308 DISPLAY_IDENTIFIER Inverters_Data_ETR07.IL2.conversion_ratio1.Gain /end CHARACTERISTIC
/begin CHARACTERISTIC Inverters_Data_ETR07.Inverters_Data_ETR07_P.conversionratio_Gain "" VALUE 0x0 SCALAR_FLOAT64_IEEE 3.5e+305 Inverters_Data_ETR07_CM_double -1.7e+308 1.7e+308 DISPLAY_IDENTIFIER Inverters_Data_ETR07.IL_4.conversion_ratio.Gain /end CHARACTERISTIC
/begin CHARACTERISTIC Inverters_Data_ETR07.Inverters_Data_ETR07_P.conversionratio_Gain_c "" VALUE 0x0 SCALAR_FLOAT64_IEEE 3.5e+305 Inverters_Data_ETR07_CM_double -1.7e+308 1.7e+308 DISPLAY_IDENTIFIER Inverters_Data_ETR07.IL_2.conversion_ratio.Gain /end CHARACTERISTIC
/begin CHARACTERISTIC Inverters_Data_ETR07.Inverters_Data_ETR07_P.conversionratio_Gain_j "" VALUE 0x0 SCALAR_FLOAT64_IEEE 3.5e+305 Inverters_Data_ETR07_CM_double -1.7e+308 1.7e+308 DISPLAY_IDENTIFIER Inverters_Data_ETR07.IL_1.conversion_ratio.Gain /end CHARACTERISTIC
/begin CHARACTERISTIC Inverters_Data_ETR07.Inverters_Data_ETR07_P.conversionratio_Gain_k "" VALUE 0x0 SCALAR_FLOAT64_IEEE 3.5e+305 Inverters_Data_ETR07_CM_double -1.7e+308 1.7e+308 DISPLAY_IDENTIFIER Inverters_Data_ETR07.IL_3.conversion_ratio.Gain /end CHARACTERISTIC
/begin CHARACTERISTIC Inverters_Data_ETR07.Inverters_Data_ETR07_P.conversionratio_Gain_o "" VALUE 0x0 SCALAR_FLOAT64_IEEE 3.5e+305 Inverters_Data_ETR07_CM_double -1.7e+308 1.7e+308 DISPLAY_IDENTIFIER Inverters_Data_ETR07.IL_5.conversion_ratio.Gain /end CHARACTERISTIC
/begin CHARACTERISTIC Inverters_Data_ETR07.Inverters_Data_ETR07_P.direction_Gain "" VALUE 0x0 SCALAR_FLOAT64_IEEE 3.5e+305 Inverters_Data_ETR07_CM_double -1.7e+308 1.7e+308 DISPLAY_IDENTIFIER Inverters_Data_ETR07.IL1.direction.Gain /end CHARACTERISTIC
/begin CHARACTERISTIC Inverters_Data_ETR07.Inverters_Data_ETR07_P.direction_Gain_f "" VALUE 0x0 SCALAR_FLOAT64_IEEE 3.5e+305 Inverters_Data_ETR07_CM_double -1.7e+308 1.7e+308 DISPLAY_IDENTIFIER Inverters_Data_ETR07.IL.direction.Gain /end CHARACTERISTIC
/begin CHARACTERISTIC Inverters_Data_ETR07.Inverters_Data_ETR07_P.ratio_Gain "" VALUE 0x0 SCALAR_FLOAT64_IEEE 3.5e+305 Inverters_Data_ETR07_CM_double -1.7e+308 1.7e+308 DISPLAY_IDENTIFIER Inverters_Data_ETR07.Subsystem2.m__s_to_km__h.ratio.Gain /end CHARACTERISTIC
/begin CHARACTERISTIC Inverters_Data_ETR07.Inverters_Data_ETR07_P.ratio_Gain_k "" VALUE 0x0 SCALAR_FLOAT64_IEEE 3.5e+305 Inverters_Data_ETR07_CM_double -1.7e+308 1.7e+308 DISPLAY_IDENTIFIER Inverters_Data_ETR07.Subsystem1.m__s_to_km__h.ratio.Gain /end CHARACTERISTIC
/begin CHARACTERISTIC Inverters_Data_ETR07.Inverters_Data_ETR07_P.upi60_Gain "" VALUE 0x0 SCALAR_FLOAT64_IEEE 3.5e+305 Inverters_Data_ETR07_CM_double -1.7e+308 1.7e+308 DISPLAY_IDENTIFIER Inverters_Data_ETR07.Subsystem2.RPM_to_rad__s.2_pi__60.Gain /end CHARACTERISTIC
/begin CHARACTERISTIC Inverters_Data_ETR07.Inverters_Data_ETR07_P.upi60_Gain_i "" VALUE 0x0 SCALAR_FLOAT64_IEEE 3.5e+305 Inverters_Data_ETR07_CM_double -1.7e+308 1.7e+308 DISPLAY_IDENTIFIER Inverters_Data_ETR07.Subsystem1.RPM_to_rad__s.2_pi__60.Gain /end CHARACTERISTIC
/begin CHARACTERISTIC LVD_Data_ETR07.LVD_Data_ETR07_P.DataStoreMemory1_InitialValue "" VALUE 0x0 SCALAR_FLOAT64_IEEE 3.5e+305 LVD_Data_ETR07_CM_double -1.7e+308 1.7e+308 DISPLAY_IDENTIFIER LVD_Data_ETR07.Low_Pass.Data_Store_Memory1.InitialValue /end CHARACTERISTIC
/begin CHARACTERISTIC LVD_Data_ETR07.LVD_Data_ETR07_P.DataStoreMemory_InitialValue "" VALUE 0x0 SCALAR_FLOAT64_IEEE 3.5e+305 LVD_Data_ETR07_CM_double -1.7e+308 1.7e+308 DISPLAY_IDENTIFIER LVD_Data_ETR07.Low_Pass.Data_Store_Memory.InitialValue /end CHARACTERISTIC
/begin CHARACTERISTIC LVD_Data_ETR07.LVD_Data_ETR07_P.MaxBits2_Value "" VALUE 0x0 SCALAR_FLOAT64_IEEE 3.5e+305 LVD_Data_ETR07_CM_double -1.7e+308 1.7e+308 DISPLAY_IDENTIFIER LVD_Data_ETR07.MaxBits2.Value /end CHARACTERISTIC
/begin CHARACTERISTIC LVD_Data_ETR07.LVD_Data_ETR07_P.MaxBits_Value "" VALUE 0x0 SCALAR_FLOAT64_IEEE 3.5e+305 LVD_Data_ETR07_CM_double -1.7e+308 1.7e+308 DISPLAY_IDENTIFIER LVD_Data_ETR07.MaxBits.Value /end CHARACTERISTIC
/begin CHARACTERISTIC LVD_Data_ETR07.LVD_Data_ETR07_P.Vmax_Value "" VALUE 0x0 SCALAR_FLOAT64_IEEE 3.5e+305 LVD_Data_ETR07_CM_double -1.7e+308 1.7e+308 DISPLAY_IDENTIFIER LVD_Data_ETR07.Vmax.Value /end CHARACTERISTIC
/begin CHARACTERISTIC LVD_Data_ETR07.LVD_Data_ETR07_P.Vmin_Value "" VALUE 0x0 SCALAR_FLOAT64_IEEE 3.5e+305 LVD_Data_ETR07_CM_double -1.7e+308 1.7e+308 DISPLAY_IDENTIFIER LVD_Data_ETR07.Vmin.Value /end CHARACTERISTIC
/begin CHARACTERISTIC LVD_Data_ETR07.LVD_Data_ETR07_P.ct_Value "" VALUE 0x0 SCALAR_FLOAT64_IEEE 3.5e+305 LVD_Data_ETR07_CM_double -1.7e+308 1.7e+308 DISPLAY_IDENTIFIER LVD_Data_ETR07.Low_Pass.ct.Value /end CHARACTERISTIC
/begin CHARACTERISTIC LVD_Data_ETR07.LVD_Data_ETR07_P.exptcycletau1_Value "" VALUE 0x0 SCALAR_FLOAT64_IEEE 3.5e+305 LVD_Data_ETR07_CM_double -1.7e+308 1.7e+308 DISPLAY_IDENTIFIER LVD_Data_ETR07.Low_Pass.exp__tcycle__tau_1.Value /end CHARACTERISTIC
/begin CHARACTERISTIC Pedals_Susp_Sensors_ETR07.Pedals_Susp_Sensors_ETR07_P.Brake_Light_Threshold_Value "" VALUE 0x0 SCALAR_FLOAT64_IEEE 3.5e+305 Pedals_Susp_Sensors_ETR07_CM_double -1.7e+308 1.7e+308 DISPLAY_IDENTIFIER Pedals_Susp_Sensors_ETR07.Brake_Light.Brake_Light_Threshold.Value /end CHARACTERISTIC
/begin CHARACTERISTIC Pedals_Susp_Sensors_ETR07.Pedals_Susp_Sensors_ETR07_P.Ctemuelles_Gain "" VALUE 0x0 SCALAR_FLOAT64_IEEE 3.5e+305 Pedals_Susp_Sensors_ETR07_CM_double -1.7e+308 1.7e+308 DISPLAY_IDENTIFIER Pedals_Susp_Sensors_ETR07.Suspension_FL_Data_Conv.Cte_muelles.Gain /end CHARACTERISTIC
/begin CHARACTERISTIC Pedals_Susp_Sensors_ETR07.Pedals_Susp_Sensors_ETR07_P.Ctemuelles_Gain_e "" VALUE 0x0 SCALAR_FLOAT64_IEEE 3.5e+305 Pedals_Susp_Sensors_ETR07_CM_double -1.7e+308 1.7e+308 DISPLAY_IDENTIFIER Pedals_Susp_Sensors_ETR07.Suspension_FR_Data_Conv.Cte_muelles.Gain /end CHARACTERISTIC
/begin CHARACTERISTIC Pedals_Susp_Sensors_ETR07.Pedals_Susp_Sensors_ETR07_P.Ctemuelles_Gain_f "" VALUE 0x0 SCALAR_FLOAT64_IEEE 3.5e+305 Pedals_Susp_Sensors_ETR07_CM_double -1.7e+308 1.7e+308 DISPLAY_IDENTIFIER Pedals_Susp_Sensors_ETR07.Suspension_RR_Data_Conv.Cte_muelles.Gain /end CHARACTERISTIC
/begin CHARACTERISTIC Pedals_Susp_Sensors_ETR07.Pedals_Susp_Sensors_ETR07_P.Ctemuelles_Gain_j "" VALUE 0x0 SCALAR_FLOAT64_IEEE 3.5e+305 Pedals_Susp_Sensors_ETR07_CM_double -1.7e+308 1.7e+308 DISPLAY_IDENTIFIER Pedals_Susp_Sensors_ETR07.Suspension_RL_Data_Conv.Cte_muelles.Gain /end CHARACTERISTIC
/begin CHARACTERISTIC Pedals_Susp_Sensors_ETR07.Pedals_Susp_Sensors_ETR07_P.Experimental_Zero_Value "" VALUE 0x0 SCALAR_FLOAT64_IEEE 3.5e+305 Pedals_Susp_Sensors_ETR07_CM_double -1.7e+308 1.7e+308 DISPLAY_IDENTIFIER Pedals_Susp_Sensors_ETR07.Suspension_FL_Data_Conv.Experimental_Zero.Value /end CHARACTERISTIC
/begin CHARACTERISTIC Pedals_Susp_Sensors_ETR07.Pedals_Susp_Sensors_ETR07_P.Experimental_Zero_Value_a "" VALUE 0x0 SCALAR_FLOAT64_IEEE 3.5e+305 Pedals_Susp_Sensors_ETR07_CM_double -1.7e+308 1.7e+308 DISPLAY_IDENTIFIER Pedals_Susp_Sensors_ETR07.Suspension_RR_Data_Conv.Experimental_Zero.Value /end CHARACTERISTIC
/begin CHARACTERISTIC Pedals_Susp_Sensors_ETR07.Pedals_Susp_Sensors_ETR07_P.Experimental_Zero_Value_e "" VALUE 0x0 SCALAR_FLOAT64_IEEE 3.5e+305 Pedals_Susp_Sensors_ETR07_CM_double -1.7e+308 1.7e+308 DISPLAY_IDENTIFIER Pedals_Susp_Sensors_ETR07.Suspension_FR_Data_Conv.Experimental_Zero.Value /end CHARACTERISTIC
/begin CHARACTERISTIC Pedals_Susp_Sensors_ETR07.Pedals_Susp_Sensors_ETR07_P.Experimental_Zero_Value_f "" VALUE 0x0 SCALAR_FLOAT64_IEEE 3.5e+305 Pedals_Susp_Sensors_ETR07_CM_double -1.7e+308 1.7e+308 DISPLAY_IDENTIFIER Pedals_Susp_Sensors_ETR07.Suspension_RL_Data_Conv.Experimental_Zero.Value /end CHARACTERISTIC
/begin CHARACTERISTIC Pedals_Susp_Sensors_ETR07.Pedals_Susp_Sensors_ETR07_P.Ltotal_Gain "" VALUE 0x0 SCALAR_FLOAT64_IEEE 3.5e+305 Pedals_Susp_Sensors_ETR07_CM_double -1.7e+308 1.7e+308 DISPLAY_IDENTIFIER Pedals_Susp_Sensors_ETR07.Suspension_FL_Data_Conv.Ltotal.Gain /end CHARACTERISTIC
/begin CHARACTERISTIC Pedals_Susp_Sensors_ETR07.Pedals_Susp_Sensors_ETR07_P.Ltotal_Gain_c "" VALUE 0x0 SCALAR_FLOAT64_IEEE 3.5e+305 Pedals_Susp_Sensors_ETR07_CM_double -1.7e+308 1.7e+308 DISPLAY_IDENTIFIER Pedals_Susp_Sensors_ETR07.Suspension_FR_Data_Conv.Ltotal.Gain /end CHARACTERISTIC
/begin CHARACTERISTIC Pedals_Susp_Sensors_ETR07.Pedals_Susp_Sensors_ETR07_P.Ltotal_Gain_d "" VALUE 0x0 SCALAR_FLOAT64_IEEE 3.5e+305 Pedals_Susp_Sensors_ETR07_CM_double -1.7e+308 1.7e+308 DISPLAY_IDENTIFIER Pedals_Susp_Sensors_ETR07.Suspension_RL_Data_Conv.Ltotal.Gain /end CHARACTERISTIC
/begin CHARACTERISTIC Pedals_Susp_Sensors_ETR07.Pedals_Susp_Sensors_ETR07_P.Ltotal_Gain_e "" VALUE 0x0 SCALAR_FLOAT64_IEEE 3.5e+305 Pedals_Susp_Sensors_ETR07_CM_double -1.7e+308 1.7e+308 DISPLAY_IDENTIFIER Pedals_Susp_Sensors_ETR07.Suspension_RR_Data_Conv.Ltotal.Gain /end CHARACTERISTIC
/begin CHARACTERISTIC Pedals_Susp_Sensors_ETR07.Pedals_Susp_Sensors_ETR07_P.ON_Value "" VALUE 0x0 SCALAR_FLOAT64_IEEE 3.5e+305 Pedals_Susp_Sensors_ETR07_CM_double -1.7e+308 1.7e+308 DISPLAY_IDENTIFIER Pedals_Susp_Sensors_ETR07.Brake_Light.Brake_Light_ON.ON.Value /end CHARACTERISTIC
/begin CHARACTERISTIC Pedals_Susp_Sensors_ETR07.Pedals_Susp_Sensors_ETR07_P.Off_Value "" VALUE 0x0 SCALAR_FLOAT64_IEEE 3.5e+305 Pedals_Susp_Sensors_ETR07_CM_double -1.7e+308 1.7e+308 DISPLAY_IDENTIFIER Pedals_Susp_Sensors_ETR07.Brake_Light.Brake_Light_OFF.Off.Value /end CHARACTERISTIC
/begin CHARACTERISTIC Pedals_Susp_Sensors_ETR07.Pedals_Susp_Sensors_ETR07_P.bitsmax_Value "" VALUE 0x0 SCALAR_FLOAT64_IEEE 3.5e+305 Pedals_Susp_Sensors_ETR07_CM_double -1.7e+308 1.7e+308 DISPLAY_IDENTIFIER Pedals_Susp_Sensors_ETR07.Suspension_FL_Data_Conv.bitsmax.Value /end CHARACTERISTIC
/begin CHARACTERISTIC Pedals_Susp_Sensors_ETR07.Pedals_Susp_Sensors_ETR07_P.bitsmax_Value_e "" VALUE 0x0 SCALAR_FLOAT64_IEEE 3.5e+305 Pedals_Susp_Sensors_ETR07_CM_double -1.7e+308 1.7e+308 DISPLAY_IDENTIFIER Pedals_Susp_Sensors_ETR07.Suspension_FR_Data_Conv.bitsmax.Value /end CHARACTERISTIC
/begin CHARACTERISTIC Pedals_Susp_Sensors_ETR07.Pedals_Susp_Sensors_ETR07_P.bitsmax_Value_g "" VALUE 0x0 SCALAR_FLOAT64_IEEE 3.5e+305 Pedals_Susp_Sensors_ETR07_CM_double -1.7e+308 1.7e+308 DISPLAY_IDENTIFIER Pedals_Susp_Sensors_ETR07.Suspension_RL_Data_Conv.bitsmax.Value /end CHARACTERISTIC
/begin CHARACTERISTIC Pedals_Susp_Sensors_ETR07.Pedals_Susp_Sensors_ETR07_P.bitsmax_Value_n "" VALUE 0x0 SCALAR_FLOAT64_IEEE 3.5e+305 Pedals_Susp_Sensors_ETR07_CM_double -1.7e+308 1.7e+308 DISPLAY_IDENTIFIER Pedals_Susp_Sensors_ETR07.Suspension_RR_Data_Conv.bitsmax.Value /end CHARACTERISTIC
/begin CHARACTERISTIC Pedals_Susp_Sensors_ETR07.Pedals_Susp_Sensors_ETR07_P.max_Value "" VALUE 0x0 SCALAR_FLOAT64_IEEE 3.5e+305 Pedals_Susp_Sensors_ETR07_CM_double -1.7e+308 1.7e+308 DISPLAY_IDENTIFIER Pedals_Susp_Sensors_ETR07.BRS_Data_Conv.max.Value /end CHARACTERISTIC
/begin CHARACTERISTIC Pedals_Susp_Sensors_ETR07.Pedals_Susp_Sensors_ETR07_P.max_Value_a "" VALUE 0x0 SCALAR_FLOAT64_IEEE 3.5e+305 Pedals_Susp_Sensors_ETR07_CM_double -1.7e+308 1.7e+308 DISPLAY_IDENTIFIER Pedals_Susp_Sensors_ETR07.APPS2_Data_Conv.max.Value /end CHARACTERISTIC
/begin CHARACTERISTIC Pedals_Susp_Sensors_ETR07.Pedals_Susp_Sensors_ETR07_P.max_Value_f "" VALUE 0x0 SCALAR_FLOAT64_IEEE 3.5e+305 Pedals_Susp_Sensors_ETR07_CM_double -1.7e+308 1.7e+308 DISPLAY_IDENTIFIER Pedals_Susp_Sensors_ETR07.APPS1_Data_Conv.max.Value /end CHARACTERISTIC
/begin CHARACTERISTIC Pedals_Susp_Sensors_ETR07.Pedals_Susp_Sensors_ETR07_P.min_Value "" VALUE 0x0 SCALAR_FLOAT64_IEEE 3.5e+305 Pedals_Susp_Sensors_ETR07_CM_double -1.7e+308 1.7e+308 DISPLAY_IDENTIFIER Pedals_Susp_Sensors_ETR07.BRS_Data_Conv.min.Value /end CHARACTERISTIC
/begin CHARACTERISTIC Pedals_Susp_Sensors_ETR07.Pedals_Susp_Sensors_ETR07_P.min_Value_a "" VALUE 0x0 SCALAR_FLOAT64_IEEE 3.5e+305 Pedals_Susp_Sensors_ETR07_CM_double -1.7e+308 1.7e+308 DISPLAY_IDENTIFIER Pedals_Susp_Sensors_ETR07.APPS1_Data_Conv.min.Value /end CHARACTERISTIC
/begin CHARACTERISTIC Pedals_Susp_Sensors_ETR07.Pedals_Susp_Sensors_ETR07_P.min_Value_g "" VALUE 0x0 SCALAR_FLOAT64_IEEE 3.5e+305 Pedals_Susp_Sensors_ETR07_CM_double -1.7e+308 1.7e+308 DISPLAY_IDENTIFIER Pedals_Susp_Sensors_ETR07.APPS2_Data_Conv.min.Value /end CHARACTERISTIC
/begin CHARACTERISTIC Racing_Mode_ETR07.Racing_Mode_ETR07_P.Apps_Sat_DwnSaturation_LowerSat "" VALUE 0x0 SCALAR_FLOAT64_IEEE 3.5e+305 Racing_Mode_ETR07_CM_double -1.7e+308 1.7e+308 DISPLAY_IDENTIFIER Racing_Mode_ETR07.Apps_Sat_Dwn_Saturation.LowerLimit /end CHARACTERISTIC
/begin CHARACTERISTIC Racing_Mode_ETR07.Racing_Mode_ETR07_P.Apps_Sat_DwnSaturation_UpperSat "" VALUE 0x0 SCALAR_FLOAT64_IEEE 3.5e+305 Racing_Mode_ETR07_CM_double -1.7e+308 1.7e+308 DISPLAY_IDENTIFIER Racing_Mode_ETR07.Apps_Sat_Dwn_Saturation.UpperLimit /end CHARACTERISTIC
/begin CHARACTERISTIC Racing_Mode_ETR07.Racing_Mode_ETR07_P.Apps_Sat_UpSaturation_LowerSat "" VALUE 0x0 SCALAR_FLOAT64_IEEE 3.5e+305 Racing_Mode_ETR07_CM_double -1.7e+308 1.7e+308 DISPLAY_IDENTIFIER Racing_Mode_ETR07.Apps_Sat_Up_Saturation.LowerLimit /end CHARACTERISTIC
/begin CHARACTERISTIC Racing_Mode_ETR07.Racing_Mode_ETR07_P.Apps_Sat_UpSaturation_UpperSat "" VALUE 0x0 SCALAR_FLOAT64_IEEE 3.5e+305 Racing_Mode_ETR07_CM_double -1.7e+308 1.7e+308 DISPLAY_IDENTIFIER Racing_Mode_ETR07.Apps_Sat_Up_Saturation.UpperLimit /end CHARACTERISTIC
/begin CHARACTERISTIC Racing_Mode_ETR07.Racing_Mode_ETR07_P.CEE_Apps_Sat_Dwn_Value "" VALUE 0x0 SCALAR_FLOAT64_IEEE 3.5e+305 Racing_Mode_ETR07_CM_double -1.7e+308 1.7e+308 DISPLAY_IDENTIFIER Racing_Mode_ETR07.Tuning.CEE_Apps_Sat_Dwn.Value /end CHARACTERISTIC
/begin CHARACTERISTIC Racing_Mode_ETR07.Racing_Mode_ETR07_P.CEE_Apps_Sat_Up_Value "" VALUE 0x0 SCALAR_FLOAT64_IEEE 3.5e+305 Racing_Mode_ETR07_CM_double -1.7e+308 1.7e+308 DISPLAY_IDENTIFIER Racing_Mode_ETR07.Tuning.CEE_Apps_Sat_Up.Value /end CHARACTERISTIC
/begin CHARACTERISTIC Racing_Mode_ETR07.Racing_Mode_ETR07_P.CEE_CKF_Initial_Value "" VALUE 0x0 SCALAR_FLOAT64_IEEE 3.5e+305 Racing_Mode_ETR07_CM_double -1.7e+308 1.7e+308 DISPLAY_IDENTIFIER Racing_Mode_ETR07.Tuning.CEE_CKF_Initial.Value /end CHARACTERISTIC
/begin CHARACTERISTIC Racing_Mode_ETR07.Racing_Mode_ETR07_P.CEE_Cte_CKF_Value "" VALUE 0x0 SCALAR_FLOAT64_IEEE 3.5e+305 Racing_Mode_ETR07_CM_double -1.7e+308 1.7e+308 DISPLAY_IDENTIFIER Racing_Mode_ETR07.Tuning.CEE_Cte_CKF.Value /end CHARACTERISTIC
/begin CHARACTERISTIC Racing_Mode_ETR07.Racing_Mode_ETR07_P.CEE_Cte_SKF_Value "" VALUE 0x0 SCALAR_FLOAT64_IEEE 3.5e+305 Racing_Mode_ETR07_CM_double -1.7e+308 1.7e+308 DISPLAY_IDENTIFIER Racing_Mode_ETR07.Tuning.CEE_Cte_SKF.Value /end CHARACTERISTIC
/begin CHARACTERISTIC Racing_Mode_ETR07.Racing_Mode_ETR07_P.CEE_K_Reduction_P_Value "" VALUE 0x0 SCALAR_FLOAT64_IEEE 3.5e+305 Racing_Mode_ETR07_CM_double -1.7e+308 1.7e+308 DISPLAY_IDENTIFIER Racing_Mode_ETR07.Tuning.CEE_K_Reduction_P.Value /end CHARACTERISTIC
/begin CHARACTERISTIC Racing_Mode_ETR07.Racing_Mode_ETR07_P.CEE_K_Reduction_Temperature_Val "" VALUE 0x0 SCALAR_FLOAT64_IEEE 3.5e+305 Racing_Mode_ETR07_CM_double -1.7e+308 1.7e+308 DISPLAY_IDENTIFIER Racing_Mode_ETR07.Tuning.CEE_K_Reduction_Temperature.Value /end CHARACTERISTIC
/begin CHARACTERISTIC Racing_Mode_ETR07.Racing_Mode_ETR07_P.CEE_Max_Regenerative_Torque_Val "" VALUE 0x0 SCALAR_FLOAT64_IEEE 3.5e+305 Racing_Mode_ETR07_CM_double -1.7e+308 1.7e+308 DISPLAY_IDENTIFIER Racing_Mode_ETR07.Tuning.CEE_Max_Regenerative_Torque.Value /end CHARACTERISTIC
/begin CHARACTERISTIC Racing_Mode_ETR07.Racing_Mode_ETR07_P.CEE_Power_Limit_Value "" VALUE 0x0 SCALAR_FLOAT64_IEEE 3.5e+305 Racing_Mode_ETR07_CM_double -1.7e+308 1.7e+308 DISPLAY_IDENTIFIER Racing_Mode_ETR07.Tuning.CEE_Power_Limit.Value /end CHARACTERISTIC
/begin CHARACTERISTIC Racing_Mode_ETR07.Racing_Mode_ETR07_P.CEE_SKF_Initial_Value "" VALUE 0x0 SCALAR_FLOAT64_IEEE 3.5e+305 Racing_Mode_ETR07_CM_double -1.7e+308 1.7e+308 DISPLAY_IDENTIFIER Racing_Mode_ETR07.Tuning.CEE_SKF_Initial.Value /end CHARACTERISTIC
/begin CHARACTERISTIC Racing_Mode_ETR07.Racing_Mode_ETR07_P.CKF_InitialSaturation_LowerSat "" VALUE 0x0 SCALAR_FLOAT64_IEEE 3.5e+305 Racing_Mode_ETR07_CM_double -1.7e+308 1.7e+308 DISPLAY_IDENTIFIER Racing_Mode_ETR07.CKF_Initial_Saturation.LowerLimit /end CHARACTERISTIC
/begin CHARACTERISTIC Racing_Mode_ETR07.Racing_Mode_ETR07_P.CKF_InitialSaturation_UpperSat "" VALUE 0x0 SCALAR_FLOAT64_IEEE 3.5e+305 Racing_Mode_ETR07_CM_double -1.7e+308 1.7e+308 DISPLAY_IDENTIFIER Racing_Mode_ETR07.CKF_Initial_Saturation.UpperLimit /end CHARACTERISTIC
/begin CHARACTERISTIC Racing_Mode_ETR07.Racing_Mode_ETR07_P.CompareToConstant_const "" VALUE 0x0 SCALAR_UBYTE 255.0 Racing_Mode_ETR07_CM_uint8 0.0 255.0 DISPLAY_IDENTIFIER Racing_Mode_ETR07.Compare_To_Constant.Constant.Value /end CHARACTERISTIC
/begin CHARACTERISTIC Racing_Mode_ETR07.Racing_Mode_ETR07_P.Cte_CKFSaturation_LowerSat "" VALUE 0x0 SCALAR_FLOAT64_IEEE 3.5e+305 Racing_Mode_ETR07_CM_double -1.7e+308 1.7e+308 DISPLAY_IDENTIFIER Racing_Mode_ETR07.Cte_CKF_Saturation.LowerLimit /end CHARACTERISTIC
/begin CHARACTERISTIC Racing_Mode_ETR07.Racing_Mode_ETR07_P.Cte_CKFSaturation_UpperSat "" VALUE 0x0 SCALAR_FLOAT64_IEEE 3.5e+305 Racing_Mode_ETR07_CM_double -1.7e+308 1.7e+308 DISPLAY_IDENTIFIER Racing_Mode_ETR07.Cte_CKF_Saturation.UpperLimit /end CHARACTERISTIC
/begin CHARACTERISTIC Racing_Mode_ETR07.Racing_Mode_ETR07_P.Cte_SKFSaturation_LowerSat "" VALUE 0x0 SCALAR_FLOAT64_IEEE 3.5e+305 Racing_Mode_ETR07_CM_double -1.7e+308 1.7e+308 DISPLAY_IDENTIFIER Racing_Mode_ETR07.Cte_SKF_Saturation.LowerLimit /end CHARACTERISTIC
/begin CHARACTERISTIC Racing_Mode_ETR07.Racing_Mode_ETR07_P.Cte_SKFSaturation_UpperSat "" VALUE 0x0 SCALAR_FLOAT64_IEEE 3.5e+305 Racing_Mode_ETR07_CM_double -1.7e+308 1.7e+308 DISPLAY_IDENTIFIER Racing_Mode_ETR07.Cte_SKF_Saturation.UpperLimit /end CHARACTERISTIC
/begin CHARACTERISTIC Racing_Mode_ETR07.Racing_Mode_ETR07_P.K_Reduction_PSaturation_LowerSa "" VALUE 0x0 SCALAR_FLOAT64_IEEE 3.5e+305 Racing_Mode_ETR07_CM_double -1.7e+308 1.7e+308 DISPLAY_IDENTIFIER Racing_Mode_ETR07.K_Reduction_P_Saturation.LowerLimit /end CHARACTERISTIC
/begin CHARACTERISTIC Racing_Mode_ETR07.Racing_Mode_ETR07_P.K_Reduction_PSaturation_UpperSa "" VALUE 0x0 SCALAR_FLOAT64_IEEE 3.5e+305 Racing_Mode_ETR07_CM_double -1.7e+308 1.7e+308 DISPLAY_IDENTIFIER Racing_Mode_ETR07.K_Reduction_P_Saturation.UpperLimit /end CHARACTERISTIC
/begin CHARACTERISTIC Racing_Mode_ETR07.Racing_Mode_ETR07_P.K_Reduction_TemperatureSatura_m "" VALUE 0x0 SCALAR_FLOAT64_IEEE 3.5e+305 Racing_Mode_ETR07_CM_double -1.7e+308 1.7e+308 DISPLAY_IDENTIFIER Racing_Mode_ETR07.K_Reduction_Temperature_Saturation.LowerLimit /end CHARACTERISTIC
/begin CHARACTERISTIC Racing_Mode_ETR07.Racing_Mode_ETR07_P.K_Reduction_TemperatureSaturati "" VALUE 0x0 SCALAR_FLOAT64_IEEE 3.5e+305 Racing_Mode_ETR07_CM_double -1.7e+308 1.7e+308 DISPLAY_IDENTIFIER Racing_Mode_ETR07.K_Reduction_Temperature_Saturation.UpperLimit /end CHARACTERISTIC
/begin CHARACTERISTIC Racing_Mode_ETR07.Racing_Mode_ETR07_P.Max_Regenerative_TorqueSatura_o "" VALUE 0x0 SCALAR_FLOAT64_IEEE 3.5e+305 Racing_Mode_ETR07_CM_double -1.7e+308 1.7e+308 DISPLAY_IDENTIFIER Racing_Mode_ETR07.Max_Regenerative_Torque_Saturation.LowerLimit /end CHARACTERISTIC
/begin CHARACTERISTIC Racing_Mode_ETR07.Racing_Mode_ETR07_P.Max_Regenerative_TorqueSaturati "" VALUE 0x0 SCALAR_FLOAT64_IEEE 3.5e+305 Racing_Mode_ETR07_CM_double -1.7e+308 1.7e+308 DISPLAY_IDENTIFIER Racing_Mode_ETR07.Max_Regenerative_Torque_Saturation.UpperLimit /end CHARACTERISTIC
/begin CHARACTERISTIC Racing_Mode_ETR07.Racing_Mode_ETR07_P.Merge_InitialOutput "" VALUE 0x0 SCALAR_FLOAT64_IEEE 3.5e+305 Racing_Mode_ETR07_CM_double -1.7e+308 1.7e+308 DISPLAY_IDENTIFIER Racing_Mode_ETR07.Merge.InitialOutput /end CHARACTERISTIC
/begin CHARACTERISTIC Racing_Mode_ETR07.Racing_Mode_ETR07_P.Power_LimitSaturation_LowerSat "" VALUE 0x0 SCALAR_FLOAT64_IEEE 3.5e+305 Racing_Mode_ETR07_CM_double -1.7e+308 1.7e+308 DISPLAY_IDENTIFIER Racing_Mode_ETR07.Power_Limit_Saturation.LowerLimit /end CHARACTERISTIC
/begin CHARACTERISTIC Racing_Mode_ETR07.Racing_Mode_ETR07_P.Power_LimitSaturation_UpperSat "" VALUE 0x0 SCALAR_FLOAT64_IEEE 3.5e+305 Racing_Mode_ETR07_CM_double -1.7e+308 1.7e+308 DISPLAY_IDENTIFIER Racing_Mode_ETR07.Power_Limit_Saturation.UpperLimit /end CHARACTERISTIC
/begin CHARACTERISTIC Racing_Mode_ETR07.Racing_Mode_ETR07_P.SKF_InitialSaturation_LowerSat "" VALUE 0x0 SCALAR_FLOAT64_IEEE 3.5e+305 Racing_Mode_ETR07_CM_double -1.7e+308 1.7e+308 DISPLAY_IDENTIFIER Racing_Mode_ETR07.SKF_Initial_Saturation.LowerLimit /end CHARACTERISTIC
/begin CHARACTERISTIC Racing_Mode_ETR07.Racing_Mode_ETR07_P.SKF_InitialSaturation_UpperSat "" VALUE 0x0 SCALAR_FLOAT64_IEEE 3.5e+305 Racing_Mode_ETR07_CM_double -1.7e+308 1.7e+308 DISPLAY_IDENTIFIER Racing_Mode_ETR07.SKF_Initial_Saturation.UpperLimit /end CHARACTERISTIC
/begin CHARACTERISTIC Synchronism_ETR07.Synchronism_ETR07_P.Constant1_Value "" VALUE 0x0 SCALAR_FLOAT64_IEEE 3.5e+305 Synchronism_ETR07_CM_double -1.7e+308 1.7e+308 DISPLAY_IDENTIFIER Synchronism_ETR07.Constant1.Value /end CHARACTERISTIC
/begin CHARACTERISTIC Synchronism_ETR07.Synchronism_ETR07_P.Constant_Value "" VALUE 0x0 SCALAR_FLOAT64_IEEE 3.5e+305 Synchronism_ETR07_CM_double -1.7e+308 1.7e+308 DISPLAY_IDENTIFIER Synchronism_ETR07.Counter.Reset_counter.Constant.Value /end CHARACTERISTIC
/begin CHARACTERISTIC Synchronism_ETR07.Synchronism_ETR07_P.Constant_Value_e "" VALUE 0x0 SCALAR_FLOAT64_IEEE 3.5e+305 Synchronism_ETR07_CM_double -1.7e+308 1.7e+308 DISPLAY_IDENTIFIER Synchronism_ETR07.Counter.Constant.Value /end CHARACTERISTIC
/begin CHARACTERISTIC Synchronism_ETR07.Synchronism_ETR07_P.DataStoreMemory_InitialValue "" VALUE 0x0 SCALAR_FLOAT64_IEEE 3.5e+305 Synchronism_ETR07_CM_double -1.7e+308 1.7e+308 DISPLAY_IDENTIFIER Synchronism_ETR07.Counter.Data_Store_Memory.InitialValue /end CHARACTERISTIC
/begin COMPU_METHOD Accel_Data_ETR07_CM_double "Q = V" RAT_FUNC "%9.6" "NO_PHYSICAL_QTY" COEFFS 0.0 1.0 0.0 0.0 0.0 1.0 /end COMPU_METHOD
/begin COMPU_METHOD Car_State_ETR07_CM_double "Q = V" RAT_FUNC "%9.6" "NO_PHYSICAL_QTY" COEFFS 0.0 1.0 0.0 0.0 0.0 1.0 /end COMPU_METHOD
/begin COMPU_METHOD Car_State_ETR07_CM_boolean "Q = V" RAT_FUNC "%9.6" "NO_PHYSICAL_QTY" COEFFS 0.0 1.0 0.0 0.0 0.0 1.0 /end COMPU_METHOD
/begin COMPU_METHOD Disconnections_ETR07_CM_double "Q = V" RAT_FUNC "%9.6" "NO_PHYSICAL_QTY" COEFFS 0.0 1.0 0.0 0.0 0.0 1.0 /end COMPU_METHOD
/begin COMPU_METHOD Disconnections_ETR07_CM_uint8 "Q = V" RAT_FUNC "%9.6" "NO_PHYSICAL_QTY" COEFFS 0.0 1.0 0.0 0.0 0.0 1.0 /end COMPU_METHOD
/begin COMPU_METHOD Disconnections_ETR07_CM_boolean "Q = V" RAT_FUNC "%9.6" "NO_PHYSICAL_QTY" COEFFS 0.0 1.0 0.0 0.0 0.0 1.0 /end COMPU_METHOD
/begin COMPU_METHOD inverters_action_ETR07_CM_boolean "Q = V" RAT_FUNC "%9.6" "NO_PHYSICAL_QTY" COEFFS 0.0 1.0 0.0 0.0 0.0 1.0 /end COMPU_METHOD
/begin COMPU_METHOD inverters_action_ETR07_CM_uint8 "Q = V" RAT_FUNC "%9.6" "NO_PHYSICAL_QTY" COEFFS 0.0 1.0 0.0 0.0 0.0 1.0 /end COMPU_METHOD
/begin COMPU_METHOD inverters_action_ETR07_CM_double "Q = V" RAT_FUNC "%9.6" "NO_PHYSICAL_QTY" COEFFS 0.0 1.0 0.0 0.0 0.0 1.0 /end COMPU_METHOD
/begin COMPU_METHOD inverters_action_ETR07_CM_uint32 "Q = V" RAT_FUNC "%9.6" "NO_PHYSICAL_QTY" COEFFS 0.0 1.0 0.0 0.0 0.0 1.0 /end COMPU_METHOD
/begin COMPU_METHOD Inverters_Data_ETR07_CM_double "Q = V" RAT_FUNC "%9.6" "NO_PHYSICAL_QTY" COEFFS 0.0 1.0 0.0 0.0 0.0 1.0 /end COMPU_METHOD
/begin COMPU_METHOD LVD_Data_ETR07_CM_double "Q = V" RAT_FUNC "%9.6" "NO_PHYSICAL_QTY" COEFFS 0.0 1.0 0.0 0.0 0.0 1.0 /end COMPU_METHOD
/begin COMPU_METHOD Pedals_Susp_Sensors_ETR07_CM_double "Q = V" RAT_FUNC "%9.6" "NO_PHYSICAL_QTY" COEFFS 0.0 1.0 0.0 0.0 0.0 1.0 /end COMPU_METHOD
/begin COMPU_METHOD Racing_Mode_ETR07_CM_double "Q = V" RAT_FUNC "%9.6" "NO_PHYSICAL_QTY" COEFFS 0.0 1.0 0.0 0.0 0.0 1.0 /end COMPU_METHOD
/begin COMPU_METHOD Racing_Mode_ETR07_CM_uint8 "Q = V" RAT_FUNC "%9.6" "NO_PHYSICAL_QTY" COEFFS 0.0 1.0 0.0 0.0 0.0 1.0 /end COMPU_METHOD
/begin COMPU_METHOD Racing_Mode_ETR07_CM_boolean "Q = V" RAT_FUNC "%9.6" "NO_PHYSICAL_QTY" COEFFS 0.0 1.0 0.0 0.0 0.0 1.0 /end COMPU_METHOD
/begin COMPU_METHOD Synchronism_ETR07_CM_double "Q = V" RAT_FUNC "%9.6" "NO_PHYSICAL_QTY" COEFFS 0.0 1.0 0.0 0.0 0.0 1.0 /end COMPU_METHOD
/begin RECORD_LAYOUT SCALAR_FLOAT64_IEEE FNC_VALUES 1 FLOAT64_IEEE COLUMN_DIR DIRECT /end RECORD_LAYOUT
/begin RECORD_LAYOUT SCALAR_UBYTE FNC_VALUES 1 UBYTE COLUMN_DIR DIRECT /end RECORD_LAYOUT
/begin RECORD_LAYOUT SCALAR_ULONG FNC_VALUES 1 ULONG COLUMN_DIR DIRECT /end RECORD_LAYOUT
/begin GROUP Accel_Data_ETR07 "" ROOT
 /begin REF_MEASUREMENT Accel_Data_ETR07.Accel_Data_ETR07_B.AccDataConversionFX.Gain Accel_Data_ETR07.Accel_Data_ETR07_B.AccDataConversionFY.Gain Accel_Data_ETR07.Accel_Data_ETR07_B.AccDataConversionFZ.Gain Accel_Data_ETR07.Accel_Data_ETR07_B.AccDataConversionRX.Gain Accel_Data_ETR07.Accel_Data_ETR07_B.AccDataConversionRY.Gain Accel_Data_ETR07.Accel_Data_ETR07_B.AccDataConversionRZ.Gain Accel_Data_ETR07.Accel_Data_ETR07_B.LowPass.Gain Accel_Data_ETR07.Accel_Data_ETR07_B.LowPass1.Gain Accel_Data_ETR07.Accel_Data_ETR07_B.LowPass2.Gain Accel_Data_ETR07.Accel_Data_ETR07_DW.A Accel_Data_ETR07.Accel_Data_ETR07_DW.A_f Accel_Data_ETR07.Accel_Data_ETR07_U.ACCEL_F_X Accel_Data_ETR07.Accel_Data_ETR07_U.ACCEL_F_Y Accel_Data_ETR07.Accel_Data_ETR07_U.ACCEL_F_Z Accel_Data_ETR07.Accel_Data_ETR07_U.ACCEL_R_X Accel_Data_ETR07.Accel_Data_ETR07_U.ACCEL_R_Y Accel_Data_ETR07.Accel_Data_ETR07_U.ACCEL_R_Z Accel_Data_ETR07.Accel_Data_ETR07_U.Gyroscope_F Accel_Data_ETR07.Accel_Data_ETR07_U.Gyroscope_R Accel_Data_ETR07.Accel_Data_ETR07_Y.Accel_F_X_SI Accel_Data_ETR07.Accel_Data_ETR07_Y.Accel_F_Y_SI Accel_Data_ETR07.Accel_Data_ETR07_Y.Accel_F_Z_SI Accel_Data_ETR07.Accel_Data_ETR07_Y.Accel_R_X_SI Accel_Data_ETR07.Accel_Data_ETR07_Y.Accel_R_Y_SI Accel_Data_ETR07.Accel_Data_ETR07_Y.Accel_R_Z_SI Accel_Data_ETR07.Accel_Data_ETR07_Y.Gyro_F_Z_Deg Accel_Data_ETR07.Accel_Data_ETR07_Y.Gyro_R_Z_Deg Accel_Data_ETR07.Accel_Data_ETR07_Y.Rate_F_Z_Degs2 Accel_Data_ETR07.Accel_Data_ETR07_Y.Rate_R_Z_Degs /end REF_MEASUREMENT
 /begin REF_CHARACTERISTIC Accel_Data_ETR07.Accel_Data_ETR07_P.CycleTime_Gain Accel_Data_ETR07.Accel_Data_ETR07_P.CycleTime_Gain_h Accel_Data_ETR07.Accel_Data_ETR07_P.DataStoreMemory_InitialValue Accel_Data_ETR07.Accel_Data_ETR07_P.DataStoreMemory_InitialValue_m Accel_Data_ETR07.Accel_Data_ETR07_P.ExperimentalOffset_Value Accel_Data_ETR07.Accel_Data_ETR07_P.ExperimentalOffset_Value_e Accel_Data_ETR07.Accel_Data_ETR07_P.Gain2_Gain Accel_Data_ETR07.Accel_Data_ETR07_P.Gain4_Gain Accel_Data_ETR07.Accel_Data_ETR07_P.RpsLSB_Value Accel_Data_ETR07.Accel_Data_ETR07_P.sbit_Value /end REF_CHARACTERISTIC
 /begin SUB_GROUP Accel_Data_ETR07.Accel_Data_ETR07_B Accel_Data_ETR07.Accel_Data_ETR07_B.AccDataConversionFX Accel_Data_ETR07.Accel_Data_ETR07_B.AccDataConversionFY Accel_Data_ETR07.Accel_Data_ETR07_B.AccDataConversionFZ Accel_Data_ETR07.Accel_Data_ETR07_B.AccDataConversionRX Accel_Data_ETR07.Accel_Data_ETR07_B.AccDataConversionRY Accel_Data_ETR07.Accel_Data_ETR07_B.AccDataConversionRZ Accel_Data_ETR07.Accel_Data_ETR07_B.LowPass Accel_Data_ETR07.Accel_Data_ETR07_B.LowPass1 Accel_Data_ETR07.Accel_Data_ETR07_B.LowPass2 Accel_Data_ETR07.Accel_Data_ETR07_DW Accel_Data_ETR07.Accel_Data_ETR07_U Accel_Data_ETR07.Accel_Data_ETR07_Y Accel_Data_ETR07.Accel_Data_ETR07_P /end SUB_GROUP
/end GROUP
/begin GROUP Accel_Data_ETR07.Accel_Data_ETR07_B ""
 /begin REF_MEASUREMENT Accel_Data_ETR07.Accel_Data_ETR07_B.AccDataConversionFX.Gain Accel_Data_ETR07.Accel_Data_ETR07_B.AccDataConversionFY.Gain Accel_Data_ETR07.Accel_Data_ETR07_B.AccDataConversionFZ.Gain Accel_Data_ETR07.Accel_Data_ETR07_B.AccDataConversionRX.Gain Accel_Data_ETR07.Accel_Data_ETR07_B.AccDataConversionRY.Gain Accel_Data_ETR07.Accel_Data_ETR07_B.AccDataConversionRZ.Gain Accel_Data_ETR07.Accel_Data_ETR07_B.LowPass.Gain Accel_Data_ETR07.Accel_Data_ETR07_B.LowPass1.Gain Accel_Data_ETR07.Accel_Data_ETR07_B.LowPass2.Gain /end REF_MEASUREMENT
/end GROUP
/begin GROUP Accel_Data_ETR07.Accel_Data_ETR07_B.AccDataConversionFX ""
 /begin REF_MEASUREMENT Accel_Data_ETR07.Accel_Data_ETR07_B.AccDataConversionFX.Gain /end REF_MEASUREMENT
/end GROUP
/begin GROUP Accel_Data_ETR07.Accel_Data_ETR07_B.AccDataConversionFY ""
 /begin REF_MEASUREMENT Accel_Data_ETR07.Accel_Data_ETR07_B.AccDataConversionFY.Gain /end REF_MEASUREMENT
/end GROUP
/begin GROUP Accel_Data_ETR07.Accel_Data_ETR07_B.AccDataConversionFZ ""
 /begin REF_MEASUREMENT Accel_Data_ETR07.Accel_Data_ETR07_B.AccDataConversionFZ.Gain /end REF_MEASUREMENT
/end GROUP
/begin GROUP Accel_Data_ETR07.Accel_Data_ETR07_B.AccDataConversionRX ""
 /begin REF_MEASUREMENT Accel_Data_ETR07.Accel_Data_ETR07_B.AccDataConversionRX.Gain /end REF_MEASUREMENT
/end GROUP
/begin GROUP Accel_Data_ETR07.Accel_Data_ETR07_B.AccDataConversionRY ""
 /begin REF_MEASUREMENT Accel_Data_ETR07.Accel_Data_ETR07_B.AccDataConversionRY.Gain /end REF_MEASUREMENT
/end GROUP
/begin GROUP Accel_Data_ETR07.Accel_Data_ETR07_B.AccDataConversionRZ ""
 /begin REF_MEASUREMENT Accel_Data_ETR07.Accel_Data_ETR07_B.AccDataConversionRZ.Gain /end REF_MEASUREMENT
/end GROUP
/begin GROUP Accel_Data_ETR07.Accel_Data_ETR07_B.LowPass "" /begin REF_MEASUREMENT Accel_Data_ETR07.Accel_Data_ETR07_B.LowPass.Gain /end REF_MEASUREMENT /end GROUP
/begin GROUP Accel_Data_ETR07.Accel_Data_ETR07_B.LowPass1 "" /begin REF_MEASUREMENT Accel_Data_ETR07.Accel_Data_ETR07_B.LowPass1.Gain /end REF_MEASUREMENT /end GROUP
/begin GROUP Accel_Data_ETR07.Accel_Data_ETR07_B.LowPass2 "" /begin REF_MEASUREMENT Accel_Data_ETR07.Accel_Data_ETR07_B.LowPass2.Gain /end REF_MEASUREMENT /end GROUP
/begin GROUP Accel_Data_ETR07.Accel_Data_ETR07_DW ""
 /begin REF_MEASUREMENT Accel_Data_ETR07.Accel_Data_ETR07_DW.A Accel_Data_ETR07.Accel_Data_ETR07_DW.A_f /end REF_MEASUREMENT
/end GROUP
/begin GROUP Accel_Data_ETR07.Accel_Data_ETR07_U ""
 /begin REF_MEASUREMENT Accel_Data_ETR07.Accel_Data_ETR07_U.ACCEL_F_X Accel_Data_ETR07.Accel_Data_ETR07_U.ACCEL_F_Y Accel_Data_ETR07.Accel_Data_ETR07_U.ACCEL_F_Z Accel_Data_ETR07.Accel_Data_ETR07_U.ACCEL_R_X Accel_Data_ETR07.Accel_Data_ETR07_U.ACCEL_R_Y Accel_Data_ETR07.Accel_Data_ETR07_U.ACCEL_R_Z Accel_Data_ETR07.Accel_Data_ETR07_U.Gyroscope_F Accel_Data_ETR07.Accel_Data_ETR07_U.Gyroscope_R /end REF_MEASUREMENT
/end GROUP
/begin GROUP Accel_Data_ETR07.Accel_Data_ETR07_Y ""
 /begin REF_MEASUREMENT Accel_Data_ETR07.Accel_Data_ETR07_Y.Accel_F_X_SI Accel_Data_ETR07.Accel_Data_ETR07_Y.Accel_F_Y_SI Accel_Data_ETR07.Accel_Data_ETR07_Y.Accel_F_Z_SI Accel_Data_ETR07.Accel_Data_ETR07_Y.Accel_R_X_SI Accel_Data_ETR07.Accel_Data_ETR07_Y.Accel_R_Y_SI Accel_Data_ETR07.Accel_Data_ETR07_Y.Accel_R_Z_SI Accel_Data_ETR07.Accel_Data_ETR07_Y.Gyro_F_Z_Deg Accel_Data_ETR07.Accel_Data_ETR07_Y.Gyro_R_Z_Deg Accel_Data_ETR07.Accel_Data_ETR07_Y.Rate_F_Z_Degs2 Accel_Data_ETR07.Accel_Data_ETR07_Y.Rate_R_Z_Degs /end REF_MEASUREMENT
/end GROUP
/begin GROUP Accel_Data_ETR07.Accel_Data_ETR07_P ""
 /begin REF_CHARACTERISTIC Accel_Data_ETR07.Accel_Data_ETR07_P.CycleTime_Gain Accel_Data_ETR07.Accel_Data_ETR07_P.CycleTime_Gain_h Accel_Data_ETR07.Accel_Data_ETR07_P.DataStoreMemory_InitialValue Accel_Data_ETR07.Accel_Data_ETR07_P.DataStoreMemory_InitialValue_m Accel_Data_ETR07.Accel_Data_ETR07_P.ExperimentalOffset_Value Accel_Data_ETR07.Accel_Data_ETR07_P.ExperimentalOffset_Value_e Accel_Data_ETR07.Accel_Data_ETR07_P.Gain2_Gain Accel_Data_ETR07.Accel_Data_ETR07_P.Gain4_Gain Accel_Data_ETR07.Accel_Data_ETR07_P.RpsLSB_Value Accel_Data_ETR07.Accel_Data_ETR07_P.sbit_Value /end REF_CHARACTERISTIC
/end GROUP
/begin GROUP Car_State_ETR07 "" ROOT
 /begin REF_MEASUREMENT Car_State_ETR07.Car_State_ETR07_B.Merge Car_State_ETR07.Car_State_ETR07_DW.A Car_State_ETR07.Car_State_ETR07_U.AIRs_State Car_State_ETR07.Car_State_ETR07_U.Accumulator_Voltage Car_State_ETR07.Car_State_ETR07_U.BMSerror_CANDisconnection Car_State_ETR07.Car_State_ETR07_U.BMSerror_CurrentSensDisc Car_State_ETR07.Car_State_ETR07_U.BMSerror_NTCDisconnection Car_State_ETR07.Car_State_ETR07_U.BMSerror_OverTemperature Car_State_ETR07.Car_State_ETR07_U.BMSerror_OverVoltage Car_State_ETR07.Car_State_ETR07_U.BMSerror_UnderTemperature Car_State_ETR07.Car_State_ETR07_U.BMSerror_UnderVoltage Car_State_ETR07.Car_State_ETR07_U.Critical_CAN_Disconnection Car_State_ETR07.Car_State_ETR07_U.DashPrechargeRequest Car_State_ETR07.Car_State_ETR07_U.EnableDrive Car_State_ETR07.Car_State_ETR07_U.InvertersMinDCBus Car_State_ETR07.Car_State_ETR07_U.InvertersSubscribed Car_State_ETR07.Car_State_ETR07_U.Lock Car_State_ETR07.Car_State_ETR07_U.Shutdown_BMS Car_State_ETR07.Car_State_ETR07_U.Shutdown_BOTS Car_State_ETR07.Car_State_ETR07_U.Shutdown_BSPD Car_State_ETR07.Car_State_ETR07_U.Shutdown_HVBOX Car_State_ETR07.Car_State_ETR07_U.Shutdown_HVD Car_State_ETR07.Car_State_ETR07_U.Shutdown_Inertia Car_State_ETR07.Car_State_ETR07_U.Shutdown_InverterLIntck Car_State_ETR07.Car_State_ETR07_U.Shutdown_InverterRIntck Car_State_ETR07.Car_State_ETR07_U.Shutdown_PackageIntck Car_State_ETR07.Car_State_ETR07_U.Shutdown_SetaCockpit Car_State_ETR07.Car_State_ETR07_U.Shutdown_SetaLeft Car_State_ETR07.Car_State_ETR07_U.Shutdown_SetaRight Car_State_ETR07.Car_State_ETR07_U.Shutdown_TSMPIntck Car_State_ETR07.Car_State_ETR07_U.Shutdown_TSMS Car_State_ETR07.Car_State_ETR07_Y.AIRs_Request Car_State_ETR07.Car_State_ETR07_Y.Car_OK Car_State_ETR07.Car_State_ETR07_Y.Car_State Car_State_ETR07.Car_State_ETR07_Y.CurrentPathDisconnectionFlag Car_State_ETR07.Car_State_ETR07_Y.InvertersAction Car_State_ETR07.Car_State_ETR07_Y.PrechargeAssert Car_State_ETR07.Car_State_ETR07_Y.Precharge_Percentage Car_State_ETR07.Car_State_ETR07_Y.Precharge_Voltage Car_State_ETR07.Car_State_ETR07_Y.ShutdownClosed Car_State_ETR07.Car_State_ETR07_Y.TorqueEnable Car_State_ETR07.Car_State_ETR07_Y.errors /end REF_MEASUREMENT
 /begin REF_CHARACTERISTIC Car_State_ETR07.Car_State_ETR07_P.CompareToConstant_const Car_State_ETR07.Car_State_ETR07_P.Constant_Value Car_State_ETR07.Car_State_ETR07_P.Constant_Value_f Car_State_ETR07.Car_State_ETR07_P.Constant_Value_fl Car_State_ETR07.Car_State_ETR07_P.Constant_Value_k Car_State_ETR07.Car_State_ETR07_P.Constant_Value_kb Car_State_ETR07.Car_State_ETR07_P.DataStoreMemory_InitialValue Car_State_ETR07.Car_State_ETR07_P.Gain_Gain Car_State_ETR07.Car_State_ETR07_P.IfDCBUSnotbits_Gain Car_State_ETR07.Car_State_ETR07_P.Merge_InitialOutput Car_State_ETR07.Car_State_ETR07_P.Saturation_LowerSat Car_State_ETR07.Car_State_ETR07_P.Saturation_UpperSat /end REF_CHARACTERISTIC
 /begin SUB_GROUP Car_State_ETR07.Car_State_ETR07_B Car_State_ETR07.Car_State_ETR07_DW Car_State_ETR07.Car_State_ETR07_U Car_State_ETR07.Car_State_ETR07_Y Car_State_ETR07.Car_State_ETR07_P /end SUB_GROUP
/end GROUP
/begin GROUP Car_State_ETR07.Car_State_ETR07_B "" /begin REF_MEASUREMENT Car_State_ETR07.Car_State_ETR07_B.Merge /end REF_MEASUREMENT /end GROUP
/begin GROUP Car_State_ETR07.Car_State_ETR07_DW "" /begin REF_MEASUREMENT Car_State_ETR07.Car_State_ETR07_DW.A /end REF_MEASUREMENT /end GROUP
/begin GROUP Car_State_ETR07.Car_State_ETR07_U ""
 /begin REF_MEASUREMENT Car_State_ETR07.Car_State_ETR07_U.AIRs_State Car_State_ETR07.Car_State_ETR07_U.Accumulator_Voltage Car_State_ETR07.Car_State_ETR07_U.BMSerror_CANDisconnection Car_State_ETR07.Car_State_ETR07_U.BMSerror_CurrentSensDisc Car_State_ETR07.Car_State_ETR07_U.BMSerror_NTCDisconnection Car_State_ETR07.Car_State_ETR07_U.BMSerror_OverTemperature Car_State_ETR07.Car_State_ETR07_U.BMSerror_OverVoltage Car_State_ETR07.Car_State_ETR07_U.BMSerror_UnderTemperature Car_State_ETR07.Car_State_ETR07_U.BMSerror_UnderVoltage Car_State_ETR07.Car_State_ETR07_U.Critical_CAN_Disconnection Car_State_ETR07.Car_State_ETR07_U.DashPrechargeRequest Car_State_ETR07.Car_State_ETR07_U.EnableDrive Car_State_ETR07.Car_State_ETR07_U.InvertersMinDCBus Car_State_ETR07.Car_State_ETR07_U.InvertersSubscribed Car_State_ETR07.Car_State_ETR07_U.Lock Car_State_ETR07.Car_State_ETR07_U.Shutdown_BMS Car_State_ETR07.Car_State_ETR07_U.Shutdown_BOTS Car_State_ETR07.Car_State_ETR07_U.Shutdown_BSPD Car_State_ETR07.Car_State_ETR07_U.Shutdown_HVBOX Car_State_ETR07.Car_State_ETR07_U.Shutdown_HVD Car_State_ETR07.Car_State_ETR07_U.Shutdown_Inertia Car_State_ETR07.Car_State_ETR07_U.Shutdown_InverterLIntck Car_State_ETR07.Car_State_ETR07_U.Shutdown_InverterRIntck Car_State_ETR07.Car_State_ETR07_U.Shutdown_PackageIntck Car_State_ETR07.Car_State_ETR07_U.Shutdown_SetaCockpit Car_State_ETR07.Car_State_ETR07_U.Shutdown_SetaLeft Car_State_ETR07.Car_State_ETR07_U.Shutdown_SetaRight Car_State_ETR07.Car_State_ETR07_U.Shutdown_TSMPIntck Car_State_ETR07.Car_State_ETR07_U.Shutdown_TSMS /end REF_MEASUREMENT
/end GROUP
/begin GROUP Car_State_ETR07.Car_State_ETR07_Y ""
 /begin REF_MEASUREMENT Car_State_ETR07.Car_State_ETR07_Y.AIRs_Request Car_State_ETR07.Car_State_ETR07_Y.Car_OK Car_State_ETR07.Car_State_ETR07_Y.Car_State Car_State_ETR07.Car_State_ETR07_Y.CurrentPathDisconnectionFlag Car_State_ETR07.Car_State_ETR07_Y.InvertersAction Car_State_ETR07.Car_State_ETR07_Y.PrechargeAssert Car_State_ETR07.Car_State_ETR07_Y.Precharge_Percentage Car_State_ETR07.Car_State_ETR07_Y.Precharge_Voltage Car_State_ETR07.Car_State_ETR07_Y.ShutdownClosed Car_State_ETR07.Car_State_ETR07_Y.TorqueEnable Car_State_ETR07.Car_State_ETR07_Y.errors /end REF_MEASUREMENT
/end GROUP
/begin GROUP Car_State_ETR07.Car_State_ETR07_P ""
 /begin REF_CHARACTERISTIC Car_State_ETR07.Car_State_ETR07_P.CompareToConstant_const Car_State_ETR07.Car_State_ETR07_P.Constant_Value Car_State_ETR07.Car_State_ETR07_P.Constant_Value_f Car_State_ETR07.Car_State_ETR07_P.Constant_Value_fl Car_State_ETR07.Car_State_ETR07_P.Constant_Value_k Car_State_ETR07.Car_State_ETR07_P.Constant_Value_kb Car_State_ETR07.Car_State_ETR07_P.DataStoreMemory_InitialValue Car_State_ETR07.Car_State_ETR07_P.Gain_Gain Car_State_ETR07.Car_State_ETR07_P.IfDCBUSnotbits_Gain Car_State_ETR07.Car_State_ETR07_P.Merge_InitialOutput Car_State_ETR07.Car_State_ETR07_P.Saturation_LowerSat Car_State_ETR07.Car_State_ETR07_P.Saturation_UpperSat /end REF_CHARACTERISTIC
/end GROUP
/begin GROUP Disconnections_ETR07 "" ROOT
 /begin REF_MEASUREMENT Disconnections_ETR07.Disconnections_ETR07_B.Merge Disconnections_ETR07.Disconnections_ETR07_B.Merge_b Disconnections_ETR07.Disconnections_ETR07_B.Merge_d Disconnections_ETR07.Disconnections_ETR07_B.Merge_f Disconnections_ETR07.Disconnections_ETR07_B.Merge_h Disconnections_ETR07.Disconnections_ETR07_B.Merge_he Disconnections_ETR07.Disconnections_ETR07_B.Merge_j Disconnections_ETR07.Disconnections_ETR07_DW.A Disconnections_ETR07.Disconnections_ETR07_DW.Last_alive Disconnections_ETR07.Disconnections_ETR07_DW.Last_alive_a Disconnections_ETR07.Disconnections_ETR07_DW.Last_alive_ar Disconnections_ETR07.Disconnections_ETR07_DW.Last_alive_c Disconnections_ETR07.Disconnections_ETR07_DW.Last_alive_c0 Disconnections_ETR07.Disconnections_ETR07_DW.Last_alive_g Disconnections_ETR07.Disconnections_ETR07_DW.Last_alive_gx Disconnections_ETR07.Disconnections_ETR07_DW.Last_alive_j Disconnections_ETR07.Disconnections_ETR07_DW.Last_alive_je Disconnections_ETR07.Disconnections_ETR07_DW.Last_alive_l Disconnections_ETR07.Disconnections_ETR07_DW.Last_alive_m Disconnections_ETR07.Disconnections_ETR07_DW.Last_alive_o Disconnections_ETR07.Disconnections_ETR07_DW.Tot_Errors Disconnections_ETR07.Disconnections_ETR07_DW.Tot_Errors_h Disconnections_ETR07.Disconnections_ETR07_DW.Tot_Errors_j Disconnections_ETR07.Disconnections_ETR07_DW.Tot_Errors_k Disconnections_ETR07.Disconnections_ETR07_DW.Tot_Errors_m Disconnections_ETR07.Disconnections_ETR07_U.ADCAN_Alive Disconnections_ETR07.Disconnections_ETR07_U.APPS1_Bits Disconnections_ETR07.Disconnections_ETR07_U.APPS2_Bits Disconnections_ETR07.Disconnections_ETR07_U.Accel_F_Alive Disconnections_ETR07.Disconnections_ETR07_U.Accel_R_Alive Disconnections_ETR07.Disconnections_ETR07_U.BMS_Alive Disconnections_ETR07.Disconnections_ETR07_U.BrakeSensor_Bits Disconnections_ETR07.Disconnections_ETR07_U.Dash_Alive Disconnections_ETR07.Disconnections_ETR07_U.Gyroscope_F Disconnections_ETR07.Disconnections_ETR07_U.Gyroscope_R Disconnections_ETR07.Disconnections_ETR07_U.LV_Derivation_Alive Disconnections_ETR07.Disconnections_ETR07_U.Shutdown_Alive Disconnections_ETR07.Disconnections_ETR07_U.SteeringSensor_Bits Disconnections_ETR07.Disconnections_ETR07_U.Susp_F_L_Bits Disconnections_ETR07.Disconnections_ETR07_U.Susp_F_R_Bits Disconnections_ETR07.Disconnections_ETR07_U.Susp_R_L_Bits Disconnections_ETR07.Disconnections_ETR07_U.Susp_R_R_Bits Disconnections_ETR07.Disconnections_ETR07_Y.CounterOut Disconnections_ETR07.Disconnections_ETR07_Y.CriticalDisconnection Disconnections_ETR07.Disconnections_ETR07_Y.Critical_CAN_Disconnection Disconnections_ETR07.Disconnections_ETR07_Y.Critical_Signal_Disconnection Disconnections_ETR07.Disconnections_ETR07_Y.Disconnection_ADCAN Disconnections_ETR07.Disconnections_ETR07_Y.Disconnection_APPS1 Disconnections_ETR07.Disconnections_ETR07_Y.Disconnection_APPS2 Disconnections_ETR07.Disconnections_ETR07_Y.Disconnection_Accel_F Disconnections_ETR07.Disconnections_ETR07_Y.Disconnection_Accel_R Disconnections_ETR07.Disconnections_ETR07_Y.Disconnection_BMS Disconnections_ETR07.Disconnections_ETR07_Y.Disconnection_Brake_Sensor Disconnections_ETR07.Disconnections_ETR07_Y.Disconnection_DashBoard Disconnections_ETR07.Disconnections_ETR07_Y.Disconnection_Gyroscope_F Disconnections_ETR07.Disconnections_ETR07_Y.Disconnection_Gyroscope_R Disconnections_ETR07.Disconnections_ETR07_Y.Disconnection_LV_Derivation Disconnections_ETR07.Disconnections_ETR07_Y.Disconnection_Shutdown Disconnections_ETR07.Disconnections_ETR07_Y.Disconnection_SteeringSensor Disconnections_ETR07.Disconnections_ETR07_Y.Disconnection_Susp_F_L Disconnections_ETR07.Disconnections_ETR07_Y.Disconnection_Susp_F_R Disconnections_ETR07.Disconnections_ETR07_Y.Disconnection_Susp_R_L Disconnections_ETR07.Disconnections_ETR07_Y.Disconnection_Susp_R_R Disconnections_ETR07.Disconnections_ETR07_Y.TV_mode /end REF_MEASUREMENT
 /begin REF_CHARACTERISTIC Disconnections_ETR07.Disconnections_ETR07_P.Constant2_Value Disconnections_ETR07.Disconnections_ETR07_P.Constant_Value Disconnections_ETR07.Disconnections_ETR07_P.Constant_Value_c Disconnections_ETR07.Disconnections_ETR07_P.Constant_Value_d Disconnections_ETR07.Disconnections_ETR07_P.Constant_Value_e Disconnections_ETR07.Disconnections_ETR07_P.Constant_Value_h Disconnections_ETR07.Disconnections_ETR07_P.Constant_Value_i Disconnections_ETR07.Disconnections_ETR07_P.Constant_Value_ic Disconnections_ETR07.Disconnections_ETR07_P.Constant_Value_l Disconnections_ETR07.Disconnections_ETR07_P.Constant_Value_m Disconnections_ETR07.Disconnections_ETR07_P.Constant_Value_o Disconnections_ETR07.Disconnections_ETR07_P.DataStoreMemory1_InitialValue Disconnections_ETR07.Disconnections_ETR07_P.DataStoreMemory1_InitialValue_b Disconnections_ETR07.Disconnections_ETR07_P.DataStoreMemory1_InitialValue_c Disconnections_ETR07.Disconnections_ETR07_P.DataStoreMemory1_InitialValue_d Disconnections_ETR07.Disconnections_ETR07_P.DataStoreMemory1_InitialValue_m Disconnections_ETR07.Disconnections_ETR07_P.DataStoreMemory_InitialValue Disconnections_ETR07.Disconnections_ETR07_P.DataStoreMemory_InitialValue_b Disconnections_ETR07.Disconnections_ETR07_P.DataStoreMemory_InitialValue_ba Disconnections_ETR07.Disconnections_ETR07_P.DataStoreMemory_InitialValue_c Disconnections_ETR07.Disconnections_ETR07_P.DataStoreMemory_InitialValue_d Disconnections_ETR07.Disconnections_ETR07_P.DataStoreMemory_InitialValue_f Disconnections_ETR07.Disconnections_ETR07_P.DataStoreMemory_InitialValue_j Disconnections_ETR07.Disconnections_ETR07_P.DataStoreMemory_InitialValue_jc Disconnections_ETR07.Disconnections_ETR07_P.DataStoreMemory_InitialValue_k Disconnections_ETR07.Disconnections_ETR07_P.DataStoreMemory_InitialValue_kg Disconnections_ETR07.Disconnections_ETR07_P.DataStoreMemory_InitialValue_ks Disconnections_ETR07.Disconnections_ETR07_P.DataStoreMemory_InitialValue_m Disconnections_ETR07.Disconnections_ETR07_P.DataStoreMemory_InitialValue_o Disconnections_ETR07.Disconnections_ETR07_P.Merge_InitialOutput Disconnections_ETR07.Disconnections_ETR07_P.Merge_InitialOutput_a Disconnections_ETR07.Disconnections_ETR07_P.Merge_InitialOutput_b Disconnections_ETR07.Disconnections_ETR07_P.Merge_InitialOutput_l Disconnections_ETR07.Disconnections_ETR07_P.Merge_InitialOutput_m Disconnections_ETR07.Disconnections_ETR07_P.Merge_InitialOutput_o Disconnections_ETR07.Disconnections_ETR07_P.Merge_InitialOutput_p /end REF_CHARACTERISTIC
 /begin SUB_GROUP Disconnections_ETR07.Disconnections_ETR07_B Disconnections_ETR07.Disconnections_ETR07_DW Disconnections_ETR07.Disconnections_ETR07_U Disconnections_ETR07.Disconnections_ETR07_Y Disconnections_ETR07.Disconnections_ETR07_P /end SUB_GROUP
/end GROUP
/begin GROUP Disconnections_ETR07.Disconnections_ETR07_B ""
 /begin REF_MEASUREMENT Disconnections_ETR07.Disconnections_ETR07_B.Merge Disconnections_ETR07.Disconnections_ETR07_B.Merge_b Disconnections_ETR07.Disconnections_ETR07_B.Merge_d Disconnections_ETR07.Disconnections_ETR07_B.Merge_f Disconnections_ETR07.Disconnections_ETR07_B.Merge_h Disconnections_ETR07.Disconnections_ETR07_B.Merge_he Disconnections_ETR07.Disconnections_ETR07_B.Merge_j /end REF_MEASUREMENT
/end GROUP
/begin GROUP Disconnections_ETR07.Disconnections_ETR07_DW ""
 /begin REF_MEASUREMENT Disconnections_ETR07.Disconnections_ETR07_DW.A Disconnections_ETR07.Disconnections_ETR07_DW.Last_alive Disconnections_ETR07.Disconnections_ETR07_DW.Last_alive_a Disconnections_ETR07.Disconnections_ETR07_DW.Last_alive_ar Disconnections_ETR07.Disconnections_ETR07_DW.Last_alive_c Disconnections_ETR07.Disconnections_ETR07_DW.Last_alive_c0 Disconnections_ETR07.Disconnections_ETR07_DW.Last_alive_g Disconnections_ETR07.Disconnections_ETR07_DW.Last_alive_gx Disconnections_ETR07.Disconnections_ETR07_DW.Last_alive_j Disconnections_ETR07.Disconnections_ETR07_DW.Last_alive_je Disconnections_ETR07.Disconnections_ETR07_DW.Last_alive_l Disconnections_ETR07.Disconnections_ETR07_DW.Last_alive_m Disconnections_ETR07.Disconnections_ETR07_DW.Last_alive_o Disconnections_ETR07.Disconnections_ETR07_DW.Tot_Errors Disconnections_ETR07.Disconnections_ETR07_DW.Tot_Errors_h Disconnections_ETR07.Disconnections_ETR07_DW.Tot_Errors_j Disconnections_ETR07.Disconnections_ETR07_DW.Tot_Errors_k Disconnections_ETR07.Disconnections_ETR07_DW.Tot_Errors_m /end REF_MEASUREMENT
/end GROUP
/begin GROUP Disconnections_ETR07.Disconnections_ETR07_U ""
 /begin REF_MEASUREMENT Disconnections_ETR07.Disconnections_ETR07_U.ADCAN_Alive Disconnections_ETR07.Disconnections_ETR07_U.APPS1_Bits Disconnections_ETR07.Disconnections_ETR07_U.APPS2_Bits Disconnections_ETR07.Disconnections_ETR07_U.Accel_F_Alive Disconnections_ETR07.Disconnections_ETR07_U.Accel_R_Alive Disconnections_ETR07.Disconnections_ETR07_U.BMS_Alive Disconnections_ETR07.Disconnections_ETR07_U.BrakeSensor_Bits Disconnections_ETR07.Disconnections_ETR07_U.Dash_Alive Disconnections_ETR07.Disconnections_ETR07_U.Gyroscope_F Disconnections_ETR07.Disconnections_ETR07_U.Gyroscope_R Disconnections_ETR07.Disconnections_ETR07_U.LV_Derivation_Alive Disconnections_ETR07.Disconnections_ETR07_U.Shutdown_Alive Disconnections_ETR07.Disconnections_ETR07_U.SteeringSensor_Bits Disconnections_ETR07.Disconnections_ETR07_U.Susp_F_L_Bits Disconnections_ETR07.Disconnections_ETR07_U.Susp_F_R_Bits Disconnections_ETR07.Disconnections_ETR07_U.Susp_R_L_Bits Disconnections_ETR07.Disconnections_ETR07_U.Susp_R_R_Bits /end REF_MEASUREMENT
/end GROUP
/begin GROUP Disconnections_ETR07.Disconnections_ETR07_Y ""
 /begin REF_MEASUREMENT Disconnections_ETR07.Disconnections_ETR07_Y.CounterOut Disconnections_ETR07.Disconnections_ETR07_Y.CriticalDisconnection Disconnections_ETR07.Disconnections_ETR07_Y.Critical_CAN_Disconnection Disconnections_ETR07.Disconnections_ETR07_Y.Critical_Signal_Disconnection Disconnections_ETR07.Disconnections_ETR07_Y.Disconnection_ADCAN Disconnections_ETR07.Disconnections_ETR07_Y.Disconnection_APPS1 Disconnections_ETR07.Disconnections_ETR07_Y.Disconnection_APPS2 Disconnections_ETR07.Disconnections_ETR07_Y.Disconnection_Accel_F Disconnections_ETR07.Disconnections_ETR07_Y.Disconnection_Accel_R Disconnections_ETR07.Disconnections_ETR07_Y.Disconnection_BMS Disconnections_ETR07.Disconnections_ETR07_Y.Disconnection_Brake_Sensor Disconnections_ETR07.Disconnections_ETR07_Y.Disconnection_DashBoard Disconnections_ETR07.Disconnections_ETR07_Y.Disconnection_Gyroscope_F Disconnections_ETR07.Disconnections_ETR07_Y.Disconnection_Gyroscope_R Disconnections_ETR07.Disconnections_ETR07_Y.Disconnection_LV_Derivation Disconnections_ETR07.Disconnections_ETR07_Y.Disconnection_Shutdown Disconnections_ETR07.Disconnections_ETR07_Y.Disconnection_SteeringSensor Disconnections_ETR07.Disconnections_ETR07_Y.Disconnection_Susp_F_L Disconnections_ETR07.Disconnections_ETR07_Y.Disconnection_Susp_F_R Disconnections_ETR07.Disconnections_ETR07_Y.Disconnection_Susp_R_L Disconnections_ETR07.Disconnections_ETR07_Y.Disconnection_Susp_R_R Disconnections_ETR07.Disconnections_ETR07_Y.TV_mode /end REF_MEASUREMENT
/end GROUP
/begin GROUP Disconnections_ETR07.Disconnections_ETR07_P ""
 /begin REF_CHARACTERISTIC Disconnections_ETR07.Disconnections_ETR07_P.Constant2_Value Disconnections_ETR07.Disconnections_ETR07_P.Constant_Value Disconnections_ETR07.Disconnections_ETR07_P.Constant_Value_c Disconnections_ETR07.Disconnections_ETR07_P.Constant_Value_d Disconnections_ETR07.Disconnections_ETR07_P.Constant_Value_e Disconnections_ETR07.Disconnections_ETR07_P.Constant_Value_h Disconnections_ETR07.Disconnections_ETR07_P.Constant_Value_i Disconnections_ETR07.Disconnections_ETR07_P.Constant_Value_ic Disconnections_ETR07.Disconnections_ETR07_P.Constant_Value_l Disconnections_ETR07.Disconnections_ETR07_P.Constant_Value_m Disconnections_ETR07.Disconnections_ETR07_P.Constant_Value_o Disconnections_ETR07.Disconnections_ETR07_P.DataStoreMemory1_InitialValue Disconnections_ETR07.Disconnections_ETR07_P.DataStoreMemory1_InitialValue_b Disconnections_ETR07.Disconnections_ETR07_P.DataStoreMemory1_InitialValue_c Disconnections_ETR07.Disconnections_ETR07_P.DataStoreMemory1_InitialValue_d Disconnections_ETR07.Disconnections_ETR07_P.DataStoreMemory1_InitialValue_m Disconnections_ETR07.Disconnections_ETR07_P.DataStoreMemory_InitialValue Disconnections_ETR07.Disconnections_ETR07_P.DataStoreMemory_InitialValue_b Disconnections_ETR07.Disconnections_ETR07_P.DataStoreMemory_InitialValue_ba Disconnections_ETR07.Disconnections_ETR07_P.DataStoreMemory_InitialValue_c Disconnections_ETR07.Disconnections_ETR07_P.DataStoreMemory_InitialValue_d Disconnections_ETR07.Disconnections_ETR07_P.DataStoreMemory_InitialValue_f Disconnections_ETR07.Disconnections_ETR07_P.DataStoreMemory_InitialValue_j Disconnections_ETR07.Disconnections_ETR07_P.DataStoreMemory_InitialValue_jc Disconnections_ETR07.Disconnections_ETR07_P.DataStoreMemory_InitialValue_k Disconnections_ETR07.Disconnections_ETR07_P.DataStoreMemory_InitialValue_kg Disconnections_ETR07.Disconnections_ETR07_P.DataStoreMemory_InitialValue_ks Disconnections_ETR07.Disconnections_ETR07_P.DataStoreMemory_InitialValue_m Disconnections_ETR07.Disconnections_ETR07_P.DataStoreMemory_InitialValue_o Disconnections_ETR07.Disconnections_ETR07_P.Merge_InitialOutput Disconnections_ETR07.Disconnections_ETR07_P.Merge_InitialOutput_a Disconnections_ETR07.Disconnections_ETR07_P.Merge_InitialOutput_b Disconnections_ETR07.Disconnections_ETR07_P.Merge_InitialOutput_l Disconnections_ETR07.Disconnections_ETR07_P.Merge_InitialOutput_m Disconnections_ETR07.Disconnections_ETR07_P.Merge_InitialOutput_o Disconnections_ETR07.Disconnections_ETR07_P.Merge_InitialOutput_p /end REF_CHARACTERISTIC
/end GROUP
/begin GROUP inverters_action_ETR07 "" ROOT
 /begin REF_MEASUREMENT inverters_action_ETR07.inverters_action_ETR07_B.Merge inverters_action_ETR07.inverters_action_ETR07_B.Merge2 inverters_action_ETR07.inverters_action_ETR07_B.Merge2_p inverters_action_ETR07.inverters_action_ETR07_B.subscribed inverters_action_ETR07.inverters_action_ETR07_B.subscribed_b inverters_action_ETR07.inverters_action_ETR07_DW.EnumerationCounter inverters_action_ETR07.inverters_action_ETR07_DW.EnumerationCounter_m inverters_action_ETR07.inverters_action_ETR07_DW.LastAction inverters_action_ETR07.inverters_action_ETR07_DW.LastAction_k inverters_action_ETR07.inverters_action_ETR07_U.InvertersAction inverters_action_ETR07.inverters_action_ETR07_U.current_L inverters_action_ETR07.inverters_action_ETR07_U.current_R inverters_action_ETR07.inverters_action_ETR07_Y.Inverter_L_RegID inverters_action_ETR07.inverters_action_ETR07_Y.Inverter_L_b15tob8 inverters_action_ETR07.inverters_action_ETR07_Y.Inverter_L_b7tob0 inverters_action_ETR07.inverters_action_ETR07_Y.Inverter_R_RegID inverters_action_ETR07.inverters_action_ETR07_Y.Inverter_R_b15tob8 inverters_action_ETR07.inverters_action_ETR07_Y.Inverter_R_b7tob0 inverters_action_ETR07.inverters_action_ETR07_Y.InvertersSubscribed /end REF_MEASUREMENT
 /begin REF_CHARACTERISTIC inverters_action_ETR07.inverters_action_ETR07_P.Constant_Value inverters_action_ETR07.inverters_action_ETR07_P.Constant_Value_m inverters_action_ETR07.inverters_action_ETR07_P.DataStoreMemory1_InitialValue inverters_action_ETR07.inverters_action_ETR07_P.DataStoreMemory1_InitialValue_m inverters_action_ETR07.inverters_action_ETR07_P.DataStoreMemory2_InitialValue inverters_action_ETR07.inverters_action_ETR07_P.DataStoreMemory2_InitialValue_c inverters_action_ETR07.inverters_action_ETR07_P.Delay_DelayLength inverters_action_ETR07.inverters_action_ETR07_P.Delay_DelayLength_h inverters_action_ETR07.inverters_action_ETR07_P.Delay_InitialCondition inverters_action_ETR07.inverters_action_ETR07_P.Delay_InitialCondition_o inverters_action_ETR07.inverters_action_ETR07_P.Merge_InitialOutput inverters_action_ETR07.inverters_action_ETR07_P.TimeInterval_Value inverters_action_ETR07.inverters_action_ETR07_P.TimeInterval_Value_d inverters_action_ETR07.inverters_action_ETR07_P._Value inverters_action_ETR07.inverters_action_ETR07_P.subscribed_InitialOutput inverters_action_ETR07.inverters_action_ETR07_P.subscribed_InitialOutput_k inverters_action_ETR07.inverters_action_ETR07_P.u_Value /end REF_CHARACTERISTIC
 /begin SUB_GROUP inverters_action_ETR07.inverters_action_ETR07_B inverters_action_ETR07.inverters_action_ETR07_DW inverters_action_ETR07.inverters_action_ETR07_U inverters_action_ETR07.inverters_action_ETR07_Y inverters_action_ETR07.inverters_action_ETR07_P /end SUB_GROUP
/end GROUP
/begin GROUP inverters_action_ETR07.inverters_action_ETR07_B ""
 /begin REF_MEASUREMENT inverters_action_ETR07.inverters_action_ETR07_B.Merge inverters_action_ETR07.inverters_action_ETR07_B.Merge2 inverters_action_ETR07.inverters_action_ETR07_B.Merge2_p inverters_action_ETR07.inverters_action_ETR07_B.subscribed inverters_action_ETR07.inverters_action_ETR07_B.subscribed_b /end REF_MEASUREMENT
/end GROUP
/begin GROUP inverters_action_ETR07.inverters_action_ETR07_DW ""
 /begin REF_MEASUREMENT inverters_action_ETR07.inverters_action_ETR07_DW.EnumerationCounter inverters_action_ETR07.inverters_action_ETR07_DW.EnumerationCounter_m inverters_action_ETR07.inverters_action_ETR07_DW.LastAction inverters_action_ETR07.inverters_action_ETR07_DW.LastAction_k /end REF_MEASUREMENT
/end GROUP
/begin GROUP inverters_action_ETR07.inverters_action_ETR07_U ""
 /begin REF_MEASUREMENT inverters_action_ETR07.inverters_action_ETR07_U.InvertersAction inverters_action_ETR07.inverters_action_ETR07_U.current_L inverters_action_ETR07.inverters_action_ETR07_U.current_R /end REF_MEASUREMENT
/end GROUP
/begin GROUP inverters_action_ETR07.inverters_action_ETR07_Y ""
 /begin REF_MEASUREMENT inverters_action_ETR07.inverters_action_ETR07_Y.Inverter_L_RegID inverters_action_ETR07.inverters_action_ETR07_Y.Inverter_L_b15tob8 inverters_action_ETR07.inverters_action_ETR07_Y.Inverter_L_b7tob0 inverters_action_ETR07.inverters_action_ETR07_Y.Inverter_R_RegID inverters_action_ETR07.inverters_action_ETR07_Y.Inverter_R_b15tob8 inverters_action_ETR07.inverters_action_ETR07_Y.Inverter_R_b7tob0 inverters_action_ETR07.inverters_action_ETR07_Y.InvertersSubscribed /end REF_MEASUREMENT
/end GROUP
/begin GROUP inverters_action_ETR07.inverters_action_ETR07_P ""
 /begin REF_CHARACTERISTIC inverters_action_ETR07.inverters_action_ETR07_P.Constant_Value inverters_action_ETR07.inverters_action_ETR07_P.Constant_Value_m inverters_action_ETR07.inverters_action_ETR07_P.DataStoreMemory1_InitialValue inverters_action_ETR07.inverters_action_ETR07_P.DataStoreMemory1_InitialValue_m inverters_action_ETR07.inverters_action_ETR07_P.DataStoreMemory2_InitialValue inverters_action_ETR07.inverters_action_ETR07_P.DataStoreMemory2_InitialValue_c inverters_action_ETR07.inverters_action_ETR07_P.Delay_DelayLength inverters_action_ETR07.inverters_action_ETR07_P.Delay_DelayLength_h inverters_action_ETR07.inverters_action_ETR07_P.Delay_InitialCondition inverters_action_ETR07.inverters_action_ETR07_P.Delay_InitialCondition_o inverters_action_ETR07.inverters_action_ETR07_P.Merge_InitialOutput inverters_action_ETR07.inverters_action_ETR07_P.TimeInterval_Value inverters_action_ETR07.inverters_action_ETR07_P.TimeInterval_Value_d inverters_action_ETR07.inverters_action_ETR07_P._Value inverters_action_ETR07.inverters_action_ETR07_P.subscribed_InitialOutput inverters_action_ETR07.inverters_action_ETR07_P.subscribed_InitialOutput_k inverters_action_ETR07.inverters_action_ETR07_P.u_Value /end REF_CHARACTERISTIC
/end GROUP
/begin GROUP Inverters_Data_ETR07 "" ROOT
 /begin REF_MEASUREMENT Inverters_Data_ETR07.Inverters_Data_ETR07_U.Inv_L_RegID_M235_Inv_L_DCBus Inverters_Data_ETR07.Inverters_Data_ETR07_U.Inv_L_RegID_M32_Inv_L_Iactual Inverters_Data_ETR07.Inverters_Data_ETR07_U.Inv_L_RegID_M38_Inv_L_Icommand Inverters_Data_ETR07.Inverters_Data_ETR07_U.Inv_L_RegID_M39_Inv_L_Iq Inverters_Data_ETR07.Inverters_Data_ETR07_U.Inv_L_RegID_M48_Inv_L_Speed Inverters_Data_ETR07.Inverters_Data_ETR07_U.Inv_L_RegID_M73_Inv_L_TempMotor Inverters_Data_ETR07.Inverters_Data_ETR07_U.Inv_L_RegID_M74_Inv_L_TempIGBT Inverters_Data_ETR07.Inverters_Data_ETR07_U.Inv_R_RegID_M235_Inv_R_DCBus Inverters_Data_ETR07.Inverters_Data_ETR07_U.Inv_R_RegID_M32_Inv_R_Iactual Inverters_Data_ETR07.Inverters_Data_ETR07_U.Inv_R_RegID_M38_Inv_R_Icommand Inverters_Data_ETR07.Inverters_Data_ETR07_U.Inv_R_RegID_M39_Inv_R_Iq Inverters_Data_ETR07.Inverters_Data_ETR07_U.Inv_R_RegID_M48_Inv_R_Speed Inverters_Data_ETR07.Inverters_Data_ETR07_U.Inv_R_RegID_M73_Inv_R_TempMotor Inverters_Data_ETR07.Inverters_Data_ETR07_U.Inv_R_RegID_M74_Inv_R_TempIGBT Inverters_Data_ETR07.Inverters_Data_ETR07_U.Torque_L Inverters_Data_ETR07.Inverters_Data_ETR07_U.Torque_R Inverters_Data_ETR07.Inverters_Data_ETR07_Y.Inv_L_Iactual Inverters_Data_ETR07.Inverters_Data_ETR07_Y.Inv_L_Icommand Inverters_Data_ETR07.Inverters_Data_ETR07_Y.Inv_L_Iq Inverters_Data_ETR07.Inverters_Data_ETR07_Y.Inv_L_Speed Inverters_Data_ETR07.Inverters_Data_ETR07_Y.Inv_L_TempIGBT Inverters_Data_ETR07.Inverters_Data_ETR07_Y.Inv_L_TempMotor Inverters_Data_ETR07.Inverters_Data_ETR07_Y.Inv_L_VdcBus Inverters_Data_ETR07.Inverters_Data_ETR07_Y.Inv_R_Iactual Inverters_Data_ETR07.Inverters_Data_ETR07_Y.Inv_R_Icommand Inverters_Data_ETR07.Inverters_Data_ETR07_Y.Inv_R_Iq Inverters_Data_ETR07.Inverters_Data_ETR07_Y.Inv_R_Speed Inverters_Data_ETR07.Inverters_Data_ETR07_Y.Inv_R_TempIGBT Inverters_Data_ETR07.Inverters_Data_ETR07_Y.Inv_R_TempMotor Inverters_Data_ETR07.Inverters_Data_ETR07_Y.Inv_R_VdcBus Inverters_Data_ETR07.Inverters_Data_ETR07_Y.InvertersMinDCBus Inverters_Data_ETR07.Inverters_Data_ETR07_Y.Mech_Power Inverters_Data_ETR07.Inverters_Data_ETR07_Y.RL_rads Inverters_Data_ETR07.Inverters_Data_ETR07_Y.RR_rads Inverters_Data_ETR07.Inverters_Data_ETR07_Y.Speed Inverters_Data_ETR07.Inverters_Data_ETR07_Y.Temp_IGBT Inverters_Data_ETR07.Inverters_Data_ETR07_Y.Temp_Motors Inverters_Data_ETR07.Inverters_Data_ETR07_Y.Vel_RL_kmh Inverters_Data_ETR07.Inverters_Data_ETR07_Y.Vel_RR_kmh /end REF_MEASUREMENT
 /begin REF_CHARACTERISTIC Inverters_Data_ETR07.Inverters_Data_ETR07_P.A1_Value Inverters_Data_ETR07.Inverters_Data_ETR07_P.A1_Value_e Inverters_Data_ETR07.Inverters_Data_ETR07_P.B1_Value Inverters_Data_ETR07.Inverters_Data_ETR07_P.B1_Value_i Inverters_Data_ETR07.Inverters_Data_ETR07_P.Bitct_Value Inverters_Data_ETR07.Inverters_Data_ETR07_P.Bitct_Value_h Inverters_Data_ETR07.Inverters_Data_ETR07_P.C1_Value Inverters_Data_ETR07.Inverters_Data_ETR07_P.C1_Value_d Inverters_Data_ETR07.Inverters_Data_ETR07_P.C1_Value_n Inverters_Data_ETR07.Inverters_Data_ETR07_P.C1_Value_n0 Inverters_Data_ETR07.Inverters_Data_ETR07_P.Constant1_Value Inverters_Data_ETR07.Inverters_Data_ETR07_P.Constant1_Value_e Inverters_Data_ETR07.Inverters_Data_ETR07_P.D1_Value Inverters_Data_ETR07.Inverters_Data_ETR07_P.D1_Value_d Inverters_Data_ETR07.Inverters_Data_ETR07_P.D1_Value_f Inverters_Data_ETR07.Inverters_Data_ETR07_P.D1_Value_j Inverters_Data_ETR07.Inverters_Data_ETR07_P.Diameterm_Gain Inverters_Data_ETR07.Inverters_Data_ETR07_P.Diameterm_Gain_p Inverters_Data_ETR07.Inverters_Data_ETR07_P.Gain_Gain Inverters_Data_ETR07.Inverters_Data_ETR07_P.Gain_Gain_a Inverters_Data_ETR07.Inverters_Data_ETR07_P.Gain_Gain_e Inverters_Data_ETR07.Inverters_Data_ETR07_P.Gain_Gain_f Inverters_Data_ETR07.Inverters_Data_ETR07_P.Gain_Gain_m Inverters_Data_ETR07.Inverters_Data_ETR07_P.MaxRPM_Value Inverters_Data_ETR07.Inverters_Data_ETR07_P.MaxRPM_Value_m Inverters_Data_ETR07.Inverters_Data_ETR07_P.conversionratio1_Gain Inverters_Data_ETR07.Inverters_Data_ETR07_P.conversionratio_Gain Inverters_Data_ETR07.Inverters_Data_ETR07_P.conversionratio_Gain_c Inverters_Data_ETR07.Inverters_Data_ETR07_P.conversionratio_Gain_j Inverters_Data_ETR07.Inverters_Data_ETR07_P.conversionratio_Gain_k Inverters_Data_ETR07.Inverters_Data_ETR07_P.conversionratio_Gain_o Inverters_Data_ETR07.Inverters_Data_ETR07_P.direction_Gain Inverters_Data_ETR07.Inverters_Data_ETR07_P.direction_Gain_f Inverters_Data_ETR07.Inverters_Data_ETR07_P.ratio_Gain Inverters_Data_ETR07.Inverters_Data_ETR07_P.ratio_Gain_k Inverters_Data_ETR07.Inverters_Data_ETR07_P.upi60_Gain Inverters_Data_ETR07.Inverters_Data_ETR07_P.upi60_Gain_i /end REF_CHARACTERISTIC
 /begin SUB_GROUP Inverters_Data_ETR07.Inverters_Data_ETR07_U Inverters_Data_ETR07.Inverters_Data_ETR07_Y Inverters_Data_ETR07.Inverters_Data_ETR07_P /end SUB_GROUP
/end GROUP
/begin GROUP Inverters_Data_ETR07.Inverters_Data_ETR07_U ""
 /begin REF_MEASUREMENT Inverters_Data_ETR07.Inverters_Data_ETR07_U.Inv_L_RegID_M235_Inv_L_DCBus Inverters_Data_ETR07.Inverters_Data_ETR07_U.Inv_L_RegID_M32_Inv_L_Iactual Inverters_Data_ETR07.Inverters_Data_ETR07_U.Inv_L_RegID_M38_Inv_L_Icommand Inverters_Data_ETR07.Inverters_Data_ETR07_U.Inv_L_RegID_M39_Inv_L_Iq Inverters_Data_ETR07.Inverters_Data_ETR07_U.Inv_L_RegID_M48_Inv_L_Speed Inverters_Data_ETR07.Inverters_Data_ETR07_U.Inv_L_RegID_M73_Inv_L_TempMotor Inverters_Data_ETR07.Inverters_Data_ETR07_U.Inv_L_RegID_M74_Inv_L_TempIGBT Inverters_Data_ETR07.Inverters_Data_ETR07_U.Inv_R_RegID_M235_Inv_R_DCBus Inverters_Data_ETR07.Inverters_Data_ETR07_U.Inv_R_RegID_M32_Inv_R_Iactual Inverters_Data_ETR07.Inverters_Data_ETR07_U.Inv_R_RegID_M38_Inv_R_Icommand Inverters_Data_ETR07.Inverters_Data_ETR07_U.Inv_R_RegID_M39_Inv_R_Iq Inverters_Data_ETR07.Inverters_Data_ETR07_U.Inv_R_RegID_M48_Inv_R_Speed Inverters_Data_ETR07.Inverters_Data_ETR07_U.Inv_R_RegID_M73_Inv_R_TempMotor Inverters_Data_ETR07.Inverters_Data_ETR07_U.Inv_R_RegID_M74_Inv_R_TempIGBT Inverters_Data_ETR07.Inverters_Data_ETR07_U.Torque_L Inverters_Data_ETR07.Inverters_Data_ETR07_U.Torque_R /end REF_MEASUREMENT
/end GROUP
/begin GROUP Inverters_Data_ETR07.Inverters_Data_ETR07_Y ""
 /begin REF_MEASUREMENT Inverters_Data_ETR07.Inverters_Data_ETR07_Y.Inv_L_Iactual Inverters_Data_ETR07.Inverters_Data_ETR07_Y.Inv_L_Icommand Inverters_Data_ETR07.Inverters_Data_ETR07_Y.Inv_L_Iq Inverters_Data_ETR07.Inverters_Data_ETR07_Y.Inv_L_Speed Inverters_Data_ETR07.Inverters_Data_ETR07_Y.Inv_L_TempIGBT Inverters_Data_ETR07.Inverters_Data_ETR07_Y.Inv_L_TempMotor Inverters_Data_ETR07.Inverters_Data_ETR07_Y.Inv_L_VdcBus Inverters_Data_ETR07.Inverters_Data_ETR07_Y.Inv_R_Iactual Inverters_Data_ETR07.Inverters_Data_ETR07_Y.Inv_R_Icommand Inverters_Data_ETR07.Inverters_Data_ETR07_Y.Inv_R_Iq Inverters_Data_ETR07.Inverters_Data_ETR07_Y.Inv_R_Speed Inverters_Data_ETR07.Inverters_Data_ETR07_Y.Inv_R_TempIGBT Inverters_Data_ETR07.Inverters_Data_ETR07_Y.Inv_R_TempMotor Inverters_Data_ETR07.Inverters_Data_ETR07_Y.Inv_R_VdcBus Inverters_Data_ETR07.Inverters_Data_ETR07_Y.InvertersMinDCBus Inverters_Data_ETR07.Inverters_Data_ETR07_Y.Mech_Power Inverters_Data_ETR07.Inverters_Data_ETR07_Y.RL_rads Inverters_Data_ETR07.Inverters_Data_ETR07_Y.RR_rads Inverters_Data_ETR07.Inverters_Data_ETR07_Y.Speed Inverters_Data_ETR07.Inverters_Data_ETR07_Y.Temp_IGBT Inverters_Data_ETR07.Inverters_Data_ETR07_Y.Temp_Motors Inverters_Data_ETR07.Inverters_Data_ETR07_Y.Vel_RL_kmh Inverters_Data_ETR07.Inverters_Data_ETR07_Y.Vel_RR_kmh /end REF_MEASUREMENT
/end GROUP
/begin GROUP Inverters_Data_ETR07.Inverters_Data_ETR07_P ""
 /begin REF_CHARACTERISTIC Inverters_Data_ETR07.Inverters_Data_ETR07_P.A1_Value Inverters_Data_ETR07.Inverters_Data_ETR07_P.A1_Value_e Inverters_Data_ETR07.Inverters_Data_ETR07_P.B1_Value Inverters_Data_ETR07.Inverters_Data_ETR07_P.B1_Value_i Inverters_Data_ETR07.Inverters_Data_ETR07_P.Bitct_Value Inverters_Data_ETR07.Inverters_Data_ETR07_P.Bitct_Value_h Inverters_Data_ETR07.Inverters_Data_ETR07_P.C1_Value Inverters_Data_ETR07.Inverters_Data_ETR07_P.C1_Value_d Inverters_Data_ETR07.Inverters_Data_ETR07_P.C1_Value_n Inverters_Data_ETR07.Inverters_Data_ETR07_P.C1_Value_n0 Inverters_Data_ETR07.Inverters_Data_ETR07_P.Constant1_Value Inverters_Data_ETR07.Inverters_Data_ETR07_P.Constant1_Value_e Inverters_Data_ETR07.Inverters_Data_ETR07_P.D1_Value Inverters_Data_ETR07.Inverters_Data_ETR07_P.D1_Value_d Inverters_Data_ETR07.Inverters_Data_ETR07_P.D1_Value_f Inverters_Data_ETR07.Inverters_Data_ETR07_P.D1_Value_j Inverters_Data_ETR07.Inverters_Data_ETR07_P.Diameterm_Gain Inverters_Data_ETR07.Inverters_Data_ETR07_P.Diameterm_Gain_p Inverters_Data_ETR07.Inverters_Data_ETR07_P.Gain_Gain Inverters_Data_ETR07.Inverters_Data_ETR07_P.Gain_Gain_a Inverters_Data_ETR07.Inverters_Data_ETR07_P.Gain_Gain_e Inverters_Data_ETR07.Inverters_Data_ETR07_P.Gain_Gain_f Inverters_Data_ETR07.Inverters_Data_ETR07_P.Gain_Gain_m Inverters_Data_ETR07.Inverters_Data_ETR07_P.MaxRPM_Value Inverters_Data_ETR07.Inverters_Data_ETR07_P.MaxRPM_Value_m Inverters_Data_ETR07.Inverters_Data_ETR07_P.conversionratio1_Gain Inverters_Data_ETR07.Inverters_Data_ETR07_P.conversionratio_Gain Inverters_Data_ETR07.Inverters_Data_ETR07_P.conversionratio_Gain_c Inverters_Data_ETR07.Inverters_Data_ETR07_P.conversionratio_Gain_j Inverters_Data_ETR07.Inverters_Data_ETR07_P.conversionratio_Gain_k Inverters_Data_ETR07.Inverters_Data_ETR07_P.conversionratio_Gain_o Inverters_Data_ETR07.Inverters_Data_ETR07_P.direction_Gain Inverters_Data_ETR07.Inverters_Data_ETR07_P.direction_Gain_f Inverters_Data_ETR07.Inverters_Data_ETR07_P.ratio_Gain Inverters_Data_ETR07.Inverters_Data_ETR07_P.ratio_Gain_k Inverters_Data_ETR07.Inverters_Data_ETR07_P.upi60_Gain Inverters_Data_ETR07.Inverters_Data_ETR07_P.upi60_Gain_i /end REF_CHARACTERISTIC
/end GROUP
/begin GROUP LVD_Data_ETR07 "" ROOT
 /begin REF_MEASUREMENT LVD_Data_ETR07.LVD_Data_ETR07_DW.Previous_IN LVD_Data_ETR07.LVD_Data_ETR07_DW.Previous_OUT LVD_Data_ETR07.LVD_Data_ETR07_U.LVBattery_Voltage_Bits LVD_Data_ETR07.LVD_Data_ETR07_Y.LVbattery_Voltage /end REF_MEASUREMENT
 /begin REF_CHARACTERISTIC LVD_Data_ETR07.LVD_Data_ETR07_P.DataStoreMemory1_InitialValue LVD_Data_ETR07.LVD_Data_ETR07_P.DataStoreMemory_InitialValue LVD_Data_ETR07.LVD_Data_ETR07_P.MaxBits2_Value LVD_Data_ETR07.LVD_Data_ETR07_P.MaxBits_Value LVD_Data_ETR07.LVD_Data_ETR07_P.Vmax_Value LVD_Data_ETR07.LVD_Data_ETR07_P.Vmin_Value LVD_Data_ETR07.LVD_Data_ETR07_P.ct_Value LVD_Data_ETR07.LVD_Data_ETR07_P.exptcycletau1_Value /end REF_CHARACTERISTIC
 /begin SUB_GROUP LVD_Data_ETR07.LVD_Data_ETR07_DW LVD_Data_ETR07.LVD_Data_ETR07_U LVD_Data_ETR07.LVD_Data_ETR07_Y LVD_Data_ETR07.LVD_Data_ETR07_P /end SUB_GROUP
/end GROUP
/begin GROUP LVD_Data_ETR07.LVD_Data_ETR07_DW ""
 /begin REF_MEASUREMENT LVD_Data_ETR07.LVD_Data_ETR07_DW.Previous_IN LVD_Data_ETR07.LVD_Data_ETR07_DW.Previous_OUT /end REF_MEASUREMENT
/end GROUP
/begin GROUP LVD_Data_ETR07.LVD_Data_ETR07_U "" /begin REF_MEASUREMENT LVD_Data_ETR07.LVD_Data_ETR07_U.LVBattery_Voltage_Bits /end REF_MEASUREMENT /end GROUP
/begin GROUP LVD_Data_ETR07.LVD_Data_ETR07_Y "" /begin REF_MEASUREMENT LVD_Data_ETR07.LVD_Data_ETR07_Y.LVbattery_Voltage /end REF_MEASUREMENT /end GROUP
/begin GROUP LVD_Data_ETR07.LVD_Data_ETR07_P ""
 /begin REF_CHARACTERISTIC LVD_Data_ETR07.LVD_Data_ETR07_P.DataStoreMemory1_InitialValue LVD_Data_ETR07.LVD_Data_ETR07_P.DataStoreMemory_InitialValue LVD_Data_ETR07.LVD_Data_ETR07_P.MaxBits2_Value LVD_Data_ETR07.LVD_Data_ETR07_P.MaxBits_Value LVD_Data_ETR07.LVD_Data_ETR07_P.Vmax_Value LVD_Data_ETR07.LVD_Data_ETR07_P.Vmin_Value LVD_Data_ETR07.LVD_Data_ETR07_P.ct_Value LVD_Data_ETR07.LVD_Data_ETR07_P.exptcycletau1_Value /end REF_CHARACTERISTIC
/end GROUP
/begin GROUP Pedals_Susp_Sensors_ETR07 "" ROOT
 /begin REF_MEASUREMENT Pedals_Susp_Sensors_ETR07.Pedals_Susp_Sensors_ETR07_U.APPS1_Bits Pedals_Susp_Sensors_ETR07.Pedals_Susp_Sensors_ETR07_U.APPS2_Bits Pedals_Susp_Sensors_ETR07.Pedals_Susp_Sensors_ETR07_U.BrakeSensor_Bits Pedals_Susp_Sensors_ETR07.Pedals_Susp_Sensors_ETR07_U.Susp_F_L_Bits Pedals_Susp_Sensors_ETR07.Pedals_Susp_Sensors_ETR07_U.Susp_F_R_Bits Pedals_Susp_Sensors_ETR07.Pedals_Susp_Sensors_ETR07_U.Susp_R_L_Bits Pedals_Susp_Sensors_ETR07.Pedals_Susp_Sensors_ETR07_U.Susp_R_R_Bits Pedals_Susp_Sensors_ETR07.Pedals_Susp_Sensors_ETR07_Y.APPS1_Value Pedals_Susp_Sensors_ETR07.Pedals_Susp_Sensors_ETR07_Y.APPS2_Value Pedals_Susp_Sensors_ETR07.Pedals_Susp_Sensors_ETR07_Y.BrakeLight_Control Pedals_Susp_Sensors_ETR07.Pedals_Susp_Sensors_ETR07_Y.BrakeSensor_Value Pedals_Susp_Sensors_ETR07.Pedals_Susp_Sensors_ETR07_Y.SUSP_F_L Pedals_Susp_Sensors_ETR07.Pedals_Susp_Sensors_ETR07_Y.SUSP_F_R Pedals_Susp_Sensors_ETR07.Pedals_Susp_Sensors_ETR07_Y.SUSP_R_L Pedals_Susp_Sensors_ETR07.Pedals_Susp_Sensors_ETR07_Y.SUSP_R_R /end REF_MEASUREMENT
 /begin REF_CHARACTERISTIC Pedals_Susp_Sensors_ETR07.Pedals_Susp_Sensors_ETR07_P.Brake_Light_Threshold_Value Pedals_Susp_Sensors_ETR07.Pedals_Susp_Sensors_ETR07_P.Ctemuelles_Gain Pedals_Susp_Sensors_ETR07.Pedals_Susp_Sensors_ETR07_P.Ctemuelles_Gain_e Pedals_Susp_Sensors_ETR07.Pedals_Susp_Sensors_ETR07_P.Ctemuelles_Gain_f Pedals_Susp_Sensors_ETR07.Pedals_Susp_Sensors_ETR07_P.Ctemuelles_Gain_j Pedals_Susp_Sensors_ETR07.Pedals_Susp_Sensors_ETR07_P.Experimental_Zero_Value Pedals_Susp_Sensors_ETR07.Pedals_Susp_Sensors_ETR07_P.Experimental_Zero_Value_a Pedals_Susp_Sensors_ETR07.Pedals_Susp_Sensors_ETR07_P.Experimental_Zero_Value_e Pedals_Susp_Sensors_ETR07.Pedals_Susp_Sensors_ETR07_P.Experimental_Zero_Value_f Pedals_Susp_Sensors_ETR07.Pedals_Susp_Sensors_ETR07_P.Ltotal_Gain Pedals_Susp_Sensors_ETR07.Pedals_Susp_Sensors_ETR07_P.Ltotal_Gain_c Pedals_Susp_Sensors_ETR07.Pedals_Susp_Sensors_ETR07_P.Ltotal_Gain_d Pedals_Susp_Sensors_ETR07.Pedals_Susp_Sensors_ETR07_P.Ltotal_Gain_e Pedals_Susp_Sensors_ETR07.Pedals_Susp_Sensors_ETR07_P.ON_Value Pedals_Susp_Sensors_ETR07.Pedals_Susp_Sensors_ETR07_P.Off_Value Pedals_Susp_Sensors_ETR07.Pedals_Susp_Sensors_ETR07_P.bitsmax_Value Pedals_Susp_Sensors_ETR07.Pedals_Susp_Sensors_ETR07_P.bitsmax_Value_e Pedals_Susp_Sensors_ETR07.Pedals_Susp_Sensors_ETR07_P.bitsmax_Value_g Pedals_Susp_Sensors_ETR07.Pedals_Susp_Sensors_ETR07_P.bitsmax_Value_n Pedals_Susp_Sensors_ETR07.Pedals_Susp_Sensors_ETR07_P.max_Value Pedals_Susp_Sensors_ETR07.Pedals_Susp_Sensors_ETR07_P.max_Value_a Pedals_Susp_Sensors_ETR07.Pedals_Susp_Sensors_ETR07_P.max_Value_f Pedals_Susp_Sensors_ETR07.Pedals_Susp_Sensors_ETR07_P.min_Value Pedals_Susp_Sensors_ETR07.Pedals_Susp_Sensors_ETR07_P.min_Value_a Pedals_Susp_Sensors_ETR07.Pedals_Susp_Sensors_ETR07_P.min_Value_g /end REF_CHARACTERISTIC
 /begin SUB_GROUP Pedals_Susp_Sensors_ETR07.Pedals_Susp_Sensors_ETR07_U Pedals_Susp_Sensors_ETR07.Pedals_Susp_Sensors_ETR07_Y Pedals_Susp_Sensors_ETR07.Pedals_Susp_Sensors_ETR07_P /end SUB_GROUP
/end GROUP
/begin GROUP Pedals_Susp_Sensors_ETR07.Pedals_Susp_Sensors_ETR07_U ""
 /begin REF_MEASUREMENT Pedals_Susp_Sensors_ETR07.Pedals_Susp_Sensors_ETR07_U.APPS1_Bits Pedals_Susp_Sensors_ETR07.Pedals_Susp_Sensors_ETR07_U.APPS2_Bits Pedals_Susp_Sensors_ETR07.Pedals_Susp_Sensors_ETR07_U.BrakeSensor_Bits Pedals_Susp_Sensors_ETR07.Pedals_Susp_Sensors_ETR07_U.Susp_F_L_Bits Pedals_Susp_Sensors_ETR07.Pedals_Susp_Sensors_ETR07_U.Susp_F_R_Bits Pedals_Susp_Sensors_ETR07.Pedals_Susp_Sensors_ETR07_U.Susp_R_L_Bits Pedals_Susp_Sensors_ETR07.Pedals_Susp_Sensors_ETR07_U.Susp_R_R_Bits /end REF_MEASUREMENT
/end GROUP
/begin GROUP Pedals_Susp_Sensors_ETR07.Pedals_Susp_Sensors_ETR07_Y ""
 /begin REF_MEASUREMENT Pedals_Susp_Sensors_ETR07.Pedals_Susp_Sensors_ETR07_Y.APPS1_Value Pedals_Susp_Sensors_ETR07.Pedals_Susp_Sensors_ETR07_Y.APPS2_Value Pedals_Susp_Sensors_ETR07.Pedals_Susp_Sensors_ETR07_Y.BrakeLight_Control Pedals_Susp_Sensors_ETR07.Pedals_Susp_Sensors_ETR07_Y.BrakeSensor_Value Pedals_Susp_Sensors_ETR07.Pedals_Susp_Sensors_ETR07_Y.SUSP_F_L Pedals_Susp_Sensors_ETR07.Pedals_Susp_Sensors_ETR07_Y.SUSP_F_R Pedals_Susp_Sensors_ETR07.Pedals_Susp_Sensors_ETR07_Y.SUSP_R_L Pedals_Susp_Sensors_ETR07.Pedals_Susp_Sensors_ETR07_Y.SUSP_R_R /end REF_MEASUREMENT
/end GROUP
/begin GROUP Pedals_Susp_Sensors_ETR07.Pedals_Susp_Sensors_ETR07_P ""
 /begin REF_CHARACTERISTIC Pedals_Susp_Sensors_ETR07.Pedals_Susp_Sensors_ETR07_P.Brake_Light_Threshold_Value Pedals_Susp_Sensors_ETR07.Pedals_Susp_Sensors_ETR07_P.Ctemuelles_Gain Pedals_Susp_Sensors_ETR07.Pedals_Susp_Sensors_ETR07_P.Ctemuelles_Gain_e Pedals_Susp_Sensors_ETR07.Pedals_Susp_Sensors_ETR07_P.Ctemuelles_Gain_f Pedals_Susp_Sensors_ETR07.Pedals_Susp_Sensors_ETR07_P.Ctemuelles_Gain_j Pedals_Susp_Sensors_ETR07.Pedals_Susp_Sensors_ETR07_P.Experimental_Zero_Value Pedals_Susp_Sensors_ETR07.Pedals_Susp_Sensors_ETR07_P.Experimental_Zero_Value_a Pedals_Susp_Sensors_ETR07.Pedals_Susp_Sensors_ETR07_P.Experimental_Zero_Value_e Pedals_Susp_Sensors_ETR07.Pedals_Susp_Sensors_ETR07_P.Experimental_Zero_Value_f Pedals_Susp_Sensors_ETR07.Pedals_Susp_Sensors_ETR07_P.Ltotal_Gain Pedals_Susp_Sensors_ETR07.Pedals_Susp_Sensors_ETR07_P.Ltotal_Gain_c Pedals_Susp_Sensors_ETR07.Pedals_Susp_Sensors_ETR07_P.Ltotal_Gain_d Pedals_Susp_Sensors_ETR07.Pedals_Susp_Sensors_ETR07_P.Ltotal_Gain_e Pedals_Susp_Sensors_ETR07.Pedals_Susp_Sensors_ETR07_P.ON_Value Pedals_Susp_Sensors_ETR07.Pedals_Susp_Sensors_ETR07_P.Off_Value Pedals_Susp_Sensors_ETR07.Pedals_Susp_Sensors_ETR07_P.bitsmax_Value Pedals_Susp_Sensors_ETR07.Pedals_Susp_Sensors_ETR07_P.bitsmax_Value_e Pedals_Susp_Sensors_ETR07.Pedals_Susp_Sensors_ETR07_P.bitsmax_Value_g Pedals_Susp_Sensors_ETR07.Pedals_Susp_Sensors_ETR07_P.bitsmax_Value_n Pedals_Susp_Sensors_ETR07.Pedals_Susp_Sensors_ETR07_P.max_Value Pedals_Susp_Sensors_ETR07.Pedals_Susp_Sensors_ETR07_P.max_Value_a Pedals_Susp_Sensors_ETR07.Pedals_Susp_Sensors_ETR07_P.max_Value_f Pedals_Susp_Sensors_ETR07.Pedals_Susp_Sensors_ETR07_P.min_Value Pedals_Susp_Sensors_ETR07.Pedals_Susp_Sensors_ETR07_P.min_Value_a Pedals_Susp_Sensors_ETR07.Pedals_Susp_Sensors_ETR07_P.min_Value_g /end REF_CHARACTERISTIC
/end GROUP
/begin GROUP Racing_Mode_ETR07 "" ROOT
 /begin REF_MEASUREMENT Racing_Mode_ETR07.Racing_Mode_ETR07_B.Apps_Sat_Dwn.Gain Racing_Mode_ETR07.Racing_Mode_ETR07_B.Apps_Sat_Up.Gain Racing_Mode_ETR07.Racing_Mode_ETR07_B.CKF_Initial.Gain Racing_Mode_ETR07.Racing_Mode_ETR07_B.Cte_CKF.Gain Racing_Mode_ETR07.Racing_Mode_ETR07_B.Cte_SKF.Gain Racing_Mode_ETR07.Racing_Mode_ETR07_B.K_Reduction_P.Gain Racing_Mode_ETR07.Racing_Mode_ETR07_B.K_Reduction_Temperature.Gain Racing_Mode_ETR07.Racing_Mode_ETR07_B.Max_Regenerative_Torque.In1 Racing_Mode_ETR07.Racing_Mode_ETR07_B.Merge Racing_Mode_ETR07.Racing_Mode_ETR07_B.Power_Limit.In1 Racing_Mode_ETR07.Racing_Mode_ETR07_B.SKF_Initial.Gain Racing_Mode_ETR07.Racing_Mode_ETR07_U.CustomMode_Data Racing_Mode_ETR07.Racing_Mode_ETR07_U.CustomMode_Identifier Racing_Mode_ETR07.Racing_Mode_ETR07_U.RacingMode Racing_Mode_ETR07.Racing_Mode_ETR07_Y.VDC_Apps_Sat_Down Racing_Mode_ETR07.Racing_Mode_ETR07_Y.VDC_Apps_Sat_Up Racing_Mode_ETR07.Racing_Mode_ETR07_Y.VDC_CKF_Initial Racing_Mode_ETR07.Racing_Mode_ETR07_Y.VDC_Cte_CKF Racing_Mode_ETR07.Racing_Mode_ETR07_Y.VDC_Cte_SKF Racing_Mode_ETR07.Racing_Mode_ETR07_Y.VDC_K_Reduction_P Racing_Mode_ETR07.Racing_Mode_ETR07_Y.VDC_K_Reduction_Temperature Racing_Mode_ETR07.Racing_Mode_ETR07_Y.VDC_Max_Regenerative_Torque Racing_Mode_ETR07.Racing_Mode_ETR07_Y.VDC_Power_Limit Racing_Mode_ETR07.Racing_Mode_ETR07_Y.VDC_SKF_Initial Racing_Mode_ETR07.Racing_Mode_ETR07_Y.Workshop_Mode_Enable /end REF_MEASUREMENT
 /begin REF_CHARACTERISTIC Racing_Mode_ETR07.Racing_Mode_ETR07_P.Apps_Sat_DwnSaturation_LowerSat Racing_Mode_ETR07.Racing_Mode_ETR07_P.Apps_Sat_DwnSaturation_UpperSat Racing_Mode_ETR07.Racing_Mode_ETR07_P.Apps_Sat_UpSaturation_LowerSat Racing_Mode_ETR07.Racing_Mode_ETR07_P.Apps_Sat_UpSaturation_UpperSat Racing_Mode_ETR07.Racing_Mode_ETR07_P.CEE_Apps_Sat_Dwn_Value Racing_Mode_ETR07.Racing_Mode_ETR07_P.CEE_Apps_Sat_Up_Value Racing_Mode_ETR07.Racing_Mode_ETR07_P.CEE_CKF_Initial_Value Racing_Mode_ETR07.Racing_Mode_ETR07_P.CEE_Cte_CKF_Value Racing_Mode_ETR07.Racing_Mode_ETR07_P.CEE_Cte_SKF_Value Racing_Mode_ETR07.Racing_Mode_ETR07_P.CEE_K_Reduction_P_Value Racing_Mode_ETR07.Racing_Mode_ETR07_P.CEE_K_Reduction_Temperature_Val Racing_Mode_ETR07.Racing_Mode_ETR07_P.CEE_Max_Regenerative_Torque_Val Racing_Mode_ETR07.Racing_Mode_ETR07_P.CEE_Power_Limit_Value Racing_Mode_ETR07.Racing_Mode_ETR07_P.CEE_SKF_Initial_Value Racing_Mode_ETR07.Racing_Mode_ETR07_P.CKF_InitialSaturation_LowerSat Racing_Mode_ETR07.Racing_Mode_ETR07_P.CKF_InitialSaturation_UpperSat Racing_Mode_ETR07.Racing_Mode_ETR07_P.CompareToConstant_const Racing_Mode_ETR07.Racing_Mode_ETR07_P.Cte_CKFSaturation_LowerSat Racing_Mode_ETR07.Racing_Mode_ETR07_P.Cte_CKFSaturation_UpperSat Racing_Mode_ETR07.Racing_Mode_ETR07_P.Cte_SKFSaturation_LowerSat Racing_Mode_ETR07.Racing_Mode_ETR07_P.Cte_SKFSaturation_UpperSat Racing_Mode_ETR07.Racing_Mode_ETR07_P.K_Reduction_PSaturation_LowerSa Racing_Mode_ETR07.Racing_Mode_ETR07_P.K_Reduction_PSaturation_UpperSa Racing_Mode_ETR07.Racing_Mode_ETR07_P.K_Reduction_TemperatureSatura_m Racing_Mode_ETR07.Racing_Mode_ETR07_P.K_Reduction_TemperatureSaturati Racing_Mode_ETR07.Racing_Mode_ETR07_P.Max_Regenerative_TorqueSatura_o Racing_Mode_ETR07.Racing_Mode_ETR07_P.Max_Regenerative_TorqueSaturati Racing_Mode_ETR07.Racing_Mode_ETR07_P.Merge_InitialOutput Racing_Mode_ETR07.Racing_Mode_ETR07_P.Power_LimitSaturation_LowerSat Racing_Mode_ETR07.Racing_Mode_ETR07_P.Power_LimitSaturation_UpperSat Racing_Mode_ETR07.Racing_Mode_ETR07_P.SKF_InitialSaturation_LowerSat Racing_Mode_ETR07.Racing_Mode_ETR07_P.SKF_InitialSaturation_UpperSat /end REF_CHARACTERISTIC
 /begin SUB_GROUP Racing_Mode_ETR07.Racing_Mode_ETR07_B Racing_Mode_ETR07.Racing_Mode_ETR07_B.Apps_Sat_Dwn Racing_Mode_ETR07.Racing_Mode_ETR07_B.Apps_Sat_Up Racing_Mode_ETR07.Racing_Mode_ETR07_B.CKF_Initial Racing_Mode_ETR07.Racing_Mode_ETR07_B.Cte_CKF Racing_Mode_ETR07.Racing_Mode_ETR07_B.Cte_SKF Racing_Mode_ETR07.Racing_Mode_ETR07_B.K_Reduction_P Racing_Mode_ETR07.Racing_Mode_ETR07_B.K_Reduction_Temperature Racing_Mode_ETR07.Racing_Mode_ETR07_B.Max_Regenerative_Torque Racing_Mode_ETR07.Racing_Mode_ETR07_B.Power_Limit Racing_Mode_ETR07.Racing_Mode_ETR07_B.SKF_Initial Racing_Mode_ETR07.Racing_Mode_ETR07_U Racing_Mode_ETR07.Racing_Mode_ETR07_Y Racing_Mode_ETR07.Racing_Mode_ETR07_P /end SUB_GROUP
/end GROUP
/begin GROUP Racing_Mode_ETR07.Racing_Mode_ETR07_B ""
 /begin REF_MEASUREMENT Racing_Mode_ETR07.Racing_Mode_ETR07_B.Apps_Sat_Dwn.Gain Racing_Mode_ETR07.Racing_Mode_ETR07_B.Apps_Sat_Up.Gain Racing_Mode_ETR07.Racing_Mode_ETR07_B.CKF_Initial.Gain Racing_Mode_ETR07.Racing_Mode_ETR07_B.Cte_CKF.Gain Racing_Mode_ETR07.Racing_Mode_ETR07_B.Cte_SKF.Gain Racing_Mode_ETR07.Racing_Mode_ETR07_B.K_Reduction_P.Gain Racing_Mode_ETR07.Racing_Mode_ETR07_B.K_Reduction_Temperature.Gain Racing_Mode_ETR07.Racing_Mode_ETR07_B.Max_Regenerative_Torque.In1 Racing_Mode_ETR07.Racing_Mode_ETR07_B.Merge Racing_Mode_ETR07.Racing_Mode_ETR07_B.Power_Limit.In1 Racing_Mode_ETR07.Racing_Mode_ETR07_B.SKF_Initial.Gain /end REF_MEASUREMENT
/end GROUP
/begin GROUP Racing_Mode_ETR07.Racing_Mode_ETR07_B.Apps_Sat_Dwn "" /begin REF_MEASUREMENT Racing_Mode_ETR07.Racing_Mode_ETR07_B.Apps_Sat_Dwn.Gain /end REF_MEASUREMENT /end GROUP
/begin GROUP Racing_Mode_ETR07.Racing_Mode_ETR07_B.Apps_Sat_Up "" /begin REF_MEASUREMENT Racing_Mode_ETR07.Racing_Mode_ETR07_B.Apps_Sat_Up.Gain /end REF_MEASUREMENT /end GROUP
/begin GROUP Racing_Mode_ETR07.Racing_Mode_ETR07_B.CKF_Initial "" /begin REF_MEASUREMENT Racing_Mode_ETR07.Racing_Mode_ETR07_B.CKF_Initial.Gain /end REF_MEASUREMENT /end GROUP
/begin GROUP Racing_Mode_ETR07.Racing_Mode_ETR07_B.Cte_CKF "" /begin REF_MEASUREMENT Racing_Mode_ETR07.Racing_Mode_ETR07_B.Cte_CKF.Gain /end REF_MEASUREMENT /end GROUP
/begin GROUP Racing_Mode_ETR07.Racing_Mode_ETR07_B.Cte_SKF "" /begin REF_MEASUREMENT Racing_Mode_ETR07.Racing_Mode_ETR07_B.Cte_SKF.Gain /end REF_MEASUREMENT /end GROUP
/begin GROUP Racing_Mode_ETR07.Racing_Mode_ETR07_B.K_Reduction_P "" /begin REF_MEASUREMENT Racing_Mode_ETR07.Racing_Mode_ETR07_B.K_Reduction_P.Gain /end REF_MEASUREMENT /end GROUP
/begin GROUP Racing_Mode_ETR07.Racing_Mode_ETR07_B.K_Reduction_Temperature ""
 /begin REF_MEASUREMENT Racing_Mode_ETR07.Racing_Mode_ETR07_B.K_Reduction_Temperature.Gain /end REF_MEASUREMENT
/end GROUP
/begin GROUP Racing_Mode_ETR07.Racing_Mode_ETR07_B.Max_Regenerative_Torque ""
 /begin REF_MEASUREMENT Racing_Mode_ETR07.Racing_Mode_ETR07_B.Max_Regenerative_Torque.In1 /end REF_MEASUREMENT
/end GROUP
/begin GROUP Racing_Mode_ETR07.Racing_Mode_ETR07_B.Power_Limit "" /begin REF_MEASUREMENT Racing_Mode_ETR07.Racing_Mode_ETR07_B.Power_Limit.In1 /end REF_MEASUREMENT /end GROUP
/begin GROUP Racing_Mode_ETR07.Racing_Mode_ETR07_B.SKF_Initial "" /begin REF_MEASUREMENT Racing_Mode_ETR07.Racing_Mode_ETR07_B.SKF_Initial.Gain /end REF_MEASUREMENT /end GROUP
/begin GROUP Racing_Mode_ETR07.Racing_Mode_ETR07_U ""
 /begin REF_MEASUREMENT Racing_Mode_ETR07.Racing_Mode_ETR07_U.CustomMode_Data Racing_Mode_ETR07.Racing_Mode_ETR07_U.CustomMode_Identifier Racing_Mode_ETR07.Racing_Mode_ETR07_U.RacingMode /end REF_MEASUREMENT
/end GROUP
/begin GROUP Racing_Mode_ETR07.Racing_Mode_ETR07_Y ""
 /begin REF_MEASUREMENT Racing_Mode_ETR07.Racing_Mode_ETR07_Y.VDC_Apps_Sat_Down Racing_Mode_ETR07.Racing_Mode_ETR07_Y.VDC_Apps_Sat_Up Racing_Mode_ETR07.Racing_Mode_ETR07_Y.VDC_CKF_Initial Racing_Mode_ETR07.Racing_Mode_ETR07_Y.VDC_Cte_CKF Racing_Mode_ETR07.Racing_Mode_ETR07_Y.VDC_Cte_SKF Racing_Mode_ETR07.Racing_Mode_ETR07_Y.VDC_K_Reduction_P Racing_Mode_ETR07.Racing_Mode_ETR07_Y.VDC_K_Reduction_Temperature Racing_Mode_ETR07.Racing_Mode_ETR07_Y.VDC_Max_Regenerative_Torque Racing_Mode_ETR07.Racing_Mode_ETR07_Y.VDC_Power_Limit Racing_Mode_ETR07.Racing_Mode_ETR07_Y.VDC_SKF_Initial Racing_Mode_ETR07.Racing_Mode_ETR07_Y.Workshop_Mode_Enable /end REF_MEASUREMENT
/end GROUP
/begin GROUP Racing_Mode_ETR07.Racing_Mode_ETR07_P ""
 /begin REF_CHARACTERISTIC Racing_Mode_ETR07.Racing_Mode_ETR07_P.Apps_Sat_DwnSaturation_LowerSat Racing_Mode_ETR07.Racing_Mode_ETR07_P.Apps_Sat_DwnSaturation_UpperSat Racing_Mode_ETR07.Racing_Mode_ETR07_P.Apps_Sat_UpSaturation_LowerSat Racing_Mode_ETR07.Racing_Mode_ETR07_P.Apps_Sat_UpSaturation_UpperSat Racing_Mode_ETR07.Racing_Mode_ETR07_P.CEE_Apps_Sat_Dwn_Value Racing_Mode_ETR07.Racing_Mode_ETR07_P.CEE_Apps_Sat_Up_Value Racing_Mode_ETR07.Racing_Mode_ETR07_P.CEE_CKF_Initial_Value Racing_Mode_ETR07.Racing_Mode_ETR07_P.CEE_Cte_CKF_Value Racing_Mode_ETR07.Racing_Mode_ETR07_P.CEE_Cte_SKF_Value Racing_Mode_ETR07.Racing_Mode_ETR07_P.CEE_K_Reduction_P_Value Racing_Mode_ETR07.Racing_Mode_ETR07_P.CEE_K_Reduction_Temperature_Val Racing_Mode_ETR07.Racing_Mode_ETR07_P.CEE_Max_Regenerative_Torque_Val Racing_Mode_ETR07.Racing_Mode_ETR07_P.CEE_Power_Limit_Value Racing_Mode_ETR07.Racing_Mode_ETR07_P.CEE_SKF_Initial_Value Racing_Mode_ETR07.Racing_Mode_ETR07_P.CKF_InitialSaturation_LowerSat Racing_Mode_ETR07.Racing_Mode_ETR07_P.CKF_InitialSaturation_UpperSat Racing_Mode_ETR07.Racing_Mode_ETR07_P.CompareToConstant_const Racing_Mode_ETR07.Racing_Mode_ETR07_P.Cte_CKFSaturation_LowerSat Racing_Mode_ETR07.Racing_Mode_ETR07_P.Cte_CKFSaturation_UpperSat Racing_Mode_ETR07.Racing_Mode_ETR07_P.Cte_SKFSaturation_LowerSat Racing_Mode_ETR07.Racing_Mode_ETR07_P.Cte_SKFSaturation_UpperSat Racing_Mode_ETR07.Racing_Mode_ETR07_P.K_Reduction_PSaturation_LowerSa Racing_Mode_ETR07.Racing_Mode_ETR07_P.K_Reduction_PSaturation_UpperSa Racing_Mode_ETR07.Racing_Mode_ETR07_P.K_Reduction_TemperatureSatura_m Racing_Mode_ETR07.Racing_Mode_ETR07_P.K_Reduction_TemperatureSaturati Racing_Mode_ETR07.Racing_Mode_ETR07_P.Max_Regenerative_TorqueSatura_o Racing_Mode_ETR07.Racing_Mode_ETR07_P.Max_Regenerative_TorqueSaturati Racing_Mode_ETR07.Racing_Mode_ETR07_P.Merge_InitialOutput Racing_Mode_ETR07.Racing_Mode_ETR07_P.Power_LimitSaturation_LowerSat Racing_Mode_ETR07.Racing_Mode_ETR07_P.Power_LimitSaturation_UpperSat Racing_Mode_ETR07.Racing_Mode_ETR07_P.SKF_InitialSaturation_LowerSat Racing_Mode_ETR07.Racing_Mode_ETR07_P.SKF_InitialSaturation_UpperSat /end REF_CHARACTERISTIC
/end GROUP
/begin GROUP Synchronism_ETR07 "" ROOT
 /begin REF_MEASUREMENT Synchronism_ETR07.Synchronism_ETR07_DW.counter Synchronism_ETR07.Synchronism_ETR07_Y.Sync_CAN1 Synchronism_ETR07.Synchronism_ETR07_Y.Sync_CAN2 /end REF_MEASUREMENT
 /begin REF_CHARACTERISTIC Synchronism_ETR07.Synchronism_ETR07_P.Constant1_Value Synchronism_ETR07.Synchronism_ETR07_P.Constant_Value Synchronism_ETR07.Synchronism_ETR07_P.Constant_Value_e Synchronism_ETR07.Synchronism_ETR07_P.DataStoreMemory_InitialValue /end REF_CHARACTERISTIC
 /begin SUB_GROUP Synchronism_ETR07.Synchronism_ETR07_DW Synchronism_ETR07.Synchronism_ETR07_Y Synchronism_ETR07.Synchronism_ETR07_P /end SUB_GROUP
/end GROUP
/begin GROUP Synchronism_ETR07.Synchronism_ETR07_DW "" /begin REF_MEASUREMENT Synchronism_ETR07.Synchronism_ETR07_DW.counter /end REF_MEASUREMENT /end GROUP
/begin GROUP Synchronism_ETR07.Synchronism_ETR07_Y ""
 /begin REF_MEASUREMENT Synchronism_ETR07.Synchronism_ETR07_Y.Sync_CAN1 Synchronism_ETR07.Synchronism_ETR07_Y.Sync_CAN2 /end REF_MEASUREMENT
/end GROUP
/begin GROUP Synchronism_ETR07.Synchronism_ETR07_P ""
 /begin REF_CHARACTERISTIC Synchronism_ETR07.Synchronism_ETR07_P.Constant1_Value Synchronism_ETR07.Synchronism_ETR07_P.Constant_Value Synchronism_ETR07.Synchronism_ETR07_P.Constant_Value_e Synchronism_ETR07.Synchronism_ETR07_P.DataStoreMemory_InitialValue /end REF_CHARACTERISTIC
/end GROUP
/end MODULE
/* INTECRIO_MERGED */
/end PROJECT
/* ETAS_ES910 */
