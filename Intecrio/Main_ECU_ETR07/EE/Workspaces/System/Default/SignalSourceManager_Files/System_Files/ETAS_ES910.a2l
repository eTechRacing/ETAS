ASAP2_VERSION 1 41
/begin PROJECT ETAS_ES910 "Generated by ETAS from INTECRIO V4.7.0.1005 integration project"
/begin HEADER "" VERSION "" PROJECT_NO Y /end HEADER
/begin MODULE INTECRIO_MERGED "Generated by ETAS INTECRIO V4.7.0.1005 for M/C interface ETARGET"
/begin MOD_COMMON "Common definitions" BYTE_ORDER MSB_FIRST ALIGNMENT_BYTE 1 ALIGNMENT_WORD 2 ALIGNMENT_LONG 4 ALIGNMENT_FLOAT32_IEEE 4 ALIGNMENT_FLOAT64_IEEE 8 /end MOD_COMMON
/begin MEASUREMENT Torque_Control_ETR07.Torque_Control_ETR07_B.A "" FLOAT64_IEEE Torque_Control_ETR07_CM_double 0 0 -1.7e+308 1.7e+308 ECU_ADDRESS 0x0 DISPLAY_IDENTIFIER Torque_Control_ETR07.Calculate_Current_Conversion.KT_L_TORKY.A.A /end MEASUREMENT
/begin MEASUREMENT Torque_Control_ETR07.Torque_Control_ETR07_B.A1 "" FLOAT64_IEEE Torque_Control_ETR07_CM_double 0 0 -1.7e+308 1.7e+308 ECU_ADDRESS 0x0 DISPLAY_IDENTIFIER Torque_Control_ETR07.Calculate_Current_Conversion.KT_R_EMY.A1.A1 /end MEASUREMENT
/begin MEASUREMENT Torque_Control_ETR07.Torque_Control_ETR07_B.Abs "" FLOAT64_IEEE Torque_Control_ETR07_CM_double 0 0 -1.7e+308 1.7e+308 ECU_ADDRESS 0x0 DISPLAY_IDENTIFIER Torque_Control_ETR07.VDC.Abs.Abs /end MEASUREMENT
/begin MEASUREMENT Torque_Control_ETR07.Torque_Control_ETR07_B.B "" FLOAT64_IEEE Torque_Control_ETR07_CM_double 0 0 -1.7e+308 1.7e+308 ECU_ADDRESS 0x0 DISPLAY_IDENTIFIER Torque_Control_ETR07.Calculate_Current_Conversion.KT_L_TORKY.B.B /end MEASUREMENT
/begin MEASUREMENT Torque_Control_ETR07.Torque_Control_ETR07_B.B1 "" FLOAT64_IEEE Torque_Control_ETR07_CM_double 0 0 -1.7e+308 1.7e+308 ECU_ADDRESS 0x0 DISPLAY_IDENTIFIER Torque_Control_ETR07.Calculate_Current_Conversion.KT_R_EMY.B1.B1 /end MEASUREMENT
/begin MEASUREMENT Torque_Control_ETR07.Torque_Control_ETR07_B.BRAKE_THRESHOLD "" FLOAT64_IEEE Torque_Control_ETR07_CM_double 0 0 -1.7e+308 1.7e+308 ECU_ADDRESS 0x0 DISPLAY_IDENTIFIER Torque_Control_ETR07.VDC.Regeneration_Enable.BRAKE_THRESHOLD.BRAKE_THRESHOLD /end MEASUREMENT
/begin MEASUREMENT Torque_Control_ETR07.Torque_Control_ETR07_B.C "" FLOAT64_IEEE Torque_Control_ETR07_CM_double 0 0 -1.7e+308 1.7e+308 ECU_ADDRESS 0x0 DISPLAY_IDENTIFIER Torque_Control_ETR07.Calculate_Current_Conversion.KT_L_TORKY.C.C /end MEASUREMENT
/begin MEASUREMENT Torque_Control_ETR07.Torque_Control_ETR07_B.C1 "" FLOAT64_IEEE Torque_Control_ETR07_CM_double 0 0 -1.7e+308 1.7e+308 ECU_ADDRESS 0x0 DISPLAY_IDENTIFIER Torque_Control_ETR07.Calculate_Current_Conversion.KT_R_EMY.C1.C1 /end MEASUREMENT
/begin MEASUREMENT Torque_Control_ETR07.Torque_Control_ETR07_B.Constant "" FLOAT64_IEEE Torque_Control_ETR07_CM_double 0 0 -1.7e+308 1.7e+308 ECU_ADDRESS 0x0 DISPLAY_IDENTIFIER Torque_Control_ETR07.SAFETY_BLOCK.Compare_To_Constant.Constant.Constant /end MEASUREMENT
/begin MEASUREMENT Torque_Control_ETR07.Torque_Control_ETR07_B.Constant1 "" FLOAT64_IEEE Torque_Control_ETR07_CM_double 0 0 -1.7e+308 1.7e+308 ECU_ADDRESS 0x0 DISPLAY_IDENTIFIER Torque_Control_ETR07.VDC.Vehicle_Dynamics_Control_2018.VDC_2018_without_Longitudinal.Kamm_Circle_Lateral.Constant1.Constant1 /end MEASUREMENT
/begin MEASUREMENT Torque_Control_ETR07.Torque_Control_ETR07_B.Constant1_i "" FLOAT64_IEEE Torque_Control_ETR07_CM_double 0 0 -1.7e+308 1.7e+308 ECU_ADDRESS 0x0 DISPLAY_IDENTIFIER Torque_Control_ETR07.VDC.Vehicle_Dynamics_Control_2018.VDC_2018_Complete.Wheel_to_engine.Constant1.Constant1_i /end MEASUREMENT
/begin MEASUREMENT Torque_Control_ETR07.Torque_Control_ETR07_B.Constant1_j "" FLOAT64_IEEE Torque_Control_ETR07_CM_double 0 0 -1.7e+308 1.7e+308 ECU_ADDRESS 0x0 DISPLAY_IDENTIFIER Torque_Control_ETR07.VDC.Vehicle_Dynamics_Control_2018.VDC_2018_Complete.In_Numbers.Constant1.Constant1_j /end MEASUREMENT
/begin MEASUREMENT Torque_Control_ETR07.Torque_Control_ETR07_B.Constant1_k "" FLOAT64_IEEE Torque_Control_ETR07_CM_double 0 0 -1.7e+308 1.7e+308 ECU_ADDRESS 0x0 DISPLAY_IDENTIFIER Torque_Control_ETR07.VDC.Vehicle_Dynamics_Control_2018.VDC_2018_without_Longitudinal.Wheel_to_engine.Constant1.Constant1_k /end MEASUREMENT
/begin MEASUREMENT Torque_Control_ETR07.Torque_Control_ETR07_B.Constant3 "" FLOAT64_IEEE Torque_Control_ETR07_CM_double 0 0 -1.7e+308 1.7e+308 ECU_ADDRESS 0x0 DISPLAY_IDENTIFIER Torque_Control_ETR07.VDC.Vehicle_Dynamics_Control_2018.VDC_2018_Complete.Lateral_Dynamics.Constant3.Constant3 /end MEASUREMENT
/begin MEASUREMENT Torque_Control_ETR07.Torque_Control_ETR07_B.Constant3_e "" FLOAT64_IEEE Torque_Control_ETR07_CM_double 0 0 -1.7e+308 1.7e+308 ECU_ADDRESS 0x0 DISPLAY_IDENTIFIER Torque_Control_ETR07.VDC.Vehicle_Dynamics_Control_2018.VDC_2018_Complete.Longitudinal_Dynamics.Constant3.Constant3_e /end MEASUREMENT
/begin MEASUREMENT Torque_Control_ETR07.Torque_Control_ETR07_B.Constant4 "" FLOAT64_IEEE Torque_Control_ETR07_CM_double 0 0 -1.7e+308 1.7e+308 ECU_ADDRESS 0x0 DISPLAY_IDENTIFIER Torque_Control_ETR07.VDC.Vehicle_Dynamics_Control_2018.VDC_2018_Complete.Lateral_Dynamics.Constant4.Constant4 /end MEASUREMENT
/begin MEASUREMENT Torque_Control_ETR07.Torque_Control_ETR07_B.Constant4_m "" FLOAT64_IEEE Torque_Control_ETR07_CM_double 0 0 -1.7e+308 1.7e+308 ECU_ADDRESS 0x0 DISPLAY_IDENTIFIER Torque_Control_ETR07.VDC.Vehicle_Dynamics_Control_2018.VDC_2018_Complete.Longitudinal_Dynamics.Constant4.Constant4_m /end MEASUREMENT
/begin MEASUREMENT Torque_Control_ETR07.Torque_Control_ETR07_B.Constant7 "" FLOAT64_IEEE Torque_Control_ETR07_CM_double 0 0 -1.7e+308 1.7e+308 ECU_ADDRESS 0x0 DISPLAY_IDENTIFIER Torque_Control_ETR07.VDC.Vehicle_Dynamics_Control_2018.VDC_2018_Complete.Lateral_Dynamics.Yaw_Rate_Reference.Constant7.Constant7 /end MEASUREMENT
/begin MEASUREMENT Torque_Control_ETR07.Torque_Control_ETR07_B.Constant8 "" FLOAT64_IEEE Torque_Control_ETR07_CM_double 0 0 -1.7e+308 1.7e+308 ECU_ADDRESS 0x0 DISPLAY_IDENTIFIER Torque_Control_ETR07.VDC.Vehicle_Dynamics_Control_2018.VDC_2018_Complete.Lateral_Dynamics.Yaw_Rate_Reference.Constant8.Constant8 /end MEASUREMENT
/begin MEASUREMENT Torque_Control_ETR07.Torque_Control_ETR07_B.Constant_b "" FLOAT64_IEEE Torque_Control_ETR07_CM_double 0 0 -1.7e+308 1.7e+308 ECU_ADDRESS 0x0 DISPLAY_IDENTIFIER Torque_Control_ETR07.VDC.Vehicle_Dynamics_Control_2018.VDC_2018_Complete.Wheel_to_engine.Constant.Constant_b /end MEASUREMENT
/begin MEASUREMENT Torque_Control_ETR07.Torque_Control_ETR07_B.Constant_d "" FLOAT64_IEEE Torque_Control_ETR07_CM_double 0 0 -1.7e+308 1.7e+308 ECU_ADDRESS 0x0 DISPLAY_IDENTIFIER Torque_Control_ETR07.VDC.Vehicle_Dynamics_Control_2018.Steering_TV_2017_with_TC.Optimization_SKF__amp__CKF.Subsystem.SKF.Spin.Constant.Constant_d /end MEASUREMENT
/begin MEASUREMENT Torque_Control_ETR07.Torque_Control_ETR07_B.Constant_dd "" FLOAT64_IEEE Torque_Control_ETR07_CM_double 0 0 -1.7e+308 1.7e+308 ECU_ADDRESS 0x0 DISPLAY_IDENTIFIER Torque_Control_ETR07.VDC.Vehicle_Dynamics_Control_2018.VDC_2018_without_Longitudinal.Kamm_Circle_Lateral.Constant.Constant_dd /end MEASUREMENT
/begin MEASUREMENT Torque_Control_ETR07.Torque_Control_ETR07_B.Constant_e "" FLOAT64_IEEE Torque_Control_ETR07_CM_double 0 0 -1.7e+308 1.7e+308 ECU_ADDRESS 0x0 DISPLAY_IDENTIFIER Torque_Control_ETR07.VDC.Vehicle_Dynamics_Control_2018.VDC_2018_without_Longitudinal.Wheel_to_engine.Constant.Constant_e /end MEASUREMENT
/begin MEASUREMENT Torque_Control_ETR07.Torque_Control_ETR07_B.Constant_h "" FLOAT64_IEEE Torque_Control_ETR07_CM_double 0 0 -1.7e+308 1.7e+308 ECU_ADDRESS 0x0 DISPLAY_IDENTIFIER Torque_Control_ETR07.Constant.Constant_h /end MEASUREMENT
/begin MEASUREMENT Torque_Control_ETR07.Torque_Control_ETR07_B.Constant_i "" FLOAT64_IEEE Torque_Control_ETR07_CM_double 0 0 -1.7e+308 1.7e+308 ECU_ADDRESS 0x0 DISPLAY_IDENTIFIER Torque_Control_ETR07.Pumps_Controller.Compare_To_Constant.Constant.Constant_i /end MEASUREMENT
/begin MEASUREMENT Torque_Control_ETR07.Torque_Control_ETR07_B.Constant_k "" FLOAT64_IEEE Torque_Control_ETR07_CM_double 0 0 -1.7e+308 1.7e+308 ECU_ADDRESS 0x0 DISPLAY_IDENTIFIER Torque_Control_ETR07.VDC.Vehicle_Dynamics_Control_2018.VDC_2018_Complete.Optimization_SKF__amp__CKF.Subsystem.SKF.Spin.Constant.Constant_k /end MEASUREMENT
/begin MEASUREMENT Torque_Control_ETR07.Torque_Control_ETR07_B.Constant_l "" FLOAT64_IEEE Torque_Control_ETR07_CM_double 0 0 -1.7e+308 1.7e+308 ECU_ADDRESS 0x0 DISPLAY_IDENTIFIER Torque_Control_ETR07.VDC.Constant.Constant_l /end MEASUREMENT
/begin MEASUREMENT Torque_Control_ETR07.Torque_Control_ETR07_B.Constant_m "" FLOAT64_IEEE Torque_Control_ETR07_CM_double 0 0 -1.7e+308 1.7e+308 ECU_ADDRESS 0x0 DISPLAY_IDENTIFIER Torque_Control_ETR07.VDC.WORKSHOP_MODE_RESTRICTIONS.Torque_Reduction.Constant.Constant_m /end MEASUREMENT
/begin MEASUREMENT Torque_Control_ETR07.Torque_Control_ETR07_B.Constant_mf "" FLOAT64_IEEE Torque_Control_ETR07_CM_double 0 0 -1.7e+308 1.7e+308 ECU_ADDRESS 0x0 DISPLAY_IDENTIFIER Torque_Control_ETR07.VDC.Vehicle_Dynamics_Control_2018.VDC_2018_Complete.Longitudinal_Dynamics.Constant.Constant_mf /end MEASUREMENT
/begin MEASUREMENT Torque_Control_ETR07.Torque_Control_ETR07_B.Constant_n "" FLOAT64_IEEE Torque_Control_ETR07_CM_double 0 0 -1.7e+308 1.7e+308 ECU_ADDRESS 0x0 DISPLAY_IDENTIFIER Torque_Control_ETR07.Pumps_Controller.Compare_To_Constant1.Constant.Constant_n /end MEASUREMENT
/begin MEASUREMENT Torque_Control_ETR07.Torque_Control_ETR07_B.Constant_o "" FLOAT64_IEEE Torque_Control_ETR07_CM_double 0 0 -1.7e+308 1.7e+308 ECU_ADDRESS 0x0 DISPLAY_IDENTIFIER Torque_Control_ETR07.VDC.Regeneration_Enable.Constant.Constant_o /end MEASUREMENT
/begin MEASUREMENT Torque_Control_ETR07.Torque_Control_ETR07_B.Constant_ob "" FLOAT64_IEEE Torque_Control_ETR07_CM_double 0 0 -1.7e+308 1.7e+308 ECU_ADDRESS 0x0 DISPLAY_IDENTIFIER Torque_Control_ETR07.VDC.Vehicle_Dynamics_Control_2018.Steering_TV_2017_with_TC.Optimization_SKF__amp__CKF.Subsystem.CKF.Spin.Constant.Constant_ob /end MEASUREMENT
/begin MEASUREMENT Torque_Control_ETR07.Torque_Control_ETR07_B.Constant_p "" FLOAT64_IEEE Torque_Control_ETR07_CM_double 0 0 -1.7e+308 1.7e+308 ECU_ADDRESS 0x0 DISPLAY_IDENTIFIER Torque_Control_ETR07.VDC.Vehicle_Dynamics_Control_2018.VDC_2018_Complete.Constant.Constant_p /end MEASUREMENT
/begin MEASUREMENT Torque_Control_ETR07.Torque_Control_ETR07_B.Divide "" FLOAT64_IEEE Torque_Control_ETR07_CM_double 0 0 -1.7e+308 1.7e+308 ECU_ADDRESS 0x0 DISPLAY_IDENTIFIER Torque_Control_ETR07.VDC.Vehicle_Dynamics_Control_2018.VDC_2018_Complete.Wheel_to_engine.Fx_to_engineTqRR.Divide.Divide /end MEASUREMENT
/begin MEASUREMENT Torque_Control_ETR07.Torque_Control_ETR07_B.Divide1 "" FLOAT64_IEEE Torque_Control_ETR07_CM_double 0 0 -1.7e+308 1.7e+308 ECU_ADDRESS 0x0 DISPLAY_IDENTIFIER Torque_Control_ETR07.VDC.Vehicle_Dynamics_Control_2018.VDC_2018_Complete.Lateral_Dynamics.Tire_Longitudinal_Force_Difference.Momentum_Z_to_Longitudinal_Force_Difference.Divide1.Divide1 /end MEASUREMENT
/begin MEASUREMENT Torque_Control_ETR07.Torque_Control_ETR07_B.Divide_i "" FLOAT64_IEEE Torque_Control_ETR07_CM_double 0 0 -1.7e+308 1.7e+308 ECU_ADDRESS 0x0 DISPLAY_IDENTIFIER Torque_Control_ETR07.VDC.Vehicle_Dynamics_Control_2018.VDC_2018_Complete.Wheel_to_engine.Fx_to_engineTqRL.Divide.Divide_i /end MEASUREMENT
/begin MEASUREMENT Torque_Control_ETR07.Torque_Control_ETR07_B.Gain "" FLOAT64_IEEE Torque_Control_ETR07_CM_double 0 0 -1.7e+308 1.7e+308 ECU_ADDRESS 0x0 DISPLAY_IDENTIFIER Torque_Control_ETR07.VDC.Vehicle_Dynamics_Control_2018.Gain.Gain /end MEASUREMENT
/begin MEASUREMENT Torque_Control_ETR07.Torque_Control_ETR07_B.LimitTemperatureCeldasC "" FLOAT64_IEEE Torque_Control_ETR07_CM_double 0 0 -1.7e+308 1.7e+308 ECU_ADDRESS 0x0 DISPLAY_IDENTIFIER Torque_Control_ETR07.VDC.Vehicle_Dynamics_Control_2018.Limit_Temperature_Celdas[C].LimitTemperatureCeldasC /end MEASUREMENT
/begin MEASUREMENT Torque_Control_ETR07.Torque_Control_ETR07_B.LimitTemperatureIGBTC "" FLOAT64_IEEE Torque_Control_ETR07_CM_double 0 0 -1.7e+308 1.7e+308 ECU_ADDRESS 0x0 DISPLAY_IDENTIFIER Torque_Control_ETR07.VDC.Vehicle_Dynamics_Control_2018.Limit_Temperature_IGBT_[C].LimitTemperatureIGBTC /end MEASUREMENT
/begin MEASUREMENT Torque_Control_ETR07.Torque_Control_ETR07_B.LimitTemperatureMotorC "" FLOAT64_IEEE Torque_Control_ETR07_CM_double 0 0 -1.7e+308 1.7e+308 ECU_ADDRESS 0x0 DISPLAY_IDENTIFIER Torque_Control_ETR07.VDC.Vehicle_Dynamics_Control_2018.Limit_Temperature_Motor_[C].LimitTemperatureMotorC /end MEASUREMENT
/begin MEASUREMENT Torque_Control_ETR07.Torque_Control_ETR07_B.LogicalOperator "" UBYTE Torque_Control_ETR07_CM_boolean 0 0 0 1 ECU_ADDRESS 0x0 DISPLAY_IDENTIFIER Torque_Control_ETR07.SAFETY_BLOCK.Logical_Operator.LogicalOperator /end MEASUREMENT
/begin MEASUREMENT Torque_Control_ETR07.Torque_Control_ETR07_B.LogicalOperator1 "" UBYTE Torque_Control_ETR07_CM_boolean 0 0 0 1 ECU_ADDRESS 0x0 DISPLAY_IDENTIFIER Torque_Control_ETR07.SAFETY_BLOCK.BRAKE_IMPLAUSIBILITY.Logical_Operator1.LogicalOperator1 /end MEASUREMENT
/begin MEASUREMENT Torque_Control_ETR07.Torque_Control_ETR07_B.MaximumTorqueperengineNm "" FLOAT64_IEEE Torque_Control_ETR07_CM_double 0 0 -1.7e+308 1.7e+308 ECU_ADDRESS 0x0 DISPLAY_IDENTIFIER Torque_Control_ETR07.VDC.Vehicle_Dynamics_Control_2018.VDC_2018_without_Longitudinal.In_Numbers.Maximum_Torque_per_engine_[Nm].MaximumTorqueperengineNm /end MEASUREMENT
/begin MEASUREMENT Torque_Control_ETR07.Torque_Control_ETR07_B.MaximumTorqueperengineNm_m "" FLOAT64_IEEE Torque_Control_ETR07_CM_double 0 0 -1.7e+308 1.7e+308 ECU_ADDRESS 0x0 DISPLAY_IDENTIFIER Torque_Control_ETR07.VDC.Vehicle_Dynamics_Control_2018.VDC_2018_Complete.In_Numbers.Maximum_Torque_per_engine_[Nm].MaximumTorqueperengineNm_m /end MEASUREMENT
/begin MEASUREMENT Torque_Control_ETR07.Torque_Control_ETR07_B.MaximumTransmissionTorqueDyna_b "" FLOAT64_IEEE Torque_Control_ETR07_CM_double 0 0 -1.7e+308 1.7e+308 ECU_ADDRESS 0x0 DISPLAY_IDENTIFIER Torque_Control_ETR07.VDC.Vehicle_Dynamics_Control_2018.VDC_2018_Complete.In_Numbers.Maximum_Transmission_Torque_Dynamic_[Nm].MaximumTransmissionTorqueDyna_b /end MEASUREMENT
/begin MEASUREMENT Torque_Control_ETR07.Torque_Control_ETR07_B.MaximumTransmissionTorqueDynami "" FLOAT64_IEEE Torque_Control_ETR07_CM_double 0 0 -1.7e+308 1.7e+308 ECU_ADDRESS 0x0 DISPLAY_IDENTIFIER Torque_Control_ETR07.VDC.Vehicle_Dynamics_Control_2018.VDC_2018_without_Longitudinal.In_Numbers.Maximum_Transmission_Torque_Dynamic_[Nm].MaximumTransmissionTorqueDynami /end MEASUREMENT
/begin MEASUREMENT Torque_Control_ETR07.Torque_Control_ETR07_B.MaximumTransmissionTorqueStat_b "" FLOAT64_IEEE Torque_Control_ETR07_CM_double 0 0 -1.7e+308 1.7e+308 ECU_ADDRESS 0x0 DISPLAY_IDENTIFIER Torque_Control_ETR07.VDC.Vehicle_Dynamics_Control_2018.VDC_2018_Complete.In_Numbers.Maximum_Transmission_Torque_Static_[Nm].MaximumTransmissionTorqueStat_b /end MEASUREMENT
/begin MEASUREMENT Torque_Control_ETR07.Torque_Control_ETR07_B.MaximumTransmissionTorqueStatic "" FLOAT64_IEEE Torque_Control_ETR07_CM_double 0 0 -1.7e+308 1.7e+308 ECU_ADDRESS 0x0 DISPLAY_IDENTIFIER Torque_Control_ETR07.VDC.Vehicle_Dynamics_Control_2018.VDC_2018_without_Longitudinal.In_Numbers.Maximum_Transmission_Torque_Static_[Nm].MaximumTransmissionTorqueStatic /end MEASUREMENT
/begin MEASUREMENT Torque_Control_ETR07.Torque_Control_ETR07_B.Merge "" FLOAT64_IEEE Torque_Control_ETR07_CM_double 0 0 -1.7e+308 1.7e+308 ECU_ADDRESS 0x0 DISPLAY_IDENTIFIER Torque_Control_ETR07.VDC.TEST_MODE_IN.Merge.Merge /end MEASUREMENT
/begin MEASUREMENT Torque_Control_ETR07.Torque_Control_ETR07_B.Merge1 "" FLOAT64_IEEE Torque_Control_ETR07_CM_double 0 0 -1.7e+308 1.7e+308 ECU_ADDRESS 0x0 DISPLAY_IDENTIFIER Torque_Control_ETR07.VDC.TEST_MODE_IN.Merge1.Merge1 /end MEASUREMENT
/begin MEASUREMENT Torque_Control_ETR07.Torque_Control_ETR07_B.Merge1_a "" FLOAT64_IEEE Torque_Control_ETR07_CM_double 0 0 -1.7e+308 1.7e+308 ECU_ADDRESS 0x0 DISPLAY_IDENTIFIER Torque_Control_ETR07.VDC.Regeneration_Enable.Merge1.Merge1_a /end MEASUREMENT
/begin MEASUREMENT Torque_Control_ETR07.Torque_Control_ETR07_B.Merge1_a0 "" FLOAT64_IEEE Torque_Control_ETR07_CM_double 0 0 -1.7e+308 1.7e+308 ECU_ADDRESS 0x0 DISPLAY_IDENTIFIER Torque_Control_ETR07.Merge1.Merge1_a0 /end MEASUREMENT
/begin MEASUREMENT Torque_Control_ETR07.Torque_Control_ETR07_B.Merge1_b "" FLOAT64_IEEE Torque_Control_ETR07_CM_double 0 0 -1.7e+308 1.7e+308 ECU_ADDRESS 0x0 DISPLAY_IDENTIFIER Torque_Control_ETR07.VDC.Vehicle_Dynamics_Control_2018.VDC_2018_Complete.Driver____CarBehaviours.Merge1.Merge1_b /end MEASUREMENT
/begin MEASUREMENT Torque_Control_ETR07.Torque_Control_ETR07_B.Merge1_i "" FLOAT64_IEEE Torque_Control_ETR07_CM_double 0 0 -1.7e+308 1.7e+308 ECU_ADDRESS 0x0 DISPLAY_IDENTIFIER Torque_Control_ETR07.Calculate_Current_Conversion.KT_R_EMY.Merge1.Merge1_i /end MEASUREMENT
/begin MEASUREMENT Torque_Control_ETR07.Torque_Control_ETR07_B.Merge1_k "" FLOAT64_IEEE Torque_Control_ETR07_CM_double 0 0 -1.7e+308 1.7e+308 ECU_ADDRESS 0x0 DISPLAY_IDENTIFIER Torque_Control_ETR07.VDC.Regeneration_Enable.Not_Braking.Merge1.Merge1_k /end MEASUREMENT
/begin MEASUREMENT Torque_Control_ETR07.Torque_Control_ETR07_B.Merge1_l "" FLOAT64_IEEE Torque_Control_ETR07_CM_double 0 0 -1.7e+308 1.7e+308 ECU_ADDRESS 0x0 DISPLAY_IDENTIFIER Torque_Control_ETR07.VDC.Vehicle_Dynamics_Control_2018.VDC_2018_without_Longitudinal.Driver____CarBehaviours.Merge1.Merge1_l /end MEASUREMENT
/begin MEASUREMENT Torque_Control_ETR07.Torque_Control_ETR07_B.Merge1_lz "" FLOAT64_IEEE Torque_Control_ETR07_CM_double 0 0 -1.7e+308 1.7e+308 ECU_ADDRESS 0x0 DISPLAY_IDENTIFIER Torque_Control_ETR07.Calculate_Current_Conversion.KT_L_TORKY.Merge1.Merge1_lz /end MEASUREMENT
/begin MEASUREMENT Torque_Control_ETR07.Torque_Control_ETR07_B.Merge1_m "" FLOAT64_IEEE Torque_Control_ETR07_CM_double 0 0 -1.7e+308 1.7e+308 ECU_ADDRESS 0x0 DISPLAY_IDENTIFIER Torque_Control_ETR07.VDC.Vehicle_Dynamics_Control_2018.Merge1.Merge1_m /end MEASUREMENT
/begin MEASUREMENT Torque_Control_ETR07.Torque_Control_ETR07_B.Merge1_n "" FLOAT64_IEEE Torque_Control_ETR07_CM_double 0 0 -1.7e+308 1.7e+308 ECU_ADDRESS 0x0 DISPLAY_IDENTIFIER Torque_Control_ETR07.VDC.Vehicle_Dynamics_Control_2018.VDC_2018_Complete.Merge1.Merge1_n /end MEASUREMENT
/begin MEASUREMENT Torque_Control_ETR07.Torque_Control_ETR07_B.Merge2 "" FLOAT64_IEEE Torque_Control_ETR07_CM_double 0 0 -1.7e+308 1.7e+308 ECU_ADDRESS 0x0 DISPLAY_IDENTIFIER Torque_Control_ETR07.VDC.TEST_MODE_IN.Merge2.Merge2 /end MEASUREMENT
/begin MEASUREMENT Torque_Control_ETR07.Torque_Control_ETR07_B.Merge2_b "" FLOAT64_IEEE Torque_Control_ETR07_CM_double 0 0 -1.7e+308 1.7e+308 ECU_ADDRESS 0x0 DISPLAY_IDENTIFIER Torque_Control_ETR07.Calculate_Current_Conversion.KT_L_TORKY.Merge2.Merge2_b /end MEASUREMENT
/begin MEASUREMENT Torque_Control_ETR07.Torque_Control_ETR07_B.Merge2_e "" FLOAT64_IEEE Torque_Control_ETR07_CM_double 0 0 -1.7e+308 1.7e+308 ECU_ADDRESS 0x0 DISPLAY_IDENTIFIER Torque_Control_ETR07.Merge2.Merge2_e /end MEASUREMENT
/begin MEASUREMENT Torque_Control_ETR07.Torque_Control_ETR07_B.Merge2_g "" FLOAT64_IEEE Torque_Control_ETR07_CM_double 0 0 -1.7e+308 1.7e+308 ECU_ADDRESS 0x0 DISPLAY_IDENTIFIER Torque_Control_ETR07.Calculate_Current_Conversion.KT_R_EMY.Merge2.Merge2_g /end MEASUREMENT
/begin MEASUREMENT Torque_Control_ETR07.Torque_Control_ETR07_B.Merge2_j "" FLOAT64_IEEE Torque_Control_ETR07_CM_double 0 0 -1.7e+308 1.7e+308 ECU_ADDRESS 0x0 DISPLAY_IDENTIFIER Torque_Control_ETR07.VDC.Vehicle_Dynamics_Control_2018.VDC_2018_Complete.Constraints.Acelerating_and_braking_without_Regenerative.Merge2.Merge2_j /end MEASUREMENT
/begin MEASUREMENT Torque_Control_ETR07.Torque_Control_ETR07_B.Merge2_l "" FLOAT64_IEEE Torque_Control_ETR07_CM_double 0 0 -1.7e+308 1.7e+308 ECU_ADDRESS 0x0 DISPLAY_IDENTIFIER Torque_Control_ETR07.VDC.Vehicle_Dynamics_Control_2018.Merge2.Merge2_l /end MEASUREMENT
/begin MEASUREMENT Torque_Control_ETR07.Torque_Control_ETR07_B.Merge2_lx "" FLOAT64_IEEE Torque_Control_ETR07_CM_double 0 0 -1.7e+308 1.7e+308 ECU_ADDRESS 0x0 DISPLAY_IDENTIFIER Torque_Control_ETR07.VDC.Vehicle_Dynamics_Control_2018.VDC_2018_Complete.Merge2.Merge2_lx /end MEASUREMENT
/begin MEASUREMENT Torque_Control_ETR07.Torque_Control_ETR07_B.Merge2_o "" FLOAT64_IEEE Torque_Control_ETR07_CM_double 0 0 -1.7e+308 1.7e+308 ECU_ADDRESS 0x0 DISPLAY_IDENTIFIER Torque_Control_ETR07.VDC.Vehicle_Dynamics_Control_2018.VDC_2018_without_Longitudinal.Constraints.Acelerating_and_braking_without_Regenerative.Merge2.Merge2_o /end MEASUREMENT
/begin MEASUREMENT Torque_Control_ETR07.Torque_Control_ETR07_B.Merge3 "" FLOAT64_IEEE Torque_Control_ETR07_CM_double 0 0 -1.7e+308 1.7e+308 ECU_ADDRESS 0x0 DISPLAY_IDENTIFIER Torque_Control_ETR07.VDC.TEST_MODE_IN.Merge3.Merge3 /end MEASUREMENT
/begin MEASUREMENT Torque_Control_ETR07.Torque_Control_ETR07_B.Merge3_c "" FLOAT64_IEEE Torque_Control_ETR07_CM_double 0 0 -1.7e+308 1.7e+308 ECU_ADDRESS 0x0 DISPLAY_IDENTIFIER Torque_Control_ETR07.VDC.Vehicle_Dynamics_Control_2018.Merge3.Merge3_c /end MEASUREMENT
/begin MEASUREMENT Torque_Control_ETR07.Torque_Control_ETR07_B.Merge3_e "" FLOAT64_IEEE Torque_Control_ETR07_CM_double 0 0 -1.7e+308 1.7e+308 ECU_ADDRESS 0x0 DISPLAY_IDENTIFIER Torque_Control_ETR07.VDC.Vehicle_Dynamics_Control_2018.VDC_2018_Complete.Merge3.Merge3_e /end MEASUREMENT
/begin MEASUREMENT Torque_Control_ETR07.Torque_Control_ETR07_B.Merge3_h "" FLOAT64_IEEE Torque_Control_ETR07_CM_double 0 0 -1.7e+308 1.7e+308 ECU_ADDRESS 0x0 DISPLAY_IDENTIFIER Torque_Control_ETR07.VDC.Vehicle_Dynamics_Control_2018.VDC_2018_Complete.Constraints.Acelerating_and_braking_without_Regenerative.Merge3.Merge3_h /end MEASUREMENT
/begin MEASUREMENT Torque_Control_ETR07.Torque_Control_ETR07_B.Merge4 "" FLOAT64_IEEE Torque_Control_ETR07_CM_double 0 0 -1.7e+308 1.7e+308 ECU_ADDRESS 0x0 DISPLAY_IDENTIFIER Torque_Control_ETR07.VDC.Vehicle_Dynamics_Control_2018.VDC_2018_Complete.Merge4.Merge4 /end MEASUREMENT
/begin MEASUREMENT Torque_Control_ETR07.Torque_Control_ETR07_B.Merge4_b "" FLOAT64_IEEE Torque_Control_ETR07_CM_double 0 0 -1.7e+308 1.7e+308 ECU_ADDRESS 0x0 DISPLAY_IDENTIFIER Torque_Control_ETR07.VDC.Vehicle_Dynamics_Control_2018.VDC_2018_Complete.Constraints.Acelerating_and_braking_without_Regenerative.Merge4.Merge4_b /end MEASUREMENT
/begin MEASUREMENT Torque_Control_ETR07.Torque_Control_ETR07_B.Merge5 "" FLOAT64_IEEE Torque_Control_ETR07_CM_double 0 0 -1.7e+308 1.7e+308 ECU_ADDRESS 0x0 DISPLAY_IDENTIFIER Torque_Control_ETR07.SAFETY_BLOCK.BRAKE_IMPLAUSIBILITY.Merge5.Merge5 /end MEASUREMENT
/begin MEASUREMENT Torque_Control_ETR07.Torque_Control_ETR07_B.Merge5_e "" FLOAT64_IEEE Torque_Control_ETR07_CM_double 0 0 -1.7e+308 1.7e+308 ECU_ADDRESS 0x0 DISPLAY_IDENTIFIER Torque_Control_ETR07.VDC.Vehicle_Dynamics_Control_2018.VDC_2018_Complete.Merge5.Merge5_e /end MEASUREMENT
/begin MEASUREMENT Torque_Control_ETR07.Torque_Control_ETR07_B.Merge6 "" FLOAT64_IEEE Torque_Control_ETR07_CM_double 0 0 -1.7e+308 1.7e+308 ECU_ADDRESS 0x0 DISPLAY_IDENTIFIER Torque_Control_ETR07.VDC.Vehicle_Dynamics_Control_2018.VDC_2018_Complete.Merge6.Merge6 /end MEASUREMENT
/begin MEASUREMENT Torque_Control_ETR07.Torque_Control_ETR07_B.Merge7 "" FLOAT64_IEEE Torque_Control_ETR07_CM_double 0 0 -1.7e+308 1.7e+308 ECU_ADDRESS 0x0 DISPLAY_IDENTIFIER Torque_Control_ETR07.VDC.Vehicle_Dynamics_Control_2018.VDC_2018_Complete.Merge7.Merge7 /end MEASUREMENT
/begin MEASUREMENT Torque_Control_ETR07.Torque_Control_ETR07_B.Merge_a "" FLOAT64_IEEE Torque_Control_ETR07_CM_double 0 0 -1.7e+308 1.7e+308 ECU_ADDRESS 0x0 DISPLAY_IDENTIFIER Torque_Control_ETR07.Calculate_Current_Conversion.KT_L_TORKY.Merge.Merge_a /end MEASUREMENT
/begin MEASUREMENT Torque_Control_ETR07.Torque_Control_ETR07_B.Merge_c "" FLOAT64_IEEE Torque_Control_ETR07_CM_double 0 0 -1.7e+308 1.7e+308 ECU_ADDRESS 0x0 DISPLAY_IDENTIFIER Torque_Control_ETR07.VDC.Vehicle_Dynamics_Control_2018.Merge.Merge_c /end MEASUREMENT
/begin MEASUREMENT Torque_Control_ETR07.Torque_Control_ETR07_B.Merge_cu "" FLOAT64_IEEE Torque_Control_ETR07_CM_double 0 0 -1.7e+308 1.7e+308 ECU_ADDRESS 0x0 DISPLAY_IDENTIFIER Torque_Control_ETR07.VDC.Vehicle_Dynamics_Control_2018.VDC_2018_Complete.Optimization_SKF__amp__CKF.Subsystem.CKF.Merge.Merge_cu /end MEASUREMENT
/begin MEASUREMENT Torque_Control_ETR07.Torque_Control_ETR07_B.Merge_d "" FLOAT64_IEEE Torque_Control_ETR07_CM_double 0 0 -1.7e+308 1.7e+308 ECU_ADDRESS 0x0 DISPLAY_IDENTIFIER Torque_Control_ETR07.VDC.Regeneration_Enable.Merge.Merge_d /end MEASUREMENT
/begin MEASUREMENT Torque_Control_ETR07.Torque_Control_ETR07_B.Merge_g "" FLOAT64_IEEE Torque_Control_ETR07_CM_double 0 0 -1.7e+308 1.7e+308 ECU_ADDRESS 0x0 DISPLAY_IDENTIFIER Torque_Control_ETR07.VDC.Vehicle_Dynamics_Control_2018.VDC_2018_without_Longitudinal.Optimization_SKF__amp__CKF.Subsystem.CKF.Merge.Merge_g /end MEASUREMENT
/begin MEASUREMENT Torque_Control_ETR07.Torque_Control_ETR07_B.Merge_h "" FLOAT64_IEEE Torque_Control_ETR07_CM_double 0 0 -1.7e+308 1.7e+308 ECU_ADDRESS 0x0 DISPLAY_IDENTIFIER Torque_Control_ETR07.VDC.Regeneration_Enable.Not_Braking.Merge.Merge_h /end MEASUREMENT
/begin MEASUREMENT Torque_Control_ETR07.Torque_Control_ETR07_B.Merge_i "" FLOAT64_IEEE Torque_Control_ETR07_CM_double 0 0 -1.7e+308 1.7e+308 ECU_ADDRESS 0x0 DISPLAY_IDENTIFIER Torque_Control_ETR07.VDC.Vehicle_Dynamics_Control_2018.VDC_2018_Complete.Optimization_SKF__amp__CKF.Subsystem.SKF.Merge.Merge_i /end MEASUREMENT
/begin MEASUREMENT Torque_Control_ETR07.Torque_Control_ETR07_B.Merge_j "" UBYTE Torque_Control_ETR07_CM_boolean 0 0 0 1 ECU_ADDRESS 0x0 DISPLAY_IDENTIFIER Torque_Control_ETR07.SAFETY_BLOCK.APPS_IMPLAUSIBILITY.Merge.Merge_j /end MEASUREMENT
/begin MEASUREMENT Torque_Control_ETR07.Torque_Control_ETR07_B.Merge_k "" FLOAT64_IEEE Torque_Control_ETR07_CM_double 0 0 -1.7e+308 1.7e+308 ECU_ADDRESS 0x0 DISPLAY_IDENTIFIER Torque_Control_ETR07.VDC.Vehicle_Dynamics_Control_2018.Steering_TV_2017_with_TC.Optimization_SKF__amp__CKF.Subsystem.CKF.Merge.Merge_k /end MEASUREMENT
/begin MEASUREMENT Torque_Control_ETR07.Torque_Control_ETR07_B.Merge_kj "" FLOAT64_IEEE Torque_Control_ETR07_CM_double 0 0 -1.7e+308 1.7e+308 ECU_ADDRESS 0x0 DISPLAY_IDENTIFIER Torque_Control_ETR07.VDC.Vehicle_Dynamics_Control_2018.Steering_TV_2017_with_TC.Optimization_SKF__amp__CKF.Subsystem.SKF.Merge.Merge_kj /end MEASUREMENT
/begin MEASUREMENT Torque_Control_ETR07.Torque_Control_ETR07_B.Merge_kt "" FLOAT64_IEEE Torque_Control_ETR07_CM_double 0 0 -1.7e+308 1.7e+308 ECU_ADDRESS 0x0 DISPLAY_IDENTIFIER Torque_Control_ETR07.VDC.Vehicle_Dynamics_Control_2018.VDC_2018_Complete.Driver____CarBehaviours.Merge.Merge_kt /end MEASUREMENT
/begin MEASUREMENT Torque_Control_ETR07.Torque_Control_ETR07_B.Merge_l "" FLOAT64_IEEE Torque_Control_ETR07_CM_double 0 0 -1.7e+308 1.7e+308 ECU_ADDRESS 0x0 DISPLAY_IDENTIFIER Torque_Control_ETR07.VDC.Vehicle_Dynamics_Control_2018.VDC_2018_without_Longitudinal.Driver____CarBehaviours.Merge.Merge_l /end MEASUREMENT
/begin MEASUREMENT Torque_Control_ETR07.Torque_Control_ETR07_B.Merge_m "" FLOAT64_IEEE Torque_Control_ETR07_CM_double 0 0 -1.7e+308 1.7e+308 ECU_ADDRESS 0x0 DISPLAY_IDENTIFIER Torque_Control_ETR07.VDC.Vehicle_Dynamics_Control_2018.VDC_2018_Complete.Merge.Merge_m /end MEASUREMENT
/begin MEASUREMENT Torque_Control_ETR07.Torque_Control_ETR07_B.Nospin_k.sf_MATLABFunction.CKF_act0 "" FLOAT64_IEEE Torque_Control_ETR07_CM_double 0 0 -1.7e+308 1.7e+308 ECU_ADDRESS 0x0 DISPLAY_IDENTIFIER Torque_Control_ETR07.VDC.Vehicle_Dynamics_Control_2018.VDC_2018_Complete.Optimization_SKF__amp__CKF.Subsystem.CKF.No_spin.MATLAB_Function.CKF_act0 /end MEASUREMENT
/begin MEASUREMENT Torque_Control_ETR07.Torque_Control_ETR07_B.Nospin_m.sf_MATLABFunction.CKF_act0 "" FLOAT64_IEEE Torque_Control_ETR07_CM_double 0 0 -1.7e+308 1.7e+308 ECU_ADDRESS 0x0 DISPLAY_IDENTIFIER Torque_Control_ETR07.VDC.Vehicle_Dynamics_Control_2018.VDC_2018_without_Longitudinal.Optimization_SKF__amp__CKF.Subsystem.CKF.No_spin.MATLAB_Function.CKF_act0 /end MEASUREMENT
/begin MEASUREMENT Torque_Control_ETR07.Torque_Control_ETR07_B.OutportBufferForFlags_num5 "" FLOAT64_IEEE Torque_Control_ETR07_CM_double 0 0 -1.7e+308 1.7e+308 ECU_ADDRESS 0x0 DISPLAY_IDENTIFIER Torque_Control_ETR07.VDC.Vehicle_Dynamics_Control_2018.VDC_2018_Complete.Flags.OutportBufferForFlags_num5 ARRAY_SIZE 5 /end MEASUREMENT
/begin MEASUREMENT Torque_Control_ETR07.Torque_Control_ETR07_B.Saturation "" FLOAT64_IEEE Torque_Control_ETR07_CM_double 0 0 -1.7e+308 1.7e+308 ECU_ADDRESS 0x0 DISPLAY_IDENTIFIER Torque_Control_ETR07.VDC.Vehicle_Dynamics_Control_2018.Steering_TV_2017_with_TC.Optimization_SKF__amp__CKF.Subsystem.CKF.Saturation.Saturation /end MEASUREMENT
/begin MEASUREMENT Torque_Control_ETR07.Torque_Control_ETR07_B.Saturation_f "" FLOAT64_IEEE Torque_Control_ETR07_CM_double 0 0 -1.7e+308 1.7e+308 ECU_ADDRESS 0x0 DISPLAY_IDENTIFIER Torque_Control_ETR07.VDC.Vehicle_Dynamics_Control_2018.VDC_2018_Complete.Optimization_SKF__amp__CKF.Subsystem.SKF.Saturation.Saturation_f /end MEASUREMENT
/begin MEASUREMENT Torque_Control_ETR07.Torque_Control_ETR07_B.Saturation_i "" FLOAT64_IEEE Torque_Control_ETR07_CM_double 0 0 -1.7e+308 1.7e+308 ECU_ADDRESS 0x0 DISPLAY_IDENTIFIER Torque_Control_ETR07.VDC.Vehicle_Dynamics_Control_2018.VDC_2018_Complete.Optimization_SKF__amp__CKF.Subsystem.CKF.Saturation.Saturation_i /end MEASUREMENT
/begin MEASUREMENT Torque_Control_ETR07.Torque_Control_ETR07_B.Saturation_k "" FLOAT64_IEEE Torque_Control_ETR07_CM_double 0 0 -1.7e+308 1.7e+308 ECU_ADDRESS 0x0 DISPLAY_IDENTIFIER Torque_Control_ETR07.VDC.Vehicle_Dynamics_Control_2018.Steering_TV_2017_with_TC.Optimization_SKF__amp__CKF.Subsystem.SKF.Saturation.Saturation_k /end MEASUREMENT
/begin MEASUREMENT Torque_Control_ETR07.Torque_Control_ETR07_B.Spin_n.Constant "" FLOAT64_IEEE Torque_Control_ETR07_CM_double 0 0 -1.7e+308 1.7e+308 ECU_ADDRESS 0x0 DISPLAY_IDENTIFIER Torque_Control_ETR07.VDC.Vehicle_Dynamics_Control_2018.VDC_2018_Complete.Optimization_SKF__amp__CKF.Subsystem.CKF.Spin.Constant.Constant /end MEASUREMENT
/begin MEASUREMENT Torque_Control_ETR07.Torque_Control_ETR07_B.Spin_n.sf_MATLABFunction.CKF_act1 "" FLOAT64_IEEE Torque_Control_ETR07_CM_double 0 0 -1.7e+308 1.7e+308 ECU_ADDRESS 0x0 DISPLAY_IDENTIFIER Torque_Control_ETR07.VDC.Vehicle_Dynamics_Control_2018.VDC_2018_Complete.Optimization_SKF__amp__CKF.Subsystem.CKF.Spin.MATLAB_Function.CKF_act1 /end MEASUREMENT
/begin MEASUREMENT Torque_Control_ETR07.Torque_Control_ETR07_B.Spin_nb.Constant "" FLOAT64_IEEE Torque_Control_ETR07_CM_double 0 0 -1.7e+308 1.7e+308 ECU_ADDRESS 0x0 DISPLAY_IDENTIFIER Torque_Control_ETR07.VDC.Vehicle_Dynamics_Control_2018.VDC_2018_without_Longitudinal.Optimization_SKF__amp__CKF.Subsystem.CKF.Spin.Constant.Constant /end MEASUREMENT
/begin MEASUREMENT Torque_Control_ETR07.Torque_Control_ETR07_B.Spin_nb.sf_MATLABFunction.CKF_act1 "" FLOAT64_IEEE Torque_Control_ETR07_CM_double 0 0 -1.7e+308 1.7e+308 ECU_ADDRESS 0x0 DISPLAY_IDENTIFIER Torque_Control_ETR07.VDC.Vehicle_Dynamics_Control_2018.VDC_2018_without_Longitudinal.Optimization_SKF__amp__CKF.Subsystem.CKF.Spin.MATLAB_Function.CKF_act1 /end MEASUREMENT
/begin MEASUREMENT Torque_Control_ETR07.Torque_Control_ETR07_B.SteeringWheelMaximumAngle "" FLOAT64_IEEE Torque_Control_ETR07_CM_double 0 0 -1.7e+308 1.7e+308 ECU_ADDRESS 0x0 DISPLAY_IDENTIFIER Torque_Control_ETR07.VDC.Vehicle_Dynamics_Control_2018.Steering_TV_2017_with_TC.Optimization_SKF__amp__CKF.Subsystem.Steering_Wheel_Maximum_Angle.SteeringWheelMaximumAngle /end MEASUREMENT
/begin MEASUREMENT Torque_Control_ETR07.Torque_Control_ETR07_B.SteeringWheelMaximumAngle_m "" FLOAT64_IEEE Torque_Control_ETR07_CM_double 0 0 -1.7e+308 1.7e+308 ECU_ADDRESS 0x0 DISPLAY_IDENTIFIER Torque_Control_ETR07.VDC.Vehicle_Dynamics_Control_2018.Steering_TV_2017_with_TC.Steering_Wheel_Maximum_Angle.SteeringWheelMaximumAngle_m /end MEASUREMENT
/begin MEASUREMENT Torque_Control_ETR07.Torque_Control_ETR07_B.SteeringWheelMaximumAngle_p "" FLOAT64_IEEE Torque_Control_ETR07_CM_double 0 0 -1.7e+308 1.7e+308 ECU_ADDRESS 0x0 DISPLAY_IDENTIFIER Torque_Control_ETR07.VDC.Vehicle_Dynamics_Control_2018.VDC_2018_Complete.Optimization_SKF__amp__CKF.Subsystem.Steering_Wheel_Maximum_Angle.SteeringWheelMaximumAngle_p /end MEASUREMENT
/begin MEASUREMENT Torque_Control_ETR07.Torque_Control_ETR07_B.SteeringWheelSaturationpersited "" FLOAT64_IEEE Torque_Control_ETR07_CM_double 0 0 -1.7e+308 1.7e+308 ECU_ADDRESS 0x0 DISPLAY_IDENTIFIER Torque_Control_ETR07.VDC.Vehicle_Dynamics_Control_2018.Steering_Wheel_Saturation__per_site__[deg].SteeringWheelSaturationpersited /end MEASUREMENT
/begin MEASUREMENT Torque_Control_ETR07.Torque_Control_ETR07_B.Steering_Ratio "" FLOAT64_IEEE Torque_Control_ETR07_CM_double 0 0 -1.7e+308 1.7e+308 ECU_ADDRESS 0x0 DISPLAY_IDENTIFIER Torque_Control_ETR07.VDC.Vehicle_Dynamics_Control_2018.VDC_2018_Complete.Lateral_Dynamics.Yaw_Rate_Reference.Steering_Ratio____.Steering_Ratio /end MEASUREMENT
/begin MEASUREMENT Torque_Control_ETR07.Torque_Control_ETR07_B.Subtract "" FLOAT64_IEEE Torque_Control_ETR07_CM_double 0 0 -1.7e+308 1.7e+308 ECU_ADDRESS 0x0 DISPLAY_IDENTIFIER Torque_Control_ETR07.Steering_Data_Conv.Low_Pass.Subtract.Subtract /end MEASUREMENT
/begin MEASUREMENT Torque_Control_ETR07.Torque_Control_ETR07_B.Throttle "" FLOAT64_IEEE Torque_Control_ETR07_CM_double 0 0 -1.7e+308 1.7e+308 ECU_ADDRESS 0x0 DISPLAY_IDENTIFIER Torque_Control_ETR07.VDC.Vehicle_Dynamics_Control_2018.VDC_2018_Complete.Driver____CarBehaviours.Accelerating.Throttle.Throttle /end MEASUREMENT
/begin MEASUREMENT Torque_Control_ETR07.Torque_Control_ETR07_B.Torque_RLNm "" FLOAT64_IEEE Torque_Control_ETR07_CM_double 0 0 -1.7e+308 1.7e+308 ECU_ADDRESS 0x0 DISPLAY_IDENTIFIER Torque_Control_ETR07.VDC.Vehicle_Dynamics_Control_2018.Rigid_Axle.Torque_RL_[Nm].Torque_RLNm /end MEASUREMENT
/begin MEASUREMENT Torque_Control_ETR07.Torque_Control_ETR07_B.Torque_RRNm "" FLOAT64_IEEE Torque_Control_ETR07_CM_double 0 0 -1.7e+308 1.7e+308 ECU_ADDRESS 0x0 DISPLAY_IDENTIFIER Torque_Control_ETR07.VDC.Vehicle_Dynamics_Control_2018.Rigid_Axle.Torque_RR_[Nm].Torque_RRNm /end MEASUREMENT
/begin MEASUREMENT Torque_Control_ETR07.Torque_Control_ETR07_B.Tq_diff_Max "" FLOAT64_IEEE Torque_Control_ETR07_CM_double 0 0 -1.7e+308 1.7e+308 ECU_ADDRESS 0x0 DISPLAY_IDENTIFIER Torque_Control_ETR07.VDC.Vehicle_Dynamics_Control_2018.VDC_2018_Complete.In_Numbers.Tq_diff_Max.Tq_diff_Max /end MEASUREMENT
/begin MEASUREMENT Torque_Control_ETR07.Torque_Control_ETR07_B.Tq_diff_maxNm "" FLOAT64_IEEE Torque_Control_ETR07_CM_double 0 0 -1.7e+308 1.7e+308 ECU_ADDRESS 0x0 DISPLAY_IDENTIFIER Torque_Control_ETR07.VDC.Vehicle_Dynamics_Control_2018.Steering_TV_2017_with_TC.Tq_diff_max_[Nm].Tq_diff_maxNm /end MEASUREMENT
/begin MEASUREMENT Torque_Control_ETR07.Torque_Control_ETR07_B.Tq_maxNm "" FLOAT64_IEEE Torque_Control_ETR07_CM_double 0 0 -1.7e+308 1.7e+308 ECU_ADDRESS 0x0 DISPLAY_IDENTIFIER Torque_Control_ETR07.VDC.Vehicle_Dynamics_Control_2018.Steering_TV_2017_with_TC.Tq_max_[Nm].Tq_maxNm /end MEASUREMENT
/begin MEASUREMENT Torque_Control_ETR07.Torque_Control_ETR07_B.TransmisionRatio "" FLOAT64_IEEE Torque_Control_ETR07_CM_double 0 0 -1.7e+308 1.7e+308 ECU_ADDRESS 0x0 DISPLAY_IDENTIFIER Torque_Control_ETR07.VDC.Vehicle_Dynamics_Control_2018.VDC_2018_without_Longitudinal.In_Numbers.Transmision_Ratio___.TransmisionRatio /end MEASUREMENT
/begin MEASUREMENT Torque_Control_ETR07.Torque_Control_ETR07_B.TransmisionRatio_b "" FLOAT64_IEEE Torque_Control_ETR07_CM_double 0 0 -1.7e+308 1.7e+308 ECU_ADDRESS 0x0 DISPLAY_IDENTIFIER Torque_Control_ETR07.VDC.Vehicle_Dynamics_Control_2018.VDC_2018_Complete.In_Numbers.Transmision_Ratio___.TransmisionRatio_b /end MEASUREMENT
/begin MEASUREMENT Torque_Control_ETR07.Torque_Control_ETR07_B.Wheelbasem "" FLOAT64_IEEE Torque_Control_ETR07_CM_double 0 0 -1.7e+308 1.7e+308 ECU_ADDRESS 0x0 DISPLAY_IDENTIFIER Torque_Control_ETR07.VDC.Vehicle_Dynamics_Control_2018.VDC_2018_Complete.Lateral_Dynamics.Yaw_Rate_Reference.Wheelbase_[m].Wheelbasem /end MEASUREMENT
/begin MEASUREMENT Torque_Control_ETR07.Torque_Control_ETR07_B.Yaw_Inertiakgm3 "" FLOAT64_IEEE Torque_Control_ETR07_CM_double 0 0 -1.7e+308 1.7e+308 ECU_ADDRESS 0x0 DISPLAY_IDENTIFIER Torque_Control_ETR07.VDC.Vehicle_Dynamics_Control_2018.VDC_2018_Complete.Lateral_Dynamics.Yaw_Inertia__kg__m_3_.Yaw_Inertiakgm3 /end MEASUREMENT
/begin MEASUREMENT Torque_Control_ETR07.Torque_Control_ETR07_B.Zero "" FLOAT64_IEEE Torque_Control_ETR07_CM_double 0 0 -1.7e+308 1.7e+308 ECU_ADDRESS 0x0 DISPLAY_IDENTIFIER Torque_Control_ETR07.VDC.Regeneration_Enable.Zero.Zero /end MEASUREMENT
/begin MEASUREMENT Torque_Control_ETR07.Torque_Control_ETR07_B.Zero_m "" FLOAT64_IEEE Torque_Control_ETR07_CM_double 0 0 -1.7e+308 1.7e+308 ECU_ADDRESS 0x0 DISPLAY_IDENTIFIER Torque_Control_ETR07.Calculate_Current_Conversion.KT_L_TORKY.Zero.Zero_m /end MEASUREMENT
/begin MEASUREMENT Torque_Control_ETR07.Torque_Control_ETR07_B.Zero_p "" FLOAT64_IEEE Torque_Control_ETR07_CM_double 0 0 -1.7e+308 1.7e+308 ECU_ADDRESS 0x0 DISPLAY_IDENTIFIER Torque_Control_ETR07.Calculate_Current_Conversion.KT_R_EMY.Zero.Zero_p /end MEASUREMENT
/begin MEASUREMENT Torque_Control_ETR07.Torque_Control_ETR07_B.approx2095 "" FLOAT64_IEEE Torque_Control_ETR07_CM_double 0 0 -1.7e+308 1.7e+308 ECU_ADDRESS 0x0 DISPLAY_IDENTIFIER Torque_Control_ETR07.VDC.Vehicle_Dynamics_Control_2018.VDC_2018_without_Longitudinal.Constraints.Acelerating_and_braking_without_Regenerative.Gain.approx_20.95 /end MEASUREMENT
/begin MEASUREMENT Torque_Control_ETR07.Torque_Control_ETR07_B.approx2095_h "" FLOAT64_IEEE Torque_Control_ETR07_CM_double 0 0 -1.7e+308 1.7e+308 ECU_ADDRESS 0x0 DISPLAY_IDENTIFIER Torque_Control_ETR07.VDC.Vehicle_Dynamics_Control_2018.VDC_2018_Complete.Constraints.Acelerating_and_braking_without_Regenerative.Gain.approx_20.95 /end MEASUREMENT
/begin MEASUREMENT Torque_Control_ETR07.Torque_Control_ETR07_B.exptcycletau1 "" FLOAT64_IEEE Torque_Control_ETR07_CM_double 0 0 -1.7e+308 1.7e+308 ECU_ADDRESS 0x0 DISPLAY_IDENTIFIER Torque_Control_ETR07.Steering_Data_Conv.Low_Pass.exp__tcycle__tau_1.exptcycletau1 /end MEASUREMENT
/begin MEASUREMENT Torque_Control_ETR07.Torque_Control_ETR07_B.sf_Acceleratorbehaviour.throttle "" FLOAT64_IEEE Torque_Control_ETR07_CM_double 0 0 -1.7e+308 1.7e+308 ECU_ADDRESS 0x0 DISPLAY_IDENTIFIER Torque_Control_ETR07.VDC.Vehicle_Dynamics_Control_2018.VDC_2018_Complete.Driver____CarBehaviours.Accelerator_behaviour.throttle /end MEASUREMENT
/begin MEASUREMENT Torque_Control_ETR07.Torque_Control_ETR07_B.sf_Acceleratorbehaviour_b.throttle "" FLOAT64_IEEE Torque_Control_ETR07_CM_double 0 0 -1.7e+308 1.7e+308 ECU_ADDRESS 0x0 DISPLAY_IDENTIFIER Torque_Control_ETR07.VDC.Vehicle_Dynamics_Control_2018.VDC_2018_without_Longitudinal.Driver____CarBehaviours.Accelerating.Accelerator_behaviour.throttle /end MEASUREMENT
/begin MEASUREMENT Torque_Control_ETR07.Torque_Control_ETR07_B.sf_Acceleratorbehaviour_f.throttle "" FLOAT64_IEEE Torque_Control_ETR07_CM_double 0 0 -1.7e+308 1.7e+308 ECU_ADDRESS 0x0 DISPLAY_IDENTIFIER Torque_Control_ETR07.VDC.Vehicle_Dynamics_Control_2018.Steering_TV_2017_with_TC.Accelerating.Accelerator_behaviour.throttle /end MEASUREMENT
/begin MEASUREMENT Torque_Control_ETR07.Torque_Control_ETR07_B.sf_Acceleratorbehaviour_o.throttle "" FLOAT64_IEEE Torque_Control_ETR07_CM_double 0 0 -1.7e+308 1.7e+308 ECU_ADDRESS 0x0 DISPLAY_IDENTIFIER Torque_Control_ETR07.VDC.Vehicle_Dynamics_Control_2018.Rigid_Axle.Accelerating.Accelerator_behaviour.throttle /end MEASUREMENT
/begin MEASUREMENT Torque_Control_ETR07.Torque_Control_ETR07_B.sf_MATLABFunction.RPM "" FLOAT64_IEEE Torque_Control_ETR07_CM_double 0 0 -1.7e+308 1.7e+308 ECU_ADDRESS 0x0 DISPLAY_IDENTIFIER Torque_Control_ETR07.VDC.Vehicle_Dynamics_Control_2018.VDC_2018_Complete.Optimization_SKF__amp__CKF.MATLAB_Function.RPM /end MEASUREMENT
/begin MEASUREMENT Torque_Control_ETR07.Torque_Control_ETR07_B.sf_MATLABFunction1_f.value "" FLOAT64_IEEE Torque_Control_ETR07_CM_double 0 0 -1.7e+308 1.7e+308 ECU_ADDRESS 0x0 DISPLAY_IDENTIFIER Torque_Control_ETR07.VDC.Vehicle_Dynamics_Control_2018.VDC_2018_without_Longitudinal.Kamm_Circle_Lateral.MATLAB_Function1.value /end MEASUREMENT
/begin MEASUREMENT Torque_Control_ETR07.Torque_Control_ETR07_B.sf_MATLABFunction1_g.value "" FLOAT64_IEEE Torque_Control_ETR07_CM_double 0 0 -1.7e+308 1.7e+308 ECU_ADDRESS 0x0 DISPLAY_IDENTIFIER Torque_Control_ETR07.VDC.Vehicle_Dynamics_Control_2018.VDC_2018_Complete.Longitudinal_Dynamics.MATLAB_Function1.value /end MEASUREMENT
/begin MEASUREMENT Torque_Control_ETR07.Torque_Control_ETR07_B.sf_MATLABFunction1_gm.value "" FLOAT64_IEEE Torque_Control_ETR07_CM_double 0 0 -1.7e+308 1.7e+308 ECU_ADDRESS 0x0 DISPLAY_IDENTIFIER Torque_Control_ETR07.VDC.Vehicle_Dynamics_Control_2018.VDC_2018_without_Longitudinal.Wheel_to_engine.MATLAB_Function1.value /end MEASUREMENT
/begin MEASUREMENT Torque_Control_ETR07.Torque_Control_ETR07_B.sf_MATLABFunction1_m.value "" FLOAT64_IEEE Torque_Control_ETR07_CM_double 0 0 -1.7e+308 1.7e+308 ECU_ADDRESS 0x0 DISPLAY_IDENTIFIER Torque_Control_ETR07.VDC.Vehicle_Dynamics_Control_2018.VDC_2018_Complete.Wheel_to_engine.MATLAB_Function1.value /end MEASUREMENT
/begin MEASUREMENT Torque_Control_ETR07.Torque_Control_ETR07_B.sf_MATLABFunction1_mk.value "" FLOAT64_IEEE Torque_Control_ETR07_CM_double 0 0 -1.7e+308 1.7e+308 ECU_ADDRESS 0x0 DISPLAY_IDENTIFIER Torque_Control_ETR07.VDC.Vehicle_Dynamics_Control_2018.VDC_2018_Complete.Lateral_Dynamics.MATLAB_Function1.value /end MEASUREMENT
/begin MEASUREMENT Torque_Control_ETR07.Torque_Control_ETR07_B.sf_MATLABFunction1_n.value "" FLOAT64_IEEE Torque_Control_ETR07_CM_double 0 0 -1.7e+308 1.7e+308 ECU_ADDRESS 0x0 DISPLAY_IDENTIFIER Torque_Control_ETR07.VDC.Vehicle_Dynamics_Control_2018.VDC_2018_Complete.MATLAB_Function1.value /end MEASUREMENT
/begin MEASUREMENT Torque_Control_ETR07.Torque_Control_ETR07_B.sf_MATLABFunction2.value "" FLOAT64_IEEE Torque_Control_ETR07_CM_double 0 0 -1.7e+308 1.7e+308 ECU_ADDRESS 0x0 DISPLAY_IDENTIFIER Torque_Control_ETR07.VDC.Vehicle_Dynamics_Control_2018.VDC_2018_Complete.Wheel_to_engine.MATLAB_Function2.value /end MEASUREMENT
/begin MEASUREMENT Torque_Control_ETR07.Torque_Control_ETR07_B.sf_MATLABFunction2_b.value "" FLOAT64_IEEE Torque_Control_ETR07_CM_double 0 0 -1.7e+308 1.7e+308 ECU_ADDRESS 0x0 DISPLAY_IDENTIFIER Torque_Control_ETR07.VDC.Vehicle_Dynamics_Control_2018.VDC_2018_without_Longitudinal.Kamm_Circle_Lateral.MATLAB_Function2.value /end MEASUREMENT
/begin MEASUREMENT Torque_Control_ETR07.Torque_Control_ETR07_B.sf_MATLABFunction2_e.value "" FLOAT64_IEEE Torque_Control_ETR07_CM_double 0 0 -1.7e+308 1.7e+308 ECU_ADDRESS 0x0 DISPLAY_IDENTIFIER Torque_Control_ETR07.VDC.Vehicle_Dynamics_Control_2018.VDC_2018_Complete.Lateral_Dynamics.MATLAB_Function2.value /end MEASUREMENT
/begin MEASUREMENT Torque_Control_ETR07.Torque_Control_ETR07_B.sf_MATLABFunction2_l.value "" FLOAT64_IEEE Torque_Control_ETR07_CM_double 0 0 -1.7e+308 1.7e+308 ECU_ADDRESS 0x0 DISPLAY_IDENTIFIER Torque_Control_ETR07.VDC.Vehicle_Dynamics_Control_2018.VDC_2018_Complete.MATLAB_Function2.value /end MEASUREMENT
/begin MEASUREMENT Torque_Control_ETR07.Torque_Control_ETR07_B.sf_MATLABFunction2_m.value "" FLOAT64_IEEE Torque_Control_ETR07_CM_double 0 0 -1.7e+308 1.7e+308 ECU_ADDRESS 0x0 DISPLAY_IDENTIFIER Torque_Control_ETR07.VDC.Vehicle_Dynamics_Control_2018.VDC_2018_without_Longitudinal.Wheel_to_engine.MATLAB_Function2.value /end MEASUREMENT
/begin MEASUREMENT Torque_Control_ETR07.Torque_Control_ETR07_B.sf_MATLABFunction_a.RPM "" FLOAT64_IEEE Torque_Control_ETR07_CM_double 0 0 -1.7e+308 1.7e+308 ECU_ADDRESS 0x0 DISPLAY_IDENTIFIER Torque_Control_ETR07.VDC.Vehicle_Dynamics_Control_2018.Steering_TV_2017_with_TC.Optimization_SKF__amp__CKF.MATLAB_Function.RPM /end MEASUREMENT
/begin MEASUREMENT Torque_Control_ETR07.Torque_Control_ETR07_B.sf_MATLABFunction_d.SKF_act0 "" FLOAT64_IEEE Torque_Control_ETR07_CM_double 0 0 -1.7e+308 1.7e+308 ECU_ADDRESS 0x0 DISPLAY_IDENTIFIER Torque_Control_ETR07.VDC.Vehicle_Dynamics_Control_2018.VDC_2018_Complete.Optimization_SKF__amp__CKF.Subsystem.SKF.No_spin.MATLAB_Function.SKF_act0 /end MEASUREMENT
/begin MEASUREMENT Torque_Control_ETR07.Torque_Control_ETR07_B.sf_MATLABFunction_d1.value "" FLOAT64_IEEE Torque_Control_ETR07_CM_double 0 0 -1.7e+308 1.7e+308 ECU_ADDRESS 0x0 DISPLAY_IDENTIFIER Torque_Control_ETR07.VDC.Vehicle_Dynamics_Control_2018.VDC_2018_Complete.Longitudinal_Dynamics.MATLAB_Function.value /end MEASUREMENT
/begin MEASUREMENT Torque_Control_ETR07.Torque_Control_ETR07_B.sf_MATLABFunction_fa.RPM "" FLOAT64_IEEE Torque_Control_ETR07_CM_double 0 0 -1.7e+308 1.7e+308 ECU_ADDRESS 0x0 DISPLAY_IDENTIFIER Torque_Control_ETR07.VDC.Vehicle_Dynamics_Control_2018.VDC_2018_without_Longitudinal.Optimization_SKF__amp__CKF.MATLAB_Function.RPM /end MEASUREMENT
/begin MEASUREMENT Torque_Control_ETR07.Torque_Control_ETR07_B.sf_MATLABFunction_fq.SKF_act0 "" FLOAT64_IEEE Torque_Control_ETR07_CM_double 0 0 -1.7e+308 1.7e+308 ECU_ADDRESS 0x0 DISPLAY_IDENTIFIER Torque_Control_ETR07.VDC.Vehicle_Dynamics_Control_2018.Steering_TV_2017_with_TC.Optimization_SKF__amp__CKF.Subsystem.SKF.No_spin.MATLAB_Function.SKF_act0 /end MEASUREMENT
/begin MEASUREMENT Torque_Control_ETR07.Torque_Control_ETR07_B.sf_MATLABFunction_k.CKF_act1 "" FLOAT64_IEEE Torque_Control_ETR07_CM_double 0 0 -1.7e+308 1.7e+308 ECU_ADDRESS 0x0 DISPLAY_IDENTIFIER Torque_Control_ETR07.VDC.Vehicle_Dynamics_Control_2018.Steering_TV_2017_with_TC.Optimization_SKF__amp__CKF.Subsystem.CKF.Spin.MATLAB_Function.CKF_act1 /end MEASUREMENT
/begin MEASUREMENT Torque_Control_ETR07.Torque_Control_ETR07_B.sf_MATLABFunction_k2.CKF_act0 "" FLOAT64_IEEE Torque_Control_ETR07_CM_double 0 0 -1.7e+308 1.7e+308 ECU_ADDRESS 0x0 DISPLAY_IDENTIFIER Torque_Control_ETR07.VDC.Vehicle_Dynamics_Control_2018.Steering_TV_2017_with_TC.Optimization_SKF__amp__CKF.Subsystem.CKF.No_spin.MATLAB_Function.CKF_act0 /end MEASUREMENT
/begin MEASUREMENT Torque_Control_ETR07.Torque_Control_ETR07_B.sf_MATLABFunction_m.SKF_act1 "" FLOAT64_IEEE Torque_Control_ETR07_CM_double 0 0 -1.7e+308 1.7e+308 ECU_ADDRESS 0x0 DISPLAY_IDENTIFIER Torque_Control_ETR07.VDC.Vehicle_Dynamics_Control_2018.VDC_2018_Complete.Optimization_SKF__amp__CKF.Subsystem.SKF.Spin.MATLAB_Function.SKF_act1 /end MEASUREMENT
/begin MEASUREMENT Torque_Control_ETR07.Torque_Control_ETR07_B.sf_MATLABFunction_p.SKF_act1 "" FLOAT64_IEEE Torque_Control_ETR07_CM_double 0 0 -1.7e+308 1.7e+308 ECU_ADDRESS 0x0 DISPLAY_IDENTIFIER Torque_Control_ETR07.VDC.Vehicle_Dynamics_Control_2018.Steering_TV_2017_with_TC.Optimization_SKF__amp__CKF.Subsystem.SKF.Spin.MATLAB_Function.SKF_act1 /end MEASUREMENT
/begin MEASUREMENT Torque_Control_ETR07.Torque_Control_ETR07_B.sf_minimumvalue.min "" FLOAT64_IEEE Torque_Control_ETR07_CM_double 0 0 -1.7e+308 1.7e+308 ECU_ADDRESS 0x0 DISPLAY_IDENTIFIER Torque_Control_ETR07.VDC.Vehicle_Dynamics_Control_2018.VDC_2018_Complete.Constraints.Acelerating_and_braking_without_Regenerative.minimum_value.min /end MEASUREMENT
/begin MEASUREMENT Torque_Control_ETR07.Torque_Control_ETR07_B.sf_minimumvalue1.min "" FLOAT64_IEEE Torque_Control_ETR07_CM_double 0 0 -1.7e+308 1.7e+308 ECU_ADDRESS 0x0 DISPLAY_IDENTIFIER Torque_Control_ETR07.VDC.Vehicle_Dynamics_Control_2018.VDC_2018_Complete.Constraints.Acelerating_and_braking_without_Regenerative.minimum_value1.min /end MEASUREMENT
/begin MEASUREMENT Torque_Control_ETR07.Torque_Control_ETR07_B.sf_minimumvalue1_k.min "" FLOAT64_IEEE Torque_Control_ETR07_CM_double 0 0 -1.7e+308 1.7e+308 ECU_ADDRESS 0x0 DISPLAY_IDENTIFIER Torque_Control_ETR07.VDC.Vehicle_Dynamics_Control_2018.VDC_2018_without_Longitudinal.Constraints.Acelerating_and_braking_without_Regenerative.minimum_value1.min /end MEASUREMENT
/begin MEASUREMENT Torque_Control_ETR07.Torque_Control_ETR07_B.sf_minimumvalue_o.min "" FLOAT64_IEEE Torque_Control_ETR07_CM_double 0 0 -1.7e+308 1.7e+308 ECU_ADDRESS 0x0 DISPLAY_IDENTIFIER Torque_Control_ETR07.VDC.Vehicle_Dynamics_Control_2018.VDC_2018_without_Longitudinal.Constraints.Acelerating_and_braking_without_Regenerative.minimum_value.min /end MEASUREMENT
/begin MEASUREMENT Torque_Control_ETR07.Torque_Control_ETR07_B.u602pi "" FLOAT64_IEEE Torque_Control_ETR07_CM_double 0 0 -1.7e+308 1.7e+308 ECU_ADDRESS 0x0 DISPLAY_IDENTIFIER Torque_Control_ETR07.VDC.Vehicle_Dynamics_Control_2018.VDC_2018_Complete.Lateral_Dynamics.Yaw_Rate_Reference.360___2_pi_.u602pi /end MEASUREMENT
/begin MEASUREMENT Torque_Control_ETR07.Torque_Control_ETR07_B.u602pi_e "" FLOAT64_IEEE Torque_Control_ETR07_CM_double 0 0 -1.7e+308 1.7e+308 ECU_ADDRESS 0x0 DISPLAY_IDENTIFIER Torque_Control_ETR07.VDC.Vehicle_Dynamics_Control_2018.VDC_2018_Complete.Lateral_Dynamics.Yaw_Rate_Reference.360___2pi_.u602pi_e /end MEASUREMENT
/begin MEASUREMENT Torque_Control_ETR07.Torque_Control_ETR07_B.udifference "" FLOAT64_IEEE Torque_Control_ETR07_CM_double 0 0 -1.7e+308 1.7e+308 ECU_ADDRESS 0x0 DISPLAY_IDENTIFIER Torque_Control_ETR07.VDC.Vehicle_Dynamics_Control_2018.VDC_2018_without_Longitudinal.In_Numbers.3__difference.udifference /end MEASUREMENT
/begin MEASUREMENT Torque_Control_ETR07.Torque_Control_ETR07_B.udifference_l "" FLOAT64_IEEE Torque_Control_ETR07_CM_double 0 0 -1.7e+308 1.7e+308 ECU_ADDRESS 0x0 DISPLAY_IDENTIFIER Torque_Control_ETR07.VDC.Vehicle_Dynamics_Control_2018.VDC_2018_Complete.In_Numbers.3__difference.udifference_l /end MEASUREMENT
/begin MEASUREMENT Torque_Control_ETR07.Torque_Control_ETR07_DW.A "" FLOAT64_IEEE Torque_Control_ETR07_CM_double 0 0 -1.7e+308 1.7e+308 ECU_ADDRESS 0x0 DISPLAY_IDENTIFIER Torque_Control_ETR07.VDC.Vehicle_Dynamics_Control_2018.Steering_TV_2017_with_TC.Optimization_SKF__amp__CKF.Data_Store_Memory.A /end MEASUREMENT
/begin MEASUREMENT Torque_Control_ETR07.Torque_Control_ETR07_DW.AA "" UBYTE Torque_Control_ETR07_CM_boolean 0 0 0 1 ECU_ADDRESS 0x0 DISPLAY_IDENTIFIER Torque_Control_ETR07.SAFETY_BLOCK.BRAKE_IMPLAUSIBILITY.Data_Store_Memory1.AA /end MEASUREMENT
/begin MEASUREMENT Torque_Control_ETR07.Torque_Control_ETR07_DW.A_b "" FLOAT64_IEEE Torque_Control_ETR07_CM_double 0 0 -1.7e+308 1.7e+308 ECU_ADDRESS 0x0 DISPLAY_IDENTIFIER Torque_Control_ETR07.VDC.Vehicle_Dynamics_Control_2018.VDC_2018_Complete.Optimization_SKF__amp__CKF.Data_Store_Memory.A_b /end MEASUREMENT
/begin MEASUREMENT Torque_Control_ETR07.Torque_Control_ETR07_DW.A_i "" FLOAT64_IEEE Torque_Control_ETR07_CM_double 0 0 -1.7e+308 1.7e+308 ECU_ADDRESS 0x0 DISPLAY_IDENTIFIER Torque_Control_ETR07.Accumulator_Power.PowerLimitDetection.Data_Store_Memory10.A_i /end MEASUREMENT
/begin MEASUREMENT Torque_Control_ETR07.Torque_Control_ETR07_DW.B "" FLOAT64_IEEE Torque_Control_ETR07_CM_double 0 0 -1.7e+308 1.7e+308 ECU_ADDRESS 0x0 DISPLAY_IDENTIFIER Torque_Control_ETR07.VDC.Vehicle_Dynamics_Control_2018.Steering_TV_2017_with_TC.Optimization_SKF__amp__CKF.Data_Store_Memory1.B /end MEASUREMENT
/begin MEASUREMENT Torque_Control_ETR07.Torque_Control_ETR07_DW.B_i "" FLOAT64_IEEE Torque_Control_ETR07_CM_double 0 0 -1.7e+308 1.7e+308 ECU_ADDRESS 0x0 DISPLAY_IDENTIFIER Torque_Control_ETR07.VDC.Vehicle_Dynamics_Control_2018.VDC_2018_Complete.Optimization_SKF__amp__CKF.Data_Store_Memory1.B_i /end MEASUREMENT
/begin MEASUREMENT Torque_Control_ETR07.Torque_Control_ETR07_DW.B_k "" FLOAT64_IEEE Torque_Control_ETR07_CM_double 0 0 -1.7e+308 1.7e+308 ECU_ADDRESS 0x0 DISPLAY_IDENTIFIER Torque_Control_ETR07.VDC.Vehicle_Dynamics_Control_2018.VDC_2018_without_Longitudinal.Optimization_SKF__amp__CKF.Data_Store_Memory1.B_k /end MEASUREMENT
/begin MEASUREMENT Torque_Control_ETR07.Torque_Control_ETR07_DW.Previous_IN "" FLOAT64_IEEE Torque_Control_ETR07_CM_double 0 0 -1.7e+308 1.7e+308 ECU_ADDRESS 0x0 DISPLAY_IDENTIFIER Torque_Control_ETR07.Steering_Data_Conv.Low_Pass.Data_Store_Memory.Previous_IN /end MEASUREMENT
/begin MEASUREMENT Torque_Control_ETR07.Torque_Control_ETR07_DW.Previous_OUT "" FLOAT64_IEEE Torque_Control_ETR07_CM_double 0 0 -1.7e+308 1.7e+308 ECU_ADDRESS 0x0 DISPLAY_IDENTIFIER Torque_Control_ETR07.Steering_Data_Conv.Low_Pass.Data_Store_Memory1.Previous_OUT /end MEASUREMENT
/begin MEASUREMENT Torque_Control_ETR07.Torque_Control_ETR07_DW.R "" FLOAT64_IEEE Torque_Control_ETR07_CM_double 0 0 -1.7e+308 1.7e+308 ECU_ADDRESS 0x0 DISPLAY_IDENTIFIER Torque_Control_ETR07.VDC.Regeneration_Enable.Data_Store_Memory.R /end MEASUREMENT
/begin MEASUREMENT Torque_Control_ETR07.Torque_Control_ETR07_U.ACCEL_F_X_SI "" FLOAT64_IEEE Torque_Control_ETR07_CM_double 0 0 -1.7e+308 1.7e+308 ECU_ADDRESS 0x0 DISPLAY_IDENTIFIER Torque_Control_ETR07.ACCEL_F_X_SI /end MEASUREMENT
/begin MEASUREMENT Torque_Control_ETR07.Torque_Control_ETR07_U.ACCEL_F_Y_SI "" FLOAT64_IEEE Torque_Control_ETR07_CM_double 0 0 -1.7e+308 1.7e+308 ECU_ADDRESS 0x0 DISPLAY_IDENTIFIER Torque_Control_ETR07.ACCEL_F_Y_SI /end MEASUREMENT
/begin MEASUREMENT Torque_Control_ETR07.Torque_Control_ETR07_U.ACCEL_F_Z_SI "" FLOAT64_IEEE Torque_Control_ETR07_CM_double 0 0 -1.7e+308 1.7e+308 ECU_ADDRESS 0x0 DISPLAY_IDENTIFIER Torque_Control_ETR07.ACCEL_F_Z_SI /end MEASUREMENT
/begin MEASUREMENT Torque_Control_ETR07.Torque_Control_ETR07_U.ACCEL_R_X_SI "" FLOAT64_IEEE Torque_Control_ETR07_CM_double 0 0 -1.7e+308 1.7e+308 ECU_ADDRESS 0x0 DISPLAY_IDENTIFIER Torque_Control_ETR07.ACCEL_R_X_SI /end MEASUREMENT
/begin MEASUREMENT Torque_Control_ETR07.Torque_Control_ETR07_U.ACCEL_R_Y_SI "" FLOAT64_IEEE Torque_Control_ETR07_CM_double 0 0 -1.7e+308 1.7e+308 ECU_ADDRESS 0x0 DISPLAY_IDENTIFIER Torque_Control_ETR07.ACCEL_R_Y_SI /end MEASUREMENT
/begin MEASUREMENT Torque_Control_ETR07.Torque_Control_ETR07_U.ACCEL_R_Z_SI "" FLOAT64_IEEE Torque_Control_ETR07_CM_double 0 0 -1.7e+308 1.7e+308 ECU_ADDRESS 0x0 DISPLAY_IDENTIFIER Torque_Control_ETR07.ACCEL_R_Z_SI /end MEASUREMENT
/begin MEASUREMENT Torque_Control_ETR07.Torque_Control_ETR07_U.APPS1_Value "" FLOAT64_IEEE Torque_Control_ETR07_CM_double 0 0 -1.7e+308 1.7e+308 ECU_ADDRESS 0x0 DISPLAY_IDENTIFIER Torque_Control_ETR07.APPS1_Value /end MEASUREMENT
/begin MEASUREMENT Torque_Control_ETR07.Torque_Control_ETR07_U.APPS2_Value "" FLOAT64_IEEE Torque_Control_ETR07_CM_double 0 0 -1.7e+308 1.7e+308 ECU_ADDRESS 0x0 DISPLAY_IDENTIFIER Torque_Control_ETR07.APPS2_Value /end MEASUREMENT
/begin MEASUREMENT Torque_Control_ETR07.Torque_Control_ETR07_U.Accumulator_Current "" FLOAT64_IEEE Torque_Control_ETR07_CM_double 0 0 -1.7e+308 1.7e+308 ECU_ADDRESS 0x0 DISPLAY_IDENTIFIER Torque_Control_ETR07.Accumulator_Current /end MEASUREMENT
/begin MEASUREMENT Torque_Control_ETR07.Torque_Control_ETR07_U.Accumulator_Voltage "" FLOAT64_IEEE Torque_Control_ETR07_CM_double 0 0 -1.7e+308 1.7e+308 ECU_ADDRESS 0x0 DISPLAY_IDENTIFIER Torque_Control_ETR07.Accumulator_Voltage /end MEASUREMENT
/begin MEASUREMENT Torque_Control_ETR07.Torque_Control_ETR07_U.BrakeSensor_Value "" FLOAT64_IEEE Torque_Control_ETR07_CM_double 0 0 -1.7e+308 1.7e+308 ECU_ADDRESS 0x0 DISPLAY_IDENTIFIER Torque_Control_ETR07.BrakeSensor_Value /end MEASUREMENT
/begin MEASUREMENT Torque_Control_ETR07.Torque_Control_ETR07_U.Car_State "" FLOAT64_IEEE Torque_Control_ETR07_CM_double 0 0 -1.7e+308 1.7e+308 ECU_ADDRESS 0x0 DISPLAY_IDENTIFIER Torque_Control_ETR07.Car_State /end MEASUREMENT
/begin MEASUREMENT Torque_Control_ETR07.Torque_Control_ETR07_U.CriticalDisconnection "" UBYTE Torque_Control_ETR07_CM_boolean 0 0 0 1 ECU_ADDRESS 0x0 DISPLAY_IDENTIFIER Torque_Control_ETR07.CriticalDisconnection /end MEASUREMENT
/begin MEASUREMENT Torque_Control_ETR07.Torque_Control_ETR07_U.Gyro_F_Z_Deg "" FLOAT64_IEEE Torque_Control_ETR07_CM_double 0 0 -1.7e+308 1.7e+308 ECU_ADDRESS 0x0 DISPLAY_IDENTIFIER Torque_Control_ETR07.Gyro_F_Z_Deg /end MEASUREMENT
/begin MEASUREMENT Torque_Control_ETR07.Torque_Control_ETR07_U.Highest_CellTemp "" FLOAT64_IEEE Torque_Control_ETR07_CM_double 0 0 -1.7e+308 1.7e+308 ECU_ADDRESS 0x0 DISPLAY_IDENTIFIER Torque_Control_ETR07.Highest_CellTemp /end MEASUREMENT
/begin MEASUREMENT Torque_Control_ETR07.Torque_Control_ETR07_U.RL_rads "" FLOAT64_IEEE Torque_Control_ETR07_CM_double 0 0 -1.7e+308 1.7e+308 ECU_ADDRESS 0x0 DISPLAY_IDENTIFIER Torque_Control_ETR07.RL_rads /end MEASUREMENT
/begin MEASUREMENT Torque_Control_ETR07.Torque_Control_ETR07_U.RR_rads "" FLOAT64_IEEE Torque_Control_ETR07_CM_double 0 0 -1.7e+308 1.7e+308 ECU_ADDRESS 0x0 DISPLAY_IDENTIFIER Torque_Control_ETR07.RR_rads /end MEASUREMENT
/begin MEASUREMENT Torque_Control_ETR07.Torque_Control_ETR07_U.ShutdownClosed "" UBYTE Torque_Control_ETR07_CM_boolean 0 0 0 1 ECU_ADDRESS 0x0 DISPLAY_IDENTIFIER Torque_Control_ETR07.ShutdownClosed /end MEASUREMENT
/begin MEASUREMENT Torque_Control_ETR07.Torque_Control_ETR07_U.SteeringSensor_Bits "" FLOAT64_IEEE Torque_Control_ETR07_CM_double 0 0 -1.7e+308 1.7e+308 ECU_ADDRESS 0x0 DISPLAY_IDENTIFIER Torque_Control_ETR07.SteeringSensor_Bits /end MEASUREMENT
/begin MEASUREMENT Torque_Control_ETR07.Torque_Control_ETR07_U.Susp_F_L "" FLOAT64_IEEE Torque_Control_ETR07_CM_double 0 0 -1.7e+308 1.7e+308 ECU_ADDRESS 0x0 DISPLAY_IDENTIFIER Torque_Control_ETR07.Susp_F_L /end MEASUREMENT
/begin MEASUREMENT Torque_Control_ETR07.Torque_Control_ETR07_U.Susp_F_R "" FLOAT64_IEEE Torque_Control_ETR07_CM_double 0 0 -1.7e+308 1.7e+308 ECU_ADDRESS 0x0 DISPLAY_IDENTIFIER Torque_Control_ETR07.Susp_F_R /end MEASUREMENT
/begin MEASUREMENT Torque_Control_ETR07.Torque_Control_ETR07_U.Susp_R_L "" FLOAT64_IEEE Torque_Control_ETR07_CM_double 0 0 -1.7e+308 1.7e+308 ECU_ADDRESS 0x0 DISPLAY_IDENTIFIER Torque_Control_ETR07.Susp_R_L /end MEASUREMENT
/begin MEASUREMENT Torque_Control_ETR07.Torque_Control_ETR07_U.Susp_R_R "" FLOAT64_IEEE Torque_Control_ETR07_CM_double 0 0 -1.7e+308 1.7e+308 ECU_ADDRESS 0x0 DISPLAY_IDENTIFIER Torque_Control_ETR07.Susp_R_R /end MEASUREMENT
/begin MEASUREMENT Torque_Control_ETR07.Torque_Control_ETR07_U.TV_Mode "" FLOAT64_IEEE Torque_Control_ETR07_CM_double 0 0 -1.7e+308 1.7e+308 ECU_ADDRESS 0x0 DISPLAY_IDENTIFIER Torque_Control_ETR07.TV_Mode /end MEASUREMENT
/begin MEASUREMENT Torque_Control_ETR07.Torque_Control_ETR07_U.Temp_IGBT "" FLOAT64_IEEE Torque_Control_ETR07_CM_double 0 0 -1.7e+308 1.7e+308 ECU_ADDRESS 0x0 DISPLAY_IDENTIFIER Torque_Control_ETR07.Temp_IGBT /end MEASUREMENT
/begin MEASUREMENT Torque_Control_ETR07.Torque_Control_ETR07_U.Temp_Motors "" FLOAT64_IEEE Torque_Control_ETR07_CM_double 0 0 -1.7e+308 1.7e+308 ECU_ADDRESS 0x0 DISPLAY_IDENTIFIER Torque_Control_ETR07.Temp_Motors /end MEASUREMENT
/begin MEASUREMENT Torque_Control_ETR07.Torque_Control_ETR07_U.TorqueEnable "" UBYTE Torque_Control_ETR07_CM_boolean 0 0 0 1 ECU_ADDRESS 0x0 DISPLAY_IDENTIFIER Torque_Control_ETR07.TorqueEnable /end MEASUREMENT
/begin MEASUREMENT Torque_Control_ETR07.Torque_Control_ETR07_U.VDC_Apps_Sat_Down "" FLOAT64_IEEE Torque_Control_ETR07_CM_double 0 0 -1.7e+308 1.7e+308 ECU_ADDRESS 0x0 DISPLAY_IDENTIFIER Torque_Control_ETR07.VDC_Apps_Sat_Down /end MEASUREMENT
/begin MEASUREMENT Torque_Control_ETR07.Torque_Control_ETR07_U.VDC_Apps_Sat_Up "" FLOAT64_IEEE Torque_Control_ETR07_CM_double 0 0 -1.7e+308 1.7e+308 ECU_ADDRESS 0x0 DISPLAY_IDENTIFIER Torque_Control_ETR07.VDC_Apps_Sat_Up /end MEASUREMENT
/begin MEASUREMENT Torque_Control_ETR07.Torque_Control_ETR07_U.VDC_CKF_Initial "" FLOAT64_IEEE Torque_Control_ETR07_CM_double 0 0 -1.7e+308 1.7e+308 ECU_ADDRESS 0x0 DISPLAY_IDENTIFIER Torque_Control_ETR07.VDC_CKF_Initial /end MEASUREMENT
/begin MEASUREMENT Torque_Control_ETR07.Torque_Control_ETR07_U.VDC_Cte_CKF "" FLOAT64_IEEE Torque_Control_ETR07_CM_double 0 0 -1.7e+308 1.7e+308 ECU_ADDRESS 0x0 DISPLAY_IDENTIFIER Torque_Control_ETR07.VDC_Cte_CKF /end MEASUREMENT
/begin MEASUREMENT Torque_Control_ETR07.Torque_Control_ETR07_U.VDC_Cte_SKF "" FLOAT64_IEEE Torque_Control_ETR07_CM_double 0 0 -1.7e+308 1.7e+308 ECU_ADDRESS 0x0 DISPLAY_IDENTIFIER Torque_Control_ETR07.VDC_Cte_SKF /end MEASUREMENT
/begin MEASUREMENT Torque_Control_ETR07.Torque_Control_ETR07_U.VDC_K_Reduction_P "" FLOAT64_IEEE Torque_Control_ETR07_CM_double 0 0 -1.7e+308 1.7e+308 ECU_ADDRESS 0x0 DISPLAY_IDENTIFIER Torque_Control_ETR07.VDC_K_Reduction_P /end MEASUREMENT
/begin MEASUREMENT Torque_Control_ETR07.Torque_Control_ETR07_U.VDC_K_Reduction_Temperature "" FLOAT64_IEEE Torque_Control_ETR07_CM_double 0 0 -1.7e+308 1.7e+308 ECU_ADDRESS 0x0 DISPLAY_IDENTIFIER Torque_Control_ETR07.VDC_K_Reduction_Temperature /end MEASUREMENT
/begin MEASUREMENT Torque_Control_ETR07.Torque_Control_ETR07_U.VDC_Max_Regenerative_Torque "" FLOAT64_IEEE Torque_Control_ETR07_CM_double 0 0 -1.7e+308 1.7e+308 ECU_ADDRESS 0x0 DISPLAY_IDENTIFIER Torque_Control_ETR07.VDC_Max_Regenerative_Torque /end MEASUREMENT
/begin MEASUREMENT Torque_Control_ETR07.Torque_Control_ETR07_U.VDC_Power_Limit "" FLOAT64_IEEE Torque_Control_ETR07_CM_double 0 0 -1.7e+308 1.7e+308 ECU_ADDRESS 0x0 DISPLAY_IDENTIFIER Torque_Control_ETR07.VDC_Power_Limit /end MEASUREMENT
/begin MEASUREMENT Torque_Control_ETR07.Torque_Control_ETR07_U.VDC_SKF_Initial "" FLOAT64_IEEE Torque_Control_ETR07_CM_double 0 0 -1.7e+308 1.7e+308 ECU_ADDRESS 0x0 DISPLAY_IDENTIFIER Torque_Control_ETR07.VDC_SKF_Initial /end MEASUREMENT
/begin MEASUREMENT Torque_Control_ETR07.Torque_Control_ETR07_U.Vel_RL_kmh "" FLOAT64_IEEE Torque_Control_ETR07_CM_double 0 0 -1.7e+308 1.7e+308 ECU_ADDRESS 0x0 DISPLAY_IDENTIFIER Torque_Control_ETR07.Vel_RL_kmh /end MEASUREMENT
/begin MEASUREMENT Torque_Control_ETR07.Torque_Control_ETR07_U.Vel_RR_kmh "" FLOAT64_IEEE Torque_Control_ETR07_CM_double 0 0 -1.7e+308 1.7e+308 ECU_ADDRESS 0x0 DISPLAY_IDENTIFIER Torque_Control_ETR07.Vel_RR_kmh /end MEASUREMENT
/begin MEASUREMENT Torque_Control_ETR07.Torque_Control_ETR07_U.Workshop_Mode_Enable "" FLOAT64_IEEE Torque_Control_ETR07_CM_double 0 0 -1.7e+308 1.7e+308 ECU_ADDRESS 0x0 DISPLAY_IDENTIFIER Torque_Control_ETR07.Workshop_Mode_Enable /end MEASUREMENT
/begin MEASUREMENT Torque_Control_ETR07.Torque_Control_ETR07_Y.APPS_Implausibility "" UBYTE Torque_Control_ETR07_CM_boolean 0 0 0 1 ECU_ADDRESS 0x0 DISPLAY_IDENTIFIER Torque_Control_ETR07.APPS_Implausibility /end MEASUREMENT
/begin MEASUREMENT Torque_Control_ETR07.Torque_Control_ETR07_Y.Brake_Implausibility "" UBYTE Torque_Control_ETR07_CM_boolean 0 0 0 1 ECU_ADDRESS 0x0 DISPLAY_IDENTIFIER Torque_Control_ETR07.Brake_Implausibility /end MEASUREMENT
/begin MEASUREMENT Torque_Control_ETR07.Torque_Control_ETR07_Y.CKF_actual "" FLOAT64_IEEE Torque_Control_ETR07_CM_double 0 0 -1.7e+308 1.7e+308 ECU_ADDRESS 0x0 DISPLAY_IDENTIFIER Torque_Control_ETR07.CKF_actual /end MEASUREMENT
/begin MEASUREMENT Torque_Control_ETR07.Torque_Control_ETR07_Y.Dash_Speed "" FLOAT64_IEEE Torque_Control_ETR07_CM_double 0 0 -1.7e+308 1.7e+308 ECU_ADDRESS 0x0 DISPLAY_IDENTIFIER Torque_Control_ETR07.Dash_Speed /end MEASUREMENT
/begin MEASUREMENT Torque_Control_ETR07.Torque_Control_ETR07_Y.Fy_R "" FLOAT64_IEEE Torque_Control_ETR07_CM_double 0 0 -1.7e+308 1.7e+308 ECU_ADDRESS 0x0 DISPLAY_IDENTIFIER Torque_Control_ETR07.Fy_R /end MEASUREMENT
/begin MEASUREMENT Torque_Control_ETR07.Torque_Control_ETR07_Y.Handling "" FLOAT64_IEEE Torque_Control_ETR07_CM_double 0 0 -1.7e+308 1.7e+308 ECU_ADDRESS 0x0 DISPLAY_IDENTIFIER Torque_Control_ETR07.Handling /end MEASUREMENT
/begin MEASUREMENT Torque_Control_ETR07.Torque_Control_ETR07_Y.Mass "" FLOAT64_IEEE Torque_Control_ETR07_CM_double 0 0 -1.7e+308 1.7e+308 ECU_ADDRESS 0x0 DISPLAY_IDENTIFIER Torque_Control_ETR07.Mass /end MEASUREMENT
/begin MEASUREMENT Torque_Control_ETR07.Torque_Control_ETR07_Y.Max_Fx_RL "" FLOAT64_IEEE Torque_Control_ETR07_CM_double 0 0 -1.7e+308 1.7e+308 ECU_ADDRESS 0x0 DISPLAY_IDENTIFIER Torque_Control_ETR07.Max_Fx_RL /end MEASUREMENT
/begin MEASUREMENT Torque_Control_ETR07.Torque_Control_ETR07_Y.Max_Fx_RR "" FLOAT64_IEEE Torque_Control_ETR07_CM_double 0 0 -1.7e+308 1.7e+308 ECU_ADDRESS 0x0 DISPLAY_IDENTIFIER Torque_Control_ETR07.Max_Fx_RR /end MEASUREMENT
/begin MEASUREMENT Torque_Control_ETR07.Torque_Control_ETR07_Y.Max_Torque_RL "" FLOAT64_IEEE Torque_Control_ETR07_CM_double 0 0 -1.7e+308 1.7e+308 ECU_ADDRESS 0x0 DISPLAY_IDENTIFIER Torque_Control_ETR07.Max_Torque_RL /end MEASUREMENT
/begin MEASUREMENT Torque_Control_ETR07.Torque_Control_ETR07_Y.Max_Torque_RR "" FLOAT64_IEEE Torque_Control_ETR07_CM_double 0 0 -1.7e+308 1.7e+308 ECU_ADDRESS 0x0 DISPLAY_IDENTIFIER Torque_Control_ETR07.Max_Torque_RR /end MEASUREMENT
/begin MEASUREMENT Torque_Control_ETR07.Torque_Control_ETR07_Y.MeasVDCTorque_L "" FLOAT64_IEEE Torque_Control_ETR07_CM_double 0 0 -1.7e+308 1.7e+308 ECU_ADDRESS 0x0 DISPLAY_IDENTIFIER Torque_Control_ETR07.Meas_VDC_Torque_L /end MEASUREMENT
/begin MEASUREMENT Torque_Control_ETR07.Torque_Control_ETR07_Y.MeasVDCTorque_R "" FLOAT64_IEEE Torque_Control_ETR07_CM_double 0 0 -1.7e+308 1.7e+308 ECU_ADDRESS 0x0 DISPLAY_IDENTIFIER Torque_Control_ETR07.Meas_VDC_Torque_R /end MEASUREMENT
/begin MEASUREMENT Torque_Control_ETR07.Torque_Control_ETR07_Y.Power "" FLOAT64_IEEE Torque_Control_ETR07_CM_double 0 0 -1.7e+308 1.7e+308 ECU_ADDRESS 0x0 DISPLAY_IDENTIFIER Torque_Control_ETR07.Power /end MEASUREMENT
/begin MEASUREMENT Torque_Control_ETR07.Torque_Control_ETR07_Y.PowerLimitReached "" FLOAT64_IEEE Torque_Control_ETR07_CM_double 0 0 -1.7e+308 1.7e+308 ECU_ADDRESS 0x0 DISPLAY_IDENTIFIER Torque_Control_ETR07.PowerLimitReached /end MEASUREMENT
/begin MEASUREMENT Torque_Control_ETR07.Torque_Control_ETR07_Y.PowerMean500ms "" FLOAT64_IEEE Torque_Control_ETR07_CM_double 0 0 -1.7e+308 1.7e+308 ECU_ADDRESS 0x0 DISPLAY_IDENTIFIER Torque_Control_ETR07.PowerMean500ms /end MEASUREMENT
/begin MEASUREMENT Torque_Control_ETR07.Torque_Control_ETR07_Y.Pumps_Control "" FLOAT64_IEEE Torque_Control_ETR07_CM_double 0 0 -1.7e+308 1.7e+308 ECU_ADDRESS 0x0 DISPLAY_IDENTIFIER Torque_Control_ETR07.Pumps_Control /end MEASUREMENT
/begin MEASUREMENT Torque_Control_ETR07.Torque_Control_ETR07_Y.Regenerative_Enable "" FLOAT64_IEEE Torque_Control_ETR07_CM_double 0 0 -1.7e+308 1.7e+308 ECU_ADDRESS 0x0 DISPLAY_IDENTIFIER Torque_Control_ETR07.Regenerative_Enable /end MEASUREMENT
/begin MEASUREMENT Torque_Control_ETR07.Torque_Control_ETR07_Y.SKF_actual "" FLOAT64_IEEE Torque_Control_ETR07_CM_double 0 0 -1.7e+308 1.7e+308 ECU_ADDRESS 0x0 DISPLAY_IDENTIFIER Torque_Control_ETR07.SKF_actual /end MEASUREMENT
/begin MEASUREMENT Torque_Control_ETR07.Torque_Control_ETR07_Y.SteeringSensor_Value "" FLOAT64_IEEE Torque_Control_ETR07_CM_double 0 0 -1.7e+308 1.7e+308 ECU_ADDRESS 0x0 DISPLAY_IDENTIFIER Torque_Control_ETR07.SteeringSensor_Value /end MEASUREMENT
/begin MEASUREMENT Torque_Control_ETR07.Torque_Control_ETR07_Y.TV_Flag_CarBehaviour "" FLOAT64_IEEE Torque_Control_ETR07_CM_double 0 0 -1.7e+308 1.7e+308 ECU_ADDRESS 0x0 DISPLAY_IDENTIFIER Torque_Control_ETR07.TV_Flag_CarBehaviour /end MEASUREMENT
/begin MEASUREMENT Torque_Control_ETR07.Torque_Control_ETR07_Y.TV_Flag_Power "" FLOAT64_IEEE Torque_Control_ETR07_CM_double 0 0 -1.7e+308 1.7e+308 ECU_ADDRESS 0x0 DISPLAY_IDENTIFIER Torque_Control_ETR07.TV_Flag_Power /end MEASUREMENT
/begin MEASUREMENT Torque_Control_ETR07.Torque_Control_ETR07_Y.TV_Flag_Temperature "" FLOAT64_IEEE Torque_Control_ETR07_CM_double 0 0 -1.7e+308 1.7e+308 ECU_ADDRESS 0x0 DISPLAY_IDENTIFIER Torque_Control_ETR07.TV_Flag_Temperature /end MEASUREMENT
/begin MEASUREMENT Torque_Control_ETR07.Torque_Control_ETR07_Y.TV_Flag_WheelSpinRL "" FLOAT64_IEEE Torque_Control_ETR07_CM_double 0 0 -1.7e+308 1.7e+308 ECU_ADDRESS 0x0 DISPLAY_IDENTIFIER Torque_Control_ETR07.TV_Flag_WheelSpinRL /end MEASUREMENT
/begin MEASUREMENT Torque_Control_ETR07.Torque_Control_ETR07_Y.TV_Flag_WheelSpinRR "" FLOAT64_IEEE Torque_Control_ETR07_CM_double 0 0 -1.7e+308 1.7e+308 ECU_ADDRESS 0x0 DISPLAY_IDENTIFIER Torque_Control_ETR07.TV_Flag_WheelSpinRR /end MEASUREMENT
/begin MEASUREMENT Torque_Control_ETR07.Torque_Control_ETR07_Y.Throttle "" FLOAT64_IEEE Torque_Control_ETR07_CM_double 0 0 -1.7e+308 1.7e+308 ECU_ADDRESS 0x0 DISPLAY_IDENTIFIER Torque_Control_ETR07.Throttle /end MEASUREMENT
/begin MEASUREMENT Torque_Control_ETR07.Torque_Control_ETR07_Y.Torque_L "" FLOAT64_IEEE Torque_Control_ETR07_CM_double 0 0 -1.7e+308 1.7e+308 ECU_ADDRESS 0x0 DISPLAY_IDENTIFIER Torque_Control_ETR07.Torque_L /end MEASUREMENT
/begin MEASUREMENT Torque_Control_ETR07.Torque_Control_ETR07_Y.Torque_OK "" UBYTE Torque_Control_ETR07_CM_boolean 0 0 0 1 ECU_ADDRESS 0x0 DISPLAY_IDENTIFIER Torque_Control_ETR07.Torque_OK /end MEASUREMENT
/begin MEASUREMENT Torque_Control_ETR07.Torque_Control_ETR07_Y.Torque_R "" FLOAT64_IEEE Torque_Control_ETR07_CM_double 0 0 -1.7e+308 1.7e+308 ECU_ADDRESS 0x0 DISPLAY_IDENTIFIER Torque_Control_ETR07.Torque_R /end MEASUREMENT
/begin MEASUREMENT Torque_Control_ETR07.Torque_Control_ETR07_Y.Torque_RLwc "" FLOAT64_IEEE Torque_Control_ETR07_CM_double 0 0 -1.7e+308 1.7e+308 ECU_ADDRESS 0x0 DISPLAY_IDENTIFIER Torque_Control_ETR07.Torque_RLwc /end MEASUREMENT
/begin MEASUREMENT Torque_Control_ETR07.Torque_Control_ETR07_Y.Torque_RRwc "" FLOAT64_IEEE Torque_Control_ETR07_CM_double 0 0 -1.7e+308 1.7e+308 ECU_ADDRESS 0x0 DISPLAY_IDENTIFIER Torque_Control_ETR07.Torque_RRwc /end MEASUREMENT
/begin MEASUREMENT Torque_Control_ETR07.Torque_Control_ETR07_Y.current_L "" FLOAT64_IEEE Torque_Control_ETR07_CM_double 0 0 -1.7e+308 1.7e+308 ECU_ADDRESS 0x0 DISPLAY_IDENTIFIER Torque_Control_ETR07.current_L /end MEASUREMENT
/begin MEASUREMENT Torque_Control_ETR07.Torque_Control_ETR07_Y.current_R "" FLOAT64_IEEE Torque_Control_ETR07_CM_double 0 0 -1.7e+308 1.7e+308 ECU_ADDRESS 0x0 DISPLAY_IDENTIFIER Torque_Control_ETR07.current_R /end MEASUREMENT
/begin CHARACTERISTIC Torque_Control_ETR07.Torque_Control_ETR07_P.A1_Value "" VALUE 0x0 SCALAR_FLOAT64_IEEE 3.5e+305 Torque_Control_ETR07_CM_double -1.7e+308 1.7e+308 DISPLAY_IDENTIFIER Torque_Control_ETR07.Calculate_Current_Conversion.KT_R_EMY.A1.Value /end CHARACTERISTIC
/begin CHARACTERISTIC Torque_Control_ETR07.Torque_Control_ETR07_P.A_Value "" VALUE 0x0 SCALAR_FLOAT64_IEEE 3.5e+305 Torque_Control_ETR07_CM_double -1.7e+308 1.7e+308 DISPLAY_IDENTIFIER Torque_Control_ETR07.Calculate_Current_Conversion.KT_L_TORKY.A.Value /end CHARACTERISTIC
/begin CHARACTERISTIC Torque_Control_ETR07.Torque_Control_ETR07_P.B1_Value "" VALUE 0x0 SCALAR_FLOAT64_IEEE 3.5e+305 Torque_Control_ETR07_CM_double -1.7e+308 1.7e+308 DISPLAY_IDENTIFIER Torque_Control_ETR07.Calculate_Current_Conversion.KT_R_EMY.B1.Value /end CHARACTERISTIC
/begin CHARACTERISTIC Torque_Control_ETR07.Torque_Control_ETR07_P.BRAKE_THRESHOLD_Value "" VALUE 0x0 SCALAR_FLOAT64_IEEE 3.5e+305 Torque_Control_ETR07_CM_double -1.7e+308 1.7e+308 DISPLAY_IDENTIFIER Torque_Control_ETR07.VDC.Regeneration_Enable.BRAKE_THRESHOLD.Value /end CHARACTERISTIC
/begin CHARACTERISTIC Torque_Control_ETR07.Torque_Control_ETR07_P.B_Value "" VALUE 0x0 SCALAR_FLOAT64_IEEE 3.5e+305 Torque_Control_ETR07_CM_double -1.7e+308 1.7e+308 DISPLAY_IDENTIFIER Torque_Control_ETR07.Calculate_Current_Conversion.KT_L_TORKY.B.Value /end CHARACTERISTIC
/begin CHARACTERISTIC Torque_Control_ETR07.Torque_Control_ETR07_P.C1_Value "" VALUE 0x0 SCALAR_FLOAT64_IEEE 3.5e+305 Torque_Control_ETR07_CM_double -1.7e+308 1.7e+308 DISPLAY_IDENTIFIER Torque_Control_ETR07.Calculate_Current_Conversion.KT_R_EMY.C1.Value /end CHARACTERISTIC
/begin CHARACTERISTIC Torque_Control_ETR07.Torque_Control_ETR07_P.CKF_act_Y0 "" VALUE 0x0 SCALAR_FLOAT64_IEEE 3.5e+305 Torque_Control_ETR07_CM_double -1.7e+308 1.7e+308 DISPLAY_IDENTIFIER Torque_Control_ETR07.VDC.Vehicle_Dynamics_Control_2018.VDC_2018_Complete.Optimization_SKF__amp__CKF.Subsystem.CKF.CKF_act.InitialOutput /end CHARACTERISTIC
/begin CHARACTERISTIC Torque_Control_ETR07.Torque_Control_ETR07_P.CKF_act_Y0_j "" VALUE 0x0 SCALAR_FLOAT64_IEEE 3.5e+305 Torque_Control_ETR07_CM_double -1.7e+308 1.7e+308 DISPLAY_IDENTIFIER Torque_Control_ETR07.VDC.Vehicle_Dynamics_Control_2018.Steering_TV_2017_with_TC.Optimization_SKF__amp__CKF.Subsystem.CKF.CKF_act.InitialOutput /end CHARACTERISTIC
/begin CHARACTERISTIC Torque_Control_ETR07.Torque_Control_ETR07_P.C_Value "" VALUE 0x0 SCALAR_FLOAT64_IEEE 3.5e+305 Torque_Control_ETR07_CM_double -1.7e+308 1.7e+308 DISPLAY_IDENTIFIER Torque_Control_ETR07.Calculate_Current_Conversion.KT_L_TORKY.C.Value /end CHARACTERISTIC
/begin CHARACTERISTIC Torque_Control_ETR07.Torque_Control_ETR07_P.CompareToConstant1_const "" VALUE 0x0 SCALAR_FLOAT64_IEEE 3.5e+305 Torque_Control_ETR07_CM_double -1.7e+308 1.7e+308 DISPLAY_IDENTIFIER Torque_Control_ETR07.Pumps_Controller.Compare_To_Constant1.Constant.Value /end CHARACTERISTIC
/begin CHARACTERISTIC Torque_Control_ETR07.Torque_Control_ETR07_P.CompareToConstant_const "" VALUE 0x0 SCALAR_FLOAT64_IEEE 3.5e+305 Torque_Control_ETR07_CM_double -1.7e+308 1.7e+308 DISPLAY_IDENTIFIER Torque_Control_ETR07.SAFETY_BLOCK.Compare_To_Constant.Constant.Value /end CHARACTERISTIC
/begin CHARACTERISTIC Torque_Control_ETR07.Torque_Control_ETR07_P.CompareToConstant_const_p "" VALUE 0x0 SCALAR_FLOAT64_IEEE 3.5e+305 Torque_Control_ETR07_CM_double -1.7e+308 1.7e+308 DISPLAY_IDENTIFIER Torque_Control_ETR07.Pumps_Controller.Compare_To_Constant.Constant.Value /end CHARACTERISTIC
/begin CHARACTERISTIC Torque_Control_ETR07.Torque_Control_ETR07_P.Constant1_Value "" VALUE 0x0 SCALAR_FLOAT64_IEEE 3.5e+305 Torque_Control_ETR07_CM_double -1.7e+308 1.7e+308 DISPLAY_IDENTIFIER Torque_Control_ETR07.VDC.Vehicle_Dynamics_Control_2018.VDC_2018_Complete.Constraints.Acelerating_and_braking_without_Regenerative.else.Constant1.Value /end CHARACTERISTIC
/begin CHARACTERISTIC Torque_Control_ETR07.Torque_Control_ETR07_P.Constant1_Value_a "" VALUE 0x0 SCALAR_FLOAT64_IEEE 3.5e+305 Torque_Control_ETR07_CM_double -1.7e+308 1.7e+308 DISPLAY_IDENTIFIER Torque_Control_ETR07.VDC.Vehicle_Dynamics_Control_2018.VDC_2018_Complete.Lateral_Dynamics.Constant1.Value /end CHARACTERISTIC
/begin CHARACTERISTIC Torque_Control_ETR07.Torque_Control_ETR07_P.Constant1_Value_ab "" VALUE 0x0 SCALAR_FLOAT64_IEEE 3.5e+305 Torque_Control_ETR07_CM_double -1.7e+308 1.7e+308 DISPLAY_IDENTIFIER Torque_Control_ETR07.VDC.Vehicle_Dynamics_Control_2018.VDC_2018_Complete.Wheel_to_engine.Constant1.Value /end CHARACTERISTIC
/begin CHARACTERISTIC Torque_Control_ETR07.Torque_Control_ETR07_P.Constant1_Value_b "" VALUE 0x0 SCALAR_FLOAT64_IEEE 3.5e+305 Torque_Control_ETR07_CM_double -1.7e+308 1.7e+308 DISPLAY_IDENTIFIER Torque_Control_ETR07.VDC.Vehicle_Dynamics_Control_2018.VDC_2018_Complete.In_Numbers.Constant1.Value /end CHARACTERISTIC
/begin CHARACTERISTIC Torque_Control_ETR07.Torque_Control_ETR07_P.Constant1_Value_c "" VALUE 0x0 SCALAR_FLOAT64_IEEE 3.5e+305 Torque_Control_ETR07_CM_double -1.7e+308 1.7e+308 DISPLAY_IDENTIFIER Torque_Control_ETR07.VDC.Vehicle_Dynamics_Control_2018.VDC_2018_without_Longitudinal.Kamm_Circle_Lateral.Constant1.Value /end CHARACTERISTIC
/begin CHARACTERISTIC Torque_Control_ETR07.Torque_Control_ETR07_P.Constant1_Value_f "" VALUE 0x0 SCALAR_FLOAT64_IEEE 3.5e+305 Torque_Control_ETR07_CM_double -1.7e+308 1.7e+308 DISPLAY_IDENTIFIER Torque_Control_ETR07.VDC.Vehicle_Dynamics_Control_2018.VDC_2018_Complete.Longitudinal_Dynamics.Constant1.Value /end CHARACTERISTIC
/begin CHARACTERISTIC Torque_Control_ETR07.Torque_Control_ETR07_P.Constant1_Value_l "" VALUE 0x0 SCALAR_FLOAT64_IEEE 3.5e+305 Torque_Control_ETR07_CM_double -1.7e+308 1.7e+308 DISPLAY_IDENTIFIER Torque_Control_ETR07.VDC.Vehicle_Dynamics_Control_2018.VDC_2018_without_Longitudinal.Wheel_to_engine.Constant1.Value /end CHARACTERISTIC
/begin CHARACTERISTIC Torque_Control_ETR07.Torque_Control_ETR07_P.Constant1_Value_ln "" VALUE 0x0 SCALAR_FLOAT64_IEEE 3.5e+305 Torque_Control_ETR07_CM_double -1.7e+308 1.7e+308 DISPLAY_IDENTIFIER Torque_Control_ETR07.VDC.TEST_MODE_IN.TEST_CONSTANTS.Constant1.Value /end CHARACTERISTIC
/begin CHARACTERISTIC Torque_Control_ETR07.Torque_Control_ETR07_P.Constant2_Value "" VALUE 0x0 SCALAR_FLOAT64_IEEE 3.5e+305 Torque_Control_ETR07_CM_double -1.7e+308 1.7e+308 DISPLAY_IDENTIFIER Torque_Control_ETR07.VDC.Vehicle_Dynamics_Control_2018.VDC_2018_Complete.Longitudinal_Dynamics.Constant2.Value /end CHARACTERISTIC
/begin CHARACTERISTIC Torque_Control_ETR07.Torque_Control_ETR07_P.Constant2_Value_g "" VALUE 0x0 SCALAR_FLOAT64_IEEE 3.5e+305 Torque_Control_ETR07_CM_double -1.7e+308 1.7e+308 DISPLAY_IDENTIFIER Torque_Control_ETR07.VDC.Vehicle_Dynamics_Control_2018.VDC_2018_Complete.Lateral_Dynamics.Constant2.Value /end CHARACTERISTIC
/begin CHARACTERISTIC Torque_Control_ETR07.Torque_Control_ETR07_P.Constant2_Value_g1 "" VALUE 0x0 SCALAR_FLOAT64_IEEE 3.5e+305 Torque_Control_ETR07_CM_double -1.7e+308 1.7e+308 DISPLAY_IDENTIFIER Torque_Control_ETR07.VDC.TEST_MODE_IN.TEST_CONSTANTS.Constant2.Value /end CHARACTERISTIC
/begin CHARACTERISTIC Torque_Control_ETR07.Torque_Control_ETR07_P.Constant3_Value "" VALUE 0x0 SCALAR_FLOAT64_IEEE 3.5e+305 Torque_Control_ETR07_CM_double -1.7e+308 1.7e+308 DISPLAY_IDENTIFIER Torque_Control_ETR07.VDC.Vehicle_Dynamics_Control_2018.VDC_2018_Complete.Longitudinal_Dynamics.Constant3.Value /end CHARACTERISTIC
/begin CHARACTERISTIC Torque_Control_ETR07.Torque_Control_ETR07_P.Constant3_Value_n "" VALUE 0x0 SCALAR_FLOAT64_IEEE 3.5e+305 Torque_Control_ETR07_CM_double -1.7e+308 1.7e+308 DISPLAY_IDENTIFIER Torque_Control_ETR07.VDC.TEST_MODE_IN.TEST_CONSTANTS.Constant3.Value /end CHARACTERISTIC
/begin CHARACTERISTIC Torque_Control_ETR07.Torque_Control_ETR07_P.Constant3_Value_o "" VALUE 0x0 SCALAR_FLOAT64_IEEE 3.5e+305 Torque_Control_ETR07_CM_double -1.7e+308 1.7e+308 DISPLAY_IDENTIFIER Torque_Control_ETR07.VDC.Vehicle_Dynamics_Control_2018.VDC_2018_Complete.Lateral_Dynamics.Constant3.Value /end CHARACTERISTIC
/begin CHARACTERISTIC Torque_Control_ETR07.Torque_Control_ETR07_P.Constant4_Value "" VALUE 0x0 SCALAR_FLOAT64_IEEE 3.5e+305 Torque_Control_ETR07_CM_double -1.7e+308 1.7e+308 DISPLAY_IDENTIFIER Torque_Control_ETR07.VDC.Vehicle_Dynamics_Control_2018.VDC_2018_Complete.Longitudinal_Dynamics.Constant4.Value /end CHARACTERISTIC
/begin CHARACTERISTIC Torque_Control_ETR07.Torque_Control_ETR07_P.Constant4_Value_p "" VALUE 0x0 SCALAR_FLOAT64_IEEE 3.5e+305 Torque_Control_ETR07_CM_double -1.7e+308 1.7e+308 DISPLAY_IDENTIFIER Torque_Control_ETR07.VDC.Vehicle_Dynamics_Control_2018.VDC_2018_Complete.Lateral_Dynamics.Constant4.Value /end CHARACTERISTIC
/begin CHARACTERISTIC Torque_Control_ETR07.Torque_Control_ETR07_P.Constant5_Value "" VALUE 0x0 SCALAR_FLOAT64_IEEE 3.5e+305 Torque_Control_ETR07_CM_double -1.7e+308 1.7e+308 DISPLAY_IDENTIFIER Torque_Control_ETR07.VDC.Vehicle_Dynamics_Control_2018.VDC_2018_Complete.Longitudinal_Dynamics.Constant5.Value /end CHARACTERISTIC
/begin CHARACTERISTIC Torque_Control_ETR07.Torque_Control_ETR07_P.Constant6_Value "" VALUE 0x0 SCALAR_FLOAT64_IEEE 3.5e+305 Torque_Control_ETR07_CM_double -1.7e+308 1.7e+308 DISPLAY_IDENTIFIER Torque_Control_ETR07.VDC.Vehicle_Dynamics_Control_2018.VDC_2018_Complete.Longitudinal_Dynamics.Constant6.Value /end CHARACTERISTIC
/begin CHARACTERISTIC Torque_Control_ETR07.Torque_Control_ETR07_P.Constant6_Value_p "" VALUE 0x0 SCALAR_FLOAT64_IEEE 3.5e+305 Torque_Control_ETR07_CM_double -1.7e+308 1.7e+308 DISPLAY_IDENTIFIER Torque_Control_ETR07.VDC.Vehicle_Dynamics_Control_2018.VDC_2018_Complete.Lateral_Dynamics.Constant6.Value /end CHARACTERISTIC
/begin CHARACTERISTIC Torque_Control_ETR07.Torque_Control_ETR07_P.Constant7_Value "" VALUE 0x0 SCALAR_FLOAT64_IEEE 3.5e+305 Torque_Control_ETR07_CM_double -1.7e+308 1.7e+308 DISPLAY_IDENTIFIER Torque_Control_ETR07.VDC.Vehicle_Dynamics_Control_2018.VDC_2018_Complete.Lateral_Dynamics.Yaw_Rate_Reference.Constant7.Value /end CHARACTERISTIC
/begin CHARACTERISTIC Torque_Control_ETR07.Torque_Control_ETR07_P.Constant8_Value "" VALUE 0x0 SCALAR_FLOAT64_IEEE 3.5e+305 Torque_Control_ETR07_CM_double -1.7e+308 1.7e+308 DISPLAY_IDENTIFIER Torque_Control_ETR07.VDC.Vehicle_Dynamics_Control_2018.VDC_2018_Complete.Lateral_Dynamics.Yaw_Rate_Reference.Constant8.Value /end CHARACTERISTIC
/begin CHARACTERISTIC Torque_Control_ETR07.Torque_Control_ETR07_P.Constant_Value "" VALUE 0x0 SCALAR_FLOAT64_IEEE 3.5e+305 Torque_Control_ETR07_CM_double -1.7e+308 1.7e+308 DISPLAY_IDENTIFIER Torque_Control_ETR07.Current_0.Constant.Value /end CHARACTERISTIC
/begin CHARACTERISTIC Torque_Control_ETR07.Torque_Control_ETR07_P.Constant_Value_a "" VALUE 0x0 SCALAR_FLOAT64_IEEE 3.5e+305 Torque_Control_ETR07_CM_double -1.7e+308 1.7e+308 DISPLAY_IDENTIFIER Torque_Control_ETR07.VDC.Vehicle_Dynamics_Control_2018.VDC_2018_Complete.Optimization_SKF__amp__CKF.Subsystem.SKF.Spin.Constant.Value /end CHARACTERISTIC
/begin CHARACTERISTIC Torque_Control_ETR07.Torque_Control_ETR07_P.Constant_Value_ad "" VALUE 0x0 SCALAR_FLOAT64_IEEE 3.5e+305 Torque_Control_ETR07_CM_double -1.7e+308 1.7e+308 DISPLAY_IDENTIFIER Torque_Control_ETR07.VDC.Vehicle_Dynamics_Control_2018.VDC_2018_Complete.Lateral_Dynamics.Tire_Longitudinal_Force_Difference.Momentum_Z_to_Longitudinal_Force_Difference.Constant.Value /end CHARACTERISTIC
/begin CHARACTERISTIC Torque_Control_ETR07.Torque_Control_ETR07_P.Constant_Value_ae "" VALUE 0x0 SCALAR_FLOAT64_IEEE 3.5e+305 Torque_Control_ETR07_CM_double -1.7e+308 1.7e+308 DISPLAY_IDENTIFIER Torque_Control_ETR07.VDC.Vehicle_Dynamics_Control_2018.VDC_2018_without_Longitudinal.Kamm_Circle_Lateral.Constant.Value /end CHARACTERISTIC
/begin CHARACTERISTIC Torque_Control_ETR07.Torque_Control_ETR07_P.Constant_Value_b "" VALUE 0x0 SCALAR_FLOAT64_IEEE 3.5e+305 Torque_Control_ETR07_CM_double -1.7e+308 1.7e+308 DISPLAY_IDENTIFIER Torque_Control_ETR07.VDC.Vehicle_Dynamics_Control_2018.VDC_2018_Complete.Constant.Value /end CHARACTERISTIC
/begin CHARACTERISTIC Torque_Control_ETR07.Torque_Control_ETR07_P.Constant_Value_d "" VALUE 0x0 SCALAR_FLOAT64_IEEE 3.5e+305 Torque_Control_ETR07_CM_double -1.7e+308 1.7e+308 DISPLAY_IDENTIFIER Torque_Control_ETR07.VDC.Vehicle_Dynamics_Control_2018.Steering_TV_2017_with_TC.Optimization_SKF__amp__CKF.Subsystem.CKF.Spin.Constant.Value /end CHARACTERISTIC
/begin CHARACTERISTIC Torque_Control_ETR07.Torque_Control_ETR07_P.Constant_Value_dm "" VALUE 0x0 SCALAR_FLOAT64_IEEE 3.5e+305 Torque_Control_ETR07_CM_double -1.7e+308 1.7e+308 DISPLAY_IDENTIFIER Torque_Control_ETR07.VDC.WORKSHOP_MODE_RESTRICTIONS.Torque_Reduction.Constant.Value /end CHARACTERISTIC
/begin CHARACTERISTIC Torque_Control_ETR07.Torque_Control_ETR07_P.Constant_Value_f "" VALUE 0x0 SCALAR_FLOAT64_IEEE 3.5e+305 Torque_Control_ETR07_CM_double -1.7e+308 1.7e+308 DISPLAY_IDENTIFIER Torque_Control_ETR07.VDC.Vehicle_Dynamics_Control_2018.VDC_2018_Complete.Longitudinal_Dynamics.Constant.Value /end CHARACTERISTIC
/begin CHARACTERISTIC Torque_Control_ETR07.Torque_Control_ETR07_P.Constant_Value_f3 "" VALUE 0x0 SCALAR_FLOAT64_IEEE 3.5e+305 Torque_Control_ETR07_CM_double -1.7e+308 1.7e+308 DISPLAY_IDENTIFIER Torque_Control_ETR07.VDC.Constant.Value /end CHARACTERISTIC
/begin CHARACTERISTIC Torque_Control_ETR07.Torque_Control_ETR07_P.Constant_Value_g "" VALUE 0x0 SCALAR_FLOAT64_IEEE 3.5e+305 Torque_Control_ETR07_CM_double -1.7e+308 1.7e+308 DISPLAY_IDENTIFIER Torque_Control_ETR07.VDC.Vehicle_Dynamics_Control_2018.VDC_2018_Complete.Constraints.Acelerating_and_braking_without_Regenerative.else.Constant.Value /end CHARACTERISTIC
/begin CHARACTERISTIC Torque_Control_ETR07.Torque_Control_ETR07_P.Constant_Value_h "" VALUE 0x0 SCALAR_FLOAT64_IEEE 3.5e+305 Torque_Control_ETR07_CM_double -1.7e+308 1.7e+308 DISPLAY_IDENTIFIER Torque_Control_ETR07.Constant.Value /end CHARACTERISTIC
/begin CHARACTERISTIC Torque_Control_ETR07.Torque_Control_ETR07_P.Constant_Value_i "" VALUE 0x0 SCALAR_FLOAT64_IEEE 3.5e+305 Torque_Control_ETR07_CM_double -1.7e+308 1.7e+308 DISPLAY_IDENTIFIER Torque_Control_ETR07.Pumps_Controller.Pumps_Control_ON.Constant.Value /end CHARACTERISTIC
/begin CHARACTERISTIC Torque_Control_ETR07.Torque_Control_ETR07_P.Constant_Value_ib "" VALUE 0x0 SCALAR_FLOAT64_IEEE 3.5e+305 Torque_Control_ETR07_CM_double -1.7e+308 1.7e+308 DISPLAY_IDENTIFIER Torque_Control_ETR07.VDC.Vehicle_Dynamics_Control_2018.VDC_2018_without_Longitudinal.Wheel_to_engine.Constant.Value /end CHARACTERISTIC
/begin CHARACTERISTIC Torque_Control_ETR07.Torque_Control_ETR07_P.Constant_Value_k "" VALUE 0x0 SCALAR_FLOAT64_IEEE 3.5e+305 Torque_Control_ETR07_CM_double -1.7e+308 1.7e+308 DISPLAY_IDENTIFIER Torque_Control_ETR07.VDC.TEST_MODE_IN.TEST_CONSTANTS.Constant.Value /end CHARACTERISTIC
/begin CHARACTERISTIC Torque_Control_ETR07.Torque_Control_ETR07_P.Constant_Value_l "" VALUE 0x0 SCALAR_FLOAT64_IEEE 3.5e+305 Torque_Control_ETR07_CM_double -1.7e+308 1.7e+308 DISPLAY_IDENTIFIER Torque_Control_ETR07.VDC.Vehicle_Dynamics_Control_2018.VDC_2018_Complete.Wheel_to_engine.Constant.Value /end CHARACTERISTIC
/begin CHARACTERISTIC Torque_Control_ETR07.Torque_Control_ETR07_P.Constant_Value_m "" VALUE 0x0 SCALAR_FLOAT64_IEEE 3.5e+305 Torque_Control_ETR07_CM_double -1.7e+308 1.7e+308 DISPLAY_IDENTIFIER Torque_Control_ETR07.VDC.Regeneration_Enable.Constant.Value /end CHARACTERISTIC
/begin CHARACTERISTIC Torque_Control_ETR07.Torque_Control_ETR07_P.Constant_Value_n "" VALUE 0x0 SCALAR_FLOAT64_IEEE 3.5e+305 Torque_Control_ETR07_CM_double -1.7e+308 1.7e+308 DISPLAY_IDENTIFIER Torque_Control_ETR07.Pumps_Controller.Pumps_Control_OFF.Constant.Value /end CHARACTERISTIC
/begin CHARACTERISTIC Torque_Control_ETR07.Torque_Control_ETR07_P.Constant_Value_n5 "" VALUE 0x0 SCALAR_FLOAT64_IEEE 3.5e+305 Torque_Control_ETR07_CM_double -1.7e+308 1.7e+308 DISPLAY_IDENTIFIER Torque_Control_ETR07.VDC.Vehicle_Dynamics_Control_2018.Steering_TV_2017_with_TC.Optimization_SKF__amp__CKF.Subsystem.SKF.Spin.Constant.Value /end CHARACTERISTIC
/begin CHARACTERISTIC Torque_Control_ETR07.Torque_Control_ETR07_P.Cornering_Stiffness_FN_Value "" VALUE 0x0 SCALAR_FLOAT64_IEEE 3.5e+305 Torque_Control_ETR07_CM_double -1.7e+308 1.7e+308 DISPLAY_IDENTIFIER Torque_Control_ETR07.VDC.Vehicle_Dynamics_Control_2018.VDC_2018_Complete.Lateral_Dynamics.Yaw_Rate_Reference.Cornering_Stiffness_F_N___.Value /end CHARACTERISTIC
/begin CHARACTERISTIC Torque_Control_ETR07.Torque_Control_ETR07_P.Cornering_Stiffness_RN_Value "" VALUE 0x0 SCALAR_FLOAT64_IEEE 3.5e+305 Torque_Control_ETR07_CM_double -1.7e+308 1.7e+308 DISPLAY_IDENTIFIER Torque_Control_ETR07.VDC.Vehicle_Dynamics_Control_2018.VDC_2018_Complete.Lateral_Dynamics.Yaw_Rate_Reference.Cornering_Stiffness_R_N___.Value /end CHARACTERISTIC
/begin CHARACTERISTIC Torque_Control_ETR07.Torque_Control_ETR07_P.DataStoreMemory10_InitialValue "" VALUE 0x0 SCALAR_FLOAT64_IEEE 3.5e+305 Torque_Control_ETR07_CM_double -1.7e+308 1.7e+308 DISPLAY_IDENTIFIER Torque_Control_ETR07.Accumulator_Power.PowerLimitDetection.Data_Store_Memory10.InitialValue /end CHARACTERISTIC
/begin CHARACTERISTIC Torque_Control_ETR07.Torque_Control_ETR07_P.DataStoreMemory1_InitialValu_fl "" VALUE 0x0 SCALAR_UBYTE 1.0 Torque_Control_ETR07_CM_boolean 0 1 DISPLAY_IDENTIFIER Torque_Control_ETR07.SAFETY_BLOCK.BRAKE_IMPLAUSIBILITY.Data_Store_Memory1.InitialValue /end CHARACTERISTIC
/begin CHARACTERISTIC Torque_Control_ETR07.Torque_Control_ETR07_P.DataStoreMemory1_InitialValue "" VALUE 0x0 SCALAR_FLOAT64_IEEE 3.5e+305 Torque_Control_ETR07_CM_double -1.7e+308 1.7e+308 DISPLAY_IDENTIFIER Torque_Control_ETR07.Steering_Data_Conv.Low_Pass.Data_Store_Memory1.InitialValue /end CHARACTERISTIC
/begin CHARACTERISTIC Torque_Control_ETR07.Torque_Control_ETR07_P.DataStoreMemory1_InitialValue_f "" VALUE 0x0 SCALAR_FLOAT64_IEEE 3.5e+305 Torque_Control_ETR07_CM_double -1.7e+308 1.7e+308 DISPLAY_IDENTIFIER Torque_Control_ETR07.VDC.Vehicle_Dynamics_Control_2018.Steering_TV_2017_with_TC.Optimization_SKF__amp__CKF.Data_Store_Memory1.InitialValue /end CHARACTERISTIC
/begin CHARACTERISTIC Torque_Control_ETR07.Torque_Control_ETR07_P.DataStoreMemory1_InitialValue_i "" VALUE 0x0 SCALAR_FLOAT64_IEEE 3.5e+305 Torque_Control_ETR07_CM_double -1.7e+308 1.7e+308 DISPLAY_IDENTIFIER Torque_Control_ETR07.VDC.Vehicle_Dynamics_Control_2018.VDC_2018_Complete.Optimization_SKF__amp__CKF.Data_Store_Memory1.InitialValue /end CHARACTERISTIC
/begin CHARACTERISTIC Torque_Control_ETR07.Torque_Control_ETR07_P.DataStoreMemory1_InitialValue_m "" VALUE 0x0 SCALAR_FLOAT64_IEEE 3.5e+305 Torque_Control_ETR07_CM_double -1.7e+308 1.7e+308 DISPLAY_IDENTIFIER Torque_Control_ETR07.VDC.Vehicle_Dynamics_Control_2018.VDC_2018_without_Longitudinal.Optimization_SKF__amp__CKF.Data_Store_Memory1.InitialValue /end CHARACTERISTIC
/begin CHARACTERISTIC Torque_Control_ETR07.Torque_Control_ETR07_P.DataStoreMemory_InitialValue "" VALUE 0x0 SCALAR_FLOAT64_IEEE 3.5e+305 Torque_Control_ETR07_CM_double -1.7e+308 1.7e+308 DISPLAY_IDENTIFIER Torque_Control_ETR07.Steering_Data_Conv.Low_Pass.Data_Store_Memory.InitialValue /end CHARACTERISTIC
/begin CHARACTERISTIC Torque_Control_ETR07.Torque_Control_ETR07_P.DataStoreMemory_InitialValue_c "" VALUE 0x0 SCALAR_FLOAT64_IEEE 3.5e+305 Torque_Control_ETR07_CM_double -1.7e+308 1.7e+308 DISPLAY_IDENTIFIER Torque_Control_ETR07.VDC.Vehicle_Dynamics_Control_2018.VDC_2018_Complete.Optimization_SKF__amp__CKF.Data_Store_Memory.InitialValue /end CHARACTERISTIC
/begin CHARACTERISTIC Torque_Control_ETR07.Torque_Control_ETR07_P.DataStoreMemory_InitialValue_j "" VALUE 0x0 SCALAR_FLOAT64_IEEE 3.5e+305 Torque_Control_ETR07_CM_double -1.7e+308 1.7e+308 DISPLAY_IDENTIFIER Torque_Control_ETR07.VDC.Regeneration_Enable.Data_Store_Memory.InitialValue /end CHARACTERISTIC
/begin CHARACTERISTIC Torque_Control_ETR07.Torque_Control_ETR07_P.DataStoreMemory_InitialValue_m "" VALUE 0x0 SCALAR_FLOAT64_IEEE 3.5e+305 Torque_Control_ETR07_CM_double -1.7e+308 1.7e+308 DISPLAY_IDENTIFIER Torque_Control_ETR07.VDC.Vehicle_Dynamics_Control_2018.Steering_TV_2017_with_TC.Optimization_SKF__amp__CKF.Data_Store_Memory.InitialValue /end CHARACTERISTIC
/begin CHARACTERISTIC Torque_Control_ETR07.Torque_Control_ETR07_P.EffectiveRollingRadiusinch_Va_b "" VALUE 0x0 SCALAR_FLOAT64_IEEE 3.5e+305 Torque_Control_ETR07_CM_double -1.7e+308 1.7e+308 DISPLAY_IDENTIFIER Torque_Control_ETR07.VDC.Vehicle_Dynamics_Control_2018.VDC_2018_without_Longitudinal.In_Numbers.Effective_Rolling_Radius[inch].Value /end CHARACTERISTIC
/begin CHARACTERISTIC Torque_Control_ETR07.Torque_Control_ETR07_P.EffectiveRollingRadiusinch_Valu "" VALUE 0x0 SCALAR_FLOAT64_IEEE 3.5e+305 Torque_Control_ETR07_CM_double -1.7e+308 1.7e+308 DISPLAY_IDENTIFIER Torque_Control_ETR07.VDC.Vehicle_Dynamics_Control_2018.VDC_2018_Complete.In_Numbers.Effective_Rolling_Radius[inch].Value /end CHARACTERISTIC
/begin CHARACTERISTIC Torque_Control_ETR07.Torque_Control_ETR07_P.Flags_num5_Y0 "" VALUE 0x0 SCALAR_FLOAT64_IEEE 3.5e+305 Torque_Control_ETR07_CM_double -1.7e+308 1.7e+308 DISPLAY_IDENTIFIER Torque_Control_ETR07.VDC.Vehicle_Dynamics_Control_2018.VDC_2018_Complete.Flags_[num5].InitialOutput /end CHARACTERISTIC
/begin CHARACTERISTIC Torque_Control_ETR07.Torque_Control_ETR07_P.Fy_RN0inf_Y0 "" VALUE 0x0 SCALAR_FLOAT64_IEEE 3.5e+305 Torque_Control_ETR07_CM_double -1.7e+308 1.7e+308 DISPLAY_IDENTIFIER Torque_Control_ETR07.VDC.Vehicle_Dynamics_Control_2018.VDC_2018_without_Longitudinal.Fy_R_[N]__0_inf_.InitialOutput /end CHARACTERISTIC
/begin CHARACTERISTIC Torque_Control_ETR07.Torque_Control_ETR07_P.Fyperwheel_Gain "" VALUE 0x0 SCALAR_FLOAT64_IEEE 3.5e+305 Torque_Control_ETR07_CM_double -1.7e+308 1.7e+308 DISPLAY_IDENTIFIER Torque_Control_ETR07.VDC.Vehicle_Dynamics_Control_2018.VDC_2018_Complete.Lateral_Dynamics.Fy_per_wheel.Gain /end CHARACTERISTIC
/begin CHARACTERISTIC Torque_Control_ETR07.Torque_Control_ETR07_P.Fyperwheel_Gain_e "" VALUE 0x0 SCALAR_FLOAT64_IEEE 3.5e+305 Torque_Control_ETR07_CM_double -1.7e+308 1.7e+308 DISPLAY_IDENTIFIER Torque_Control_ETR07.VDC.Vehicle_Dynamics_Control_2018.VDC_2018_without_Longitudinal.Lateral_Dynamics.Fy_per_wheel.Gain /end CHARACTERISTIC
/begin CHARACTERISTIC Torque_Control_ETR07.Torque_Control_ETR07_P.Gain1_Gain "" VALUE 0x0 SCALAR_FLOAT64_IEEE 3.5e+305 Torque_Control_ETR07_CM_double -1.7e+308 1.7e+308 DISPLAY_IDENTIFIER Torque_Control_ETR07.VDC.Vehicle_Dynamics_Control_2018.VDC_2018_Complete.Constraints.Braking_with_Regenerative.Gain1.Gain /end CHARACTERISTIC
/begin CHARACTERISTIC Torque_Control_ETR07.Torque_Control_ETR07_P.Gain1_Gain_i "" VALUE 0x0 SCALAR_FLOAT64_IEEE 3.5e+305 Torque_Control_ETR07_CM_double -1.7e+308 1.7e+308 DISPLAY_IDENTIFIER Torque_Control_ETR07.VDC.Vehicle_Dynamics_Control_2018.VDC_2018_without_Longitudinal.Constraints.Braking_with_Regenerative.Gain1.Gain /end CHARACTERISTIC
/begin CHARACTERISTIC Torque_Control_ETR07.Torque_Control_ETR07_P.Gain1_Gain_o "" VALUE 0x0 SCALAR_FLOAT64_IEEE 3.5e+305 Torque_Control_ETR07_CM_double -1.7e+308 1.7e+308 DISPLAY_IDENTIFIER Torque_Control_ETR07.VDC.Gain1.Gain /end CHARACTERISTIC
/begin CHARACTERISTIC Torque_Control_ETR07.Torque_Control_ETR07_P.Gain_Gain "" VALUE 0x0 SCALAR_FLOAT64_IEEE 3.5e+305 Torque_Control_ETR07_CM_double -1.7e+308 1.7e+308 DISPLAY_IDENTIFIER Torque_Control_ETR07.Calculate_Current_Conversion.Gain.Gain /end CHARACTERISTIC
/begin CHARACTERISTIC Torque_Control_ETR07.Torque_Control_ETR07_P.Gain_Gain_a "" VALUE 0x0 SCALAR_FLOAT64_IEEE 3.5e+305 Torque_Control_ETR07_CM_double -1.7e+308 1.7e+308 DISPLAY_IDENTIFIER Torque_Control_ETR07.VDC.Vehicle_Dynamics_Control_2018.VDC_2018_without_Longitudinal.Constraints.Braking_with_Regenerative.Gain.Gain /end CHARACTERISTIC
/begin CHARACTERISTIC Torque_Control_ETR07.Torque_Control_ETR07_P.Gain_Gain_c "" VALUE 0x0 SCALAR_FLOAT64_IEEE 3.5e+305 Torque_Control_ETR07_CM_double -1.7e+308 1.7e+308 DISPLAY_IDENTIFIER Torque_Control_ETR07.Steering_Data_Conv.Low_Pass.Gain.Gain /end CHARACTERISTIC
/begin CHARACTERISTIC Torque_Control_ETR07.Torque_Control_ETR07_P.Gain_Gain_co "" VALUE 0x0 SCALAR_FLOAT64_IEEE 3.5e+305 Torque_Control_ETR07_CM_double -1.7e+308 1.7e+308 DISPLAY_IDENTIFIER Torque_Control_ETR07.VDC.Vehicle_Dynamics_Control_2018.VDC_2018_Complete.Constraints.Acelerating_and_braking_without_Regenerative.Gain.Gain /end CHARACTERISTIC
/begin CHARACTERISTIC Torque_Control_ETR07.Torque_Control_ETR07_P.Gain_Gain_cv "" VALUE 0x0 SCALAR_FLOAT64_IEEE 3.5e+305 Torque_Control_ETR07_CM_double -1.7e+308 1.7e+308 DISPLAY_IDENTIFIER Torque_Control_ETR07.VDC.Vehicle_Dynamics_Control_2018.VDC_2018_without_Longitudinal.Constraints.Acelerating_and_braking_without_Regenerative.Gain.Gain /end CHARACTERISTIC
/begin CHARACTERISTIC Torque_Control_ETR07.Torque_Control_ETR07_P.Gain_Gain_f "" VALUE 0x0 SCALAR_FLOAT64_IEEE 3.5e+305 Torque_Control_ETR07_CM_double -1.7e+308 1.7e+308 DISPLAY_IDENTIFIER Torque_Control_ETR07.VDC.Vehicle_Dynamics_Control_2018.Gain.Gain /end CHARACTERISTIC
/begin CHARACTERISTIC Torque_Control_ETR07.Torque_Control_ETR07_P.Gain_Gain_k "" VALUE 0x0 SCALAR_FLOAT64_IEEE 3.5e+305 Torque_Control_ETR07_CM_double -1.7e+308 1.7e+308 DISPLAY_IDENTIFIER Torque_Control_ETR07.VDC.Vehicle_Dynamics_Control_2018.VDC_2018_Complete.Longitudinal_Dynamics.Gain.Gain /end CHARACTERISTIC
/begin CHARACTERISTIC Torque_Control_ETR07.Torque_Control_ETR07_P.Gain_Gain_l "" VALUE 0x0 SCALAR_FLOAT64_IEEE 3.5e+305 Torque_Control_ETR07_CM_double -1.7e+308 1.7e+308 DISPLAY_IDENTIFIER Torque_Control_ETR07.VDC.Vehicle_Dynamics_Control_2018.VDC_2018_Complete.Constraints.Braking_with_Regenerative.Gain.Gain /end CHARACTERISTIC
/begin CHARACTERISTIC Torque_Control_ETR07.Torque_Control_ETR07_P.Gain_Gain_o "" VALUE 0x0 SCALAR_FLOAT64_IEEE 3.5e+305 Torque_Control_ETR07_CM_double -1.7e+308 1.7e+308 DISPLAY_IDENTIFIER Torque_Control_ETR07.Steering_Data_Conv.Gain.Gain /end CHARACTERISTIC
/begin CHARACTERISTIC Torque_Control_ETR07.Torque_Control_ETR07_P.Gravity1_Gain "" VALUE 0x0 SCALAR_FLOAT64_IEEE 3.5e+305 Torque_Control_ETR07_CM_double -1.7e+308 1.7e+308 DISPLAY_IDENTIFIER Torque_Control_ETR07.VDC.Vehicle_Dynamics_Control_2018.VDC_2018_Complete.Lateral_Dynamics.Gravity1.Gain /end CHARACTERISTIC
/begin CHARACTERISTIC Torque_Control_ETR07.Torque_Control_ETR07_P.Gravity1_Gain_g "" VALUE 0x0 SCALAR_FLOAT64_IEEE 3.5e+305 Torque_Control_ETR07_CM_double -1.7e+308 1.7e+308 DISPLAY_IDENTIFIER Torque_Control_ETR07.VDC.Vehicle_Dynamics_Control_2018.VDC_2018_without_Longitudinal.Lateral_Dynamics.Gravity1.Gain /end CHARACTERISTIC
/begin CHARACTERISTIC Torque_Control_ETR07.Torque_Control_ETR07_P.Gravity_Gain "" VALUE 0x0 SCALAR_FLOAT64_IEEE 3.5e+305 Torque_Control_ETR07_CM_double -1.7e+308 1.7e+308 DISPLAY_IDENTIFIER Torque_Control_ETR07.VDC.Vehicle_Dynamics_Control_2018.VDC_2018_Complete.Lateral_Dynamics.Gravity.Gain /end CHARACTERISTIC
/begin CHARACTERISTIC Torque_Control_ETR07.Torque_Control_ETR07_P.Handlinginfinf_Y0 "" VALUE 0x0 SCALAR_FLOAT64_IEEE 3.5e+305 Torque_Control_ETR07_CM_double -1.7e+308 1.7e+308 DISPLAY_IDENTIFIER Torque_Control_ETR07.VDC.Vehicle_Dynamics_Control_2018.VDC_2018_without_Longitudinal.Handling_______inf_inf_.InitialOutput /end CHARACTERISTIC
/begin CHARACTERISTIC Torque_Control_ETR07.Torque_Control_ETR07_P.Integrator_IC "" VALUE 0x0 SCALAR_FLOAT64_IEEE 3.5e+305 Torque_Control_ETR07_CM_double -1.7e+308 1.7e+308 DISPLAY_IDENTIFIER Torque_Control_ETR07.VDC.Vehicle_Dynamics_Control_2018.VDC_2018_Complete.Lateral_Dynamics.Integrator.InitialCondition /end CHARACTERISTIC
/begin CHARACTERISTIC Torque_Control_ETR07.Torque_Control_ETR07_P.LimitTemperatureCeldasC_Value "" VALUE 0x0 SCALAR_FLOAT64_IEEE 3.5e+305 Torque_Control_ETR07_CM_double -1.7e+308 1.7e+308 DISPLAY_IDENTIFIER Torque_Control_ETR07.VDC.Vehicle_Dynamics_Control_2018.Limit_Temperature_Celdas[C].Value /end CHARACTERISTIC
/begin CHARACTERISTIC Torque_Control_ETR07.Torque_Control_ETR07_P.LimitTemperatureIGBTC_Value "" VALUE 0x0 SCALAR_FLOAT64_IEEE 3.5e+305 Torque_Control_ETR07_CM_double -1.7e+308 1.7e+308 DISPLAY_IDENTIFIER Torque_Control_ETR07.VDC.Vehicle_Dynamics_Control_2018.Limit_Temperature_IGBT_[C].Value /end CHARACTERISTIC
/begin CHARACTERISTIC Torque_Control_ETR07.Torque_Control_ETR07_P.LimitTemperatureMotorC_Value "" VALUE 0x0 SCALAR_FLOAT64_IEEE 3.5e+305 Torque_Control_ETR07_CM_double -1.7e+308 1.7e+308 DISPLAY_IDENTIFIER Torque_Control_ETR07.VDC.Vehicle_Dynamics_Control_2018.Limit_Temperature_Motor_[C].Value /end CHARACTERISTIC
/begin CHARACTERISTIC Torque_Control_ETR07.Torque_Control_ETR07_P.Masskg0inf_Y0 "" VALUE 0x0 SCALAR_FLOAT64_IEEE 3.5e+305 Torque_Control_ETR07_CM_double -1.7e+308 1.7e+308 DISPLAY_IDENTIFIER Torque_Control_ETR07.VDC.Vehicle_Dynamics_Control_2018.VDC_2018_without_Longitudinal.Mass_[kg]__0_inf_.InitialOutput /end CHARACTERISTIC
/begin CHARACTERISTIC Torque_Control_ETR07.Torque_Control_ETR07_P.MaxFx_RLN0inf_Y0 "" VALUE 0x0 SCALAR_FLOAT64_IEEE 3.5e+305 Torque_Control_ETR07_CM_double -1.7e+308 1.7e+308 DISPLAY_IDENTIFIER Torque_Control_ETR07.VDC.Vehicle_Dynamics_Control_2018.VDC_2018_without_Longitudinal.MaxFx_RL_[N]__0_inf_.InitialOutput /end CHARACTERISTIC
/begin CHARACTERISTIC Torque_Control_ETR07.Torque_Control_ETR07_P.MaxFx_RRN0inf_Y0 "" VALUE 0x0 SCALAR_FLOAT64_IEEE 3.5e+305 Torque_Control_ETR07_CM_double -1.7e+308 1.7e+308 DISPLAY_IDENTIFIER Torque_Control_ETR07.VDC.Vehicle_Dynamics_Control_2018.VDC_2018_without_Longitudinal.MaxFx_RR_[N]__0_inf_.InitialOutput /end CHARACTERISTIC
/begin CHARACTERISTIC Torque_Control_ETR07.Torque_Control_ETR07_P.MaxTq_RLNm0inf_Y0 "" VALUE 0x0 SCALAR_FLOAT64_IEEE 3.5e+305 Torque_Control_ETR07_CM_double -1.7e+308 1.7e+308 DISPLAY_IDENTIFIER Torque_Control_ETR07.VDC.Vehicle_Dynamics_Control_2018.VDC_2018_Complete.MaxTq_RL_[Nm]__0_inf_.InitialOutput /end CHARACTERISTIC
/begin CHARACTERISTIC Torque_Control_ETR07.Torque_Control_ETR07_P.MaxTq_RLNm0inf_Y0_d "" VALUE 0x0 SCALAR_FLOAT64_IEEE 3.5e+305 Torque_Control_ETR07_CM_double -1.7e+308 1.7e+308 DISPLAY_IDENTIFIER Torque_Control_ETR07.VDC.Vehicle_Dynamics_Control_2018.VDC_2018_without_Longitudinal.MaxTq_RL_[Nm]__0_inf_.InitialOutput /end CHARACTERISTIC
/begin CHARACTERISTIC Torque_Control_ETR07.Torque_Control_ETR07_P.MaxTq_RRNm0inf_Y0 "" VALUE 0x0 SCALAR_FLOAT64_IEEE 3.5e+305 Torque_Control_ETR07_CM_double -1.7e+308 1.7e+308 DISPLAY_IDENTIFIER Torque_Control_ETR07.VDC.Vehicle_Dynamics_Control_2018.VDC_2018_Complete.MaxTq_RR_[Nm]__0_inf_.InitialOutput /end CHARACTERISTIC
/begin CHARACTERISTIC Torque_Control_ETR07.Torque_Control_ETR07_P.MaxTq_RRNm0inf_Y0_o "" VALUE 0x0 SCALAR_FLOAT64_IEEE 3.5e+305 Torque_Control_ETR07_CM_double -1.7e+308 1.7e+308 DISPLAY_IDENTIFIER Torque_Control_ETR07.VDC.Vehicle_Dynamics_Control_2018.VDC_2018_without_Longitudinal.MaxTq_RR_[Nm]__0_inf_.InitialOutput /end CHARACTERISTIC
/begin CHARACTERISTIC Torque_Control_ETR07.Torque_Control_ETR07_P.MaximumTorqueperengineNm_Valu_b "" VALUE 0x0 SCALAR_FLOAT64_IEEE 3.5e+305 Torque_Control_ETR07_CM_double -1.7e+308 1.7e+308 DISPLAY_IDENTIFIER Torque_Control_ETR07.VDC.Vehicle_Dynamics_Control_2018.VDC_2018_without_Longitudinal.In_Numbers.Maximum_Torque_per_engine_[Nm].Value /end CHARACTERISTIC
/begin CHARACTERISTIC Torque_Control_ETR07.Torque_Control_ETR07_P.MaximumTorqueperengineNm_Value "" VALUE 0x0 SCALAR_FLOAT64_IEEE 3.5e+305 Torque_Control_ETR07_CM_double -1.7e+308 1.7e+308 DISPLAY_IDENTIFIER Torque_Control_ETR07.VDC.Vehicle_Dynamics_Control_2018.VDC_2018_Complete.In_Numbers.Maximum_Torque_per_engine_[Nm].Value /end CHARACTERISTIC
/begin CHARACTERISTIC Torque_Control_ETR07.Torque_Control_ETR07_P.MaximumTransmissionTorqueDyna_a "" VALUE 0x0 SCALAR_FLOAT64_IEEE 3.5e+305 Torque_Control_ETR07_CM_double -1.7e+308 1.7e+308 DISPLAY_IDENTIFIER Torque_Control_ETR07.VDC.Vehicle_Dynamics_Control_2018.VDC_2018_without_Longitudinal.In_Numbers.Maximum_Transmission_Torque_Dynamic_[Nm].Value /end CHARACTERISTIC
/begin CHARACTERISTIC Torque_Control_ETR07.Torque_Control_ETR07_P.MaximumTransmissionTorqueDynami "" VALUE 0x0 SCALAR_FLOAT64_IEEE 3.5e+305 Torque_Control_ETR07_CM_double -1.7e+308 1.7e+308 DISPLAY_IDENTIFIER Torque_Control_ETR07.VDC.Vehicle_Dynamics_Control_2018.VDC_2018_Complete.In_Numbers.Maximum_Transmission_Torque_Dynamic_[Nm].Value /end CHARACTERISTIC
/begin CHARACTERISTIC Torque_Control_ETR07.Torque_Control_ETR07_P.MaximumTransmissionTorqueStat_n "" VALUE 0x0 SCALAR_FLOAT64_IEEE 3.5e+305 Torque_Control_ETR07_CM_double -1.7e+308 1.7e+308 DISPLAY_IDENTIFIER Torque_Control_ETR07.VDC.Vehicle_Dynamics_Control_2018.VDC_2018_without_Longitudinal.In_Numbers.Maximum_Transmission_Torque_Static_[Nm].Value /end CHARACTERISTIC
/begin CHARACTERISTIC Torque_Control_ETR07.Torque_Control_ETR07_P.MaximumTransmissionTorqueStatic "" VALUE 0x0 SCALAR_FLOAT64_IEEE 3.5e+305 Torque_Control_ETR07_CM_double -1.7e+308 1.7e+308 DISPLAY_IDENTIFIER Torque_Control_ETR07.VDC.Vehicle_Dynamics_Control_2018.VDC_2018_Complete.In_Numbers.Maximum_Transmission_Torque_Static_[Nm].Value /end CHARACTERISTIC
/begin CHARACTERISTIC Torque_Control_ETR07.Torque_Control_ETR07_P.Merge1_InitialOutput "" VALUE 0x0 SCALAR_FLOAT64_IEEE 3.5e+305 Torque_Control_ETR07_CM_double -1.7e+308 1.7e+308 DISPLAY_IDENTIFIER Torque_Control_ETR07.VDC.Vehicle_Dynamics_Control_2018.VDC_2018_Complete.Driver____CarBehaviours.Merge1.InitialOutput /end CHARACTERISTIC
/begin CHARACTERISTIC Torque_Control_ETR07.Torque_Control_ETR07_P.Merge1_InitialOutput_f "" VALUE 0x0 SCALAR_FLOAT64_IEEE 3.5e+305 Torque_Control_ETR07_CM_double -1.7e+308 1.7e+308 DISPLAY_IDENTIFIER Torque_Control_ETR07.VDC.Vehicle_Dynamics_Control_2018.Merge1.InitialOutput /end CHARACTERISTIC
/begin CHARACTERISTIC Torque_Control_ETR07.Torque_Control_ETR07_P.Merge1_InitialOutput_k "" VALUE 0x0 SCALAR_FLOAT64_IEEE 3.5e+305 Torque_Control_ETR07_CM_double -1.7e+308 1.7e+308 DISPLAY_IDENTIFIER Torque_Control_ETR07.VDC.Vehicle_Dynamics_Control_2018.VDC_2018_without_Longitudinal.Driver____CarBehaviours.Merge1.InitialOutput /end CHARACTERISTIC
/begin CHARACTERISTIC Torque_Control_ETR07.Torque_Control_ETR07_P.Merge2_InitialOutput "" VALUE 0x0 SCALAR_FLOAT64_IEEE 3.5e+305 Torque_Control_ETR07_CM_double -1.7e+308 1.7e+308 DISPLAY_IDENTIFIER Torque_Control_ETR07.VDC.Vehicle_Dynamics_Control_2018.VDC_2018_Complete.Merge2.InitialOutput /end CHARACTERISTIC
/begin CHARACTERISTIC Torque_Control_ETR07.Torque_Control_ETR07_P.Merge2_InitialOutput_o "" VALUE 0x0 SCALAR_FLOAT64_IEEE 3.5e+305 Torque_Control_ETR07_CM_double -1.7e+308 1.7e+308 DISPLAY_IDENTIFIER Torque_Control_ETR07.VDC.Vehicle_Dynamics_Control_2018.Merge2.InitialOutput /end CHARACTERISTIC
/begin CHARACTERISTIC Torque_Control_ETR07.Torque_Control_ETR07_P.Merge3_InitialOutput "" VALUE 0x0 SCALAR_FLOAT64_IEEE 3.5e+305 Torque_Control_ETR07_CM_double -1.7e+308 1.7e+308 DISPLAY_IDENTIFIER Torque_Control_ETR07.VDC.Vehicle_Dynamics_Control_2018.VDC_2018_Complete.Constraints.Acelerating_and_braking_without_Regenerative.Merge3.InitialOutput /end CHARACTERISTIC
/begin CHARACTERISTIC Torque_Control_ETR07.Torque_Control_ETR07_P.Merge3_InitialOutput_j "" VALUE 0x0 SCALAR_FLOAT64_IEEE 3.5e+305 Torque_Control_ETR07_CM_double -1.7e+308 1.7e+308 DISPLAY_IDENTIFIER Torque_Control_ETR07.VDC.Vehicle_Dynamics_Control_2018.VDC_2018_Complete.Merge3.InitialOutput /end CHARACTERISTIC
/begin CHARACTERISTIC Torque_Control_ETR07.Torque_Control_ETR07_P.Merge3_InitialOutput_n "" VALUE 0x0 SCALAR_FLOAT64_IEEE 3.5e+305 Torque_Control_ETR07_CM_double -1.7e+308 1.7e+308 DISPLAY_IDENTIFIER Torque_Control_ETR07.VDC.Vehicle_Dynamics_Control_2018.Merge3.InitialOutput /end CHARACTERISTIC
/begin CHARACTERISTIC Torque_Control_ETR07.Torque_Control_ETR07_P.Merge4_InitialOutput "" VALUE 0x0 SCALAR_FLOAT64_IEEE 3.5e+305 Torque_Control_ETR07_CM_double -1.7e+308 1.7e+308 DISPLAY_IDENTIFIER Torque_Control_ETR07.VDC.Vehicle_Dynamics_Control_2018.VDC_2018_Complete.Constraints.Acelerating_and_braking_without_Regenerative.Merge4.InitialOutput /end CHARACTERISTIC
/begin CHARACTERISTIC Torque_Control_ETR07.Torque_Control_ETR07_P.Merge4_InitialOutput_d "" VALUE 0x0 SCALAR_FLOAT64_IEEE 3.5e+305 Torque_Control_ETR07_CM_double -1.7e+308 1.7e+308 DISPLAY_IDENTIFIER Torque_Control_ETR07.VDC.Vehicle_Dynamics_Control_2018.VDC_2018_Complete.Merge4.InitialOutput /end CHARACTERISTIC
/begin CHARACTERISTIC Torque_Control_ETR07.Torque_Control_ETR07_P.Merge5_InitialOutput "" VALUE 0x0 SCALAR_FLOAT64_IEEE 3.5e+305 Torque_Control_ETR07_CM_double -1.7e+308 1.7e+308 DISPLAY_IDENTIFIER Torque_Control_ETR07.VDC.Vehicle_Dynamics_Control_2018.VDC_2018_Complete.Merge5.InitialOutput /end CHARACTERISTIC
/begin CHARACTERISTIC Torque_Control_ETR07.Torque_Control_ETR07_P.Merge6_InitialOutput "" VALUE 0x0 SCALAR_FLOAT64_IEEE 3.5e+305 Torque_Control_ETR07_CM_double -1.7e+308 1.7e+308 DISPLAY_IDENTIFIER Torque_Control_ETR07.VDC.Vehicle_Dynamics_Control_2018.VDC_2018_Complete.Merge6.InitialOutput /end CHARACTERISTIC
/begin CHARACTERISTIC Torque_Control_ETR07.Torque_Control_ETR07_P.Merge7_InitialOutput "" VALUE 0x0 SCALAR_FLOAT64_IEEE 3.5e+305 Torque_Control_ETR07_CM_double -1.7e+308 1.7e+308 DISPLAY_IDENTIFIER Torque_Control_ETR07.VDC.Vehicle_Dynamics_Control_2018.VDC_2018_Complete.Merge7.InitialOutput /end CHARACTERISTIC
/begin CHARACTERISTIC Torque_Control_ETR07.Torque_Control_ETR07_P.Merge_InitialOutput "" VALUE 0x0 SCALAR_FLOAT64_IEEE 3.5e+305 Torque_Control_ETR07_CM_double -1.7e+308 1.7e+308 DISPLAY_IDENTIFIER Torque_Control_ETR07.VDC.Vehicle_Dynamics_Control_2018.VDC_2018_Complete.Optimization_SKF__amp__CKF.Subsystem.SKF.Merge.InitialOutput /end CHARACTERISTIC
/begin CHARACTERISTIC Torque_Control_ETR07.Torque_Control_ETR07_P.Merge_InitialOutput_a "" VALUE 0x0 SCALAR_FLOAT64_IEEE 3.5e+305 Torque_Control_ETR07_CM_double -1.7e+308 1.7e+308 DISPLAY_IDENTIFIER Torque_Control_ETR07.VDC.Vehicle_Dynamics_Control_2018.Steering_TV_2017_with_TC.Optimization_SKF__amp__CKF.Subsystem.CKF.Merge.InitialOutput /end CHARACTERISTIC
/begin CHARACTERISTIC Torque_Control_ETR07.Torque_Control_ETR07_P.Merge_InitialOutput_h "" VALUE 0x0 SCALAR_FLOAT64_IEEE 3.5e+305 Torque_Control_ETR07_CM_double -1.7e+308 1.7e+308 DISPLAY_IDENTIFIER Torque_Control_ETR07.VDC.Vehicle_Dynamics_Control_2018.VDC_2018_without_Longitudinal.Optimization_SKF__amp__CKF.Subsystem.CKF.Merge.InitialOutput /end CHARACTERISTIC
/begin CHARACTERISTIC Torque_Control_ETR07.Torque_Control_ETR07_P.Merge_InitialOutput_i "" VALUE 0x0 SCALAR_FLOAT64_IEEE 3.5e+305 Torque_Control_ETR07_CM_double -1.7e+308 1.7e+308 DISPLAY_IDENTIFIER Torque_Control_ETR07.VDC.Vehicle_Dynamics_Control_2018.VDC_2018_Complete.Driver____CarBehaviours.Merge.InitialOutput /end CHARACTERISTIC
/begin CHARACTERISTIC Torque_Control_ETR07.Torque_Control_ETR07_P.Merge_InitialOutput_j "" VALUE 0x0 SCALAR_FLOAT64_IEEE 3.5e+305 Torque_Control_ETR07_CM_double -1.7e+308 1.7e+308 DISPLAY_IDENTIFIER Torque_Control_ETR07.VDC.Vehicle_Dynamics_Control_2018.VDC_2018_Complete.Optimization_SKF__amp__CKF.Subsystem.CKF.Merge.InitialOutput /end CHARACTERISTIC
/begin CHARACTERISTIC Torque_Control_ETR07.Torque_Control_ETR07_P.Merge_InitialOutput_jq "" VALUE 0x0 SCALAR_FLOAT64_IEEE 3.5e+305 Torque_Control_ETR07_CM_double -1.7e+308 1.7e+308 DISPLAY_IDENTIFIER Torque_Control_ETR07.VDC.Regeneration_Enable.Not_Braking.Merge.InitialOutput /end CHARACTERISTIC
/begin CHARACTERISTIC Torque_Control_ETR07.Torque_Control_ETR07_P.Merge_InitialOutput_l "" VALUE 0x0 SCALAR_FLOAT64_IEEE 3.5e+305 Torque_Control_ETR07_CM_double -1.7e+308 1.7e+308 DISPLAY_IDENTIFIER Torque_Control_ETR07.VDC.Vehicle_Dynamics_Control_2018.VDC_2018_without_Longitudinal.Driver____CarBehaviours.Merge.InitialOutput /end CHARACTERISTIC
/begin CHARACTERISTIC Torque_Control_ETR07.Torque_Control_ETR07_P.Merge_InitialOutput_p "" VALUE 0x0 SCALAR_FLOAT64_IEEE 3.5e+305 Torque_Control_ETR07_CM_double -1.7e+308 1.7e+308 DISPLAY_IDENTIFIER Torque_Control_ETR07.VDC.Vehicle_Dynamics_Control_2018.Steering_TV_2017_with_TC.Optimization_SKF__amp__CKF.Subsystem.SKF.Merge.InitialOutput /end CHARACTERISTIC
/begin CHARACTERISTIC Torque_Control_ETR07.Torque_Control_ETR07_P.Merge_InitialOutput_pp "" VALUE 0x0 SCALAR_FLOAT64_IEEE 3.5e+305 Torque_Control_ETR07_CM_double -1.7e+308 1.7e+308 DISPLAY_IDENTIFIER Torque_Control_ETR07.VDC.Vehicle_Dynamics_Control_2018.Merge.InitialOutput /end CHARACTERISTIC
/begin CHARACTERISTIC Torque_Control_ETR07.Torque_Control_ETR07_P.Nospin_k.Switch_Threshold "" VALUE 0x0 SCALAR_FLOAT64_IEEE 3.5e+305 Torque_Control_ETR07_CM_double -1.7e+308 1.7e+308 DISPLAY_IDENTIFIER Torque_Control_ETR07.VDC.Vehicle_Dynamics_Control_2018.VDC_2018_Complete.Optimization_SKF__amp__CKF.Subsystem.CKF.No_spin.Switch.Threshold /end CHARACTERISTIC
/begin CHARACTERISTIC Torque_Control_ETR07.Torque_Control_ETR07_P.Not_Braking_Value "" VALUE 0x0 SCALAR_FLOAT64_IEEE 3.5e+305 Torque_Control_ETR07_CM_double -1.7e+308 1.7e+308 DISPLAY_IDENTIFIER Torque_Control_ETR07.VDC.Regeneration_Enable.Not_Braking.Not_Braking.Value /end CHARACTERISTIC
/begin CHARACTERISTIC Torque_Control_ETR07.Torque_Control_ETR07_P.Out_Throttle_Y0 "" VALUE 0x0 SCALAR_FLOAT64_IEEE 3.5e+305 Torque_Control_ETR07_CM_double -1.7e+308 1.7e+308 DISPLAY_IDENTIFIER Torque_Control_ETR07.VDC.Vehicle_Dynamics_Control_2018.VDC_2018_Complete.Driver____CarBehaviours.Accelerating.Out_Throttle.InitialOutput /end CHARACTERISTIC
/begin CHARACTERISTIC Torque_Control_ETR07.Torque_Control_ETR07_P.Out_Throttle_Y0_a "" VALUE 0x0 SCALAR_FLOAT64_IEEE 3.5e+305 Torque_Control_ETR07_CM_double -1.7e+308 1.7e+308 DISPLAY_IDENTIFIER Torque_Control_ETR07.VDC.Vehicle_Dynamics_Control_2018.VDC_2018_without_Longitudinal.Driver____CarBehaviours.Accelerating.Out_Throttle.InitialOutput /end CHARACTERISTIC
/begin CHARACTERISTIC Torque_Control_ETR07.Torque_Control_ETR07_P.Rear_Trackwidthm_Value "" VALUE 0x0 SCALAR_FLOAT64_IEEE 3.5e+305 Torque_Control_ETR07_CM_double -1.7e+308 1.7e+308 DISPLAY_IDENTIFIER Torque_Control_ETR07.VDC.Vehicle_Dynamics_Control_2018.VDC_2018_Complete.Lateral_Dynamics.Rear_Trackwidth_[m].Value /end CHARACTERISTIC
/begin CHARACTERISTIC Torque_Control_ETR07.Torque_Control_ETR07_P.SKF_act_Y0 "" VALUE 0x0 SCALAR_FLOAT64_IEEE 3.5e+305 Torque_Control_ETR07_CM_double -1.7e+308 1.7e+308 DISPLAY_IDENTIFIER Torque_Control_ETR07.VDC.Vehicle_Dynamics_Control_2018.VDC_2018_Complete.Optimization_SKF__amp__CKF.Subsystem.SKF.SKF_act.InitialOutput /end CHARACTERISTIC
/begin CHARACTERISTIC Torque_Control_ETR07.Torque_Control_ETR07_P.SKF_act_Y0_l "" VALUE 0x0 SCALAR_FLOAT64_IEEE 3.5e+305 Torque_Control_ETR07_CM_double -1.7e+308 1.7e+308 DISPLAY_IDENTIFIER Torque_Control_ETR07.VDC.Vehicle_Dynamics_Control_2018.Steering_TV_2017_with_TC.Optimization_SKF__amp__CKF.Subsystem.SKF.SKF_act.InitialOutput /end CHARACTERISTIC
/begin CHARACTERISTIC Torque_Control_ETR07.Torque_Control_ETR07_P.Saturation1_LowerSat "" VALUE 0x0 SCALAR_FLOAT64_IEEE 3.5e+305 Torque_Control_ETR07_CM_double -1.7e+308 1.7e+308 DISPLAY_IDENTIFIER Torque_Control_ETR07.VDC.WORKSHOP_MODE_RESTRICTIONS.Torque_Reduction.Saturation1.LowerLimit /end CHARACTERISTIC
/begin CHARACTERISTIC Torque_Control_ETR07.Torque_Control_ETR07_P.Saturation1_LowerSat_l "" VALUE 0x0 SCALAR_FLOAT64_IEEE 3.5e+305 Torque_Control_ETR07_CM_double -1.7e+308 1.7e+308 DISPLAY_IDENTIFIER Torque_Control_ETR07.VDC.WORKSHOP_MODE_RESTRICTIONS.Saturation1.LowerLimit /end CHARACTERISTIC
/begin CHARACTERISTIC Torque_Control_ETR07.Torque_Control_ETR07_P.Saturation1_UpperSat "" VALUE 0x0 SCALAR_FLOAT64_IEEE 3.5e+305 Torque_Control_ETR07_CM_double -1.7e+308 1.7e+308 DISPLAY_IDENTIFIER Torque_Control_ETR07.VDC.WORKSHOP_MODE_RESTRICTIONS.Torque_Reduction.Saturation1.UpperLimit /end CHARACTERISTIC
/begin CHARACTERISTIC Torque_Control_ETR07.Torque_Control_ETR07_P.Saturation1_UpperSat_m "" VALUE 0x0 SCALAR_FLOAT64_IEEE 3.5e+305 Torque_Control_ETR07_CM_double -1.7e+308 1.7e+308 DISPLAY_IDENTIFIER Torque_Control_ETR07.VDC.WORKSHOP_MODE_RESTRICTIONS.Saturation1.UpperLimit /end CHARACTERISTIC
/begin CHARACTERISTIC Torque_Control_ETR07.Torque_Control_ETR07_P.Saturation_LowerSat "" VALUE 0x0 SCALAR_FLOAT64_IEEE 3.5e+305 Torque_Control_ETR07_CM_double -1.7e+308 1.7e+308 DISPLAY_IDENTIFIER Torque_Control_ETR07.VDC.Vehicle_Dynamics_Control_2018.VDC_2018_Complete.Optimization_SKF__amp__CKF.Subsystem.SKF.Saturation.LowerLimit /end CHARACTERISTIC
/begin CHARACTERISTIC Torque_Control_ETR07.Torque_Control_ETR07_P.Saturation_LowerSat_c "" VALUE 0x0 SCALAR_FLOAT64_IEEE 3.5e+305 Torque_Control_ETR07_CM_double -1.7e+308 1.7e+308 DISPLAY_IDENTIFIER Torque_Control_ETR07.VDC.Vehicle_Dynamics_Control_2018.VDC_2018_without_Longitudinal.Optimization_SKF__amp__CKF.Subsystem.CKF.Saturation.LowerLimit /end CHARACTERISTIC
/begin CHARACTERISTIC Torque_Control_ETR07.Torque_Control_ETR07_P.Saturation_LowerSat_e "" VALUE 0x0 SCALAR_FLOAT64_IEEE 3.5e+305 Torque_Control_ETR07_CM_double -1.7e+308 1.7e+308 DISPLAY_IDENTIFIER Torque_Control_ETR07.VDC.Vehicle_Dynamics_Control_2018.Steering_TV_2017_with_TC.Optimization_SKF__amp__CKF.Subsystem.CKF.Saturation.LowerLimit /end CHARACTERISTIC
/begin CHARACTERISTIC Torque_Control_ETR07.Torque_Control_ETR07_P.Saturation_LowerSat_f "" VALUE 0x0 SCALAR_FLOAT64_IEEE 3.5e+305 Torque_Control_ETR07_CM_double -1.7e+308 1.7e+308 DISPLAY_IDENTIFIER Torque_Control_ETR07.VDC.Vehicle_Dynamics_Control_2018.VDC_2018_Complete.Optimization_SKF__amp__CKF.Subsystem.CKF.Saturation.LowerLimit /end CHARACTERISTIC
/begin CHARACTERISTIC Torque_Control_ETR07.Torque_Control_ETR07_P.Saturation_LowerSat_f3 "" VALUE 0x0 SCALAR_FLOAT64_IEEE 3.5e+305 Torque_Control_ETR07_CM_double -1.7e+308 1.7e+308 DISPLAY_IDENTIFIER Torque_Control_ETR07.VDC.Vehicle_Dynamics_Control_2018.Steering_TV_2017_with_TC.Optimization_SKF__amp__CKF.Subsystem.SKF.Saturation.LowerLimit /end CHARACTERISTIC
/begin CHARACTERISTIC Torque_Control_ETR07.Torque_Control_ETR07_P.Saturation_LowerSat_fi "" VALUE 0x0 SCALAR_FLOAT64_IEEE 3.5e+305 Torque_Control_ETR07_CM_double -1.7e+308 1.7e+308 DISPLAY_IDENTIFIER Torque_Control_ETR07.VDC.WORKSHOP_MODE_RESTRICTIONS.Saturation.LowerLimit /end CHARACTERISTIC
/begin CHARACTERISTIC Torque_Control_ETR07.Torque_Control_ETR07_P.Saturation_LowerSat_j "" VALUE 0x0 SCALAR_FLOAT64_IEEE 3.5e+305 Torque_Control_ETR07_CM_double -1.7e+308 1.7e+308 DISPLAY_IDENTIFIER Torque_Control_ETR07.VDC.WORKSHOP_MODE_RESTRICTIONS.Torque_Reduction.Saturation.LowerLimit /end CHARACTERISTIC
/begin CHARACTERISTIC Torque_Control_ETR07.Torque_Control_ETR07_P.Saturation_UpperSat "" VALUE 0x0 SCALAR_FLOAT64_IEEE 3.5e+305 Torque_Control_ETR07_CM_double -1.7e+308 1.7e+308 DISPLAY_IDENTIFIER Torque_Control_ETR07.VDC.Vehicle_Dynamics_Control_2018.VDC_2018_Complete.Optimization_SKF__amp__CKF.Subsystem.SKF.Saturation.UpperLimit /end CHARACTERISTIC
/begin CHARACTERISTIC Torque_Control_ETR07.Torque_Control_ETR07_P.Saturation_UpperSat_c "" VALUE 0x0 SCALAR_FLOAT64_IEEE 3.5e+305 Torque_Control_ETR07_CM_double -1.7e+308 1.7e+308 DISPLAY_IDENTIFIER Torque_Control_ETR07.VDC.Vehicle_Dynamics_Control_2018.Steering_TV_2017_with_TC.Optimization_SKF__amp__CKF.Subsystem.CKF.Saturation.UpperLimit /end CHARACTERISTIC
/begin CHARACTERISTIC Torque_Control_ETR07.Torque_Control_ETR07_P.Saturation_UpperSat_f "" VALUE 0x0 SCALAR_FLOAT64_IEEE 3.5e+305 Torque_Control_ETR07_CM_double -1.7e+308 1.7e+308 DISPLAY_IDENTIFIER Torque_Control_ETR07.VDC.Vehicle_Dynamics_Control_2018.VDC_2018_Complete.Optimization_SKF__amp__CKF.Subsystem.CKF.Saturation.UpperLimit /end CHARACTERISTIC
/begin CHARACTERISTIC Torque_Control_ETR07.Torque_Control_ETR07_P.Saturation_UpperSat_g "" VALUE 0x0 SCALAR_FLOAT64_IEEE 3.5e+305 Torque_Control_ETR07_CM_double -1.7e+308 1.7e+308 DISPLAY_IDENTIFIER Torque_Control_ETR07.VDC.WORKSHOP_MODE_RESTRICTIONS.Saturation.UpperLimit /end CHARACTERISTIC
/begin CHARACTERISTIC Torque_Control_ETR07.Torque_Control_ETR07_P.Saturation_UpperSat_h "" VALUE 0x0 SCALAR_FLOAT64_IEEE 3.5e+305 Torque_Control_ETR07_CM_double -1.7e+308 1.7e+308 DISPLAY_IDENTIFIER Torque_Control_ETR07.VDC.WORKSHOP_MODE_RESTRICTIONS.Torque_Reduction.Saturation.UpperLimit /end CHARACTERISTIC
/begin CHARACTERISTIC Torque_Control_ETR07.Torque_Control_ETR07_P.Saturation_UpperSat_i "" VALUE 0x0 SCALAR_FLOAT64_IEEE 3.5e+305 Torque_Control_ETR07_CM_double -1.7e+308 1.7e+308 DISPLAY_IDENTIFIER Torque_Control_ETR07.VDC.Vehicle_Dynamics_Control_2018.VDC_2018_without_Longitudinal.Optimization_SKF__amp__CKF.Subsystem.CKF.Saturation.UpperLimit /end CHARACTERISTIC
/begin CHARACTERISTIC Torque_Control_ETR07.Torque_Control_ETR07_P.Saturation_UpperSat_k "" VALUE 0x0 SCALAR_FLOAT64_IEEE 3.5e+305 Torque_Control_ETR07_CM_double -1.7e+308 1.7e+308 DISPLAY_IDENTIFIER Torque_Control_ETR07.VDC.Vehicle_Dynamics_Control_2018.Steering_TV_2017_with_TC.Optimization_SKF__amp__CKF.Subsystem.SKF.Saturation.UpperLimit /end CHARACTERISTIC
/begin CHARACTERISTIC Torque_Control_ETR07.Torque_Control_ETR07_P.Spin_n.Constant_Value "" VALUE 0x0 SCALAR_FLOAT64_IEEE 3.5e+305 Torque_Control_ETR07_CM_double -1.7e+308 1.7e+308 DISPLAY_IDENTIFIER Torque_Control_ETR07.VDC.Vehicle_Dynamics_Control_2018.VDC_2018_Complete.Optimization_SKF__amp__CKF.Subsystem.CKF.Spin.Constant.Value /end CHARACTERISTIC
/begin CHARACTERISTIC Torque_Control_ETR07.Torque_Control_ETR07_P.Spin_n.Switch_Threshold "" VALUE 0x0 SCALAR_FLOAT64_IEEE 3.5e+305 Torque_Control_ETR07_CM_double -1.7e+308 1.7e+308 DISPLAY_IDENTIFIER Torque_Control_ETR07.VDC.Vehicle_Dynamics_Control_2018.VDC_2018_Complete.Optimization_SKF__amp__CKF.Subsystem.CKF.Spin.Switch.Threshold /end CHARACTERISTIC
/begin CHARACTERISTIC Torque_Control_ETR07.Torque_Control_ETR07_P.SteeringWheelMaximumAngle_Val_i "" VALUE 0x0 SCALAR_FLOAT64_IEEE 3.5e+305 Torque_Control_ETR07_CM_double -1.7e+308 1.7e+308 DISPLAY_IDENTIFIER Torque_Control_ETR07.VDC.Vehicle_Dynamics_Control_2018.Steering_TV_2017_with_TC.Steering_Wheel_Maximum_Angle.Value /end CHARACTERISTIC
/begin CHARACTERISTIC Torque_Control_ETR07.Torque_Control_ETR07_P.SteeringWheelMaximumAngle_Val_o "" VALUE 0x0 SCALAR_FLOAT64_IEEE 3.5e+305 Torque_Control_ETR07_CM_double -1.7e+308 1.7e+308 DISPLAY_IDENTIFIER Torque_Control_ETR07.VDC.Vehicle_Dynamics_Control_2018.Steering_TV_2017_with_TC.Optimization_SKF__amp__CKF.Subsystem.Steering_Wheel_Maximum_Angle.Value /end CHARACTERISTIC
/begin CHARACTERISTIC Torque_Control_ETR07.Torque_Control_ETR07_P.SteeringWheelMaximumAngle_Value "" VALUE 0x0 SCALAR_FLOAT64_IEEE 3.5e+305 Torque_Control_ETR07_CM_double -1.7e+308 1.7e+308 DISPLAY_IDENTIFIER Torque_Control_ETR07.VDC.Vehicle_Dynamics_Control_2018.VDC_2018_Complete.Optimization_SKF__amp__CKF.Subsystem.Steering_Wheel_Maximum_Angle.Value /end CHARACTERISTIC
/begin CHARACTERISTIC Torque_Control_ETR07.Torque_Control_ETR07_P.SteeringWheelSaturationpersited "" VALUE 0x0 SCALAR_FLOAT64_IEEE 3.5e+305 Torque_Control_ETR07_CM_double -1.7e+308 1.7e+308 DISPLAY_IDENTIFIER Torque_Control_ETR07.VDC.Vehicle_Dynamics_Control_2018.Steering_Wheel_Saturation__per_site__[deg].Value /end CHARACTERISTIC
/begin CHARACTERISTIC Torque_Control_ETR07.Torque_Control_ETR07_P.Steering_Ratio_Value "" VALUE 0x0 SCALAR_FLOAT64_IEEE 3.5e+305 Torque_Control_ETR07_CM_double -1.7e+308 1.7e+308 DISPLAY_IDENTIFIER Torque_Control_ETR07.VDC.Vehicle_Dynamics_Control_2018.VDC_2018_Complete.Lateral_Dynamics.Yaw_Rate_Reference.Steering_Ratio____.Value /end CHARACTERISTIC
/begin CHARACTERISTIC Torque_Control_ETR07.Torque_Control_ETR07_P.Switch_Threshold "" VALUE 0x0 SCALAR_FLOAT64_IEEE 3.5e+305 Torque_Control_ETR07_CM_double -1.7e+308 1.7e+308 DISPLAY_IDENTIFIER Torque_Control_ETR07.VDC.Vehicle_Dynamics_Control_2018.VDC_2018_Complete.Optimization_SKF__amp__CKF.Subsystem.SKF.Spin.Switch.Threshold /end CHARACTERISTIC
/begin CHARACTERISTIC Torque_Control_ETR07.Torque_Control_ETR07_P.Switch_Threshold_a "" VALUE 0x0 SCALAR_FLOAT64_IEEE 3.5e+305 Torque_Control_ETR07_CM_double -1.7e+308 1.7e+308 DISPLAY_IDENTIFIER Torque_Control_ETR07.VDC.Vehicle_Dynamics_Control_2018.Steering_TV_2017_with_TC.Optimization_SKF__amp__CKF.Subsystem.SKF.Spin.Switch.Threshold /end CHARACTERISTIC
/begin CHARACTERISTIC Torque_Control_ETR07.Torque_Control_ETR07_P.Switch_Threshold_b "" VALUE 0x0 SCALAR_FLOAT64_IEEE 3.5e+305 Torque_Control_ETR07_CM_double -1.7e+308 1.7e+308 DISPLAY_IDENTIFIER Torque_Control_ETR07.VDC.Vehicle_Dynamics_Control_2018.Steering_TV_2017_with_TC.Optimization_SKF__amp__CKF.Subsystem.CKF.Spin.Switch.Threshold /end CHARACTERISTIC
/begin CHARACTERISTIC Torque_Control_ETR07.Torque_Control_ETR07_P.Switch_Threshold_e "" VALUE 0x0 SCALAR_FLOAT64_IEEE 3.5e+305 Torque_Control_ETR07_CM_double -1.7e+308 1.7e+308 DISPLAY_IDENTIFIER Torque_Control_ETR07.VDC.Vehicle_Dynamics_Control_2018.Steering_TV_2017_with_TC.Optimization_SKF__amp__CKF.Subsystem.CKF.No_spin.Switch.Threshold /end CHARACTERISTIC
/begin CHARACTERISTIC Torque_Control_ETR07.Torque_Control_ETR07_P.Switch_Threshold_f "" VALUE 0x0 SCALAR_FLOAT64_IEEE 3.5e+305 Torque_Control_ETR07_CM_double -1.7e+308 1.7e+308 DISPLAY_IDENTIFIER Torque_Control_ETR07.VDC.Vehicle_Dynamics_Control_2018.Steering_TV_2017_with_TC.Optimization_SKF__amp__CKF.Subsystem.SKF.No_spin.Switch.Threshold /end CHARACTERISTIC
/begin CHARACTERISTIC Torque_Control_ETR07.Torque_Control_ETR07_P.Switch_Threshold_g "" VALUE 0x0 SCALAR_FLOAT64_IEEE 3.5e+305 Torque_Control_ETR07_CM_double -1.7e+308 1.7e+308 DISPLAY_IDENTIFIER Torque_Control_ETR07.VDC.Vehicle_Dynamics_Control_2018.VDC_2018_Complete.Optimization_SKF__amp__CKF.Subsystem.SKF.No_spin.Switch.Threshold /end CHARACTERISTIC
/begin CHARACTERISTIC Torque_Control_ETR07.Torque_Control_ETR07_P.TEMP_LIMIT_LOWER_Value "" VALUE 0x0 SCALAR_FLOAT64_IEEE 3.5e+305 Torque_Control_ETR07_CM_double -1.7e+308 1.7e+308 DISPLAY_IDENTIFIER Torque_Control_ETR07.VDC.Regeneration_Enable.Not_Braking.Low_Threshold.TEMP_LIMIT_LOWER.Value /end CHARACTERISTIC
/begin CHARACTERISTIC Torque_Control_ETR07.Torque_Control_ETR07_P.TEMP_LIMIT_UPPER_Value "" VALUE 0x0 SCALAR_FLOAT64_IEEE 3.5e+305 Torque_Control_ETR07_CM_double -1.7e+308 1.7e+308 DISPLAY_IDENTIFIER Torque_Control_ETR07.VDC.Regeneration_Enable.Not_Braking.Upper_Threshold.TEMP_LIMIT_UPPER.Value /end CHARACTERISTIC
/begin CHARACTERISTIC Torque_Control_ETR07.Torque_Control_ETR07_P.Temp_LIMIT.TEMP_LIMIT_Value "" VALUE 0x0 SCALAR_FLOAT64_IEEE 3.5e+305 Torque_Control_ETR07_CM_double -1.7e+308 1.7e+308 DISPLAY_IDENTIFIER Torque_Control_ETR07.VDC.Regeneration_Enable.Not_Braking.Temp_LIMIT.TEMP_LIMIT.Value /end CHARACTERISTIC
/begin CHARACTERISTIC Torque_Control_ETR07.Torque_Control_ETR07_P.Torque_RLNm_Value "" VALUE 0x0 SCALAR_FLOAT64_IEEE 3.5e+305 Torque_Control_ETR07_CM_double -1.7e+308 1.7e+308 DISPLAY_IDENTIFIER Torque_Control_ETR07.VDC.Vehicle_Dynamics_Control_2018.Rigid_Axle.Torque_RL_[Nm].Value /end CHARACTERISTIC
/begin CHARACTERISTIC Torque_Control_ETR07.Torque_Control_ETR07_P.Torque_RRNm_Value "" VALUE 0x0 SCALAR_FLOAT64_IEEE 3.5e+305 Torque_Control_ETR07_CM_double -1.7e+308 1.7e+308 DISPLAY_IDENTIFIER Torque_Control_ETR07.VDC.Vehicle_Dynamics_Control_2018.Rigid_Axle.Torque_RR_[Nm].Value /end CHARACTERISTIC
/begin CHARACTERISTIC Torque_Control_ETR07.Torque_Control_ETR07_P.Tq_diff_Max_Value "" VALUE 0x0 SCALAR_FLOAT64_IEEE 3.5e+305 Torque_Control_ETR07_CM_double -1.7e+308 1.7e+308 DISPLAY_IDENTIFIER Torque_Control_ETR07.VDC.Vehicle_Dynamics_Control_2018.VDC_2018_Complete.In_Numbers.Tq_diff_Max.Value /end CHARACTERISTIC
/begin CHARACTERISTIC Torque_Control_ETR07.Torque_Control_ETR07_P.Tq_diff_maxNm_Value "" VALUE 0x0 SCALAR_FLOAT64_IEEE 3.5e+305 Torque_Control_ETR07_CM_double -1.7e+308 1.7e+308 DISPLAY_IDENTIFIER Torque_Control_ETR07.VDC.Vehicle_Dynamics_Control_2018.Steering_TV_2017_with_TC.Tq_diff_max_[Nm].Value /end CHARACTERISTIC
/begin CHARACTERISTIC Torque_Control_ETR07.Torque_Control_ETR07_P.Tq_maxNm_Value "" VALUE 0x0 SCALAR_FLOAT64_IEEE 3.5e+305 Torque_Control_ETR07_CM_double -1.7e+308 1.7e+308 DISPLAY_IDENTIFIER Torque_Control_ETR07.VDC.Vehicle_Dynamics_Control_2018.Steering_TV_2017_with_TC.Tq_max_[Nm].Value /end CHARACTERISTIC
/begin CHARACTERISTIC Torque_Control_ETR07.Torque_Control_ETR07_P.TransmisionRatio_Value "" VALUE 0x0 SCALAR_FLOAT64_IEEE 3.5e+305 Torque_Control_ETR07_CM_double -1.7e+308 1.7e+308 DISPLAY_IDENTIFIER Torque_Control_ETR07.VDC.Vehicle_Dynamics_Control_2018.VDC_2018_Complete.In_Numbers.Transmision_Ratio___.Value /end CHARACTERISTIC
/begin CHARACTERISTIC Torque_Control_ETR07.Torque_Control_ETR07_P.TransmisionRatio_Value_j "" VALUE 0x0 SCALAR_FLOAT64_IEEE 3.5e+305 Torque_Control_ETR07_CM_double -1.7e+308 1.7e+308 DISPLAY_IDENTIFIER Torque_Control_ETR07.VDC.Vehicle_Dynamics_Control_2018.VDC_2018_without_Longitudinal.In_Numbers.Transmision_Ratio___.Value /end CHARACTERISTIC
/begin CHARACTERISTIC Torque_Control_ETR07.Torque_Control_ETR07_P.Wheelbasem_Value "" VALUE 0x0 SCALAR_FLOAT64_IEEE 3.5e+305 Torque_Control_ETR07_CM_double -1.7e+308 1.7e+308 DISPLAY_IDENTIFIER Torque_Control_ETR07.VDC.Vehicle_Dynamics_Control_2018.VDC_2018_Complete.Lateral_Dynamics.Yaw_Rate_Reference.Wheelbase_[m].Value /end CHARACTERISTIC
/begin CHARACTERISTIC Torque_Control_ETR07.Torque_Control_ETR07_P.Yaw_Inertiakgm3_Value "" VALUE 0x0 SCALAR_FLOAT64_IEEE 3.5e+305 Torque_Control_ETR07_CM_double -1.7e+308 1.7e+308 DISPLAY_IDENTIFIER Torque_Control_ETR07.VDC.Vehicle_Dynamics_Control_2018.VDC_2018_Complete.Lateral_Dynamics.Yaw_Inertia__kg__m_3_.Value /end CHARACTERISTIC
/begin CHARACTERISTIC Torque_Control_ETR07.Torque_Control_ETR07_P.Zero_Value "" VALUE 0x0 SCALAR_FLOAT64_IEEE 3.5e+305 Torque_Control_ETR07_CM_double -1.7e+308 1.7e+308 DISPLAY_IDENTIFIER Torque_Control_ETR07.Calculate_Current_Conversion.KT_L_TORKY.Zero.Value /end CHARACTERISTIC
/begin CHARACTERISTIC Torque_Control_ETR07.Torque_Control_ETR07_P.Zero_Value_c "" VALUE 0x0 SCALAR_FLOAT64_IEEE 3.5e+305 Torque_Control_ETR07_CM_double -1.7e+308 1.7e+308 DISPLAY_IDENTIFIER Torque_Control_ETR07.VDC.Regeneration_Enable.Zero.Value /end CHARACTERISTIC
/begin CHARACTERISTIC Torque_Control_ETR07.Torque_Control_ETR07_P.Zero_Value_p "" VALUE 0x0 SCALAR_FLOAT64_IEEE 3.5e+305 Torque_Control_ETR07_CM_double -1.7e+308 1.7e+308 DISPLAY_IDENTIFIER Torque_Control_ETR07.Calculate_Current_Conversion.KT_R_EMY.Zero.Value /end CHARACTERISTIC
/begin CHARACTERISTIC Torque_Control_ETR07.Torque_Control_ETR07_P.ct_Value "" VALUE 0x0 SCALAR_FLOAT64_IEEE 3.5e+305 Torque_Control_ETR07_CM_double -1.7e+308 1.7e+308 DISPLAY_IDENTIFIER Torque_Control_ETR07.Steering_Data_Conv.Low_Pass.ct.Value /end CHARACTERISTIC
/begin CHARACTERISTIC Torque_Control_ETR07.Torque_Control_ETR07_P.exptcycletau1_Value "" VALUE 0x0 SCALAR_FLOAT64_IEEE 3.5e+305 Torque_Control_ETR07_CM_double -1.7e+308 1.7e+308 DISPLAY_IDENTIFIER Torque_Control_ETR07.Steering_Data_Conv.Low_Pass.exp__tcycle__tau_1.Value /end CHARACTERISTIC
/begin CHARACTERISTIC Torque_Control_ETR07.Torque_Control_ETR07_P.halfrange_Value "" VALUE 0x0 SCALAR_FLOAT64_IEEE 3.5e+305 Torque_Control_ETR07_CM_double -1.7e+308 1.7e+308 DISPLAY_IDENTIFIER Torque_Control_ETR07.Steering_Data_Conv.half_range.Value /end CHARACTERISTIC
/begin CHARACTERISTIC Torque_Control_ETR07.Torque_Control_ETR07_P.inchtom_Gain "" VALUE 0x0 SCALAR_FLOAT64_IEEE 3.5e+305 Torque_Control_ETR07_CM_double -1.7e+308 1.7e+308 DISPLAY_IDENTIFIER Torque_Control_ETR07.VDC.Vehicle_Dynamics_Control_2018.VDC_2018_Complete.In_Numbers.inch_to_m.Gain /end CHARACTERISTIC
/begin CHARACTERISTIC Torque_Control_ETR07.Torque_Control_ETR07_P.inchtom_Gain_g "" VALUE 0x0 SCALAR_FLOAT64_IEEE 3.5e+305 Torque_Control_ETR07_CM_double -1.7e+308 1.7e+308 DISPLAY_IDENTIFIER Torque_Control_ETR07.VDC.Vehicle_Dynamics_Control_2018.VDC_2018_without_Longitudinal.In_Numbers.inch_to_m.Gain /end CHARACTERISTIC
/begin CHARACTERISTIC Torque_Control_ETR07.Torque_Control_ETR07_P.range_Value "" VALUE 0x0 SCALAR_FLOAT64_IEEE 3.5e+305 Torque_Control_ETR07_CM_double -1.7e+308 1.7e+308 DISPLAY_IDENTIFIER Torque_Control_ETR07.Steering_Data_Conv.range.Value /end CHARACTERISTIC
/begin CHARACTERISTIC Torque_Control_ETR07.Torque_Control_ETR07_P.rpm_Value "" VALUE 0x0 SCALAR_FLOAT64_IEEE 3.5e+305 Torque_Control_ETR07_CM_double -1.7e+308 1.7e+308 DISPLAY_IDENTIFIER Torque_Control_ETR07.VDC.Vehicle_Dynamics_Control_2018.VDC_2018_Complete.Constraints.Acelerating_and_braking_without_Regenerative.rpm.Value /end CHARACTERISTIC
/begin CHARACTERISTIC Torque_Control_ETR07.Torque_Control_ETR07_P.rpm_Value_k "" VALUE 0x0 SCALAR_FLOAT64_IEEE 3.5e+305 Torque_Control_ETR07_CM_double -1.7e+308 1.7e+308 DISPLAY_IDENTIFIER Torque_Control_ETR07.VDC.Vehicle_Dynamics_Control_2018.VDC_2018_without_Longitudinal.Constraints.Acelerating_and_braking_without_Regenerative.rpm.Value /end CHARACTERISTIC
/begin CHARACTERISTIC Torque_Control_ETR07.Torque_Control_ETR07_P.u602pi_Gain "" VALUE 0x0 SCALAR_FLOAT64_IEEE 3.5e+305 Torque_Control_ETR07_CM_double -1.7e+308 1.7e+308 DISPLAY_IDENTIFIER Torque_Control_ETR07.VDC.Vehicle_Dynamics_Control_2018.VDC_2018_Complete.Lateral_Dynamics.Yaw_Rate_Reference.360___2_pi_.Gain /end CHARACTERISTIC
/begin CHARACTERISTIC Torque_Control_ETR07.Torque_Control_ETR07_P.u602pi_Gain_g "" VALUE 0x0 SCALAR_FLOAT64_IEEE 3.5e+305 Torque_Control_ETR07_CM_double -1.7e+308 1.7e+308 DISPLAY_IDENTIFIER Torque_Control_ETR07.VDC.Vehicle_Dynamics_Control_2018.VDC_2018_Complete.Lateral_Dynamics.Yaw_Rate_Reference.360___2pi_.Gain /end CHARACTERISTIC
/begin CHARACTERISTIC Torque_Control_ETR07.Torque_Control_ETR07_P.udifference_Gain "" VALUE 0x0 SCALAR_FLOAT64_IEEE 3.5e+305 Torque_Control_ETR07_CM_double -1.7e+308 1.7e+308 DISPLAY_IDENTIFIER Torque_Control_ETR07.VDC.Vehicle_Dynamics_Control_2018.VDC_2018_Complete.In_Numbers.3__difference.Gain /end CHARACTERISTIC
/begin CHARACTERISTIC Torque_Control_ETR07.Torque_Control_ETR07_P.udifference_Gain_d "" VALUE 0x0 SCALAR_FLOAT64_IEEE 3.5e+305 Torque_Control_ETR07_CM_double -1.7e+308 1.7e+308 DISPLAY_IDENTIFIER Torque_Control_ETR07.VDC.Vehicle_Dynamics_Control_2018.VDC_2018_without_Longitudinal.In_Numbers.3__difference.Gain /end CHARACTERISTIC
/begin CHARACTERISTIC Torque_Control_ETR07.Torque_Control_ETR07_P.zero_Value "" VALUE 0x0 SCALAR_FLOAT64_IEEE 3.5e+305 Torque_Control_ETR07_CM_double -1.7e+308 1.7e+308 DISPLAY_IDENTIFIER Torque_Control_ETR07.Steering_Data_Conv.zero.Value /end CHARACTERISTIC
/begin COMPU_METHOD Torque_Control_ETR07_CM_double "Q = V" RAT_FUNC "%9.6" "NO_PHYSICAL_QTY" COEFFS 0.0 1.0 0.0 0.0 0.0 1.0 /end COMPU_METHOD
/begin COMPU_METHOD Torque_Control_ETR07_CM_boolean "Q = V" RAT_FUNC "%9.6" "NO_PHYSICAL_QTY" COEFFS 0.0 1.0 0.0 0.0 0.0 1.0 /end COMPU_METHOD
/begin RECORD_LAYOUT SCALAR_FLOAT64_IEEE FNC_VALUES 1 FLOAT64_IEEE COLUMN_DIR DIRECT /end RECORD_LAYOUT
/begin RECORD_LAYOUT SCALAR_UBYTE FNC_VALUES 1 UBYTE COLUMN_DIR DIRECT /end RECORD_LAYOUT
/begin GROUP Torque_Control_ETR07 "" ROOT
 /begin REF_MEASUREMENT Torque_Control_ETR07.Torque_Control_ETR07_B.A Torque_Control_ETR07.Torque_Control_ETR07_B.A1 Torque_Control_ETR07.Torque_Control_ETR07_B.Abs Torque_Control_ETR07.Torque_Control_ETR07_B.B Torque_Control_ETR07.Torque_Control_ETR07_B.B1 Torque_Control_ETR07.Torque_Control_ETR07_B.BRAKE_THRESHOLD Torque_Control_ETR07.Torque_Control_ETR07_B.C Torque_Control_ETR07.Torque_Control_ETR07_B.C1 Torque_Control_ETR07.Torque_Control_ETR07_B.Constant Torque_Control_ETR07.Torque_Control_ETR07_B.Constant1 Torque_Control_ETR07.Torque_Control_ETR07_B.Constant1_i Torque_Control_ETR07.Torque_Control_ETR07_B.Constant1_j Torque_Control_ETR07.Torque_Control_ETR07_B.Constant1_k Torque_Control_ETR07.Torque_Control_ETR07_B.Constant3 Torque_Control_ETR07.Torque_Control_ETR07_B.Constant3_e Torque_Control_ETR07.Torque_Control_ETR07_B.Constant4 Torque_Control_ETR07.Torque_Control_ETR07_B.Constant4_m Torque_Control_ETR07.Torque_Control_ETR07_B.Constant7 Torque_Control_ETR07.Torque_Control_ETR07_B.Constant8 Torque_Control_ETR07.Torque_Control_ETR07_B.Constant_b Torque_Control_ETR07.Torque_Control_ETR07_B.Constant_d Torque_Control_ETR07.Torque_Control_ETR07_B.Constant_dd Torque_Control_ETR07.Torque_Control_ETR07_B.Constant_e Torque_Control_ETR07.Torque_Control_ETR07_B.Constant_h Torque_Control_ETR07.Torque_Control_ETR07_B.Constant_i Torque_Control_ETR07.Torque_Control_ETR07_B.Constant_k Torque_Control_ETR07.Torque_Control_ETR07_B.Constant_l Torque_Control_ETR07.Torque_Control_ETR07_B.Constant_m Torque_Control_ETR07.Torque_Control_ETR07_B.Constant_mf Torque_Control_ETR07.Torque_Control_ETR07_B.Constant_n Torque_Control_ETR07.Torque_Control_ETR07_B.Constant_o Torque_Control_ETR07.Torque_Control_ETR07_B.Constant_ob Torque_Control_ETR07.Torque_Control_ETR07_B.Constant_p Torque_Control_ETR07.Torque_Control_ETR07_B.Divide Torque_Control_ETR07.Torque_Control_ETR07_B.Divide1 Torque_Control_ETR07.Torque_Control_ETR07_B.Divide_i Torque_Control_ETR07.Torque_Control_ETR07_B.Gain Torque_Control_ETR07.Torque_Control_ETR07_B.LimitTemperatureCeldasC Torque_Control_ETR07.Torque_Control_ETR07_B.LimitTemperatureIGBTC Torque_Control_ETR07.Torque_Control_ETR07_B.LimitTemperatureMotorC Torque_Control_ETR07.Torque_Control_ETR07_B.LogicalOperator Torque_Control_ETR07.Torque_Control_ETR07_B.LogicalOperator1 Torque_Control_ETR07.Torque_Control_ETR07_B.MaximumTorqueperengineNm Torque_Control_ETR07.Torque_Control_ETR07_B.MaximumTorqueperengineNm_m Torque_Control_ETR07.Torque_Control_ETR07_B.MaximumTransmissionTorqueDyna_b Torque_Control_ETR07.Torque_Control_ETR07_B.MaximumTransmissionTorqueDynami Torque_Control_ETR07.Torque_Control_ETR07_B.MaximumTransmissionTorqueStat_b Torque_Control_ETR07.Torque_Control_ETR07_B.MaximumTransmissionTorqueStatic Torque_Control_ETR07.Torque_Control_ETR07_B.Merge Torque_Control_ETR07.Torque_Control_ETR07_B.Merge1 Torque_Control_ETR07.Torque_Control_ETR07_B.Merge1_a Torque_Control_ETR07.Torque_Control_ETR07_B.Merge1_a0 Torque_Control_ETR07.Torque_Control_ETR07_B.Merge1_b Torque_Control_ETR07.Torque_Control_ETR07_B.Merge1_i Torque_Control_ETR07.Torque_Control_ETR07_B.Merge1_k Torque_Control_ETR07.Torque_Control_ETR07_B.Merge1_l Torque_Control_ETR07.Torque_Control_ETR07_B.Merge1_lz Torque_Control_ETR07.Torque_Control_ETR07_B.Merge1_m Torque_Control_ETR07.Torque_Control_ETR07_B.Merge1_n Torque_Control_ETR07.Torque_Control_ETR07_B.Merge2 Torque_Control_ETR07.Torque_Control_ETR07_B.Merge2_b Torque_Control_ETR07.Torque_Control_ETR07_B.Merge2_e Torque_Control_ETR07.Torque_Control_ETR07_B.Merge2_g Torque_Control_ETR07.Torque_Control_ETR07_B.Merge2_j Torque_Control_ETR07.Torque_Control_ETR07_B.Merge2_l Torque_Control_ETR07.Torque_Control_ETR07_B.Merge2_lx Torque_Control_ETR07.Torque_Control_ETR07_B.Merge2_o Torque_Control_ETR07.Torque_Control_ETR07_B.Merge3 Torque_Control_ETR07.Torque_Control_ETR07_B.Merge3_c Torque_Control_ETR07.Torque_Control_ETR07_B.Merge3_e Torque_Control_ETR07.Torque_Control_ETR07_B.Merge3_h Torque_Control_ETR07.Torque_Control_ETR07_B.Merge4 Torque_Control_ETR07.Torque_Control_ETR07_B.Merge4_b Torque_Control_ETR07.Torque_Control_ETR07_B.Merge5 Torque_Control_ETR07.Torque_Control_ETR07_B.Merge5_e Torque_Control_ETR07.Torque_Control_ETR07_B.Merge6 Torque_Control_ETR07.Torque_Control_ETR07_B.Merge7 Torque_Control_ETR07.Torque_Control_ETR07_B.Merge_a Torque_Control_ETR07.Torque_Control_ETR07_B.Merge_c Torque_Control_ETR07.Torque_Control_ETR07_B.Merge_cu Torque_Control_ETR07.Torque_Control_ETR07_B.Merge_d Torque_Control_ETR07.Torque_Control_ETR07_B.Merge_g Torque_Control_ETR07.Torque_Control_ETR07_B.Merge_h Torque_Control_ETR07.Torque_Control_ETR07_B.Merge_i Torque_Control_ETR07.Torque_Control_ETR07_B.Merge_j Torque_Control_ETR07.Torque_Control_ETR07_B.Merge_k Torque_Control_ETR07.Torque_Control_ETR07_B.Merge_kj Torque_Control_ETR07.Torque_Control_ETR07_B.Merge_kt Torque_Control_ETR07.Torque_Control_ETR07_B.Merge_l Torque_Control_ETR07.Torque_Control_ETR07_B.Merge_m Torque_Control_ETR07.Torque_Control_ETR07_B.Nospin_k.sf_MATLABFunction.CKF_act0 Torque_Control_ETR07.Torque_Control_ETR07_B.Nospin_m.sf_MATLABFunction.CKF_act0 Torque_Control_ETR07.Torque_Control_ETR07_B.OutportBufferForFlags_num5 Torque_Control_ETR07.Torque_Control_ETR07_B.Saturation Torque_Control_ETR07.Torque_Control_ETR07_B.Saturation_f Torque_Control_ETR07.Torque_Control_ETR07_B.Saturation_i Torque_Control_ETR07.Torque_Control_ETR07_B.Saturation_k Torque_Control_ETR07.Torque_Control_ETR07_B.Spin_n.Constant Torque_Control_ETR07.Torque_Control_ETR07_B.Spin_n.sf_MATLABFunction.CKF_act1 Torque_Control_ETR07.Torque_Control_ETR07_B.Spin_nb.Constant Torque_Control_ETR07.Torque_Control_ETR07_B.Spin_nb.sf_MATLABFunction.CKF_act1 Torque_Control_ETR07.Torque_Control_ETR07_B.SteeringWheelMaximumAngle Torque_Control_ETR07.Torque_Control_ETR07_B.SteeringWheelMaximumAngle_m Torque_Control_ETR07.Torque_Control_ETR07_B.SteeringWheelMaximumAngle_p Torque_Control_ETR07.Torque_Control_ETR07_B.SteeringWheelSaturationpersited Torque_Control_ETR07.Torque_Control_ETR07_B.Steering_Ratio Torque_Control_ETR07.Torque_Control_ETR07_B.Subtract Torque_Control_ETR07.Torque_Control_ETR07_B.Throttle Torque_Control_ETR07.Torque_Control_ETR07_B.Torque_RLNm Torque_Control_ETR07.Torque_Control_ETR07_B.Torque_RRNm Torque_Control_ETR07.Torque_Control_ETR07_B.Tq_diff_Max Torque_Control_ETR07.Torque_Control_ETR07_B.Tq_diff_maxNm Torque_Control_ETR07.Torque_Control_ETR07_B.Tq_maxNm Torque_Control_ETR07.Torque_Control_ETR07_B.TransmisionRatio Torque_Control_ETR07.Torque_Control_ETR07_B.TransmisionRatio_b Torque_Control_ETR07.Torque_Control_ETR07_B.Wheelbasem Torque_Control_ETR07.Torque_Control_ETR07_B.Yaw_Inertiakgm3 Torque_Control_ETR07.Torque_Control_ETR07_B.Zero Torque_Control_ETR07.Torque_Control_ETR07_B.Zero_m Torque_Control_ETR07.Torque_Control_ETR07_B.Zero_p Torque_Control_ETR07.Torque_Control_ETR07_B.approx2095 Torque_Control_ETR07.Torque_Control_ETR07_B.approx2095_h Torque_Control_ETR07.Torque_Control_ETR07_B.exptcycletau1 Torque_Control_ETR07.Torque_Control_ETR07_B.sf_Acceleratorbehaviour.throttle Torque_Control_ETR07.Torque_Control_ETR07_B.sf_Acceleratorbehaviour_b.throttle Torque_Control_ETR07.Torque_Control_ETR07_B.sf_Acceleratorbehaviour_f.throttle Torque_Control_ETR07.Torque_Control_ETR07_B.sf_Acceleratorbehaviour_o.throttle Torque_Control_ETR07.Torque_Control_ETR07_B.sf_MATLABFunction.RPM Torque_Control_ETR07.Torque_Control_ETR07_B.sf_MATLABFunction1_f.value Torque_Control_ETR07.Torque_Control_ETR07_B.sf_MATLABFunction1_g.value Torque_Control_ETR07.Torque_Control_ETR07_B.sf_MATLABFunction1_gm.value Torque_Control_ETR07.Torque_Control_ETR07_B.sf_MATLABFunction1_m.value Torque_Control_ETR07.Torque_Control_ETR07_B.sf_MATLABFunction1_mk.value Torque_Control_ETR07.Torque_Control_ETR07_B.sf_MATLABFunction1_n.value Torque_Control_ETR07.Torque_Control_ETR07_B.sf_MATLABFunction2.value Torque_Control_ETR07.Torque_Control_ETR07_B.sf_MATLABFunction2_b.value Torque_Control_ETR07.Torque_Control_ETR07_B.sf_MATLABFunction2_e.value Torque_Control_ETR07.Torque_Control_ETR07_B.sf_MATLABFunction2_l.value Torque_Control_ETR07.Torque_Control_ETR07_B.sf_MATLABFunction2_m.value Torque_Control_ETR07.Torque_Control_ETR07_B.sf_MATLABFunction_a.RPM Torque_Control_ETR07.Torque_Control_ETR07_B.sf_MATLABFunction_d.SKF_act0 Torque_Control_ETR07.Torque_Control_ETR07_B.sf_MATLABFunction_d1.value Torque_Control_ETR07.Torque_Control_ETR07_B.sf_MATLABFunction_fa.RPM Torque_Control_ETR07.Torque_Control_ETR07_B.sf_MATLABFunction_fq.SKF_act0 Torque_Control_ETR07.Torque_Control_ETR07_B.sf_MATLABFunction_k.CKF_act1 Torque_Control_ETR07.Torque_Control_ETR07_B.sf_MATLABFunction_k2.CKF_act0 Torque_Control_ETR07.Torque_Control_ETR07_B.sf_MATLABFunction_m.SKF_act1 Torque_Control_ETR07.Torque_Control_ETR07_B.sf_MATLABFunction_p.SKF_act1 Torque_Control_ETR07.Torque_Control_ETR07_B.sf_minimumvalue.min Torque_Control_ETR07.Torque_Control_ETR07_B.sf_minimumvalue1.min Torque_Control_ETR07.Torque_Control_ETR07_B.sf_minimumvalue1_k.min Torque_Control_ETR07.Torque_Control_ETR07_B.sf_minimumvalue_o.min Torque_Control_ETR07.Torque_Control_ETR07_B.u602pi Torque_Control_ETR07.Torque_Control_ETR07_B.u602pi_e Torque_Control_ETR07.Torque_Control_ETR07_B.udifference Torque_Control_ETR07.Torque_Control_ETR07_B.udifference_l Torque_Control_ETR07.Torque_Control_ETR07_DW.A Torque_Control_ETR07.Torque_Control_ETR07_DW.AA Torque_Control_ETR07.Torque_Control_ETR07_DW.A_b Torque_Control_ETR07.Torque_Control_ETR07_DW.A_i Torque_Control_ETR07.Torque_Control_ETR07_DW.B Torque_Control_ETR07.Torque_Control_ETR07_DW.B_i Torque_Control_ETR07.Torque_Control_ETR07_DW.B_k Torque_Control_ETR07.Torque_Control_ETR07_DW.Previous_IN Torque_Control_ETR07.Torque_Control_ETR07_DW.Previous_OUT Torque_Control_ETR07.Torque_Control_ETR07_DW.R Torque_Control_ETR07.Torque_Control_ETR07_U.ACCEL_F_X_SI Torque_Control_ETR07.Torque_Control_ETR07_U.ACCEL_F_Y_SI Torque_Control_ETR07.Torque_Control_ETR07_U.ACCEL_F_Z_SI Torque_Control_ETR07.Torque_Control_ETR07_U.ACCEL_R_X_SI Torque_Control_ETR07.Torque_Control_ETR07_U.ACCEL_R_Y_SI Torque_Control_ETR07.Torque_Control_ETR07_U.ACCEL_R_Z_SI Torque_Control_ETR07.Torque_Control_ETR07_U.APPS1_Value Torque_Control_ETR07.Torque_Control_ETR07_U.APPS2_Value Torque_Control_ETR07.Torque_Control_ETR07_U.Accumulator_Current Torque_Control_ETR07.Torque_Control_ETR07_U.Accumulator_Voltage Torque_Control_ETR07.Torque_Control_ETR07_U.BrakeSensor_Value Torque_Control_ETR07.Torque_Control_ETR07_U.Car_State Torque_Control_ETR07.Torque_Control_ETR07_U.CriticalDisconnection Torque_Control_ETR07.Torque_Control_ETR07_U.Gyro_F_Z_Deg Torque_Control_ETR07.Torque_Control_ETR07_U.Highest_CellTemp Torque_Control_ETR07.Torque_Control_ETR07_U.RL_rads Torque_Control_ETR07.Torque_Control_ETR07_U.RR_rads Torque_Control_ETR07.Torque_Control_ETR07_U.ShutdownClosed Torque_Control_ETR07.Torque_Control_ETR07_U.SteeringSensor_Bits Torque_Control_ETR07.Torque_Control_ETR07_U.Susp_F_L Torque_Control_ETR07.Torque_Control_ETR07_U.Susp_F_R Torque_Control_ETR07.Torque_Control_ETR07_U.Susp_R_L Torque_Control_ETR07.Torque_Control_ETR07_U.Susp_R_R Torque_Control_ETR07.Torque_Control_ETR07_U.TV_Mode Torque_Control_ETR07.Torque_Control_ETR07_U.Temp_IGBT Torque_Control_ETR07.Torque_Control_ETR07_U.Temp_Motors Torque_Control_ETR07.Torque_Control_ETR07_U.TorqueEnable Torque_Control_ETR07.Torque_Control_ETR07_U.VDC_Apps_Sat_Down Torque_Control_ETR07.Torque_Control_ETR07_U.VDC_Apps_Sat_Up Torque_Control_ETR07.Torque_Control_ETR07_U.VDC_CKF_Initial Torque_Control_ETR07.Torque_Control_ETR07_U.VDC_Cte_CKF Torque_Control_ETR07.Torque_Control_ETR07_U.VDC_Cte_SKF Torque_Control_ETR07.Torque_Control_ETR07_U.VDC_K_Reduction_P Torque_Control_ETR07.Torque_Control_ETR07_U.VDC_K_Reduction_Temperature Torque_Control_ETR07.Torque_Control_ETR07_U.VDC_Max_Regenerative_Torque Torque_Control_ETR07.Torque_Control_ETR07_U.VDC_Power_Limit Torque_Control_ETR07.Torque_Control_ETR07_U.VDC_SKF_Initial Torque_Control_ETR07.Torque_Control_ETR07_U.Vel_RL_kmh Torque_Control_ETR07.Torque_Control_ETR07_U.Vel_RR_kmh Torque_Control_ETR07.Torque_Control_ETR07_U.Workshop_Mode_Enable Torque_Control_ETR07.Torque_Control_ETR07_Y.APPS_Implausibility Torque_Control_ETR07.Torque_Control_ETR07_Y.Brake_Implausibility Torque_Control_ETR07.Torque_Control_ETR07_Y.CKF_actual Torque_Control_ETR07.Torque_Control_ETR07_Y.Dash_Speed Torque_Control_ETR07.Torque_Control_ETR07_Y.Fy_R Torque_Control_ETR07.Torque_Control_ETR07_Y.Handling Torque_Control_ETR07.Torque_Control_ETR07_Y.Mass Torque_Control_ETR07.Torque_Control_ETR07_Y.Max_Fx_RL Torque_Control_ETR07.Torque_Control_ETR07_Y.Max_Fx_RR Torque_Control_ETR07.Torque_Control_ETR07_Y.Max_Torque_RL Torque_Control_ETR07.Torque_Control_ETR07_Y.Max_Torque_RR Torque_Control_ETR07.Torque_Control_ETR07_Y.MeasVDCTorque_L Torque_Control_ETR07.Torque_Control_ETR07_Y.MeasVDCTorque_R Torque_Control_ETR07.Torque_Control_ETR07_Y.Power Torque_Control_ETR07.Torque_Control_ETR07_Y.PowerLimitReached Torque_Control_ETR07.Torque_Control_ETR07_Y.PowerMean500ms Torque_Control_ETR07.Torque_Control_ETR07_Y.Pumps_Control Torque_Control_ETR07.Torque_Control_ETR07_Y.Regenerative_Enable Torque_Control_ETR07.Torque_Control_ETR07_Y.SKF_actual Torque_Control_ETR07.Torque_Control_ETR07_Y.SteeringSensor_Value Torque_Control_ETR07.Torque_Control_ETR07_Y.TV_Flag_CarBehaviour Torque_Control_ETR07.Torque_Control_ETR07_Y.TV_Flag_Power Torque_Control_ETR07.Torque_Control_ETR07_Y.TV_Flag_Temperature Torque_Control_ETR07.Torque_Control_ETR07_Y.TV_Flag_WheelSpinRL Torque_Control_ETR07.Torque_Control_ETR07_Y.TV_Flag_WheelSpinRR Torque_Control_ETR07.Torque_Control_ETR07_Y.Throttle Torque_Control_ETR07.Torque_Control_ETR07_Y.Torque_L Torque_Control_ETR07.Torque_Control_ETR07_Y.Torque_OK Torque_Control_ETR07.Torque_Control_ETR07_Y.Torque_R Torque_Control_ETR07.Torque_Control_ETR07_Y.Torque_RLwc Torque_Control_ETR07.Torque_Control_ETR07_Y.Torque_RRwc Torque_Control_ETR07.Torque_Control_ETR07_Y.current_L Torque_Control_ETR07.Torque_Control_ETR07_Y.current_R /end REF_MEASUREMENT
 /begin REF_CHARACTERISTIC Torque_Control_ETR07.Torque_Control_ETR07_P.A1_Value Torque_Control_ETR07.Torque_Control_ETR07_P.A_Value Torque_Control_ETR07.Torque_Control_ETR07_P.B1_Value Torque_Control_ETR07.Torque_Control_ETR07_P.BRAKE_THRESHOLD_Value Torque_Control_ETR07.Torque_Control_ETR07_P.B_Value Torque_Control_ETR07.Torque_Control_ETR07_P.C1_Value Torque_Control_ETR07.Torque_Control_ETR07_P.CKF_act_Y0 Torque_Control_ETR07.Torque_Control_ETR07_P.CKF_act_Y0_j Torque_Control_ETR07.Torque_Control_ETR07_P.C_Value Torque_Control_ETR07.Torque_Control_ETR07_P.CompareToConstant1_const Torque_Control_ETR07.Torque_Control_ETR07_P.CompareToConstant_const Torque_Control_ETR07.Torque_Control_ETR07_P.CompareToConstant_const_p Torque_Control_ETR07.Torque_Control_ETR07_P.Constant1_Value Torque_Control_ETR07.Torque_Control_ETR07_P.Constant1_Value_a Torque_Control_ETR07.Torque_Control_ETR07_P.Constant1_Value_ab Torque_Control_ETR07.Torque_Control_ETR07_P.Constant1_Value_b Torque_Control_ETR07.Torque_Control_ETR07_P.Constant1_Value_c Torque_Control_ETR07.Torque_Control_ETR07_P.Constant1_Value_f Torque_Control_ETR07.Torque_Control_ETR07_P.Constant1_Value_l Torque_Control_ETR07.Torque_Control_ETR07_P.Constant1_Value_ln Torque_Control_ETR07.Torque_Control_ETR07_P.Constant2_Value Torque_Control_ETR07.Torque_Control_ETR07_P.Constant2_Value_g Torque_Control_ETR07.Torque_Control_ETR07_P.Constant2_Value_g1 Torque_Control_ETR07.Torque_Control_ETR07_P.Constant3_Value Torque_Control_ETR07.Torque_Control_ETR07_P.Constant3_Value_n Torque_Control_ETR07.Torque_Control_ETR07_P.Constant3_Value_o Torque_Control_ETR07.Torque_Control_ETR07_P.Constant4_Value Torque_Control_ETR07.Torque_Control_ETR07_P.Constant4_Value_p Torque_Control_ETR07.Torque_Control_ETR07_P.Constant5_Value Torque_Control_ETR07.Torque_Control_ETR07_P.Constant6_Value Torque_Control_ETR07.Torque_Control_ETR07_P.Constant6_Value_p Torque_Control_ETR07.Torque_Control_ETR07_P.Constant7_Value Torque_Control_ETR07.Torque_Control_ETR07_P.Constant8_Value Torque_Control_ETR07.Torque_Control_ETR07_P.Constant_Value Torque_Control_ETR07.Torque_Control_ETR07_P.Constant_Value_a Torque_Control_ETR07.Torque_Control_ETR07_P.Constant_Value_ad Torque_Control_ETR07.Torque_Control_ETR07_P.Constant_Value_ae Torque_Control_ETR07.Torque_Control_ETR07_P.Constant_Value_b Torque_Control_ETR07.Torque_Control_ETR07_P.Constant_Value_d Torque_Control_ETR07.Torque_Control_ETR07_P.Constant_Value_dm Torque_Control_ETR07.Torque_Control_ETR07_P.Constant_Value_f Torque_Control_ETR07.Torque_Control_ETR07_P.Constant_Value_f3 Torque_Control_ETR07.Torque_Control_ETR07_P.Constant_Value_g Torque_Control_ETR07.Torque_Control_ETR07_P.Constant_Value_h Torque_Control_ETR07.Torque_Control_ETR07_P.Constant_Value_i Torque_Control_ETR07.Torque_Control_ETR07_P.Constant_Value_ib Torque_Control_ETR07.Torque_Control_ETR07_P.Constant_Value_k Torque_Control_ETR07.Torque_Control_ETR07_P.Constant_Value_l Torque_Control_ETR07.Torque_Control_ETR07_P.Constant_Value_m Torque_Control_ETR07.Torque_Control_ETR07_P.Constant_Value_n Torque_Control_ETR07.Torque_Control_ETR07_P.Constant_Value_n5 Torque_Control_ETR07.Torque_Control_ETR07_P.Cornering_Stiffness_FN_Value Torque_Control_ETR07.Torque_Control_ETR07_P.Cornering_Stiffness_RN_Value Torque_Control_ETR07.Torque_Control_ETR07_P.DataStoreMemory10_InitialValue Torque_Control_ETR07.Torque_Control_ETR07_P.DataStoreMemory1_InitialValu_fl Torque_Control_ETR07.Torque_Control_ETR07_P.DataStoreMemory1_InitialValue Torque_Control_ETR07.Torque_Control_ETR07_P.DataStoreMemory1_InitialValue_f Torque_Control_ETR07.Torque_Control_ETR07_P.DataStoreMemory1_InitialValue_i Torque_Control_ETR07.Torque_Control_ETR07_P.DataStoreMemory1_InitialValue_m Torque_Control_ETR07.Torque_Control_ETR07_P.DataStoreMemory_InitialValue Torque_Control_ETR07.Torque_Control_ETR07_P.DataStoreMemory_InitialValue_c Torque_Control_ETR07.Torque_Control_ETR07_P.DataStoreMemory_InitialValue_j Torque_Control_ETR07.Torque_Control_ETR07_P.DataStoreMemory_InitialValue_m Torque_Control_ETR07.Torque_Control_ETR07_P.EffectiveRollingRadiusinch_Va_b Torque_Control_ETR07.Torque_Control_ETR07_P.EffectiveRollingRadiusinch_Valu Torque_Control_ETR07.Torque_Control_ETR07_P.Flags_num5_Y0 Torque_Control_ETR07.Torque_Control_ETR07_P.Fy_RN0inf_Y0 Torque_Control_ETR07.Torque_Control_ETR07_P.Fyperwheel_Gain Torque_Control_ETR07.Torque_Control_ETR07_P.Fyperwheel_Gain_e Torque_Control_ETR07.Torque_Control_ETR07_P.Gain1_Gain Torque_Control_ETR07.Torque_Control_ETR07_P.Gain1_Gain_i Torque_Control_ETR07.Torque_Control_ETR07_P.Gain1_Gain_o Torque_Control_ETR07.Torque_Control_ETR07_P.Gain_Gain Torque_Control_ETR07.Torque_Control_ETR07_P.Gain_Gain_a Torque_Control_ETR07.Torque_Control_ETR07_P.Gain_Gain_c Torque_Control_ETR07.Torque_Control_ETR07_P.Gain_Gain_co Torque_Control_ETR07.Torque_Control_ETR07_P.Gain_Gain_cv Torque_Control_ETR07.Torque_Control_ETR07_P.Gain_Gain_f Torque_Control_ETR07.Torque_Control_ETR07_P.Gain_Gain_k Torque_Control_ETR07.Torque_Control_ETR07_P.Gain_Gain_l Torque_Control_ETR07.Torque_Control_ETR07_P.Gain_Gain_o Torque_Control_ETR07.Torque_Control_ETR07_P.Gravity1_Gain Torque_Control_ETR07.Torque_Control_ETR07_P.Gravity1_Gain_g Torque_Control_ETR07.Torque_Control_ETR07_P.Gravity_Gain Torque_Control_ETR07.Torque_Control_ETR07_P.Handlinginfinf_Y0 Torque_Control_ETR07.Torque_Control_ETR07_P.Integrator_IC Torque_Control_ETR07.Torque_Control_ETR07_P.LimitTemperatureCeldasC_Value Torque_Control_ETR07.Torque_Control_ETR07_P.LimitTemperatureIGBTC_Value Torque_Control_ETR07.Torque_Control_ETR07_P.LimitTemperatureMotorC_Value Torque_Control_ETR07.Torque_Control_ETR07_P.Masskg0inf_Y0 Torque_Control_ETR07.Torque_Control_ETR07_P.MaxFx_RLN0inf_Y0 Torque_Control_ETR07.Torque_Control_ETR07_P.MaxFx_RRN0inf_Y0 Torque_Control_ETR07.Torque_Control_ETR07_P.MaxTq_RLNm0inf_Y0 Torque_Control_ETR07.Torque_Control_ETR07_P.MaxTq_RLNm0inf_Y0_d Torque_Control_ETR07.Torque_Control_ETR07_P.MaxTq_RRNm0inf_Y0 Torque_Control_ETR07.Torque_Control_ETR07_P.MaxTq_RRNm0inf_Y0_o Torque_Control_ETR07.Torque_Control_ETR07_P.MaximumTorqueperengineNm_Valu_b Torque_Control_ETR07.Torque_Control_ETR07_P.MaximumTorqueperengineNm_Value Torque_Control_ETR07.Torque_Control_ETR07_P.MaximumTransmissionTorqueDyna_a Torque_Control_ETR07.Torque_Control_ETR07_P.MaximumTransmissionTorqueDynami Torque_Control_ETR07.Torque_Control_ETR07_P.MaximumTransmissionTorqueStat_n Torque_Control_ETR07.Torque_Control_ETR07_P.MaximumTransmissionTorqueStatic Torque_Control_ETR07.Torque_Control_ETR07_P.Merge1_InitialOutput Torque_Control_ETR07.Torque_Control_ETR07_P.Merge1_InitialOutput_f Torque_Control_ETR07.Torque_Control_ETR07_P.Merge1_InitialOutput_k Torque_Control_ETR07.Torque_Control_ETR07_P.Merge2_InitialOutput Torque_Control_ETR07.Torque_Control_ETR07_P.Merge2_InitialOutput_o Torque_Control_ETR07.Torque_Control_ETR07_P.Merge3_InitialOutput Torque_Control_ETR07.Torque_Control_ETR07_P.Merge3_InitialOutput_j Torque_Control_ETR07.Torque_Control_ETR07_P.Merge3_InitialOutput_n Torque_Control_ETR07.Torque_Control_ETR07_P.Merge4_InitialOutput Torque_Control_ETR07.Torque_Control_ETR07_P.Merge4_InitialOutput_d Torque_Control_ETR07.Torque_Control_ETR07_P.Merge5_InitialOutput Torque_Control_ETR07.Torque_Control_ETR07_P.Merge6_InitialOutput Torque_Control_ETR07.Torque_Control_ETR07_P.Merge7_InitialOutput Torque_Control_ETR07.Torque_Control_ETR07_P.Merge_InitialOutput Torque_Control_ETR07.Torque_Control_ETR07_P.Merge_InitialOutput_a Torque_Control_ETR07.Torque_Control_ETR07_P.Merge_InitialOutput_h Torque_Control_ETR07.Torque_Control_ETR07_P.Merge_InitialOutput_i Torque_Control_ETR07.Torque_Control_ETR07_P.Merge_InitialOutput_j Torque_Control_ETR07.Torque_Control_ETR07_P.Merge_InitialOutput_jq Torque_Control_ETR07.Torque_Control_ETR07_P.Merge_InitialOutput_l Torque_Control_ETR07.Torque_Control_ETR07_P.Merge_InitialOutput_p Torque_Control_ETR07.Torque_Control_ETR07_P.Merge_InitialOutput_pp Torque_Control_ETR07.Torque_Control_ETR07_P.Nospin_k.Switch_Threshold Torque_Control_ETR07.Torque_Control_ETR07_P.Not_Braking_Value Torque_Control_ETR07.Torque_Control_ETR07_P.Out_Throttle_Y0 Torque_Control_ETR07.Torque_Control_ETR07_P.Out_Throttle_Y0_a Torque_Control_ETR07.Torque_Control_ETR07_P.Rear_Trackwidthm_Value Torque_Control_ETR07.Torque_Control_ETR07_P.SKF_act_Y0 Torque_Control_ETR07.Torque_Control_ETR07_P.SKF_act_Y0_l Torque_Control_ETR07.Torque_Control_ETR07_P.Saturation1_LowerSat Torque_Control_ETR07.Torque_Control_ETR07_P.Saturation1_LowerSat_l Torque_Control_ETR07.Torque_Control_ETR07_P.Saturation1_UpperSat Torque_Control_ETR07.Torque_Control_ETR07_P.Saturation1_UpperSat_m Torque_Control_ETR07.Torque_Control_ETR07_P.Saturation_LowerSat Torque_Control_ETR07.Torque_Control_ETR07_P.Saturation_LowerSat_c Torque_Control_ETR07.Torque_Control_ETR07_P.Saturation_LowerSat_e Torque_Control_ETR07.Torque_Control_ETR07_P.Saturation_LowerSat_f Torque_Control_ETR07.Torque_Control_ETR07_P.Saturation_LowerSat_f3 Torque_Control_ETR07.Torque_Control_ETR07_P.Saturation_LowerSat_fi Torque_Control_ETR07.Torque_Control_ETR07_P.Saturation_LowerSat_j Torque_Control_ETR07.Torque_Control_ETR07_P.Saturation_UpperSat Torque_Control_ETR07.Torque_Control_ETR07_P.Saturation_UpperSat_c Torque_Control_ETR07.Torque_Control_ETR07_P.Saturation_UpperSat_f Torque_Control_ETR07.Torque_Control_ETR07_P.Saturation_UpperSat_g Torque_Control_ETR07.Torque_Control_ETR07_P.Saturation_UpperSat_h Torque_Control_ETR07.Torque_Control_ETR07_P.Saturation_UpperSat_i Torque_Control_ETR07.Torque_Control_ETR07_P.Saturation_UpperSat_k Torque_Control_ETR07.Torque_Control_ETR07_P.Spin_n.Constant_Value Torque_Control_ETR07.Torque_Control_ETR07_P.Spin_n.Switch_Threshold Torque_Control_ETR07.Torque_Control_ETR07_P.SteeringWheelMaximumAngle_Val_i Torque_Control_ETR07.Torque_Control_ETR07_P.SteeringWheelMaximumAngle_Val_o Torque_Control_ETR07.Torque_Control_ETR07_P.SteeringWheelMaximumAngle_Value Torque_Control_ETR07.Torque_Control_ETR07_P.SteeringWheelSaturationpersited Torque_Control_ETR07.Torque_Control_ETR07_P.Steering_Ratio_Value Torque_Control_ETR07.Torque_Control_ETR07_P.Switch_Threshold Torque_Control_ETR07.Torque_Control_ETR07_P.Switch_Threshold_a Torque_Control_ETR07.Torque_Control_ETR07_P.Switch_Threshold_b Torque_Control_ETR07.Torque_Control_ETR07_P.Switch_Threshold_e Torque_Control_ETR07.Torque_Control_ETR07_P.Switch_Threshold_f Torque_Control_ETR07.Torque_Control_ETR07_P.Switch_Threshold_g Torque_Control_ETR07.Torque_Control_ETR07_P.TEMP_LIMIT_LOWER_Value Torque_Control_ETR07.Torque_Control_ETR07_P.TEMP_LIMIT_UPPER_Value Torque_Control_ETR07.Torque_Control_ETR07_P.Temp_LIMIT.TEMP_LIMIT_Value Torque_Control_ETR07.Torque_Control_ETR07_P.Torque_RLNm_Value Torque_Control_ETR07.Torque_Control_ETR07_P.Torque_RRNm_Value Torque_Control_ETR07.Torque_Control_ETR07_P.Tq_diff_Max_Value Torque_Control_ETR07.Torque_Control_ETR07_P.Tq_diff_maxNm_Value Torque_Control_ETR07.Torque_Control_ETR07_P.Tq_maxNm_Value Torque_Control_ETR07.Torque_Control_ETR07_P.TransmisionRatio_Value Torque_Control_ETR07.Torque_Control_ETR07_P.TransmisionRatio_Value_j Torque_Control_ETR07.Torque_Control_ETR07_P.Wheelbasem_Value Torque_Control_ETR07.Torque_Control_ETR07_P.Yaw_Inertiakgm3_Value Torque_Control_ETR07.Torque_Control_ETR07_P.Zero_Value Torque_Control_ETR07.Torque_Control_ETR07_P.Zero_Value_c Torque_Control_ETR07.Torque_Control_ETR07_P.Zero_Value_p Torque_Control_ETR07.Torque_Control_ETR07_P.ct_Value Torque_Control_ETR07.Torque_Control_ETR07_P.exptcycletau1_Value Torque_Control_ETR07.Torque_Control_ETR07_P.halfrange_Value Torque_Control_ETR07.Torque_Control_ETR07_P.inchtom_Gain Torque_Control_ETR07.Torque_Control_ETR07_P.inchtom_Gain_g Torque_Control_ETR07.Torque_Control_ETR07_P.range_Value Torque_Control_ETR07.Torque_Control_ETR07_P.rpm_Value Torque_Control_ETR07.Torque_Control_ETR07_P.rpm_Value_k Torque_Control_ETR07.Torque_Control_ETR07_P.u602pi_Gain Torque_Control_ETR07.Torque_Control_ETR07_P.u602pi_Gain_g Torque_Control_ETR07.Torque_Control_ETR07_P.udifference_Gain Torque_Control_ETR07.Torque_Control_ETR07_P.udifference_Gain_d Torque_Control_ETR07.Torque_Control_ETR07_P.zero_Value /end REF_CHARACTERISTIC
 /begin SUB_GROUP Torque_Control_ETR07.Torque_Control_ETR07_B Torque_Control_ETR07.Torque_Control_ETR07_B.Nospin_k Torque_Control_ETR07.Torque_Control_ETR07_B.Nospin_k.sf_MATLABFunction Torque_Control_ETR07.Torque_Control_ETR07_B.Nospin_m Torque_Control_ETR07.Torque_Control_ETR07_B.Nospin_m.sf_MATLABFunction Torque_Control_ETR07.Torque_Control_ETR07_B.Spin_n Torque_Control_ETR07.Torque_Control_ETR07_B.Spin_n.sf_MATLABFunction Torque_Control_ETR07.Torque_Control_ETR07_B.Spin_nb Torque_Control_ETR07.Torque_Control_ETR07_B.Spin_nb.sf_MATLABFunction Torque_Control_ETR07.Torque_Control_ETR07_B.sf_Acceleratorbehaviour Torque_Control_ETR07.Torque_Control_ETR07_B.sf_Acceleratorbehaviour_b Torque_Control_ETR07.Torque_Control_ETR07_B.sf_Acceleratorbehaviour_f Torque_Control_ETR07.Torque_Control_ETR07_B.sf_Acceleratorbehaviour_o Torque_Control_ETR07.Torque_Control_ETR07_B.sf_MATLABFunction Torque_Control_ETR07.Torque_Control_ETR07_B.sf_MATLABFunction1_f Torque_Control_ETR07.Torque_Control_ETR07_B.sf_MATLABFunction1_g Torque_Control_ETR07.Torque_Control_ETR07_B.sf_MATLABFunction1_gm Torque_Control_ETR07.Torque_Control_ETR07_B.sf_MATLABFunction1_m Torque_Control_ETR07.Torque_Control_ETR07_B.sf_MATLABFunction1_mk Torque_Control_ETR07.Torque_Control_ETR07_B.sf_MATLABFunction1_n Torque_Control_ETR07.Torque_Control_ETR07_B.sf_MATLABFunction2 Torque_Control_ETR07.Torque_Control_ETR07_B.sf_MATLABFunction2_b Torque_Control_ETR07.Torque_Control_ETR07_B.sf_MATLABFunction2_e Torque_Control_ETR07.Torque_Control_ETR07_B.sf_MATLABFunction2_l Torque_Control_ETR07.Torque_Control_ETR07_B.sf_MATLABFunction2_m Torque_Control_ETR07.Torque_Control_ETR07_B.sf_MATLABFunction_a Torque_Control_ETR07.Torque_Control_ETR07_B.sf_MATLABFunction_d Torque_Control_ETR07.Torque_Control_ETR07_B.sf_MATLABFunction_d1 Torque_Control_ETR07.Torque_Control_ETR07_B.sf_MATLABFunction_fa Torque_Control_ETR07.Torque_Control_ETR07_B.sf_MATLABFunction_fq Torque_Control_ETR07.Torque_Control_ETR07_B.sf_MATLABFunction_k Torque_Control_ETR07.Torque_Control_ETR07_B.sf_MATLABFunction_k2 Torque_Control_ETR07.Torque_Control_ETR07_B.sf_MATLABFunction_m Torque_Control_ETR07.Torque_Control_ETR07_B.sf_MATLABFunction_p Torque_Control_ETR07.Torque_Control_ETR07_B.sf_minimumvalue Torque_Control_ETR07.Torque_Control_ETR07_B.sf_minimumvalue1 Torque_Control_ETR07.Torque_Control_ETR07_B.sf_minimumvalue1_k Torque_Control_ETR07.Torque_Control_ETR07_B.sf_minimumvalue_o Torque_Control_ETR07.Torque_Control_ETR07_DW Torque_Control_ETR07.Torque_Control_ETR07_U Torque_Control_ETR07.Torque_Control_ETR07_Y Torque_Control_ETR07.Torque_Control_ETR07_P Torque_Control_ETR07.Torque_Control_ETR07_P.Nospin_k Torque_Control_ETR07.Torque_Control_ETR07_P.Spin_n Torque_Control_ETR07.Torque_Control_ETR07_P.Temp_LIMIT /end SUB_GROUP
/end GROUP
/begin GROUP Torque_Control_ETR07.Torque_Control_ETR07_B ""
 /begin REF_MEASUREMENT Torque_Control_ETR07.Torque_Control_ETR07_B.A Torque_Control_ETR07.Torque_Control_ETR07_B.A1 Torque_Control_ETR07.Torque_Control_ETR07_B.Abs Torque_Control_ETR07.Torque_Control_ETR07_B.B Torque_Control_ETR07.Torque_Control_ETR07_B.B1 Torque_Control_ETR07.Torque_Control_ETR07_B.BRAKE_THRESHOLD Torque_Control_ETR07.Torque_Control_ETR07_B.C Torque_Control_ETR07.Torque_Control_ETR07_B.C1 Torque_Control_ETR07.Torque_Control_ETR07_B.Constant Torque_Control_ETR07.Torque_Control_ETR07_B.Constant1 Torque_Control_ETR07.Torque_Control_ETR07_B.Constant1_i Torque_Control_ETR07.Torque_Control_ETR07_B.Constant1_j Torque_Control_ETR07.Torque_Control_ETR07_B.Constant1_k Torque_Control_ETR07.Torque_Control_ETR07_B.Constant3 Torque_Control_ETR07.Torque_Control_ETR07_B.Constant3_e Torque_Control_ETR07.Torque_Control_ETR07_B.Constant4 Torque_Control_ETR07.Torque_Control_ETR07_B.Constant4_m Torque_Control_ETR07.Torque_Control_ETR07_B.Constant7 Torque_Control_ETR07.Torque_Control_ETR07_B.Constant8 Torque_Control_ETR07.Torque_Control_ETR07_B.Constant_b Torque_Control_ETR07.Torque_Control_ETR07_B.Constant_d Torque_Control_ETR07.Torque_Control_ETR07_B.Constant_dd Torque_Control_ETR07.Torque_Control_ETR07_B.Constant_e Torque_Control_ETR07.Torque_Control_ETR07_B.Constant_h Torque_Control_ETR07.Torque_Control_ETR07_B.Constant_i Torque_Control_ETR07.Torque_Control_ETR07_B.Constant_k Torque_Control_ETR07.Torque_Control_ETR07_B.Constant_l Torque_Control_ETR07.Torque_Control_ETR07_B.Constant_m Torque_Control_ETR07.Torque_Control_ETR07_B.Constant_mf Torque_Control_ETR07.Torque_Control_ETR07_B.Constant_n Torque_Control_ETR07.Torque_Control_ETR07_B.Constant_o Torque_Control_ETR07.Torque_Control_ETR07_B.Constant_ob Torque_Control_ETR07.Torque_Control_ETR07_B.Constant_p Torque_Control_ETR07.Torque_Control_ETR07_B.Divide Torque_Control_ETR07.Torque_Control_ETR07_B.Divide1 Torque_Control_ETR07.Torque_Control_ETR07_B.Divide_i Torque_Control_ETR07.Torque_Control_ETR07_B.Gain Torque_Control_ETR07.Torque_Control_ETR07_B.LimitTemperatureCeldasC Torque_Control_ETR07.Torque_Control_ETR07_B.LimitTemperatureIGBTC Torque_Control_ETR07.Torque_Control_ETR07_B.LimitTemperatureMotorC Torque_Control_ETR07.Torque_Control_ETR07_B.LogicalOperator Torque_Control_ETR07.Torque_Control_ETR07_B.LogicalOperator1 Torque_Control_ETR07.Torque_Control_ETR07_B.MaximumTorqueperengineNm Torque_Control_ETR07.Torque_Control_ETR07_B.MaximumTorqueperengineNm_m Torque_Control_ETR07.Torque_Control_ETR07_B.MaximumTransmissionTorqueDyna_b Torque_Control_ETR07.Torque_Control_ETR07_B.MaximumTransmissionTorqueDynami Torque_Control_ETR07.Torque_Control_ETR07_B.MaximumTransmissionTorqueStat_b Torque_Control_ETR07.Torque_Control_ETR07_B.MaximumTransmissionTorqueStatic Torque_Control_ETR07.Torque_Control_ETR07_B.Merge Torque_Control_ETR07.Torque_Control_ETR07_B.Merge1 Torque_Control_ETR07.Torque_Control_ETR07_B.Merge1_a Torque_Control_ETR07.Torque_Control_ETR07_B.Merge1_a0 Torque_Control_ETR07.Torque_Control_ETR07_B.Merge1_b Torque_Control_ETR07.Torque_Control_ETR07_B.Merge1_i Torque_Control_ETR07.Torque_Control_ETR07_B.Merge1_k Torque_Control_ETR07.Torque_Control_ETR07_B.Merge1_l Torque_Control_ETR07.Torque_Control_ETR07_B.Merge1_lz Torque_Control_ETR07.Torque_Control_ETR07_B.Merge1_m Torque_Control_ETR07.Torque_Control_ETR07_B.Merge1_n Torque_Control_ETR07.Torque_Control_ETR07_B.Merge2 Torque_Control_ETR07.Torque_Control_ETR07_B.Merge2_b Torque_Control_ETR07.Torque_Control_ETR07_B.Merge2_e Torque_Control_ETR07.Torque_Control_ETR07_B.Merge2_g Torque_Control_ETR07.Torque_Control_ETR07_B.Merge2_j Torque_Control_ETR07.Torque_Control_ETR07_B.Merge2_l Torque_Control_ETR07.Torque_Control_ETR07_B.Merge2_lx Torque_Control_ETR07.Torque_Control_ETR07_B.Merge2_o Torque_Control_ETR07.Torque_Control_ETR07_B.Merge3 Torque_Control_ETR07.Torque_Control_ETR07_B.Merge3_c Torque_Control_ETR07.Torque_Control_ETR07_B.Merge3_e Torque_Control_ETR07.Torque_Control_ETR07_B.Merge3_h Torque_Control_ETR07.Torque_Control_ETR07_B.Merge4 Torque_Control_ETR07.Torque_Control_ETR07_B.Merge4_b Torque_Control_ETR07.Torque_Control_ETR07_B.Merge5 Torque_Control_ETR07.Torque_Control_ETR07_B.Merge5_e Torque_Control_ETR07.Torque_Control_ETR07_B.Merge6 Torque_Control_ETR07.Torque_Control_ETR07_B.Merge7 Torque_Control_ETR07.Torque_Control_ETR07_B.Merge_a Torque_Control_ETR07.Torque_Control_ETR07_B.Merge_c Torque_Control_ETR07.Torque_Control_ETR07_B.Merge_cu Torque_Control_ETR07.Torque_Control_ETR07_B.Merge_d Torque_Control_ETR07.Torque_Control_ETR07_B.Merge_g Torque_Control_ETR07.Torque_Control_ETR07_B.Merge_h Torque_Control_ETR07.Torque_Control_ETR07_B.Merge_i Torque_Control_ETR07.Torque_Control_ETR07_B.Merge_j Torque_Control_ETR07.Torque_Control_ETR07_B.Merge_k Torque_Control_ETR07.Torque_Control_ETR07_B.Merge_kj Torque_Control_ETR07.Torque_Control_ETR07_B.Merge_kt Torque_Control_ETR07.Torque_Control_ETR07_B.Merge_l Torque_Control_ETR07.Torque_Control_ETR07_B.Merge_m Torque_Control_ETR07.Torque_Control_ETR07_B.Nospin_k.sf_MATLABFunction.CKF_act0 Torque_Control_ETR07.Torque_Control_ETR07_B.Nospin_m.sf_MATLABFunction.CKF_act0 Torque_Control_ETR07.Torque_Control_ETR07_B.OutportBufferForFlags_num5 Torque_Control_ETR07.Torque_Control_ETR07_B.Saturation Torque_Control_ETR07.Torque_Control_ETR07_B.Saturation_f Torque_Control_ETR07.Torque_Control_ETR07_B.Saturation_i Torque_Control_ETR07.Torque_Control_ETR07_B.Saturation_k Torque_Control_ETR07.Torque_Control_ETR07_B.Spin_n.Constant Torque_Control_ETR07.Torque_Control_ETR07_B.Spin_n.sf_MATLABFunction.CKF_act1 Torque_Control_ETR07.Torque_Control_ETR07_B.Spin_nb.Constant Torque_Control_ETR07.Torque_Control_ETR07_B.Spin_nb.sf_MATLABFunction.CKF_act1 Torque_Control_ETR07.Torque_Control_ETR07_B.SteeringWheelMaximumAngle Torque_Control_ETR07.Torque_Control_ETR07_B.SteeringWheelMaximumAngle_m Torque_Control_ETR07.Torque_Control_ETR07_B.SteeringWheelMaximumAngle_p Torque_Control_ETR07.Torque_Control_ETR07_B.SteeringWheelSaturationpersited Torque_Control_ETR07.Torque_Control_ETR07_B.Steering_Ratio Torque_Control_ETR07.Torque_Control_ETR07_B.Subtract Torque_Control_ETR07.Torque_Control_ETR07_B.Throttle Torque_Control_ETR07.Torque_Control_ETR07_B.Torque_RLNm Torque_Control_ETR07.Torque_Control_ETR07_B.Torque_RRNm Torque_Control_ETR07.Torque_Control_ETR07_B.Tq_diff_Max Torque_Control_ETR07.Torque_Control_ETR07_B.Tq_diff_maxNm Torque_Control_ETR07.Torque_Control_ETR07_B.Tq_maxNm Torque_Control_ETR07.Torque_Control_ETR07_B.TransmisionRatio Torque_Control_ETR07.Torque_Control_ETR07_B.TransmisionRatio_b Torque_Control_ETR07.Torque_Control_ETR07_B.Wheelbasem Torque_Control_ETR07.Torque_Control_ETR07_B.Yaw_Inertiakgm3 Torque_Control_ETR07.Torque_Control_ETR07_B.Zero Torque_Control_ETR07.Torque_Control_ETR07_B.Zero_m Torque_Control_ETR07.Torque_Control_ETR07_B.Zero_p Torque_Control_ETR07.Torque_Control_ETR07_B.approx2095 Torque_Control_ETR07.Torque_Control_ETR07_B.approx2095_h Torque_Control_ETR07.Torque_Control_ETR07_B.exptcycletau1 Torque_Control_ETR07.Torque_Control_ETR07_B.sf_Acceleratorbehaviour.throttle Torque_Control_ETR07.Torque_Control_ETR07_B.sf_Acceleratorbehaviour_b.throttle Torque_Control_ETR07.Torque_Control_ETR07_B.sf_Acceleratorbehaviour_f.throttle Torque_Control_ETR07.Torque_Control_ETR07_B.sf_Acceleratorbehaviour_o.throttle Torque_Control_ETR07.Torque_Control_ETR07_B.sf_MATLABFunction.RPM Torque_Control_ETR07.Torque_Control_ETR07_B.sf_MATLABFunction1_f.value Torque_Control_ETR07.Torque_Control_ETR07_B.sf_MATLABFunction1_g.value Torque_Control_ETR07.Torque_Control_ETR07_B.sf_MATLABFunction1_gm.value Torque_Control_ETR07.Torque_Control_ETR07_B.sf_MATLABFunction1_m.value Torque_Control_ETR07.Torque_Control_ETR07_B.sf_MATLABFunction1_mk.value Torque_Control_ETR07.Torque_Control_ETR07_B.sf_MATLABFunction1_n.value Torque_Control_ETR07.Torque_Control_ETR07_B.sf_MATLABFunction2.value Torque_Control_ETR07.Torque_Control_ETR07_B.sf_MATLABFunction2_b.value Torque_Control_ETR07.Torque_Control_ETR07_B.sf_MATLABFunction2_e.value Torque_Control_ETR07.Torque_Control_ETR07_B.sf_MATLABFunction2_l.value Torque_Control_ETR07.Torque_Control_ETR07_B.sf_MATLABFunction2_m.value Torque_Control_ETR07.Torque_Control_ETR07_B.sf_MATLABFunction_a.RPM Torque_Control_ETR07.Torque_Control_ETR07_B.sf_MATLABFunction_d.SKF_act0 Torque_Control_ETR07.Torque_Control_ETR07_B.sf_MATLABFunction_d1.value Torque_Control_ETR07.Torque_Control_ETR07_B.sf_MATLABFunction_fa.RPM Torque_Control_ETR07.Torque_Control_ETR07_B.sf_MATLABFunction_fq.SKF_act0 Torque_Control_ETR07.Torque_Control_ETR07_B.sf_MATLABFunction_k.CKF_act1 Torque_Control_ETR07.Torque_Control_ETR07_B.sf_MATLABFunction_k2.CKF_act0 Torque_Control_ETR07.Torque_Control_ETR07_B.sf_MATLABFunction_m.SKF_act1 Torque_Control_ETR07.Torque_Control_ETR07_B.sf_MATLABFunction_p.SKF_act1 Torque_Control_ETR07.Torque_Control_ETR07_B.sf_minimumvalue.min Torque_Control_ETR07.Torque_Control_ETR07_B.sf_minimumvalue1.min Torque_Control_ETR07.Torque_Control_ETR07_B.sf_minimumvalue1_k.min Torque_Control_ETR07.Torque_Control_ETR07_B.sf_minimumvalue_o.min Torque_Control_ETR07.Torque_Control_ETR07_B.u602pi Torque_Control_ETR07.Torque_Control_ETR07_B.u602pi_e Torque_Control_ETR07.Torque_Control_ETR07_B.udifference Torque_Control_ETR07.Torque_Control_ETR07_B.udifference_l /end REF_MEASUREMENT
/end GROUP
/begin GROUP Torque_Control_ETR07.Torque_Control_ETR07_B.Nospin_k ""
 /begin REF_MEASUREMENT Torque_Control_ETR07.Torque_Control_ETR07_B.Nospin_k.sf_MATLABFunction.CKF_act0 /end REF_MEASUREMENT
/end GROUP
/begin GROUP Torque_Control_ETR07.Torque_Control_ETR07_B.Nospin_k.sf_MATLABFunction ""
 /begin REF_MEASUREMENT Torque_Control_ETR07.Torque_Control_ETR07_B.Nospin_k.sf_MATLABFunction.CKF_act0 /end REF_MEASUREMENT
/end GROUP
/begin GROUP Torque_Control_ETR07.Torque_Control_ETR07_B.Nospin_m ""
 /begin REF_MEASUREMENT Torque_Control_ETR07.Torque_Control_ETR07_B.Nospin_m.sf_MATLABFunction.CKF_act0 /end REF_MEASUREMENT
/end GROUP
/begin GROUP Torque_Control_ETR07.Torque_Control_ETR07_B.Nospin_m.sf_MATLABFunction ""
 /begin REF_MEASUREMENT Torque_Control_ETR07.Torque_Control_ETR07_B.Nospin_m.sf_MATLABFunction.CKF_act0 /end REF_MEASUREMENT
/end GROUP
/begin GROUP Torque_Control_ETR07.Torque_Control_ETR07_B.Spin_n ""
 /begin REF_MEASUREMENT Torque_Control_ETR07.Torque_Control_ETR07_B.Spin_n.Constant Torque_Control_ETR07.Torque_Control_ETR07_B.Spin_n.sf_MATLABFunction.CKF_act1 /end REF_MEASUREMENT
/end GROUP
/begin GROUP Torque_Control_ETR07.Torque_Control_ETR07_B.Spin_n.sf_MATLABFunction ""
 /begin REF_MEASUREMENT Torque_Control_ETR07.Torque_Control_ETR07_B.Spin_n.sf_MATLABFunction.CKF_act1 /end REF_MEASUREMENT
/end GROUP
/begin GROUP Torque_Control_ETR07.Torque_Control_ETR07_B.Spin_nb ""
 /begin REF_MEASUREMENT Torque_Control_ETR07.Torque_Control_ETR07_B.Spin_nb.Constant Torque_Control_ETR07.Torque_Control_ETR07_B.Spin_nb.sf_MATLABFunction.CKF_act1 /end REF_MEASUREMENT
/end GROUP
/begin GROUP Torque_Control_ETR07.Torque_Control_ETR07_B.Spin_nb.sf_MATLABFunction ""
 /begin REF_MEASUREMENT Torque_Control_ETR07.Torque_Control_ETR07_B.Spin_nb.sf_MATLABFunction.CKF_act1 /end REF_MEASUREMENT
/end GROUP
/begin GROUP Torque_Control_ETR07.Torque_Control_ETR07_B.sf_Acceleratorbehaviour ""
 /begin REF_MEASUREMENT Torque_Control_ETR07.Torque_Control_ETR07_B.sf_Acceleratorbehaviour.throttle /end REF_MEASUREMENT
/end GROUP
/begin GROUP Torque_Control_ETR07.Torque_Control_ETR07_B.sf_Acceleratorbehaviour_b ""
 /begin REF_MEASUREMENT Torque_Control_ETR07.Torque_Control_ETR07_B.sf_Acceleratorbehaviour_b.throttle /end REF_MEASUREMENT
/end GROUP
/begin GROUP Torque_Control_ETR07.Torque_Control_ETR07_B.sf_Acceleratorbehaviour_f ""
 /begin REF_MEASUREMENT Torque_Control_ETR07.Torque_Control_ETR07_B.sf_Acceleratorbehaviour_f.throttle /end REF_MEASUREMENT
/end GROUP
/begin GROUP Torque_Control_ETR07.Torque_Control_ETR07_B.sf_Acceleratorbehaviour_o ""
 /begin REF_MEASUREMENT Torque_Control_ETR07.Torque_Control_ETR07_B.sf_Acceleratorbehaviour_o.throttle /end REF_MEASUREMENT
/end GROUP
/begin GROUP Torque_Control_ETR07.Torque_Control_ETR07_B.sf_MATLABFunction ""
 /begin REF_MEASUREMENT Torque_Control_ETR07.Torque_Control_ETR07_B.sf_MATLABFunction.RPM /end REF_MEASUREMENT
/end GROUP
/begin GROUP Torque_Control_ETR07.Torque_Control_ETR07_B.sf_MATLABFunction1_f ""
 /begin REF_MEASUREMENT Torque_Control_ETR07.Torque_Control_ETR07_B.sf_MATLABFunction1_f.value /end REF_MEASUREMENT
/end GROUP
/begin GROUP Torque_Control_ETR07.Torque_Control_ETR07_B.sf_MATLABFunction1_g ""
 /begin REF_MEASUREMENT Torque_Control_ETR07.Torque_Control_ETR07_B.sf_MATLABFunction1_g.value /end REF_MEASUREMENT
/end GROUP
/begin GROUP Torque_Control_ETR07.Torque_Control_ETR07_B.sf_MATLABFunction1_gm ""
 /begin REF_MEASUREMENT Torque_Control_ETR07.Torque_Control_ETR07_B.sf_MATLABFunction1_gm.value /end REF_MEASUREMENT
/end GROUP
/begin GROUP Torque_Control_ETR07.Torque_Control_ETR07_B.sf_MATLABFunction1_m ""
 /begin REF_MEASUREMENT Torque_Control_ETR07.Torque_Control_ETR07_B.sf_MATLABFunction1_m.value /end REF_MEASUREMENT
/end GROUP
/begin GROUP Torque_Control_ETR07.Torque_Control_ETR07_B.sf_MATLABFunction1_mk ""
 /begin REF_MEASUREMENT Torque_Control_ETR07.Torque_Control_ETR07_B.sf_MATLABFunction1_mk.value /end REF_MEASUREMENT
/end GROUP
/begin GROUP Torque_Control_ETR07.Torque_Control_ETR07_B.sf_MATLABFunction1_n ""
 /begin REF_MEASUREMENT Torque_Control_ETR07.Torque_Control_ETR07_B.sf_MATLABFunction1_n.value /end REF_MEASUREMENT
/end GROUP
/begin GROUP Torque_Control_ETR07.Torque_Control_ETR07_B.sf_MATLABFunction2 ""
 /begin REF_MEASUREMENT Torque_Control_ETR07.Torque_Control_ETR07_B.sf_MATLABFunction2.value /end REF_MEASUREMENT
/end GROUP
/begin GROUP Torque_Control_ETR07.Torque_Control_ETR07_B.sf_MATLABFunction2_b ""
 /begin REF_MEASUREMENT Torque_Control_ETR07.Torque_Control_ETR07_B.sf_MATLABFunction2_b.value /end REF_MEASUREMENT
/end GROUP
/begin GROUP Torque_Control_ETR07.Torque_Control_ETR07_B.sf_MATLABFunction2_e ""
 /begin REF_MEASUREMENT Torque_Control_ETR07.Torque_Control_ETR07_B.sf_MATLABFunction2_e.value /end REF_MEASUREMENT
/end GROUP
/begin GROUP Torque_Control_ETR07.Torque_Control_ETR07_B.sf_MATLABFunction2_l ""
 /begin REF_MEASUREMENT Torque_Control_ETR07.Torque_Control_ETR07_B.sf_MATLABFunction2_l.value /end REF_MEASUREMENT
/end GROUP
/begin GROUP Torque_Control_ETR07.Torque_Control_ETR07_B.sf_MATLABFunction2_m ""
 /begin REF_MEASUREMENT Torque_Control_ETR07.Torque_Control_ETR07_B.sf_MATLABFunction2_m.value /end REF_MEASUREMENT
/end GROUP
/begin GROUP Torque_Control_ETR07.Torque_Control_ETR07_B.sf_MATLABFunction_a ""
 /begin REF_MEASUREMENT Torque_Control_ETR07.Torque_Control_ETR07_B.sf_MATLABFunction_a.RPM /end REF_MEASUREMENT
/end GROUP
/begin GROUP Torque_Control_ETR07.Torque_Control_ETR07_B.sf_MATLABFunction_d ""
 /begin REF_MEASUREMENT Torque_Control_ETR07.Torque_Control_ETR07_B.sf_MATLABFunction_d.SKF_act0 /end REF_MEASUREMENT
/end GROUP
/begin GROUP Torque_Control_ETR07.Torque_Control_ETR07_B.sf_MATLABFunction_d1 ""
 /begin REF_MEASUREMENT Torque_Control_ETR07.Torque_Control_ETR07_B.sf_MATLABFunction_d1.value /end REF_MEASUREMENT
/end GROUP
/begin GROUP Torque_Control_ETR07.Torque_Control_ETR07_B.sf_MATLABFunction_fa ""
 /begin REF_MEASUREMENT Torque_Control_ETR07.Torque_Control_ETR07_B.sf_MATLABFunction_fa.RPM /end REF_MEASUREMENT
/end GROUP
/begin GROUP Torque_Control_ETR07.Torque_Control_ETR07_B.sf_MATLABFunction_fq ""
 /begin REF_MEASUREMENT Torque_Control_ETR07.Torque_Control_ETR07_B.sf_MATLABFunction_fq.SKF_act0 /end REF_MEASUREMENT
/end GROUP
/begin GROUP Torque_Control_ETR07.Torque_Control_ETR07_B.sf_MATLABFunction_k ""
 /begin REF_MEASUREMENT Torque_Control_ETR07.Torque_Control_ETR07_B.sf_MATLABFunction_k.CKF_act1 /end REF_MEASUREMENT
/end GROUP
/begin GROUP Torque_Control_ETR07.Torque_Control_ETR07_B.sf_MATLABFunction_k2 ""
 /begin REF_MEASUREMENT Torque_Control_ETR07.Torque_Control_ETR07_B.sf_MATLABFunction_k2.CKF_act0 /end REF_MEASUREMENT
/end GROUP
/begin GROUP Torque_Control_ETR07.Torque_Control_ETR07_B.sf_MATLABFunction_m ""
 /begin REF_MEASUREMENT Torque_Control_ETR07.Torque_Control_ETR07_B.sf_MATLABFunction_m.SKF_act1 /end REF_MEASUREMENT
/end GROUP
/begin GROUP Torque_Control_ETR07.Torque_Control_ETR07_B.sf_MATLABFunction_p ""
 /begin REF_MEASUREMENT Torque_Control_ETR07.Torque_Control_ETR07_B.sf_MATLABFunction_p.SKF_act1 /end REF_MEASUREMENT
/end GROUP
/begin GROUP Torque_Control_ETR07.Torque_Control_ETR07_B.sf_minimumvalue ""
 /begin REF_MEASUREMENT Torque_Control_ETR07.Torque_Control_ETR07_B.sf_minimumvalue.min /end REF_MEASUREMENT
/end GROUP
/begin GROUP Torque_Control_ETR07.Torque_Control_ETR07_B.sf_minimumvalue1 ""
 /begin REF_MEASUREMENT Torque_Control_ETR07.Torque_Control_ETR07_B.sf_minimumvalue1.min /end REF_MEASUREMENT
/end GROUP
/begin GROUP Torque_Control_ETR07.Torque_Control_ETR07_B.sf_minimumvalue1_k ""
 /begin REF_MEASUREMENT Torque_Control_ETR07.Torque_Control_ETR07_B.sf_minimumvalue1_k.min /end REF_MEASUREMENT
/end GROUP
/begin GROUP Torque_Control_ETR07.Torque_Control_ETR07_B.sf_minimumvalue_o ""
 /begin REF_MEASUREMENT Torque_Control_ETR07.Torque_Control_ETR07_B.sf_minimumvalue_o.min /end REF_MEASUREMENT
/end GROUP
/begin GROUP Torque_Control_ETR07.Torque_Control_ETR07_DW ""
 /begin REF_MEASUREMENT Torque_Control_ETR07.Torque_Control_ETR07_DW.A Torque_Control_ETR07.Torque_Control_ETR07_DW.AA Torque_Control_ETR07.Torque_Control_ETR07_DW.A_b Torque_Control_ETR07.Torque_Control_ETR07_DW.A_i Torque_Control_ETR07.Torque_Control_ETR07_DW.B Torque_Control_ETR07.Torque_Control_ETR07_DW.B_i Torque_Control_ETR07.Torque_Control_ETR07_DW.B_k Torque_Control_ETR07.Torque_Control_ETR07_DW.Previous_IN Torque_Control_ETR07.Torque_Control_ETR07_DW.Previous_OUT Torque_Control_ETR07.Torque_Control_ETR07_DW.R /end REF_MEASUREMENT
/end GROUP
/begin GROUP Torque_Control_ETR07.Torque_Control_ETR07_U ""
 /begin REF_MEASUREMENT Torque_Control_ETR07.Torque_Control_ETR07_U.ACCEL_F_X_SI Torque_Control_ETR07.Torque_Control_ETR07_U.ACCEL_F_Y_SI Torque_Control_ETR07.Torque_Control_ETR07_U.ACCEL_F_Z_SI Torque_Control_ETR07.Torque_Control_ETR07_U.ACCEL_R_X_SI Torque_Control_ETR07.Torque_Control_ETR07_U.ACCEL_R_Y_SI Torque_Control_ETR07.Torque_Control_ETR07_U.ACCEL_R_Z_SI Torque_Control_ETR07.Torque_Control_ETR07_U.APPS1_Value Torque_Control_ETR07.Torque_Control_ETR07_U.APPS2_Value Torque_Control_ETR07.Torque_Control_ETR07_U.Accumulator_Current Torque_Control_ETR07.Torque_Control_ETR07_U.Accumulator_Voltage Torque_Control_ETR07.Torque_Control_ETR07_U.BrakeSensor_Value Torque_Control_ETR07.Torque_Control_ETR07_U.Car_State Torque_Control_ETR07.Torque_Control_ETR07_U.CriticalDisconnection Torque_Control_ETR07.Torque_Control_ETR07_U.Gyro_F_Z_Deg Torque_Control_ETR07.Torque_Control_ETR07_U.Highest_CellTemp Torque_Control_ETR07.Torque_Control_ETR07_U.RL_rads Torque_Control_ETR07.Torque_Control_ETR07_U.RR_rads Torque_Control_ETR07.Torque_Control_ETR07_U.ShutdownClosed Torque_Control_ETR07.Torque_Control_ETR07_U.SteeringSensor_Bits Torque_Control_ETR07.Torque_Control_ETR07_U.Susp_F_L Torque_Control_ETR07.Torque_Control_ETR07_U.Susp_F_R Torque_Control_ETR07.Torque_Control_ETR07_U.Susp_R_L Torque_Control_ETR07.Torque_Control_ETR07_U.Susp_R_R Torque_Control_ETR07.Torque_Control_ETR07_U.TV_Mode Torque_Control_ETR07.Torque_Control_ETR07_U.Temp_IGBT Torque_Control_ETR07.Torque_Control_ETR07_U.Temp_Motors Torque_Control_ETR07.Torque_Control_ETR07_U.TorqueEnable Torque_Control_ETR07.Torque_Control_ETR07_U.VDC_Apps_Sat_Down Torque_Control_ETR07.Torque_Control_ETR07_U.VDC_Apps_Sat_Up Torque_Control_ETR07.Torque_Control_ETR07_U.VDC_CKF_Initial Torque_Control_ETR07.Torque_Control_ETR07_U.VDC_Cte_CKF Torque_Control_ETR07.Torque_Control_ETR07_U.VDC_Cte_SKF Torque_Control_ETR07.Torque_Control_ETR07_U.VDC_K_Reduction_P Torque_Control_ETR07.Torque_Control_ETR07_U.VDC_K_Reduction_Temperature Torque_Control_ETR07.Torque_Control_ETR07_U.VDC_Max_Regenerative_Torque Torque_Control_ETR07.Torque_Control_ETR07_U.VDC_Power_Limit Torque_Control_ETR07.Torque_Control_ETR07_U.VDC_SKF_Initial Torque_Control_ETR07.Torque_Control_ETR07_U.Vel_RL_kmh Torque_Control_ETR07.Torque_Control_ETR07_U.Vel_RR_kmh Torque_Control_ETR07.Torque_Control_ETR07_U.Workshop_Mode_Enable /end REF_MEASUREMENT
/end GROUP
/begin GROUP Torque_Control_ETR07.Torque_Control_ETR07_Y ""
 /begin REF_MEASUREMENT Torque_Control_ETR07.Torque_Control_ETR07_Y.APPS_Implausibility Torque_Control_ETR07.Torque_Control_ETR07_Y.Brake_Implausibility Torque_Control_ETR07.Torque_Control_ETR07_Y.CKF_actual Torque_Control_ETR07.Torque_Control_ETR07_Y.Dash_Speed Torque_Control_ETR07.Torque_Control_ETR07_Y.Fy_R Torque_Control_ETR07.Torque_Control_ETR07_Y.Handling Torque_Control_ETR07.Torque_Control_ETR07_Y.Mass Torque_Control_ETR07.Torque_Control_ETR07_Y.Max_Fx_RL Torque_Control_ETR07.Torque_Control_ETR07_Y.Max_Fx_RR Torque_Control_ETR07.Torque_Control_ETR07_Y.Max_Torque_RL Torque_Control_ETR07.Torque_Control_ETR07_Y.Max_Torque_RR Torque_Control_ETR07.Torque_Control_ETR07_Y.MeasVDCTorque_L Torque_Control_ETR07.Torque_Control_ETR07_Y.MeasVDCTorque_R Torque_Control_ETR07.Torque_Control_ETR07_Y.Power Torque_Control_ETR07.Torque_Control_ETR07_Y.PowerLimitReached Torque_Control_ETR07.Torque_Control_ETR07_Y.PowerMean500ms Torque_Control_ETR07.Torque_Control_ETR07_Y.Pumps_Control Torque_Control_ETR07.Torque_Control_ETR07_Y.Regenerative_Enable Torque_Control_ETR07.Torque_Control_ETR07_Y.SKF_actual Torque_Control_ETR07.Torque_Control_ETR07_Y.SteeringSensor_Value Torque_Control_ETR07.Torque_Control_ETR07_Y.TV_Flag_CarBehaviour Torque_Control_ETR07.Torque_Control_ETR07_Y.TV_Flag_Power Torque_Control_ETR07.Torque_Control_ETR07_Y.TV_Flag_Temperature Torque_Control_ETR07.Torque_Control_ETR07_Y.TV_Flag_WheelSpinRL Torque_Control_ETR07.Torque_Control_ETR07_Y.TV_Flag_WheelSpinRR Torque_Control_ETR07.Torque_Control_ETR07_Y.Throttle Torque_Control_ETR07.Torque_Control_ETR07_Y.Torque_L Torque_Control_ETR07.Torque_Control_ETR07_Y.Torque_OK Torque_Control_ETR07.Torque_Control_ETR07_Y.Torque_R Torque_Control_ETR07.Torque_Control_ETR07_Y.Torque_RLwc Torque_Control_ETR07.Torque_Control_ETR07_Y.Torque_RRwc Torque_Control_ETR07.Torque_Control_ETR07_Y.current_L Torque_Control_ETR07.Torque_Control_ETR07_Y.current_R /end REF_MEASUREMENT
/end GROUP
/begin GROUP Torque_Control_ETR07.Torque_Control_ETR07_P ""
 /begin REF_CHARACTERISTIC Torque_Control_ETR07.Torque_Control_ETR07_P.A1_Value Torque_Control_ETR07.Torque_Control_ETR07_P.A_Value Torque_Control_ETR07.Torque_Control_ETR07_P.B1_Value Torque_Control_ETR07.Torque_Control_ETR07_P.BRAKE_THRESHOLD_Value Torque_Control_ETR07.Torque_Control_ETR07_P.B_Value Torque_Control_ETR07.Torque_Control_ETR07_P.C1_Value Torque_Control_ETR07.Torque_Control_ETR07_P.CKF_act_Y0 Torque_Control_ETR07.Torque_Control_ETR07_P.CKF_act_Y0_j Torque_Control_ETR07.Torque_Control_ETR07_P.C_Value Torque_Control_ETR07.Torque_Control_ETR07_P.CompareToConstant1_const Torque_Control_ETR07.Torque_Control_ETR07_P.CompareToConstant_const Torque_Control_ETR07.Torque_Control_ETR07_P.CompareToConstant_const_p Torque_Control_ETR07.Torque_Control_ETR07_P.Constant1_Value Torque_Control_ETR07.Torque_Control_ETR07_P.Constant1_Value_a Torque_Control_ETR07.Torque_Control_ETR07_P.Constant1_Value_ab Torque_Control_ETR07.Torque_Control_ETR07_P.Constant1_Value_b Torque_Control_ETR07.Torque_Control_ETR07_P.Constant1_Value_c Torque_Control_ETR07.Torque_Control_ETR07_P.Constant1_Value_f Torque_Control_ETR07.Torque_Control_ETR07_P.Constant1_Value_l Torque_Control_ETR07.Torque_Control_ETR07_P.Constant1_Value_ln Torque_Control_ETR07.Torque_Control_ETR07_P.Constant2_Value Torque_Control_ETR07.Torque_Control_ETR07_P.Constant2_Value_g Torque_Control_ETR07.Torque_Control_ETR07_P.Constant2_Value_g1 Torque_Control_ETR07.Torque_Control_ETR07_P.Constant3_Value Torque_Control_ETR07.Torque_Control_ETR07_P.Constant3_Value_n Torque_Control_ETR07.Torque_Control_ETR07_P.Constant3_Value_o Torque_Control_ETR07.Torque_Control_ETR07_P.Constant4_Value Torque_Control_ETR07.Torque_Control_ETR07_P.Constant4_Value_p Torque_Control_ETR07.Torque_Control_ETR07_P.Constant5_Value Torque_Control_ETR07.Torque_Control_ETR07_P.Constant6_Value Torque_Control_ETR07.Torque_Control_ETR07_P.Constant6_Value_p Torque_Control_ETR07.Torque_Control_ETR07_P.Constant7_Value Torque_Control_ETR07.Torque_Control_ETR07_P.Constant8_Value Torque_Control_ETR07.Torque_Control_ETR07_P.Constant_Value Torque_Control_ETR07.Torque_Control_ETR07_P.Constant_Value_a Torque_Control_ETR07.Torque_Control_ETR07_P.Constant_Value_ad Torque_Control_ETR07.Torque_Control_ETR07_P.Constant_Value_ae Torque_Control_ETR07.Torque_Control_ETR07_P.Constant_Value_b Torque_Control_ETR07.Torque_Control_ETR07_P.Constant_Value_d Torque_Control_ETR07.Torque_Control_ETR07_P.Constant_Value_dm Torque_Control_ETR07.Torque_Control_ETR07_P.Constant_Value_f Torque_Control_ETR07.Torque_Control_ETR07_P.Constant_Value_f3 Torque_Control_ETR07.Torque_Control_ETR07_P.Constant_Value_g Torque_Control_ETR07.Torque_Control_ETR07_P.Constant_Value_h Torque_Control_ETR07.Torque_Control_ETR07_P.Constant_Value_i Torque_Control_ETR07.Torque_Control_ETR07_P.Constant_Value_ib Torque_Control_ETR07.Torque_Control_ETR07_P.Constant_Value_k Torque_Control_ETR07.Torque_Control_ETR07_P.Constant_Value_l Torque_Control_ETR07.Torque_Control_ETR07_P.Constant_Value_m Torque_Control_ETR07.Torque_Control_ETR07_P.Constant_Value_n Torque_Control_ETR07.Torque_Control_ETR07_P.Constant_Value_n5 Torque_Control_ETR07.Torque_Control_ETR07_P.Cornering_Stiffness_FN_Value Torque_Control_ETR07.Torque_Control_ETR07_P.Cornering_Stiffness_RN_Value Torque_Control_ETR07.Torque_Control_ETR07_P.DataStoreMemory10_InitialValue Torque_Control_ETR07.Torque_Control_ETR07_P.DataStoreMemory1_InitialValu_fl Torque_Control_ETR07.Torque_Control_ETR07_P.DataStoreMemory1_InitialValue Torque_Control_ETR07.Torque_Control_ETR07_P.DataStoreMemory1_InitialValue_f Torque_Control_ETR07.Torque_Control_ETR07_P.DataStoreMemory1_InitialValue_i Torque_Control_ETR07.Torque_Control_ETR07_P.DataStoreMemory1_InitialValue_m Torque_Control_ETR07.Torque_Control_ETR07_P.DataStoreMemory_InitialValue Torque_Control_ETR07.Torque_Control_ETR07_P.DataStoreMemory_InitialValue_c Torque_Control_ETR07.Torque_Control_ETR07_P.DataStoreMemory_InitialValue_j Torque_Control_ETR07.Torque_Control_ETR07_P.DataStoreMemory_InitialValue_m Torque_Control_ETR07.Torque_Control_ETR07_P.EffectiveRollingRadiusinch_Va_b Torque_Control_ETR07.Torque_Control_ETR07_P.EffectiveRollingRadiusinch_Valu Torque_Control_ETR07.Torque_Control_ETR07_P.Flags_num5_Y0 Torque_Control_ETR07.Torque_Control_ETR07_P.Fy_RN0inf_Y0 Torque_Control_ETR07.Torque_Control_ETR07_P.Fyperwheel_Gain Torque_Control_ETR07.Torque_Control_ETR07_P.Fyperwheel_Gain_e Torque_Control_ETR07.Torque_Control_ETR07_P.Gain1_Gain Torque_Control_ETR07.Torque_Control_ETR07_P.Gain1_Gain_i Torque_Control_ETR07.Torque_Control_ETR07_P.Gain1_Gain_o Torque_Control_ETR07.Torque_Control_ETR07_P.Gain_Gain Torque_Control_ETR07.Torque_Control_ETR07_P.Gain_Gain_a Torque_Control_ETR07.Torque_Control_ETR07_P.Gain_Gain_c Torque_Control_ETR07.Torque_Control_ETR07_P.Gain_Gain_co Torque_Control_ETR07.Torque_Control_ETR07_P.Gain_Gain_cv Torque_Control_ETR07.Torque_Control_ETR07_P.Gain_Gain_f Torque_Control_ETR07.Torque_Control_ETR07_P.Gain_Gain_k Torque_Control_ETR07.Torque_Control_ETR07_P.Gain_Gain_l Torque_Control_ETR07.Torque_Control_ETR07_P.Gain_Gain_o Torque_Control_ETR07.Torque_Control_ETR07_P.Gravity1_Gain Torque_Control_ETR07.Torque_Control_ETR07_P.Gravity1_Gain_g Torque_Control_ETR07.Torque_Control_ETR07_P.Gravity_Gain Torque_Control_ETR07.Torque_Control_ETR07_P.Handlinginfinf_Y0 Torque_Control_ETR07.Torque_Control_ETR07_P.Integrator_IC Torque_Control_ETR07.Torque_Control_ETR07_P.LimitTemperatureCeldasC_Value Torque_Control_ETR07.Torque_Control_ETR07_P.LimitTemperatureIGBTC_Value Torque_Control_ETR07.Torque_Control_ETR07_P.LimitTemperatureMotorC_Value Torque_Control_ETR07.Torque_Control_ETR07_P.Masskg0inf_Y0 Torque_Control_ETR07.Torque_Control_ETR07_P.MaxFx_RLN0inf_Y0 Torque_Control_ETR07.Torque_Control_ETR07_P.MaxFx_RRN0inf_Y0 Torque_Control_ETR07.Torque_Control_ETR07_P.MaxTq_RLNm0inf_Y0 Torque_Control_ETR07.Torque_Control_ETR07_P.MaxTq_RLNm0inf_Y0_d Torque_Control_ETR07.Torque_Control_ETR07_P.MaxTq_RRNm0inf_Y0 Torque_Control_ETR07.Torque_Control_ETR07_P.MaxTq_RRNm0inf_Y0_o Torque_Control_ETR07.Torque_Control_ETR07_P.MaximumTorqueperengineNm_Valu_b Torque_Control_ETR07.Torque_Control_ETR07_P.MaximumTorqueperengineNm_Value Torque_Control_ETR07.Torque_Control_ETR07_P.MaximumTransmissionTorqueDyna_a Torque_Control_ETR07.Torque_Control_ETR07_P.MaximumTransmissionTorqueDynami Torque_Control_ETR07.Torque_Control_ETR07_P.MaximumTransmissionTorqueStat_n Torque_Control_ETR07.Torque_Control_ETR07_P.MaximumTransmissionTorqueStatic Torque_Control_ETR07.Torque_Control_ETR07_P.Merge1_InitialOutput Torque_Control_ETR07.Torque_Control_ETR07_P.Merge1_InitialOutput_f Torque_Control_ETR07.Torque_Control_ETR07_P.Merge1_InitialOutput_k Torque_Control_ETR07.Torque_Control_ETR07_P.Merge2_InitialOutput Torque_Control_ETR07.Torque_Control_ETR07_P.Merge2_InitialOutput_o Torque_Control_ETR07.Torque_Control_ETR07_P.Merge3_InitialOutput Torque_Control_ETR07.Torque_Control_ETR07_P.Merge3_InitialOutput_j Torque_Control_ETR07.Torque_Control_ETR07_P.Merge3_InitialOutput_n Torque_Control_ETR07.Torque_Control_ETR07_P.Merge4_InitialOutput Torque_Control_ETR07.Torque_Control_ETR07_P.Merge4_InitialOutput_d Torque_Control_ETR07.Torque_Control_ETR07_P.Merge5_InitialOutput Torque_Control_ETR07.Torque_Control_ETR07_P.Merge6_InitialOutput Torque_Control_ETR07.Torque_Control_ETR07_P.Merge7_InitialOutput Torque_Control_ETR07.Torque_Control_ETR07_P.Merge_InitialOutput Torque_Control_ETR07.Torque_Control_ETR07_P.Merge_InitialOutput_a Torque_Control_ETR07.Torque_Control_ETR07_P.Merge_InitialOutput_h Torque_Control_ETR07.Torque_Control_ETR07_P.Merge_InitialOutput_i Torque_Control_ETR07.Torque_Control_ETR07_P.Merge_InitialOutput_j Torque_Control_ETR07.Torque_Control_ETR07_P.Merge_InitialOutput_jq Torque_Control_ETR07.Torque_Control_ETR07_P.Merge_InitialOutput_l Torque_Control_ETR07.Torque_Control_ETR07_P.Merge_InitialOutput_p Torque_Control_ETR07.Torque_Control_ETR07_P.Merge_InitialOutput_pp Torque_Control_ETR07.Torque_Control_ETR07_P.Nospin_k.Switch_Threshold Torque_Control_ETR07.Torque_Control_ETR07_P.Not_Braking_Value Torque_Control_ETR07.Torque_Control_ETR07_P.Out_Throttle_Y0 Torque_Control_ETR07.Torque_Control_ETR07_P.Out_Throttle_Y0_a Torque_Control_ETR07.Torque_Control_ETR07_P.Rear_Trackwidthm_Value Torque_Control_ETR07.Torque_Control_ETR07_P.SKF_act_Y0 Torque_Control_ETR07.Torque_Control_ETR07_P.SKF_act_Y0_l Torque_Control_ETR07.Torque_Control_ETR07_P.Saturation1_LowerSat Torque_Control_ETR07.Torque_Control_ETR07_P.Saturation1_LowerSat_l Torque_Control_ETR07.Torque_Control_ETR07_P.Saturation1_UpperSat Torque_Control_ETR07.Torque_Control_ETR07_P.Saturation1_UpperSat_m Torque_Control_ETR07.Torque_Control_ETR07_P.Saturation_LowerSat Torque_Control_ETR07.Torque_Control_ETR07_P.Saturation_LowerSat_c Torque_Control_ETR07.Torque_Control_ETR07_P.Saturation_LowerSat_e Torque_Control_ETR07.Torque_Control_ETR07_P.Saturation_LowerSat_f Torque_Control_ETR07.Torque_Control_ETR07_P.Saturation_LowerSat_f3 Torque_Control_ETR07.Torque_Control_ETR07_P.Saturation_LowerSat_fi Torque_Control_ETR07.Torque_Control_ETR07_P.Saturation_LowerSat_j Torque_Control_ETR07.Torque_Control_ETR07_P.Saturation_UpperSat Torque_Control_ETR07.Torque_Control_ETR07_P.Saturation_UpperSat_c Torque_Control_ETR07.Torque_Control_ETR07_P.Saturation_UpperSat_f Torque_Control_ETR07.Torque_Control_ETR07_P.Saturation_UpperSat_g Torque_Control_ETR07.Torque_Control_ETR07_P.Saturation_UpperSat_h Torque_Control_ETR07.Torque_Control_ETR07_P.Saturation_UpperSat_i Torque_Control_ETR07.Torque_Control_ETR07_P.Saturation_UpperSat_k Torque_Control_ETR07.Torque_Control_ETR07_P.Spin_n.Constant_Value Torque_Control_ETR07.Torque_Control_ETR07_P.Spin_n.Switch_Threshold Torque_Control_ETR07.Torque_Control_ETR07_P.SteeringWheelMaximumAngle_Val_i Torque_Control_ETR07.Torque_Control_ETR07_P.SteeringWheelMaximumAngle_Val_o Torque_Control_ETR07.Torque_Control_ETR07_P.SteeringWheelMaximumAngle_Value Torque_Control_ETR07.Torque_Control_ETR07_P.SteeringWheelSaturationpersited Torque_Control_ETR07.Torque_Control_ETR07_P.Steering_Ratio_Value Torque_Control_ETR07.Torque_Control_ETR07_P.Switch_Threshold Torque_Control_ETR07.Torque_Control_ETR07_P.Switch_Threshold_a Torque_Control_ETR07.Torque_Control_ETR07_P.Switch_Threshold_b Torque_Control_ETR07.Torque_Control_ETR07_P.Switch_Threshold_e Torque_Control_ETR07.Torque_Control_ETR07_P.Switch_Threshold_f Torque_Control_ETR07.Torque_Control_ETR07_P.Switch_Threshold_g Torque_Control_ETR07.Torque_Control_ETR07_P.TEMP_LIMIT_LOWER_Value Torque_Control_ETR07.Torque_Control_ETR07_P.TEMP_LIMIT_UPPER_Value Torque_Control_ETR07.Torque_Control_ETR07_P.Temp_LIMIT.TEMP_LIMIT_Value Torque_Control_ETR07.Torque_Control_ETR07_P.Torque_RLNm_Value Torque_Control_ETR07.Torque_Control_ETR07_P.Torque_RRNm_Value Torque_Control_ETR07.Torque_Control_ETR07_P.Tq_diff_Max_Value Torque_Control_ETR07.Torque_Control_ETR07_P.Tq_diff_maxNm_Value Torque_Control_ETR07.Torque_Control_ETR07_P.Tq_maxNm_Value Torque_Control_ETR07.Torque_Control_ETR07_P.TransmisionRatio_Value Torque_Control_ETR07.Torque_Control_ETR07_P.TransmisionRatio_Value_j Torque_Control_ETR07.Torque_Control_ETR07_P.Wheelbasem_Value Torque_Control_ETR07.Torque_Control_ETR07_P.Yaw_Inertiakgm3_Value Torque_Control_ETR07.Torque_Control_ETR07_P.Zero_Value Torque_Control_ETR07.Torque_Control_ETR07_P.Zero_Value_c Torque_Control_ETR07.Torque_Control_ETR07_P.Zero_Value_p Torque_Control_ETR07.Torque_Control_ETR07_P.ct_Value Torque_Control_ETR07.Torque_Control_ETR07_P.exptcycletau1_Value Torque_Control_ETR07.Torque_Control_ETR07_P.halfrange_Value Torque_Control_ETR07.Torque_Control_ETR07_P.inchtom_Gain Torque_Control_ETR07.Torque_Control_ETR07_P.inchtom_Gain_g Torque_Control_ETR07.Torque_Control_ETR07_P.range_Value Torque_Control_ETR07.Torque_Control_ETR07_P.rpm_Value Torque_Control_ETR07.Torque_Control_ETR07_P.rpm_Value_k Torque_Control_ETR07.Torque_Control_ETR07_P.u602pi_Gain Torque_Control_ETR07.Torque_Control_ETR07_P.u602pi_Gain_g Torque_Control_ETR07.Torque_Control_ETR07_P.udifference_Gain Torque_Control_ETR07.Torque_Control_ETR07_P.udifference_Gain_d Torque_Control_ETR07.Torque_Control_ETR07_P.zero_Value /end REF_CHARACTERISTIC
/end GROUP
/begin GROUP Torque_Control_ETR07.Torque_Control_ETR07_P.Nospin_k ""
 /begin REF_CHARACTERISTIC Torque_Control_ETR07.Torque_Control_ETR07_P.Nospin_k.Switch_Threshold /end REF_CHARACTERISTIC
/end GROUP
/begin GROUP Torque_Control_ETR07.Torque_Control_ETR07_P.Spin_n ""
 /begin REF_CHARACTERISTIC Torque_Control_ETR07.Torque_Control_ETR07_P.Spin_n.Constant_Value Torque_Control_ETR07.Torque_Control_ETR07_P.Spin_n.Switch_Threshold /end REF_CHARACTERISTIC
/end GROUP
/begin GROUP Torque_Control_ETR07.Torque_Control_ETR07_P.Temp_LIMIT ""
 /begin REF_CHARACTERISTIC Torque_Control_ETR07.Torque_Control_ETR07_P.Temp_LIMIT.TEMP_LIMIT_Value /end REF_CHARACTERISTIC
/end GROUP
/end MODULE
/end PROJECT
