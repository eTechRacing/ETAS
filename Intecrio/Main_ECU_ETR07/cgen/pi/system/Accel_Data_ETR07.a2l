ASAP2_VERSION
/begin PROJECT "Generated by ETAS from INTECRIO integration project"
/begin HEADER "" VERSION "" PROJECT_NO Y /end HEADER
/begin MODULE Accel_Data_ETR07 "Generated by ETAS from INTECRIO integration project"
/begin MOD_PAR "" VERSION "" ADDR_EPK 0x0 EPK "" SUPPLIER "ETAS GmbH" CUSTOMER "" CUSTOMER_NO "" USER "" PHONE_NO "" ECU "NO_ECU" CPU_TYPE "MPC750" NO_OF_INTERFACES 1 /end MOD_PAR
/begin MOD_COMMON "Common definitions" BYTE_ORDER MSB_FIRST ALIGNMENT_BYTE 1 ALIGNMENT_WORD 2 ALIGNMENT_LONG 4 ALIGNMENT_FLOAT32_IEEE 4 ALIGNMENT_FLOAT64_IEEE 8 /end MOD_COMMON
/begin MEASUREMENT Accel_Data_ETR07_B.AccDataConversionFX.Gain "" FLOAT64_IEEE Accel_Data_ETR07_CM_double 0 0 -1.7e+308 1.7e+308 ECU_ADDRESS 0x0 DISPLAY_IDENTIFIER Accel_Data_ETR07.Acc_Data_Conversion_F_X.Gain.Gain /end MEASUREMENT
/begin COMPU_METHOD Accel_Data_ETR07_CM_double "Q = V" /* ConversionType */ RAT_FUNC /* Format */ "%9.6" /* Unit */ "NO_PHYSICAL_QTY" COEFFS 0.0 1.0 0.0 0.0 0.0 1.0 /end COMPU_METHOD
/begin MEASUREMENT Accel_Data_ETR07_B.AccDataConversionFY.Gain "" FLOAT64_IEEE Accel_Data_ETR07_CM_double 0 0 -1.7e+308 1.7e+308 ECU_ADDRESS 0x0 DISPLAY_IDENTIFIER Accel_Data_ETR07.Acc_Data_Conversion_F_Y.Gain.Gain /end MEASUREMENT
/begin MEASUREMENT Accel_Data_ETR07_B.AccDataConversionFZ.Gain "" FLOAT64_IEEE Accel_Data_ETR07_CM_double 0 0 -1.7e+308 1.7e+308 ECU_ADDRESS 0x0 DISPLAY_IDENTIFIER Accel_Data_ETR07.Acc_Data_Conversion_F_Z.Gain.Gain /end MEASUREMENT
/begin MEASUREMENT Accel_Data_ETR07_B.AccDataConversionRX.Gain "" FLOAT64_IEEE Accel_Data_ETR07_CM_double 0 0 -1.7e+308 1.7e+308 ECU_ADDRESS 0x0 DISPLAY_IDENTIFIER Accel_Data_ETR07.Acc_Data_Conversion_R_X.Gain.Gain /end MEASUREMENT
/begin MEASUREMENT Accel_Data_ETR07_B.AccDataConversionRY.Gain "" FLOAT64_IEEE Accel_Data_ETR07_CM_double 0 0 -1.7e+308 1.7e+308 ECU_ADDRESS 0x0 DISPLAY_IDENTIFIER Accel_Data_ETR07.Acc_Data_Conversion_R_Y.Gain.Gain /end MEASUREMENT
/begin MEASUREMENT Accel_Data_ETR07_B.AccDataConversionRZ.Gain "" FLOAT64_IEEE Accel_Data_ETR07_CM_double 0 0 -1.7e+308 1.7e+308 ECU_ADDRESS 0x0 DISPLAY_IDENTIFIER Accel_Data_ETR07.Acc_Data_Conversion_R_Z.Gain.Gain /end MEASUREMENT
/begin MEASUREMENT Accel_Data_ETR07_B.LowPass.Gain "" FLOAT64_IEEE Accel_Data_ETR07_CM_double 0 0 -1.7e+308 1.7e+308 ECU_ADDRESS 0x0 DISPLAY_IDENTIFIER Accel_Data_ETR07.Low_Pass.Gain.Gain /end MEASUREMENT
/begin MEASUREMENT Accel_Data_ETR07_B.LowPass1.Gain "" FLOAT64_IEEE Accel_Data_ETR07_CM_double 0 0 -1.7e+308 1.7e+308 ECU_ADDRESS 0x0 DISPLAY_IDENTIFIER Accel_Data_ETR07.Low_Pass1.Gain.Gain /end MEASUREMENT
/begin MEASUREMENT Accel_Data_ETR07_B.LowPass2.Gain "" FLOAT64_IEEE Accel_Data_ETR07_CM_double 0 0 -1.7e+308 1.7e+308 ECU_ADDRESS 0x0 DISPLAY_IDENTIFIER Accel_Data_ETR07.Low_Pass2.Gain.Gain /end MEASUREMENT
/begin MEASUREMENT Accel_Data_ETR07_DW.A "" FLOAT64_IEEE Accel_Data_ETR07_CM_double 0 0 -1.7e+308 1.7e+308 ECU_ADDRESS 0x0 DISPLAY_IDENTIFIER Accel_Data_ETR07.Gyro_Data_Conversion_R_Z.Data_Store_Memory.A /end MEASUREMENT
/begin MEASUREMENT Accel_Data_ETR07_DW.A_f "" FLOAT64_IEEE Accel_Data_ETR07_CM_double 0 0 -1.7e+308 1.7e+308 ECU_ADDRESS 0x0 DISPLAY_IDENTIFIER Accel_Data_ETR07.Gyro_Data_Conversion_F_Z.Data_Store_Memory.A_f /end MEASUREMENT
/begin CHARACTERISTIC Accel_Data_ETR07_P.CycleTime_Gain "" VALUE 0x0 SCALAR_FLOAT64_IEEE 3.5e+305 Accel_Data_ETR07_CM_double -1.7e+308 1.7e+308 DISPLAY_IDENTIFIER Accel_Data_ETR07.Gyro_Data_Conversion_F_Z.Cycle_Time.Gain /end CHARACTERISTIC
/begin RECORD_LAYOUT SCALAR_FLOAT64_IEEE FNC_VALUES 1 FLOAT64_IEEE COLUMN_DIR DIRECT /end RECORD_LAYOUT
/begin CHARACTERISTIC Accel_Data_ETR07_P.CycleTime_Gain_h "" VALUE 0x0 SCALAR_FLOAT64_IEEE 3.5e+305 Accel_Data_ETR07_CM_double -1.7e+308 1.7e+308 DISPLAY_IDENTIFIER Accel_Data_ETR07.Gyro_Data_Conversion_R_Z.Cycle_Time.Gain /end CHARACTERISTIC
/begin CHARACTERISTIC Accel_Data_ETR07_P.DataStoreMemory_InitialValue "" VALUE 0x0 SCALAR_FLOAT64_IEEE 3.5e+305 Accel_Data_ETR07_CM_double -1.7e+308 1.7e+308 DISPLAY_IDENTIFIER Accel_Data_ETR07.Gyro_Data_Conversion_F_Z.Data_Store_Memory.InitialValue /end CHARACTERISTIC
/begin CHARACTERISTIC Accel_Data_ETR07_P.DataStoreMemory_InitialValue_m "" VALUE 0x0 SCALAR_FLOAT64_IEEE 3.5e+305 Accel_Data_ETR07_CM_double -1.7e+308 1.7e+308 DISPLAY_IDENTIFIER Accel_Data_ETR07.Gyro_Data_Conversion_R_Z.Data_Store_Memory.InitialValue /end CHARACTERISTIC
/begin CHARACTERISTIC Accel_Data_ETR07_P.ExperimentalOffset_Value "" VALUE 0x0 SCALAR_FLOAT64_IEEE 3.5e+305 Accel_Data_ETR07_CM_double -1.7e+308 1.7e+308 DISPLAY_IDENTIFIER Accel_Data_ETR07.Gyro_Data_Conversion_F_Z.Experimental_Offset.Value /end CHARACTERISTIC
/begin CHARACTERISTIC Accel_Data_ETR07_P.ExperimentalOffset_Value_e "" VALUE 0x0 SCALAR_FLOAT64_IEEE 3.5e+305 Accel_Data_ETR07_CM_double -1.7e+308 1.7e+308 DISPLAY_IDENTIFIER Accel_Data_ETR07.Gyro_Data_Conversion_R_Z.Experimental_Offset.Value /end CHARACTERISTIC
/begin CHARACTERISTIC Accel_Data_ETR07_P.Gain2_Gain "" VALUE 0x0 SCALAR_FLOAT64_IEEE 3.5e+305 Accel_Data_ETR07_CM_double -1.7e+308 1.7e+308 DISPLAY_IDENTIFIER Accel_Data_ETR07.Gain2.Gain /end CHARACTERISTIC
/begin CHARACTERISTIC Accel_Data_ETR07_P.Gain4_Gain "" VALUE 0x0 SCALAR_FLOAT64_IEEE 3.5e+305 Accel_Data_ETR07_CM_double -1.7e+308 1.7e+308 DISPLAY_IDENTIFIER Accel_Data_ETR07.Gain4.Gain /end CHARACTERISTIC
/begin CHARACTERISTIC Accel_Data_ETR07_P.RpsLSB_Value "" VALUE 0x0 SCALAR_FLOAT64_IEEE 3.5e+305 Accel_Data_ETR07_CM_double -1.7e+308 1.7e+308 DISPLAY_IDENTIFIER Accel_Data_ETR07.Gyro_Data_Conversion_R_Z.Rps__LSB.Value /end CHARACTERISTIC
/begin CHARACTERISTIC Accel_Data_ETR07_P.sbit_Value "" VALUE 0x0 SCALAR_FLOAT64_IEEE 3.5e+305 Accel_Data_ETR07_CM_double -1.7e+308 1.7e+308 DISPLAY_IDENTIFIER Accel_Data_ETR07.Gyro_Data_Conversion_F_Z.___s___bit.Value /end CHARACTERISTIC
/begin MEASUREMENT Accel_Data_ETR07_U.ACCEL_F_X "" FLOAT64_IEEE Accel_Data_ETR07_CM_double 0 0 -1.7e+308 1.7e+308 ECU_ADDRESS 0x0 DISPLAY_IDENTIFIER Accel_Data_ETR07.ACCEL_F_X /end MEASUREMENT
/begin MEASUREMENT Accel_Data_ETR07_U.ACCEL_F_Y "" FLOAT64_IEEE Accel_Data_ETR07_CM_double 0 0 -1.7e+308 1.7e+308 ECU_ADDRESS 0x0 DISPLAY_IDENTIFIER Accel_Data_ETR07.ACCEL_F_Y /end MEASUREMENT
/begin MEASUREMENT Accel_Data_ETR07_U.ACCEL_F_Z "" FLOAT64_IEEE Accel_Data_ETR07_CM_double 0 0 -1.7e+308 1.7e+308 ECU_ADDRESS 0x0 DISPLAY_IDENTIFIER Accel_Data_ETR07.ACCEL_F_Z /end MEASUREMENT
/begin MEASUREMENT Accel_Data_ETR07_U.ACCEL_R_X "" FLOAT64_IEEE Accel_Data_ETR07_CM_double 0 0 -1.7e+308 1.7e+308 ECU_ADDRESS 0x0 DISPLAY_IDENTIFIER Accel_Data_ETR07.ACCEL_R_X /end MEASUREMENT
/begin MEASUREMENT Accel_Data_ETR07_U.ACCEL_R_Y "" FLOAT64_IEEE Accel_Data_ETR07_CM_double 0 0 -1.7e+308 1.7e+308 ECU_ADDRESS 0x0 DISPLAY_IDENTIFIER Accel_Data_ETR07.ACCEL_R_Y /end MEASUREMENT
/begin MEASUREMENT Accel_Data_ETR07_U.ACCEL_R_Z "" FLOAT64_IEEE Accel_Data_ETR07_CM_double 0 0 -1.7e+308 1.7e+308 ECU_ADDRESS 0x0 DISPLAY_IDENTIFIER Accel_Data_ETR07.ACCEL_R_Z /end MEASUREMENT
/begin MEASUREMENT Accel_Data_ETR07_U.Gyroscope_F "" FLOAT64_IEEE Accel_Data_ETR07_CM_double 0 0 -1.7e+308 1.7e+308 ECU_ADDRESS 0x0 DISPLAY_IDENTIFIER Accel_Data_ETR07.Gyroscope_F /end MEASUREMENT
/begin MEASUREMENT Accel_Data_ETR07_U.Gyroscope_R "" FLOAT64_IEEE Accel_Data_ETR07_CM_double 0 0 -1.7e+308 1.7e+308 ECU_ADDRESS 0x0 DISPLAY_IDENTIFIER Accel_Data_ETR07.Gyroscope_R /end MEASUREMENT
/begin MEASUREMENT Accel_Data_ETR07_Y.Accel_F_X_SI "" FLOAT64_IEEE Accel_Data_ETR07_CM_double 0 0 -1.7e+308 1.7e+308 ECU_ADDRESS 0x0 DISPLAY_IDENTIFIER Accel_Data_ETR07.Accel_F_X_SI /end MEASUREMENT
/begin MEASUREMENT Accel_Data_ETR07_Y.Accel_F_Y_SI "" FLOAT64_IEEE Accel_Data_ETR07_CM_double 0 0 -1.7e+308 1.7e+308 ECU_ADDRESS 0x0 DISPLAY_IDENTIFIER Accel_Data_ETR07.Accel_F_Y_SI /end MEASUREMENT
/begin MEASUREMENT Accel_Data_ETR07_Y.Accel_F_Z_SI "" FLOAT64_IEEE Accel_Data_ETR07_CM_double 0 0 -1.7e+308 1.7e+308 ECU_ADDRESS 0x0 DISPLAY_IDENTIFIER Accel_Data_ETR07.Accel_F_Z_SI /end MEASUREMENT
/begin MEASUREMENT Accel_Data_ETR07_Y.Accel_R_X_SI "" FLOAT64_IEEE Accel_Data_ETR07_CM_double 0 0 -1.7e+308 1.7e+308 ECU_ADDRESS 0x0 DISPLAY_IDENTIFIER Accel_Data_ETR07.Accel_R_X_SI /end MEASUREMENT
/begin MEASUREMENT Accel_Data_ETR07_Y.Accel_R_Y_SI "" FLOAT64_IEEE Accel_Data_ETR07_CM_double 0 0 -1.7e+308 1.7e+308 ECU_ADDRESS 0x0 DISPLAY_IDENTIFIER Accel_Data_ETR07.Accel_R_Y_SI /end MEASUREMENT
/begin MEASUREMENT Accel_Data_ETR07_Y.Accel_R_Z_SI "" FLOAT64_IEEE Accel_Data_ETR07_CM_double 0 0 -1.7e+308 1.7e+308 ECU_ADDRESS 0x0 DISPLAY_IDENTIFIER Accel_Data_ETR07.Accel_R_Z_SI /end MEASUREMENT
/begin MEASUREMENT Accel_Data_ETR07_Y.Gyro_F_Z_Deg "" FLOAT64_IEEE Accel_Data_ETR07_CM_double 0 0 -1.7e+308 1.7e+308 ECU_ADDRESS 0x0 DISPLAY_IDENTIFIER Accel_Data_ETR07.Gyro_F_Z_Deg /end MEASUREMENT
/begin MEASUREMENT Accel_Data_ETR07_Y.Gyro_R_Z_Deg "" FLOAT64_IEEE Accel_Data_ETR07_CM_double 0 0 -1.7e+308 1.7e+308 ECU_ADDRESS 0x0 DISPLAY_IDENTIFIER Accel_Data_ETR07.Gyro_R_Z_Deg /end MEASUREMENT
/begin MEASUREMENT Accel_Data_ETR07_Y.Rate_F_Z_Degs2 "" FLOAT64_IEEE Accel_Data_ETR07_CM_double 0 0 -1.7e+308 1.7e+308 ECU_ADDRESS 0x0 DISPLAY_IDENTIFIER Accel_Data_ETR07.Rate_F_Z_Deg_s2 /end MEASUREMENT
/begin MEASUREMENT Accel_Data_ETR07_Y.Rate_R_Z_Degs "" FLOAT64_IEEE Accel_Data_ETR07_CM_double 0 0 -1.7e+308 1.7e+308 ECU_ADDRESS 0x0 DISPLAY_IDENTIFIER Accel_Data_ETR07.Rate_R_Z_Deg_s /end MEASUREMENT
/end MODULE
/* Accel_Data_ETR07 */
/end PROJECT
