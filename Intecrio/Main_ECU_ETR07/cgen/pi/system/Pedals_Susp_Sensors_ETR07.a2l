ASAP2_VERSION
/begin PROJECT "Generated by ETAS from INTECRIO integration project"
/begin HEADER "" VERSION "" PROJECT_NO Y /end HEADER
/begin MODULE Pedals_Susp_Sensors_ETR07 "Generated by ETAS from INTECRIO integration project"
/begin MOD_PAR "" VERSION "" ADDR_EPK 0x0 EPK "" SUPPLIER "ETAS GmbH" CUSTOMER "" CUSTOMER_NO "" USER "" PHONE_NO "" ECU "NO_ECU" CPU_TYPE "MPC750" NO_OF_INTERFACES 1 /end MOD_PAR
/begin MOD_COMMON "Common definitions" BYTE_ORDER MSB_FIRST ALIGNMENT_BYTE 1 ALIGNMENT_WORD 2 ALIGNMENT_LONG 4 ALIGNMENT_FLOAT32_IEEE 4 ALIGNMENT_FLOAT64_IEEE 8 /end MOD_COMMON
/begin CHARACTERISTIC Pedals_Susp_Sensors_ETR07_P.Brake_Light_Threshold_Value "" VALUE 0x0 SCALAR_FLOAT64_IEEE 3.5e+305 Pedals_Susp_Sensors_ETR07_CM_double -1.7e+308 1.7e+308 DISPLAY_IDENTIFIER Pedals_Susp_Sensors_ETR07.Brake_Light.Brake_Light_Threshold.Value /end CHARACTERISTIC
/begin RECORD_LAYOUT SCALAR_FLOAT64_IEEE FNC_VALUES 1 FLOAT64_IEEE COLUMN_DIR DIRECT /end RECORD_LAYOUT
/begin COMPU_METHOD Pedals_Susp_Sensors_ETR07_CM_double "Q = V" /* ConversionType */ RAT_FUNC /* Format */ "%9.6" /* Unit */ "NO_PHYSICAL_QTY" COEFFS 0.0 1.0 0.0 0.0 0.0 1.0 /end COMPU_METHOD
/begin CHARACTERISTIC Pedals_Susp_Sensors_ETR07_P.Ctemuelles_Gain "" VALUE 0x0 SCALAR_FLOAT64_IEEE 3.5e+305 Pedals_Susp_Sensors_ETR07_CM_double -1.7e+308 1.7e+308 DISPLAY_IDENTIFIER Pedals_Susp_Sensors_ETR07.Suspension_FL_Data_Conv.Cte_muelles.Gain /end CHARACTERISTIC
/begin CHARACTERISTIC Pedals_Susp_Sensors_ETR07_P.Ctemuelles_Gain_e "" VALUE 0x0 SCALAR_FLOAT64_IEEE 3.5e+305 Pedals_Susp_Sensors_ETR07_CM_double -1.7e+308 1.7e+308 DISPLAY_IDENTIFIER Pedals_Susp_Sensors_ETR07.Suspension_FR_Data_Conv.Cte_muelles.Gain /end CHARACTERISTIC
/begin CHARACTERISTIC Pedals_Susp_Sensors_ETR07_P.Ctemuelles_Gain_f "" VALUE 0x0 SCALAR_FLOAT64_IEEE 3.5e+305 Pedals_Susp_Sensors_ETR07_CM_double -1.7e+308 1.7e+308 DISPLAY_IDENTIFIER Pedals_Susp_Sensors_ETR07.Suspension_RR_Data_Conv.Cte_muelles.Gain /end CHARACTERISTIC
/begin CHARACTERISTIC Pedals_Susp_Sensors_ETR07_P.Ctemuelles_Gain_j "" VALUE 0x0 SCALAR_FLOAT64_IEEE 3.5e+305 Pedals_Susp_Sensors_ETR07_CM_double -1.7e+308 1.7e+308 DISPLAY_IDENTIFIER Pedals_Susp_Sensors_ETR07.Suspension_RL_Data_Conv.Cte_muelles.Gain /end CHARACTERISTIC
/begin CHARACTERISTIC Pedals_Susp_Sensors_ETR07_P.Experimental_Zero_Value "" VALUE 0x0 SCALAR_FLOAT64_IEEE 3.5e+305 Pedals_Susp_Sensors_ETR07_CM_double -1.7e+308 1.7e+308 DISPLAY_IDENTIFIER Pedals_Susp_Sensors_ETR07.Suspension_FL_Data_Conv.Experimental_Zero.Value /end CHARACTERISTIC
/begin CHARACTERISTIC Pedals_Susp_Sensors_ETR07_P.Experimental_Zero_Value_a "" VALUE 0x0 SCALAR_FLOAT64_IEEE 3.5e+305 Pedals_Susp_Sensors_ETR07_CM_double -1.7e+308 1.7e+308 DISPLAY_IDENTIFIER Pedals_Susp_Sensors_ETR07.Suspension_RR_Data_Conv.Experimental_Zero.Value /end CHARACTERISTIC
/begin CHARACTERISTIC Pedals_Susp_Sensors_ETR07_P.Experimental_Zero_Value_e "" VALUE 0x0 SCALAR_FLOAT64_IEEE 3.5e+305 Pedals_Susp_Sensors_ETR07_CM_double -1.7e+308 1.7e+308 DISPLAY_IDENTIFIER Pedals_Susp_Sensors_ETR07.Suspension_FR_Data_Conv.Experimental_Zero.Value /end CHARACTERISTIC
/begin CHARACTERISTIC Pedals_Susp_Sensors_ETR07_P.Experimental_Zero_Value_f "" VALUE 0x0 SCALAR_FLOAT64_IEEE 3.5e+305 Pedals_Susp_Sensors_ETR07_CM_double -1.7e+308 1.7e+308 DISPLAY_IDENTIFIER Pedals_Susp_Sensors_ETR07.Suspension_RL_Data_Conv.Experimental_Zero.Value /end CHARACTERISTIC
/begin CHARACTERISTIC Pedals_Susp_Sensors_ETR07_P.Ltotal_Gain "" VALUE 0x0 SCALAR_FLOAT64_IEEE 3.5e+305 Pedals_Susp_Sensors_ETR07_CM_double -1.7e+308 1.7e+308 DISPLAY_IDENTIFIER Pedals_Susp_Sensors_ETR07.Suspension_FL_Data_Conv.Ltotal.Gain /end CHARACTERISTIC
/begin CHARACTERISTIC Pedals_Susp_Sensors_ETR07_P.Ltotal_Gain_c "" VALUE 0x0 SCALAR_FLOAT64_IEEE 3.5e+305 Pedals_Susp_Sensors_ETR07_CM_double -1.7e+308 1.7e+308 DISPLAY_IDENTIFIER Pedals_Susp_Sensors_ETR07.Suspension_FR_Data_Conv.Ltotal.Gain /end CHARACTERISTIC
/begin CHARACTERISTIC Pedals_Susp_Sensors_ETR07_P.Ltotal_Gain_d "" VALUE 0x0 SCALAR_FLOAT64_IEEE 3.5e+305 Pedals_Susp_Sensors_ETR07_CM_double -1.7e+308 1.7e+308 DISPLAY_IDENTIFIER Pedals_Susp_Sensors_ETR07.Suspension_RL_Data_Conv.Ltotal.Gain /end CHARACTERISTIC
/begin CHARACTERISTIC Pedals_Susp_Sensors_ETR07_P.Ltotal_Gain_e "" VALUE 0x0 SCALAR_FLOAT64_IEEE 3.5e+305 Pedals_Susp_Sensors_ETR07_CM_double -1.7e+308 1.7e+308 DISPLAY_IDENTIFIER Pedals_Susp_Sensors_ETR07.Suspension_RR_Data_Conv.Ltotal.Gain /end CHARACTERISTIC
/begin CHARACTERISTIC Pedals_Susp_Sensors_ETR07_P.ON_Value "" VALUE 0x0 SCALAR_FLOAT64_IEEE 3.5e+305 Pedals_Susp_Sensors_ETR07_CM_double -1.7e+308 1.7e+308 DISPLAY_IDENTIFIER Pedals_Susp_Sensors_ETR07.Brake_Light.Brake_Light_ON.ON.Value /end CHARACTERISTIC
/begin CHARACTERISTIC Pedals_Susp_Sensors_ETR07_P.Off_Value "" VALUE 0x0 SCALAR_FLOAT64_IEEE 3.5e+305 Pedals_Susp_Sensors_ETR07_CM_double -1.7e+308 1.7e+308 DISPLAY_IDENTIFIER Pedals_Susp_Sensors_ETR07.Brake_Light.Brake_Light_OFF.Off.Value /end CHARACTERISTIC
/begin CHARACTERISTIC Pedals_Susp_Sensors_ETR07_P.bitsmax_Value "" VALUE 0x0 SCALAR_FLOAT64_IEEE 3.5e+305 Pedals_Susp_Sensors_ETR07_CM_double -1.7e+308 1.7e+308 DISPLAY_IDENTIFIER Pedals_Susp_Sensors_ETR07.Suspension_FL_Data_Conv.bitsmax.Value /end CHARACTERISTIC
/begin CHARACTERISTIC Pedals_Susp_Sensors_ETR07_P.bitsmax_Value_e "" VALUE 0x0 SCALAR_FLOAT64_IEEE 3.5e+305 Pedals_Susp_Sensors_ETR07_CM_double -1.7e+308 1.7e+308 DISPLAY_IDENTIFIER Pedals_Susp_Sensors_ETR07.Suspension_FR_Data_Conv.bitsmax.Value /end CHARACTERISTIC
/begin CHARACTERISTIC Pedals_Susp_Sensors_ETR07_P.bitsmax_Value_g "" VALUE 0x0 SCALAR_FLOAT64_IEEE 3.5e+305 Pedals_Susp_Sensors_ETR07_CM_double -1.7e+308 1.7e+308 DISPLAY_IDENTIFIER Pedals_Susp_Sensors_ETR07.Suspension_RL_Data_Conv.bitsmax.Value /end CHARACTERISTIC
/begin CHARACTERISTIC Pedals_Susp_Sensors_ETR07_P.bitsmax_Value_n "" VALUE 0x0 SCALAR_FLOAT64_IEEE 3.5e+305 Pedals_Susp_Sensors_ETR07_CM_double -1.7e+308 1.7e+308 DISPLAY_IDENTIFIER Pedals_Susp_Sensors_ETR07.Suspension_RR_Data_Conv.bitsmax.Value /end CHARACTERISTIC
/begin CHARACTERISTIC Pedals_Susp_Sensors_ETR07_P.max_Value "" VALUE 0x0 SCALAR_FLOAT64_IEEE 3.5e+305 Pedals_Susp_Sensors_ETR07_CM_double -1.7e+308 1.7e+308 DISPLAY_IDENTIFIER Pedals_Susp_Sensors_ETR07.BRS_Data_Conv.max.Value /end CHARACTERISTIC
/begin CHARACTERISTIC Pedals_Susp_Sensors_ETR07_P.max_Value_a "" VALUE 0x0 SCALAR_FLOAT64_IEEE 3.5e+305 Pedals_Susp_Sensors_ETR07_CM_double -1.7e+308 1.7e+308 DISPLAY_IDENTIFIER Pedals_Susp_Sensors_ETR07.APPS2_Data_Conv.max.Value /end CHARACTERISTIC
/begin CHARACTERISTIC Pedals_Susp_Sensors_ETR07_P.max_Value_f "" VALUE 0x0 SCALAR_FLOAT64_IEEE 3.5e+305 Pedals_Susp_Sensors_ETR07_CM_double -1.7e+308 1.7e+308 DISPLAY_IDENTIFIER Pedals_Susp_Sensors_ETR07.APPS1_Data_Conv.max.Value /end CHARACTERISTIC
/begin CHARACTERISTIC Pedals_Susp_Sensors_ETR07_P.min_Value "" VALUE 0x0 SCALAR_FLOAT64_IEEE 3.5e+305 Pedals_Susp_Sensors_ETR07_CM_double -1.7e+308 1.7e+308 DISPLAY_IDENTIFIER Pedals_Susp_Sensors_ETR07.BRS_Data_Conv.min.Value /end CHARACTERISTIC
/begin CHARACTERISTIC Pedals_Susp_Sensors_ETR07_P.min_Value_a "" VALUE 0x0 SCALAR_FLOAT64_IEEE 3.5e+305 Pedals_Susp_Sensors_ETR07_CM_double -1.7e+308 1.7e+308 DISPLAY_IDENTIFIER Pedals_Susp_Sensors_ETR07.APPS1_Data_Conv.min.Value /end CHARACTERISTIC
/begin CHARACTERISTIC Pedals_Susp_Sensors_ETR07_P.min_Value_g "" VALUE 0x0 SCALAR_FLOAT64_IEEE 3.5e+305 Pedals_Susp_Sensors_ETR07_CM_double -1.7e+308 1.7e+308 DISPLAY_IDENTIFIER Pedals_Susp_Sensors_ETR07.APPS2_Data_Conv.min.Value /end CHARACTERISTIC
/begin MEASUREMENT Pedals_Susp_Sensors_ETR07_U.APPS1_Bits "" FLOAT64_IEEE Pedals_Susp_Sensors_ETR07_CM_double 0 0 -1.7e+308 1.7e+308 ECU_ADDRESS 0x0 DISPLAY_IDENTIFIER Pedals_Susp_Sensors_ETR07.APPS1_Bits /end MEASUREMENT
/begin MEASUREMENT Pedals_Susp_Sensors_ETR07_U.APPS2_Bits "" FLOAT64_IEEE Pedals_Susp_Sensors_ETR07_CM_double 0 0 -1.7e+308 1.7e+308 ECU_ADDRESS 0x0 DISPLAY_IDENTIFIER Pedals_Susp_Sensors_ETR07.APPS2_Bits /end MEASUREMENT
/begin MEASUREMENT Pedals_Susp_Sensors_ETR07_U.BrakeSensor_Bits "" FLOAT64_IEEE Pedals_Susp_Sensors_ETR07_CM_double 0 0 -1.7e+308 1.7e+308 ECU_ADDRESS 0x0 DISPLAY_IDENTIFIER Pedals_Susp_Sensors_ETR07.BrakeSensor_Bits /end MEASUREMENT
/begin MEASUREMENT Pedals_Susp_Sensors_ETR07_U.Susp_F_L_Bits "" FLOAT64_IEEE Pedals_Susp_Sensors_ETR07_CM_double 0 0 -1.7e+308 1.7e+308 ECU_ADDRESS 0x0 DISPLAY_IDENTIFIER Pedals_Susp_Sensors_ETR07.Susp_F_L_Bits /end MEASUREMENT
/begin MEASUREMENT Pedals_Susp_Sensors_ETR07_U.Susp_F_R_Bits "" FLOAT64_IEEE Pedals_Susp_Sensors_ETR07_CM_double 0 0 -1.7e+308 1.7e+308 ECU_ADDRESS 0x0 DISPLAY_IDENTIFIER Pedals_Susp_Sensors_ETR07.Susp_F_R_Bits /end MEASUREMENT
/begin MEASUREMENT Pedals_Susp_Sensors_ETR07_U.Susp_R_L_Bits "" FLOAT64_IEEE Pedals_Susp_Sensors_ETR07_CM_double 0 0 -1.7e+308 1.7e+308 ECU_ADDRESS 0x0 DISPLAY_IDENTIFIER Pedals_Susp_Sensors_ETR07.Susp_R_L_Bits /end MEASUREMENT
/begin MEASUREMENT Pedals_Susp_Sensors_ETR07_U.Susp_R_R_Bits "" FLOAT64_IEEE Pedals_Susp_Sensors_ETR07_CM_double 0 0 -1.7e+308 1.7e+308 ECU_ADDRESS 0x0 DISPLAY_IDENTIFIER Pedals_Susp_Sensors_ETR07.Susp_R_R_Bits /end MEASUREMENT
/begin MEASUREMENT Pedals_Susp_Sensors_ETR07_Y.APPS1_Value "" FLOAT64_IEEE Pedals_Susp_Sensors_ETR07_CM_double 0 0 -1.7e+308 1.7e+308 ECU_ADDRESS 0x0 DISPLAY_IDENTIFIER Pedals_Susp_Sensors_ETR07.APPS1_Value /end MEASUREMENT
/begin MEASUREMENT Pedals_Susp_Sensors_ETR07_Y.APPS2_Value "" FLOAT64_IEEE Pedals_Susp_Sensors_ETR07_CM_double 0 0 -1.7e+308 1.7e+308 ECU_ADDRESS 0x0 DISPLAY_IDENTIFIER Pedals_Susp_Sensors_ETR07.APPS2_Value /end MEASUREMENT
/begin MEASUREMENT Pedals_Susp_Sensors_ETR07_Y.BrakeLight_Control "" FLOAT64_IEEE Pedals_Susp_Sensors_ETR07_CM_double 0 0 -1.7e+308 1.7e+308 ECU_ADDRESS 0x0 DISPLAY_IDENTIFIER Pedals_Susp_Sensors_ETR07.BrakeLight_Control /end MEASUREMENT
/begin MEASUREMENT Pedals_Susp_Sensors_ETR07_Y.BrakeSensor_Value "" FLOAT64_IEEE Pedals_Susp_Sensors_ETR07_CM_double 0 0 -1.7e+308 1.7e+308 ECU_ADDRESS 0x0 DISPLAY_IDENTIFIER Pedals_Susp_Sensors_ETR07.BrakeSensor_Value /end MEASUREMENT
/begin MEASUREMENT Pedals_Susp_Sensors_ETR07_Y.SUSP_F_L "" FLOAT64_IEEE Pedals_Susp_Sensors_ETR07_CM_double 0 0 -1.7e+308 1.7e+308 ECU_ADDRESS 0x0 DISPLAY_IDENTIFIER Pedals_Susp_Sensors_ETR07.SUSP_F_L /end MEASUREMENT
/begin MEASUREMENT Pedals_Susp_Sensors_ETR07_Y.SUSP_F_R "" FLOAT64_IEEE Pedals_Susp_Sensors_ETR07_CM_double 0 0 -1.7e+308 1.7e+308 ECU_ADDRESS 0x0 DISPLAY_IDENTIFIER Pedals_Susp_Sensors_ETR07.SUSP_F_R /end MEASUREMENT
/begin MEASUREMENT Pedals_Susp_Sensors_ETR07_Y.SUSP_R_L "" FLOAT64_IEEE Pedals_Susp_Sensors_ETR07_CM_double 0 0 -1.7e+308 1.7e+308 ECU_ADDRESS 0x0 DISPLAY_IDENTIFIER Pedals_Susp_Sensors_ETR07.SUSP_R_L /end MEASUREMENT
/begin MEASUREMENT Pedals_Susp_Sensors_ETR07_Y.SUSP_R_R "" FLOAT64_IEEE Pedals_Susp_Sensors_ETR07_CM_double 0 0 -1.7e+308 1.7e+308 ECU_ADDRESS 0x0 DISPLAY_IDENTIFIER Pedals_Susp_Sensors_ETR07.SUSP_R_R /end MEASUREMENT
/end MODULE
/* Pedals_Susp_Sensors_ETR07 */
/end PROJECT
