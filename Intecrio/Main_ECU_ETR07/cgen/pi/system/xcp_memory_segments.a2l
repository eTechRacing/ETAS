ASAP2_VERSION 1 41
/begin PROJECT PI_CORE_MEMSEG ""
/begin HEADER "" VERSION "" PROJECT_NO Y /end HEADER
/begin MODULE PI_CORE_MEMSEG ""
/begin MOD_PAR "" VERSION "" ADDR_EPK 0x0 EPK "" SUPPLIER "ETAS GmbH" CUSTOMER "" CUSTOMER_NO "" USER "" PHONE_NO "" ECU "NO_ECU" CPU_TYPE "" NO_OF_INTERFACES 1
 /begin MEMORY_SEGMENT Data "DATA" DATA FLASH EXTERN 0x20000000 0x0 -1 -1 -1 -1 -1
  /begin IF_DATA XCP
   /begin SEGMENT 0x00 /* segment logical number */ 0x01 /* number of pages */ 0x00 /* address extension */ 0x00 /* compression method */ 0x00 /* encryption method */ /begin CHECKSUM XCP_CRC_16_CITT /end CHECKSUM
    /begin PAGE 0x00 /* page number WP */ ECU_ACCESS_WITH_XCP_ONLY XCP_READ_ACCESS_WITH_ECU_ONLY XCP_WRITE_ACCESS_WITH_ECU_ONLY /end PAGE
   /end SEGMENT
  /end IF_DATA
 /end MEMORY_SEGMENT
 /begin MEMORY_SEGMENT EXRAM "EXRAM" VARIABLES RAM EXTERN 0x10000000 0x0 -1 -1 -1 -1 -1 /end MEMORY_SEGMENT
/end MOD_PAR
/end MODULE
/end PROJECT
