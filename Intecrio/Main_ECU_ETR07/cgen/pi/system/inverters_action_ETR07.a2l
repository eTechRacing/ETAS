ASAP2_VERSION
/begin PROJECT "Generated by ETAS from INTECRIO integration project"
/begin HEADER "" VERSION "" PROJECT_NO Y /end HEADER
/begin MODULE inverters_action_ETR07 "Generated by ETAS from INTECRIO integration project"
/begin MOD_PAR "" VERSION "" ADDR_EPK 0x0 EPK "" SUPPLIER "ETAS GmbH" CUSTOMER "" CUSTOMER_NO "" USER "" PHONE_NO "" ECU "NO_ECU" CPU_TYPE "MPC750" NO_OF_INTERFACES 1 /end MOD_PAR
/begin MOD_COMMON "Common definitions" BYTE_ORDER MSB_FIRST ALIGNMENT_BYTE 1 ALIGNMENT_WORD 2 ALIGNMENT_LONG 4 ALIGNMENT_FLOAT32_IEEE 4 ALIGNMENT_FLOAT64_IEEE 8 /end MOD_COMMON
/begin MEASUREMENT inverters_action_ETR07_B.Merge "" UBYTE inverters_action_ETR07_CM_boolean 0 0 0 1 ECU_ADDRESS 0x0 DISPLAY_IDENTIFIER inverters_action_ETR07.Merge.Merge /end MEASUREMENT
/begin COMPU_METHOD inverters_action_ETR07_CM_boolean "Q = V" RAT_FUNC "%9.6" "NO_PHYSICAL_QTY" COEFFS 0.0 1.0 0.0 0.0 0.0 1.0 /end COMPU_METHOD
/begin MEASUREMENT inverters_action_ETR07_B.Merge2 "" UBYTE inverters_action_ETR07_CM_uint8 0 0 0.0 255.0 ECU_ADDRESS 0x0 DISPLAY_IDENTIFIER inverters_action_ETR07.Subsystem9.Merge2.Merge2 /end MEASUREMENT
/begin COMPU_METHOD inverters_action_ETR07_CM_uint8 "Q = V" RAT_FUNC "%9.6" "NO_PHYSICAL_QTY" COEFFS 0.0 1.0 0.0 0.0 0.0 1.0 /end COMPU_METHOD
/begin MEASUREMENT inverters_action_ETR07_B.Merge2_p "" UBYTE inverters_action_ETR07_CM_uint8 0 0 0.0 255.0 ECU_ADDRESS 0x0 DISPLAY_IDENTIFIER inverters_action_ETR07.Subsystem10.Merge2.Merge2_p /end MEASUREMENT
/begin MEASUREMENT inverters_action_ETR07_B.subscribed "" UBYTE inverters_action_ETR07_CM_boolean 0 0 0 1 ECU_ADDRESS 0x0 DISPLAY_IDENTIFIER inverters_action_ETR07.Subsystem9.Unsubscribe__Subscribe.subscribed_.subscribed /end MEASUREMENT
/begin MEASUREMENT inverters_action_ETR07_B.subscribed_b "" UBYTE inverters_action_ETR07_CM_boolean 0 0 0 1 ECU_ADDRESS 0x0 DISPLAY_IDENTIFIER inverters_action_ETR07.Subsystem10.Unsubscribe__Subscribe.subscribed_.subscribed_b /end MEASUREMENT
/begin MEASUREMENT inverters_action_ETR07_DW.EnumerationCounter "" FLOAT64_IEEE inverters_action_ETR07_CM_double 0 0 -1.7e+308 1.7e+308 ECU_ADDRESS 0x0 DISPLAY_IDENTIFIER inverters_action_ETR07.Subsystem10.Data_Store_Memory2.EnumerationCounter /end MEASUREMENT
/begin COMPU_METHOD inverters_action_ETR07_CM_double "Q = V" RAT_FUNC "%9.6" "NO_PHYSICAL_QTY" COEFFS 0.0 1.0 0.0 0.0 0.0 1.0 /end COMPU_METHOD
/begin MEASUREMENT inverters_action_ETR07_DW.EnumerationCounter_m "" FLOAT64_IEEE inverters_action_ETR07_CM_double 0 0 -1.7e+308 1.7e+308 ECU_ADDRESS 0x0 DISPLAY_IDENTIFIER inverters_action_ETR07.Subsystem9.Data_Store_Memory2.EnumerationCounter_m /end MEASUREMENT
/begin MEASUREMENT inverters_action_ETR07_DW.LastAction "" FLOAT64_IEEE inverters_action_ETR07_CM_double 0 0 -1.7e+308 1.7e+308 ECU_ADDRESS 0x0 DISPLAY_IDENTIFIER inverters_action_ETR07.Subsystem10.Data_Store_Memory1.LastAction /end MEASUREMENT
/begin MEASUREMENT inverters_action_ETR07_DW.LastAction_k "" FLOAT64_IEEE inverters_action_ETR07_CM_double 0 0 -1.7e+308 1.7e+308 ECU_ADDRESS 0x0 DISPLAY_IDENTIFIER inverters_action_ETR07.Subsystem9.Data_Store_Memory1.LastAction_k /end MEASUREMENT
/begin CHARACTERISTIC inverters_action_ETR07_P.Constant_Value "" VALUE 0x0 SCALAR_UBYTE 255.0 inverters_action_ETR07_CM_uint8 0.0 255.0 DISPLAY_IDENTIFIER inverters_action_ETR07.Subsystem10.Unsubscribe__Subscribe.Constant.Value /end CHARACTERISTIC
/begin RECORD_LAYOUT SCALAR_UBYTE FNC_VALUES 1 UBYTE COLUMN_DIR DIRECT /end RECORD_LAYOUT
/begin CHARACTERISTIC inverters_action_ETR07_P.Constant_Value_m "" VALUE 0x0 SCALAR_UBYTE 255.0 inverters_action_ETR07_CM_uint8 0.0 255.0 DISPLAY_IDENTIFIER inverters_action_ETR07.Subsystem9.Unsubscribe__Subscribe.Constant.Value /end CHARACTERISTIC
/begin CHARACTERISTIC inverters_action_ETR07_P.DataStoreMemory1_InitialValue "" VALUE 0x0 SCALAR_FLOAT64_IEEE 3.5e+305 inverters_action_ETR07_CM_double -1.7e+308 1.7e+308 DISPLAY_IDENTIFIER inverters_action_ETR07.Subsystem10.Data_Store_Memory1.InitialValue /end CHARACTERISTIC
/begin RECORD_LAYOUT SCALAR_FLOAT64_IEEE FNC_VALUES 1 FLOAT64_IEEE COLUMN_DIR DIRECT /end RECORD_LAYOUT
/begin CHARACTERISTIC inverters_action_ETR07_P.DataStoreMemory1_InitialValue_m "" VALUE 0x0 SCALAR_FLOAT64_IEEE 3.5e+305 inverters_action_ETR07_CM_double -1.7e+308 1.7e+308 DISPLAY_IDENTIFIER inverters_action_ETR07.Subsystem9.Data_Store_Memory1.InitialValue /end CHARACTERISTIC
/begin CHARACTERISTIC inverters_action_ETR07_P.DataStoreMemory2_InitialValue "" VALUE 0x0 SCALAR_FLOAT64_IEEE 3.5e+305 inverters_action_ETR07_CM_double -1.7e+308 1.7e+308 DISPLAY_IDENTIFIER inverters_action_ETR07.Subsystem10.Data_Store_Memory2.InitialValue /end CHARACTERISTIC
/begin CHARACTERISTIC inverters_action_ETR07_P.DataStoreMemory2_InitialValue_c "" VALUE 0x0 SCALAR_FLOAT64_IEEE 3.5e+305 inverters_action_ETR07_CM_double -1.7e+308 1.7e+308 DISPLAY_IDENTIFIER inverters_action_ETR07.Subsystem9.Data_Store_Memory2.InitialValue /end CHARACTERISTIC
/begin CHARACTERISTIC inverters_action_ETR07_P.Delay_DelayLength "" VALUE 0x0 SCALAR_ULONG 4294967295.0 inverters_action_ETR07_CM_uint32 0.0 4294967295.0 DISPLAY_IDENTIFIER inverters_action_ETR07.Subsystem10.edge_detection.Delay.DelayLength /end CHARACTERISTIC
/begin RECORD_LAYOUT SCALAR_ULONG FNC_VALUES 1 ULONG COLUMN_DIR DIRECT /end RECORD_LAYOUT
/begin COMPU_METHOD inverters_action_ETR07_CM_uint32 "Q = V" RAT_FUNC "%9.6" "NO_PHYSICAL_QTY" COEFFS 0.0 1.0 0.0 0.0 0.0 1.0 /end COMPU_METHOD
/begin CHARACTERISTIC inverters_action_ETR07_P.Delay_DelayLength_h "" VALUE 0x0 SCALAR_ULONG 4294967295.0 inverters_action_ETR07_CM_uint32 0.0 4294967295.0 DISPLAY_IDENTIFIER inverters_action_ETR07.Subsystem9.edge_detection.Delay.DelayLength /end CHARACTERISTIC
/begin CHARACTERISTIC inverters_action_ETR07_P.Delay_InitialCondition "" VALUE 0x0 SCALAR_FLOAT64_IEEE 3.5e+305 inverters_action_ETR07_CM_double -1.7e+308 1.7e+308 DISPLAY_IDENTIFIER inverters_action_ETR07.Subsystem10.edge_detection.Delay.InitialCondition /end CHARACTERISTIC
/begin CHARACTERISTIC inverters_action_ETR07_P.Delay_InitialCondition_o "" VALUE 0x0 SCALAR_FLOAT64_IEEE 3.5e+305 inverters_action_ETR07_CM_double -1.7e+308 1.7e+308 DISPLAY_IDENTIFIER inverters_action_ETR07.Subsystem9.edge_detection.Delay.InitialCondition /end CHARACTERISTIC
/begin CHARACTERISTIC inverters_action_ETR07_P.Merge_InitialOutput "" VALUE 0x0 SCALAR_UBYTE 1.0 inverters_action_ETR07_CM_boolean 0 1 DISPLAY_IDENTIFIER inverters_action_ETR07.Merge.InitialOutput /end CHARACTERISTIC
/begin CHARACTERISTIC inverters_action_ETR07_P.TimeInterval_Value "" VALUE 0x0 SCALAR_UBYTE 255.0 inverters_action_ETR07_CM_uint8 0.0 255.0 DISPLAY_IDENTIFIER inverters_action_ETR07.Subsystem10.Unsubscribe__Subscribe.Subscribe.Time_Interval.Value /end CHARACTERISTIC
/begin CHARACTERISTIC inverters_action_ETR07_P.TimeInterval_Value_d "" VALUE 0x0 SCALAR_UBYTE 255.0 inverters_action_ETR07_CM_uint8 0.0 255.0 DISPLAY_IDENTIFIER inverters_action_ETR07.Subsystem9.Unsubscribe__Subscribe.Subscribe.Time_Interval.Value /end CHARACTERISTIC
/begin CHARACTERISTIC inverters_action_ETR07_P._Value "" VALUE 0x0 SCALAR_UBYTE 1.0 inverters_action_ETR07_CM_boolean 0 1 DISPLAY_IDENTIFIER inverters_action_ETR07.Subsystem10.Unsubscribe__Subscribe.Subscribe._.Value /end CHARACTERISTIC
/begin CHARACTERISTIC inverters_action_ETR07_P.subscribed_InitialOutput "" VALUE 0x0 SCALAR_UBYTE 1.0 inverters_action_ETR07_CM_boolean 0 1 DISPLAY_IDENTIFIER inverters_action_ETR07.Subsystem10.Unsubscribe__Subscribe.subscribed_.InitialOutput /end CHARACTERISTIC
/begin CHARACTERISTIC inverters_action_ETR07_P.subscribed_InitialOutput_k "" VALUE 0x0 SCALAR_UBYTE 1.0 inverters_action_ETR07_CM_boolean 0 1 DISPLAY_IDENTIFIER inverters_action_ETR07.Subsystem9.Unsubscribe__Subscribe.subscribed_.InitialOutput /end CHARACTERISTIC
/begin CHARACTERISTIC inverters_action_ETR07_P.u_Value "" VALUE 0x0 SCALAR_UBYTE 1.0 inverters_action_ETR07_CM_boolean 0 1 DISPLAY_IDENTIFIER inverters_action_ETR07.Subsystem9.Unsubscribe__Subscribe.Subscribe.1.Value /end CHARACTERISTIC
/begin MEASUREMENT inverters_action_ETR07_U.InvertersAction "" FLOAT64_IEEE inverters_action_ETR07_CM_double 0 0 -1.7e+308 1.7e+308 ECU_ADDRESS 0x0 DISPLAY_IDENTIFIER inverters_action_ETR07.InvertersAction /end MEASUREMENT
/begin MEASUREMENT inverters_action_ETR07_U.current_L "" FLOAT64_IEEE inverters_action_ETR07_CM_double 0 0 -1.7e+308 1.7e+308 ECU_ADDRESS 0x0 DISPLAY_IDENTIFIER inverters_action_ETR07.current_L /end MEASUREMENT
/begin MEASUREMENT inverters_action_ETR07_U.current_R "" FLOAT64_IEEE inverters_action_ETR07_CM_double 0 0 -1.7e+308 1.7e+308 ECU_ADDRESS 0x0 DISPLAY_IDENTIFIER inverters_action_ETR07.current_R /end MEASUREMENT
/begin MEASUREMENT inverters_action_ETR07_Y.Inverter_L_RegID "" UBYTE inverters_action_ETR07_CM_uint8 0 0 0.0 255.0 ECU_ADDRESS 0x0 DISPLAY_IDENTIFIER inverters_action_ETR07.Inverter_L_RegID /end MEASUREMENT
/begin MEASUREMENT inverters_action_ETR07_Y.Inverter_L_b15tob8 "" UBYTE inverters_action_ETR07_CM_uint8 0 0 0.0 255.0 ECU_ADDRESS 0x0 DISPLAY_IDENTIFIER inverters_action_ETR07.Inverter_L_b15tob8 /end MEASUREMENT
/begin MEASUREMENT inverters_action_ETR07_Y.Inverter_L_b7tob0 "" UBYTE inverters_action_ETR07_CM_uint8 0 0 0.0 255.0 ECU_ADDRESS 0x0 DISPLAY_IDENTIFIER inverters_action_ETR07.Inverter_L_b7tob0 /end MEASUREMENT
/begin MEASUREMENT inverters_action_ETR07_Y.Inverter_R_RegID "" UBYTE inverters_action_ETR07_CM_uint8 0 0 0.0 255.0 ECU_ADDRESS 0x0 DISPLAY_IDENTIFIER inverters_action_ETR07.Inverter_R_RegID /end MEASUREMENT
/begin MEASUREMENT inverters_action_ETR07_Y.Inverter_R_b15tob8 "" UBYTE inverters_action_ETR07_CM_uint8 0 0 0.0 255.0 ECU_ADDRESS 0x0 DISPLAY_IDENTIFIER inverters_action_ETR07.Inverter_R_b15tob8 /end MEASUREMENT
/begin MEASUREMENT inverters_action_ETR07_Y.Inverter_R_b7tob0 "" UBYTE inverters_action_ETR07_CM_uint8 0 0 0.0 255.0 ECU_ADDRESS 0x0 DISPLAY_IDENTIFIER inverters_action_ETR07.Inverter_R_b7tob0 /end MEASUREMENT
/begin MEASUREMENT inverters_action_ETR07_Y.InvertersSubscribed "" UBYTE inverters_action_ETR07_CM_boolean 0 0 0 1 ECU_ADDRESS 0x0 DISPLAY_IDENTIFIER inverters_action_ETR07.InvertersSubscribed /end MEASUREMENT
/end MODULE
/* inverters_action_ETR07 */
/end PROJECT
