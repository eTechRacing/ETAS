ASAP2_VERSION
/begin PROJECT "Generated by ETAS from INTECRIO integration project"
/begin HEADER "" VERSION "" PROJECT_NO Y /end HEADER
/begin MODULE Racing_Mode_ETR07 "Generated by ETAS from INTECRIO integration project"
/begin MOD_PAR "" VERSION "" ADDR_EPK 0x0 EPK "" SUPPLIER "ETAS GmbH" CUSTOMER "" CUSTOMER_NO "" USER "" PHONE_NO "" ECU "NO_ECU" CPU_TYPE "MPC750" NO_OF_INTERFACES 1 /end MOD_PAR
/begin MOD_COMMON "Common definitions" BYTE_ORDER MSB_FIRST ALIGNMENT_BYTE 1 ALIGNMENT_WORD 2 ALIGNMENT_LONG 4 ALIGNMENT_FLOAT32_IEEE 4 ALIGNMENT_FLOAT64_IEEE 8 /end MOD_COMMON
/begin MEASUREMENT Racing_Mode_ETR07_B.Apps_Sat_Dwn.Gain "" FLOAT64_IEEE Racing_Mode_ETR07_CM_double 0 0 -1.7e+308 1.7e+308 ECU_ADDRESS 0x0 DISPLAY_IDENTIFIER Racing_Mode_ETR07.Custom_Dash__11_.Apps_Sat_Dwn.Gain.Gain /end MEASUREMENT
/begin COMPU_METHOD Racing_Mode_ETR07_CM_double "Q = V" RAT_FUNC "%9.6" "NO_PHYSICAL_QTY" COEFFS 0.0 1.0 0.0 0.0 0.0 1.0 /end COMPU_METHOD
/begin MEASUREMENT Racing_Mode_ETR07_B.Apps_Sat_Up.Gain "" FLOAT64_IEEE Racing_Mode_ETR07_CM_double 0 0 -1.7e+308 1.7e+308 ECU_ADDRESS 0x0 DISPLAY_IDENTIFIER Racing_Mode_ETR07.Custom_Dash__11_.Apps_Sat_Up.Gain.Gain /end MEASUREMENT
/begin MEASUREMENT Racing_Mode_ETR07_B.CKF_Initial.Gain "" FLOAT64_IEEE Racing_Mode_ETR07_CM_double 0 0 -1.7e+308 1.7e+308 ECU_ADDRESS 0x0 DISPLAY_IDENTIFIER Racing_Mode_ETR07.Custom_Dash__11_.CKF_Initial.Gain.Gain /end MEASUREMENT
/begin MEASUREMENT Racing_Mode_ETR07_B.Cte_CKF.Gain "" FLOAT64_IEEE Racing_Mode_ETR07_CM_double 0 0 -1.7e+308 1.7e+308 ECU_ADDRESS 0x0 DISPLAY_IDENTIFIER Racing_Mode_ETR07.Custom_Dash__11_.Cte_CKF.Gain.Gain /end MEASUREMENT
/begin MEASUREMENT Racing_Mode_ETR07_B.Cte_SKF.Gain "" FLOAT64_IEEE Racing_Mode_ETR07_CM_double 0 0 -1.7e+308 1.7e+308 ECU_ADDRESS 0x0 DISPLAY_IDENTIFIER Racing_Mode_ETR07.Custom_Dash__11_.Cte_SKF.Gain.Gain /end MEASUREMENT
/begin MEASUREMENT Racing_Mode_ETR07_B.K_Reduction_P.Gain "" FLOAT64_IEEE Racing_Mode_ETR07_CM_double 0 0 -1.7e+308 1.7e+308 ECU_ADDRESS 0x0 DISPLAY_IDENTIFIER Racing_Mode_ETR07.Custom_Dash__11_.K_Reduction_P.Gain.Gain /end MEASUREMENT
/begin MEASUREMENT Racing_Mode_ETR07_B.K_Reduction_Temperature.Gain "" FLOAT64_IEEE Racing_Mode_ETR07_CM_double 0 0 -1.7e+308 1.7e+308 ECU_ADDRESS 0x0 DISPLAY_IDENTIFIER Racing_Mode_ETR07.Custom_Dash__11_.K_Reduction_Temperature.Gain.Gain /end MEASUREMENT
/begin MEASUREMENT Racing_Mode_ETR07_B.Max_Regenerative_Torque.In1 "" FLOAT64_IEEE Racing_Mode_ETR07_CM_double 0 0 -1.7e+308 1.7e+308 ECU_ADDRESS 0x0 DISPLAY_IDENTIFIER Racing_Mode_ETR07.Custom_Dash__11_.Max_Regenerative_Torque.In1.In1 /end MEASUREMENT
/begin MEASUREMENT Racing_Mode_ETR07_B.Merge "" FLOAT64_IEEE Racing_Mode_ETR07_CM_double 0 0 -1.7e+308 1.7e+308 ECU_ADDRESS 0x0 DISPLAY_IDENTIFIER Racing_Mode_ETR07.Merge.Merge ARRAY_SIZE 10 /end MEASUREMENT
/begin MEASUREMENT Racing_Mode_ETR07_B.Power_Limit.In1 "" FLOAT64_IEEE Racing_Mode_ETR07_CM_double 0 0 -1.7e+308 1.7e+308 ECU_ADDRESS 0x0 DISPLAY_IDENTIFIER Racing_Mode_ETR07.Custom_Dash__11_.Power_Limit.In1.In1 /end MEASUREMENT
/begin MEASUREMENT Racing_Mode_ETR07_B.SKF_Initial.Gain "" FLOAT64_IEEE Racing_Mode_ETR07_CM_double 0 0 -1.7e+308 1.7e+308 ECU_ADDRESS 0x0 DISPLAY_IDENTIFIER Racing_Mode_ETR07.Custom_Dash__11_.SKF_Initial.Gain.Gain /end MEASUREMENT
/begin CHARACTERISTIC Racing_Mode_ETR07_P.Apps_Sat_DwnSaturation_LowerSat "" VALUE 0x0 SCALAR_FLOAT64_IEEE 3.5e+305 Racing_Mode_ETR07_CM_double -1.7e+308 1.7e+308 DISPLAY_IDENTIFIER Racing_Mode_ETR07.Apps_Sat_Dwn_Saturation.LowerLimit /end CHARACTERISTIC
/begin RECORD_LAYOUT SCALAR_FLOAT64_IEEE FNC_VALUES 1 FLOAT64_IEEE COLUMN_DIR DIRECT /end RECORD_LAYOUT
/begin CHARACTERISTIC Racing_Mode_ETR07_P.Apps_Sat_DwnSaturation_UpperSat "" VALUE 0x0 SCALAR_FLOAT64_IEEE 3.5e+305 Racing_Mode_ETR07_CM_double -1.7e+308 1.7e+308 DISPLAY_IDENTIFIER Racing_Mode_ETR07.Apps_Sat_Dwn_Saturation.UpperLimit /end CHARACTERISTIC
/begin CHARACTERISTIC Racing_Mode_ETR07_P.Apps_Sat_UpSaturation_LowerSat "" VALUE 0x0 SCALAR_FLOAT64_IEEE 3.5e+305 Racing_Mode_ETR07_CM_double -1.7e+308 1.7e+308 DISPLAY_IDENTIFIER Racing_Mode_ETR07.Apps_Sat_Up_Saturation.LowerLimit /end CHARACTERISTIC
/begin CHARACTERISTIC Racing_Mode_ETR07_P.Apps_Sat_UpSaturation_UpperSat "" VALUE 0x0 SCALAR_FLOAT64_IEEE 3.5e+305 Racing_Mode_ETR07_CM_double -1.7e+308 1.7e+308 DISPLAY_IDENTIFIER Racing_Mode_ETR07.Apps_Sat_Up_Saturation.UpperLimit /end CHARACTERISTIC
/begin CHARACTERISTIC Racing_Mode_ETR07_P.CEE_Apps_Sat_Dwn_Value "" VALUE 0x0 SCALAR_FLOAT64_IEEE 3.5e+305 Racing_Mode_ETR07_CM_double -1.7e+308 1.7e+308 DISPLAY_IDENTIFIER Racing_Mode_ETR07.Tuning.CEE_Apps_Sat_Dwn.Value /end CHARACTERISTIC
/begin CHARACTERISTIC Racing_Mode_ETR07_P.CEE_Apps_Sat_Up_Value "" VALUE 0x0 SCALAR_FLOAT64_IEEE 3.5e+305 Racing_Mode_ETR07_CM_double -1.7e+308 1.7e+308 DISPLAY_IDENTIFIER Racing_Mode_ETR07.Tuning.CEE_Apps_Sat_Up.Value /end CHARACTERISTIC
/begin CHARACTERISTIC Racing_Mode_ETR07_P.CEE_CKF_Initial_Value "" VALUE 0x0 SCALAR_FLOAT64_IEEE 3.5e+305 Racing_Mode_ETR07_CM_double -1.7e+308 1.7e+308 DISPLAY_IDENTIFIER Racing_Mode_ETR07.Tuning.CEE_CKF_Initial.Value /end CHARACTERISTIC
/begin CHARACTERISTIC Racing_Mode_ETR07_P.CEE_Cte_CKF_Value "" VALUE 0x0 SCALAR_FLOAT64_IEEE 3.5e+305 Racing_Mode_ETR07_CM_double -1.7e+308 1.7e+308 DISPLAY_IDENTIFIER Racing_Mode_ETR07.Tuning.CEE_Cte_CKF.Value /end CHARACTERISTIC
/begin CHARACTERISTIC Racing_Mode_ETR07_P.CEE_Cte_SKF_Value "" VALUE 0x0 SCALAR_FLOAT64_IEEE 3.5e+305 Racing_Mode_ETR07_CM_double -1.7e+308 1.7e+308 DISPLAY_IDENTIFIER Racing_Mode_ETR07.Tuning.CEE_Cte_SKF.Value /end CHARACTERISTIC
/begin CHARACTERISTIC Racing_Mode_ETR07_P.CEE_K_Reduction_P_Value "" VALUE 0x0 SCALAR_FLOAT64_IEEE 3.5e+305 Racing_Mode_ETR07_CM_double -1.7e+308 1.7e+308 DISPLAY_IDENTIFIER Racing_Mode_ETR07.Tuning.CEE_K_Reduction_P.Value /end CHARACTERISTIC
/begin CHARACTERISTIC Racing_Mode_ETR07_P.CEE_K_Reduction_Temperature_Val "" VALUE 0x0 SCALAR_FLOAT64_IEEE 3.5e+305 Racing_Mode_ETR07_CM_double -1.7e+308 1.7e+308 DISPLAY_IDENTIFIER Racing_Mode_ETR07.Tuning.CEE_K_Reduction_Temperature.Value /end CHARACTERISTIC
/begin CHARACTERISTIC Racing_Mode_ETR07_P.CEE_Max_Regenerative_Torque_Val "" VALUE 0x0 SCALAR_FLOAT64_IEEE 3.5e+305 Racing_Mode_ETR07_CM_double -1.7e+308 1.7e+308 DISPLAY_IDENTIFIER Racing_Mode_ETR07.Tuning.CEE_Max_Regenerative_Torque.Value /end CHARACTERISTIC
/begin CHARACTERISTIC Racing_Mode_ETR07_P.CEE_Power_Limit_Value "" VALUE 0x0 SCALAR_FLOAT64_IEEE 3.5e+305 Racing_Mode_ETR07_CM_double -1.7e+308 1.7e+308 DISPLAY_IDENTIFIER Racing_Mode_ETR07.Tuning.CEE_Power_Limit.Value /end CHARACTERISTIC
/begin CHARACTERISTIC Racing_Mode_ETR07_P.CEE_SKF_Initial_Value "" VALUE 0x0 SCALAR_FLOAT64_IEEE 3.5e+305 Racing_Mode_ETR07_CM_double -1.7e+308 1.7e+308 DISPLAY_IDENTIFIER Racing_Mode_ETR07.Tuning.CEE_SKF_Initial.Value /end CHARACTERISTIC
/begin CHARACTERISTIC Racing_Mode_ETR07_P.CKF_InitialSaturation_LowerSat "" VALUE 0x0 SCALAR_FLOAT64_IEEE 3.5e+305 Racing_Mode_ETR07_CM_double -1.7e+308 1.7e+308 DISPLAY_IDENTIFIER Racing_Mode_ETR07.CKF_Initial_Saturation.LowerLimit /end CHARACTERISTIC
/begin CHARACTERISTIC Racing_Mode_ETR07_P.CKF_InitialSaturation_UpperSat "" VALUE 0x0 SCALAR_FLOAT64_IEEE 3.5e+305 Racing_Mode_ETR07_CM_double -1.7e+308 1.7e+308 DISPLAY_IDENTIFIER Racing_Mode_ETR07.CKF_Initial_Saturation.UpperLimit /end CHARACTERISTIC
/begin CHARACTERISTIC Racing_Mode_ETR07_P.CompareToConstant_const "" VALUE 0x0 SCALAR_UBYTE 255.0 Racing_Mode_ETR07_CM_uint8 0.0 255.0 DISPLAY_IDENTIFIER Racing_Mode_ETR07.Compare_To_Constant.Constant.Value /end CHARACTERISTIC
/begin RECORD_LAYOUT SCALAR_UBYTE FNC_VALUES 1 UBYTE COLUMN_DIR DIRECT /end RECORD_LAYOUT
/begin COMPU_METHOD Racing_Mode_ETR07_CM_uint8 "Q = V" RAT_FUNC "%9.6" "NO_PHYSICAL_QTY" COEFFS 0.0 1.0 0.0 0.0 0.0 1.0 /end COMPU_METHOD
/begin CHARACTERISTIC Racing_Mode_ETR07_P.Cte_CKFSaturation_LowerSat "" VALUE 0x0 SCALAR_FLOAT64_IEEE 3.5e+305 Racing_Mode_ETR07_CM_double -1.7e+308 1.7e+308 DISPLAY_IDENTIFIER Racing_Mode_ETR07.Cte_CKF_Saturation.LowerLimit /end CHARACTERISTIC
/begin CHARACTERISTIC Racing_Mode_ETR07_P.Cte_CKFSaturation_UpperSat "" VALUE 0x0 SCALAR_FLOAT64_IEEE 3.5e+305 Racing_Mode_ETR07_CM_double -1.7e+308 1.7e+308 DISPLAY_IDENTIFIER Racing_Mode_ETR07.Cte_CKF_Saturation.UpperLimit /end CHARACTERISTIC
/begin CHARACTERISTIC Racing_Mode_ETR07_P.Cte_SKFSaturation_LowerSat "" VALUE 0x0 SCALAR_FLOAT64_IEEE 3.5e+305 Racing_Mode_ETR07_CM_double -1.7e+308 1.7e+308 DISPLAY_IDENTIFIER Racing_Mode_ETR07.Cte_SKF_Saturation.LowerLimit /end CHARACTERISTIC
/begin CHARACTERISTIC Racing_Mode_ETR07_P.Cte_SKFSaturation_UpperSat "" VALUE 0x0 SCALAR_FLOAT64_IEEE 3.5e+305 Racing_Mode_ETR07_CM_double -1.7e+308 1.7e+308 DISPLAY_IDENTIFIER Racing_Mode_ETR07.Cte_SKF_Saturation.UpperLimit /end CHARACTERISTIC
/begin CHARACTERISTIC Racing_Mode_ETR07_P.K_Reduction_PSaturation_LowerSa "" VALUE 0x0 SCALAR_FLOAT64_IEEE 3.5e+305 Racing_Mode_ETR07_CM_double -1.7e+308 1.7e+308 DISPLAY_IDENTIFIER Racing_Mode_ETR07.K_Reduction_P_Saturation.LowerLimit /end CHARACTERISTIC
/begin CHARACTERISTIC Racing_Mode_ETR07_P.K_Reduction_PSaturation_UpperSa "" VALUE 0x0 SCALAR_FLOAT64_IEEE 3.5e+305 Racing_Mode_ETR07_CM_double -1.7e+308 1.7e+308 DISPLAY_IDENTIFIER Racing_Mode_ETR07.K_Reduction_P_Saturation.UpperLimit /end CHARACTERISTIC
/begin CHARACTERISTIC Racing_Mode_ETR07_P.K_Reduction_TemperatureSatura_m "" VALUE 0x0 SCALAR_FLOAT64_IEEE 3.5e+305 Racing_Mode_ETR07_CM_double -1.7e+308 1.7e+308 DISPLAY_IDENTIFIER Racing_Mode_ETR07.K_Reduction_Temperature_Saturation.LowerLimit /end CHARACTERISTIC
/begin CHARACTERISTIC Racing_Mode_ETR07_P.K_Reduction_TemperatureSaturati "" VALUE 0x0 SCALAR_FLOAT64_IEEE 3.5e+305 Racing_Mode_ETR07_CM_double -1.7e+308 1.7e+308 DISPLAY_IDENTIFIER Racing_Mode_ETR07.K_Reduction_Temperature_Saturation.UpperLimit /end CHARACTERISTIC
/begin CHARACTERISTIC Racing_Mode_ETR07_P.Max_Regenerative_TorqueSatura_o "" VALUE 0x0 SCALAR_FLOAT64_IEEE 3.5e+305 Racing_Mode_ETR07_CM_double -1.7e+308 1.7e+308 DISPLAY_IDENTIFIER Racing_Mode_ETR07.Max_Regenerative_Torque_Saturation.LowerLimit /end CHARACTERISTIC
/begin CHARACTERISTIC Racing_Mode_ETR07_P.Max_Regenerative_TorqueSaturati "" VALUE 0x0 SCALAR_FLOAT64_IEEE 3.5e+305 Racing_Mode_ETR07_CM_double -1.7e+308 1.7e+308 DISPLAY_IDENTIFIER Racing_Mode_ETR07.Max_Regenerative_Torque_Saturation.UpperLimit /end CHARACTERISTIC
/begin CHARACTERISTIC Racing_Mode_ETR07_P.Merge_InitialOutput "" VALUE 0x0 SCALAR_FLOAT64_IEEE 3.5e+305 Racing_Mode_ETR07_CM_double -1.7e+308 1.7e+308 DISPLAY_IDENTIFIER Racing_Mode_ETR07.Merge.InitialOutput /end CHARACTERISTIC
/begin CHARACTERISTIC Racing_Mode_ETR07_P.Power_LimitSaturation_LowerSat "" VALUE 0x0 SCALAR_FLOAT64_IEEE 3.5e+305 Racing_Mode_ETR07_CM_double -1.7e+308 1.7e+308 DISPLAY_IDENTIFIER Racing_Mode_ETR07.Power_Limit_Saturation.LowerLimit /end CHARACTERISTIC
/begin CHARACTERISTIC Racing_Mode_ETR07_P.Power_LimitSaturation_UpperSat "" VALUE 0x0 SCALAR_FLOAT64_IEEE 3.5e+305 Racing_Mode_ETR07_CM_double -1.7e+308 1.7e+308 DISPLAY_IDENTIFIER Racing_Mode_ETR07.Power_Limit_Saturation.UpperLimit /end CHARACTERISTIC
/begin CHARACTERISTIC Racing_Mode_ETR07_P.SKF_InitialSaturation_LowerSat "" VALUE 0x0 SCALAR_FLOAT64_IEEE 3.5e+305 Racing_Mode_ETR07_CM_double -1.7e+308 1.7e+308 DISPLAY_IDENTIFIER Racing_Mode_ETR07.SKF_Initial_Saturation.LowerLimit /end CHARACTERISTIC
/begin CHARACTERISTIC Racing_Mode_ETR07_P.SKF_InitialSaturation_UpperSat "" VALUE 0x0 SCALAR_FLOAT64_IEEE 3.5e+305 Racing_Mode_ETR07_CM_double -1.7e+308 1.7e+308 DISPLAY_IDENTIFIER Racing_Mode_ETR07.SKF_Initial_Saturation.UpperLimit /end CHARACTERISTIC
/begin MEASUREMENT Racing_Mode_ETR07_U.CustomMode_Data "" FLOAT64_IEEE Racing_Mode_ETR07_CM_double 0 0 -1.7e+308 1.7e+308 ECU_ADDRESS 0x0 DISPLAY_IDENTIFIER Racing_Mode_ETR07.CustomMode_Data /end MEASUREMENT
/begin MEASUREMENT Racing_Mode_ETR07_U.CustomMode_Identifier "" FLOAT64_IEEE Racing_Mode_ETR07_CM_double 0 0 -1.7e+308 1.7e+308 ECU_ADDRESS 0x0 DISPLAY_IDENTIFIER Racing_Mode_ETR07.CustomMode_Identifier /end MEASUREMENT
/begin MEASUREMENT Racing_Mode_ETR07_U.RacingMode "" UBYTE Racing_Mode_ETR07_CM_uint8 0 0 0.0 255.0 ECU_ADDRESS 0x0 DISPLAY_IDENTIFIER Racing_Mode_ETR07.RacingMode /end MEASUREMENT
/begin MEASUREMENT Racing_Mode_ETR07_Y.VDC_Apps_Sat_Down "" FLOAT64_IEEE Racing_Mode_ETR07_CM_double 0 0 -1.7e+308 1.7e+308 ECU_ADDRESS 0x0 DISPLAY_IDENTIFIER Racing_Mode_ETR07.VDC_Apps_Sat_Down /end MEASUREMENT
/begin MEASUREMENT Racing_Mode_ETR07_Y.VDC_Apps_Sat_Up "" FLOAT64_IEEE Racing_Mode_ETR07_CM_double 0 0 -1.7e+308 1.7e+308 ECU_ADDRESS 0x0 DISPLAY_IDENTIFIER Racing_Mode_ETR07.VDC_Apps_Sat_Up /end MEASUREMENT
/begin MEASUREMENT Racing_Mode_ETR07_Y.VDC_CKF_Initial "" FLOAT64_IEEE Racing_Mode_ETR07_CM_double 0 0 -1.7e+308 1.7e+308 ECU_ADDRESS 0x0 DISPLAY_IDENTIFIER Racing_Mode_ETR07.VDC_CKF_Initial /end MEASUREMENT
/begin MEASUREMENT Racing_Mode_ETR07_Y.VDC_Cte_CKF "" FLOAT64_IEEE Racing_Mode_ETR07_CM_double 0 0 -1.7e+308 1.7e+308 ECU_ADDRESS 0x0 DISPLAY_IDENTIFIER Racing_Mode_ETR07.VDC_Cte_CKF /end MEASUREMENT
/begin MEASUREMENT Racing_Mode_ETR07_Y.VDC_Cte_SKF "" FLOAT64_IEEE Racing_Mode_ETR07_CM_double 0 0 -1.7e+308 1.7e+308 ECU_ADDRESS 0x0 DISPLAY_IDENTIFIER Racing_Mode_ETR07.VDC_Cte_SKF /end MEASUREMENT
/begin MEASUREMENT Racing_Mode_ETR07_Y.VDC_K_Reduction_P "" FLOAT64_IEEE Racing_Mode_ETR07_CM_double 0 0 -1.7e+308 1.7e+308 ECU_ADDRESS 0x0 DISPLAY_IDENTIFIER Racing_Mode_ETR07.VDC_K_Reduction_P /end MEASUREMENT
/begin MEASUREMENT Racing_Mode_ETR07_Y.VDC_K_Reduction_Temperature "" FLOAT64_IEEE Racing_Mode_ETR07_CM_double 0 0 -1.7e+308 1.7e+308 ECU_ADDRESS 0x0 DISPLAY_IDENTIFIER Racing_Mode_ETR07.VDC_K_Reduction_Temperature /end MEASUREMENT
/begin MEASUREMENT Racing_Mode_ETR07_Y.VDC_Max_Regenerative_Torque "" FLOAT64_IEEE Racing_Mode_ETR07_CM_double 0 0 -1.7e+308 1.7e+308 ECU_ADDRESS 0x0 DISPLAY_IDENTIFIER Racing_Mode_ETR07.VDC_Max_Regenerative_Torque /end MEASUREMENT
/begin MEASUREMENT Racing_Mode_ETR07_Y.VDC_Power_Limit "" FLOAT64_IEEE Racing_Mode_ETR07_CM_double 0 0 -1.7e+308 1.7e+308 ECU_ADDRESS 0x0 DISPLAY_IDENTIFIER Racing_Mode_ETR07.VDC_Power_Limit /end MEASUREMENT
/begin MEASUREMENT Racing_Mode_ETR07_Y.VDC_SKF_Initial "" FLOAT64_IEEE Racing_Mode_ETR07_CM_double 0 0 -1.7e+308 1.7e+308 ECU_ADDRESS 0x0 DISPLAY_IDENTIFIER Racing_Mode_ETR07.VDC_SKF_Initial /end MEASUREMENT
/begin MEASUREMENT Racing_Mode_ETR07_Y.Workshop_Mode_Enable "" UBYTE Racing_Mode_ETR07_CM_boolean 0 0 0 1 ECU_ADDRESS 0x0 DISPLAY_IDENTIFIER Racing_Mode_ETR07.Workshop_Mode_Enable /end MEASUREMENT
/begin COMPU_METHOD Racing_Mode_ETR07_CM_boolean "Q = V" RAT_FUNC "%9.6" "NO_PHYSICAL_QTY" COEFFS 0.0 1.0 0.0 0.0 0.0 1.0 /end COMPU_METHOD
/end MODULE
/* Racing_Mode_ETR07 */
/end PROJECT
