ASAP2_VERSION
/begin PROJECT "Generated by ETAS from INTECRIO integration project"
/begin HEADER "" VERSION "" PROJECT_NO Y /end HEADER
/begin MODULE APPS_Implausibility "Generated by ETAS from INTECRIO integration project"
/begin MOD_PAR "" VERSION "" ADDR_EPK 0x0 EPK "" SUPPLIER "ETAS GmbH" CUSTOMER "" CUSTOMER_NO "" USER "" PHONE_NO "" ECU "NO_ECU" CPU_TYPE "MPC750" NO_OF_INTERFACES 1 /end MOD_PAR
/begin MOD_COMMON "Common definitions" BYTE_ORDER MSB_FIRST ALIGNMENT_BYTE 1 ALIGNMENT_WORD 2 ALIGNMENT_LONG 4 ALIGNMENT_FLOAT32_IEEE 4 ALIGNMENT_FLOAT64_IEEE 8 /end MOD_COMMON
/begin MEASUREMENT APPS_Implausibility_DW.ERROR_Counter "" FLOAT64_IEEE APPS_Implausibility_CM_double 0 0 -1.7e+308 1.7e+308 ECU_ADDRESS 0x0 DISPLAY_IDENTIFIER APPS_Implausibility.Data_Store_Memory1.ERROR_Counter /end MEASUREMENT
/begin COMPU_METHOD APPS_Implausibility_CM_double "Q = V" /* ConversionType */ RAT_FUNC /* Format */ "%9.6" /* Unit */ "NO_PHYSICAL_QTY" COEFFS 0.0 1.0 0.0 0.0 0.0 1.0 /end COMPU_METHOD
/begin MEASUREMENT APPS_Implausibility_U.APPS1_Value "" FLOAT64_IEEE APPS_Implausibility_CM_double 0 0 -1.7e+308 1.7e+308 ECU_ADDRESS 0x0 DISPLAY_IDENTIFIER APPS_Implausibility.APPS1_Value /end MEASUREMENT
/begin MEASUREMENT APPS_Implausibility_U.APPS2_Value "" FLOAT64_IEEE APPS_Implausibility_CM_double 0 0 -1.7e+308 1.7e+308 ECU_ADDRESS 0x0 DISPLAY_IDENTIFIER APPS_Implausibility.APPS2_Value /end MEASUREMENT
/begin MEASUREMENT APPS_Implausibility_Y.Disconnect_Fail "" FLOAT64_IEEE APPS_Implausibility_CM_double 0 0 -1.7e+308 1.7e+308 ECU_ADDRESS 0x0 DISPLAY_IDENTIFIER APPS_Implausibility.Disconnect_Fail /end MEASUREMENT
/end MODULE
/* APPS_Implausibility */
/end PROJECT
