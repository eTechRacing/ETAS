ASAP2_VERSION
/begin PROJECT "Generated by ETAS from INTECRIO integration project"
/begin HEADER "" VERSION "" PROJECT_NO Y /end HEADER
/begin MODULE Power_Control "Generated by ETAS from INTECRIO integration project"
/begin MOD_PAR "" VERSION "" ADDR_EPK 0x0 EPK "" SUPPLIER "ETAS GmbH" CUSTOMER "" CUSTOMER_NO "" USER "" PHONE_NO "" ECU "NO_ECU" CPU_TYPE "MPC750" NO_OF_INTERFACES 1 /end MOD_PAR
/begin MOD_COMMON "Common definitions" BYTE_ORDER MSB_FIRST ALIGNMENT_BYTE 1 ALIGNMENT_WORD 2 ALIGNMENT_LONG 4 ALIGNMENT_FLOAT32_IEEE 4 ALIGNMENT_FLOAT64_IEEE 8 /end MOD_COMMON
/begin MEASUREMENT Power_Control_B.sf_InverterL_Temp_Limitation.Current_out "" FLOAT64_IEEE Power_Control_CM_double 0 0 -1.7e+308 1.7e+308 ECU_ADDRESS 0x0 DISPLAY_IDENTIFIER Power_Control.InverterL_Temp_Limitation.Current_out /end MEASUREMENT
/begin COMPU_METHOD Power_Control_CM_double "Q = V" /* ConversionType */ RAT_FUNC /* Format */ "%9.6" /* Unit */ "NO_PHYSICAL_QTY" COEFFS 0.0 1.0 0.0 0.0 0.0 1.0 /end COMPU_METHOD
/begin MEASUREMENT Power_Control_B.sf_InverterR_Temp_Limitation.Current_out "" FLOAT64_IEEE Power_Control_CM_double 0 0 -1.7e+308 1.7e+308 ECU_ADDRESS 0x0 DISPLAY_IDENTIFIER Power_Control.InverterR_Temp_Limitation.Current_out /end MEASUREMENT
/begin MEASUREMENT Power_Control_B.sf_MotorL_Temp_Limitation.Current_out "" FLOAT64_IEEE Power_Control_CM_double 0 0 -1.7e+308 1.7e+308 ECU_ADDRESS 0x0 DISPLAY_IDENTIFIER Power_Control.MotorL_Temp_Limitation.Current_out /end MEASUREMENT
/begin MEASUREMENT Power_Control_B.sf_MotorR_Temp_Limitation.Current_out "" FLOAT64_IEEE Power_Control_CM_double 0 0 -1.7e+308 1.7e+308 ECU_ADDRESS 0x0 DISPLAY_IDENTIFIER Power_Control.MotorR_Temp_Limitation.Current_out /end MEASUREMENT
/begin MEASUREMENT Power_Control_DW.A "" FLOAT64_IEEE Power_Control_CM_double 0 0 -1.7e+308 1.7e+308 ECU_ADDRESS 0x0 DISPLAY_IDENTIFIER Power_Control.Accumulator_Power.PowerLimitDetection.Data_Store_Memory10.A /end MEASUREMENT
/begin MEASUREMENT Power_Control_U.Accumulator_Current "" FLOAT64_IEEE Power_Control_CM_double 0 0 -1.7e+308 1.7e+308 ECU_ADDRESS 0x0 DISPLAY_IDENTIFIER Power_Control.Accumulator_Current /end MEASUREMENT
/begin MEASUREMENT Power_Control_U.Accumulator_Voltage "" FLOAT64_IEEE Power_Control_CM_double 0 0 -1.7e+308 1.7e+308 ECU_ADDRESS 0x0 DISPLAY_IDENTIFIER Power_Control.Accumulator_Voltage /end MEASUREMENT
/begin MEASUREMENT Power_Control_U.Inv_L_TempIGBT "" FLOAT64_IEEE Power_Control_CM_double 0 0 -1.7e+308 1.7e+308 ECU_ADDRESS 0x0 DISPLAY_IDENTIFIER Power_Control.Inv_L_TempIGBT /end MEASUREMENT
/begin MEASUREMENT Power_Control_U.Inv_L_TempMotor "" FLOAT64_IEEE Power_Control_CM_double 0 0 -1.7e+308 1.7e+308 ECU_ADDRESS 0x0 DISPLAY_IDENTIFIER Power_Control.Inv_L_TempMotor /end MEASUREMENT
/begin MEASUREMENT Power_Control_U.Inv_R_TempIGBT "" FLOAT64_IEEE Power_Control_CM_double 0 0 -1.7e+308 1.7e+308 ECU_ADDRESS 0x0 DISPLAY_IDENTIFIER Power_Control.Inv_R_TempIGBT /end MEASUREMENT
/begin MEASUREMENT Power_Control_U.Inv_R_TempMotor "" FLOAT64_IEEE Power_Control_CM_double 0 0 -1.7e+308 1.7e+308 ECU_ADDRESS 0x0 DISPLAY_IDENTIFIER Power_Control.Inv_R_TempMotor /end MEASUREMENT
/begin MEASUREMENT Power_Control_U.Torque_L "" FLOAT64_IEEE Power_Control_CM_double 0 0 -1.7e+308 1.7e+308 ECU_ADDRESS 0x0 DISPLAY_IDENTIFIER Power_Control.Torque_L /end MEASUREMENT
/begin MEASUREMENT Power_Control_U.Torque_R "" FLOAT64_IEEE Power_Control_CM_double 0 0 -1.7e+308 1.7e+308 ECU_ADDRESS 0x0 DISPLAY_IDENTIFIER Power_Control.Torque_R /end MEASUREMENT
/begin MEASUREMENT Power_Control_Y.Power "" FLOAT64_IEEE Power_Control_CM_double 0 0 -1.7e+308 1.7e+308 ECU_ADDRESS 0x0 DISPLAY_IDENTIFIER Power_Control.Power /end MEASUREMENT
/begin MEASUREMENT Power_Control_Y.PowerLimitReached "" FLOAT64_IEEE Power_Control_CM_double 0 0 -1.7e+308 1.7e+308 ECU_ADDRESS 0x0 DISPLAY_IDENTIFIER Power_Control.PowerLimitReached /end MEASUREMENT
/begin MEASUREMENT Power_Control_Y.PowerMean500ms "" FLOAT64_IEEE Power_Control_CM_double 0 0 -1.7e+308 1.7e+308 ECU_ADDRESS 0x0 DISPLAY_IDENTIFIER Power_Control.PowerMean500ms /end MEASUREMENT
/begin MEASUREMENT Power_Control_Y.current_L "" FLOAT64_IEEE Power_Control_CM_double 0 0 -1.7e+308 1.7e+308 ECU_ADDRESS 0x0 DISPLAY_IDENTIFIER Power_Control.current_L /end MEASUREMENT
/begin MEASUREMENT Power_Control_Y.current_R "" FLOAT64_IEEE Power_Control_CM_double 0 0 -1.7e+308 1.7e+308 ECU_ADDRESS 0x0 DISPLAY_IDENTIFIER Power_Control.current_R /end MEASUREMENT
/end MODULE
/* Power_Control */
/end PROJECT
