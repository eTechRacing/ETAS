ASAP2_VERSION
/begin PROJECT "Generated by ETAS from INTECRIO integration project"
/begin HEADER "" VERSION "" PROJECT_NO Y /end HEADER
/begin MODULE Pedals_Susp_Sensors "Generated by ETAS from INTECRIO integration project"
/begin MOD_PAR "" VERSION "" ADDR_EPK 0x0 EPK "" SUPPLIER "ETAS GmbH" CUSTOMER "" CUSTOMER_NO "" USER "" PHONE_NO "" ECU "NO_ECU" CPU_TYPE "MPC750" NO_OF_INTERFACES 1 /end MOD_PAR
/begin MOD_COMMON "Common definitions" BYTE_ORDER MSB_FIRST ALIGNMENT_BYTE 1 ALIGNMENT_WORD 2 ALIGNMENT_LONG 4 ALIGNMENT_FLOAT32_IEEE 4 ALIGNMENT_FLOAT64_IEEE 8 /end MOD_COMMON
/begin MEASUREMENT Pedals_Susp_Sensors_B.bitsmax "" FLOAT64_IEEE Pedals_Susp_Sensors_CM_double 0 0 -1.7e+308 1.7e+308 ECU_ADDRESS 0x0 DISPLAY_IDENTIFIER Pedals_Susp_Sensors.Suspension_FL_Data_Conv.bitsmax.bitsmax /end MEASUREMENT
/begin COMPU_METHOD Pedals_Susp_Sensors_CM_double "Q = V" /* ConversionType */ RAT_FUNC /* Format */ "%9.6" /* Unit */ "NO_PHYSICAL_QTY" COEFFS 0.0 1.0 0.0 0.0 0.0 1.0 /end COMPU_METHOD
/begin MEASUREMENT Pedals_Susp_Sensors_B.bitsmax_n "" FLOAT64_IEEE Pedals_Susp_Sensors_CM_double 0 0 -1.7e+308 1.7e+308 ECU_ADDRESS 0x0 DISPLAY_IDENTIFIER Pedals_Susp_Sensors.Suspension_RR_Data_Conv.bitsmax.bitsmax_n /end MEASUREMENT
/begin MEASUREMENT Pedals_Susp_Sensors_B.bitsmax_o "" FLOAT64_IEEE Pedals_Susp_Sensors_CM_double 0 0 -1.7e+308 1.7e+308 ECU_ADDRESS 0x0 DISPLAY_IDENTIFIER Pedals_Susp_Sensors.Suspension_RL_Data_Conv.bitsmax.bitsmax_o /end MEASUREMENT
/begin MEASUREMENT Pedals_Susp_Sensors_B.bitsmax_p "" FLOAT64_IEEE Pedals_Susp_Sensors_CM_double 0 0 -1.7e+308 1.7e+308 ECU_ADDRESS 0x0 DISPLAY_IDENTIFIER Pedals_Susp_Sensors.Suspension_FR_Data_Conv.bitsmax.bitsmax_p /end MEASUREMENT
/begin MEASUREMENT Pedals_Susp_Sensors_B.sf_MATLABFunction.ZeroExperimental "" FLOAT64_IEEE Pedals_Susp_Sensors_CM_double 0 0 -1.7e+308 1.7e+308 ECU_ADDRESS 0x0 DISPLAY_IDENTIFIER Pedals_Susp_Sensors.Suspension_FL_Data_Conv.MATLAB_Function.ZeroExperimental /end MEASUREMENT
/begin MEASUREMENT Pedals_Susp_Sensors_B.sf_MATLABFunction_b.ZeroExperimental "" FLOAT64_IEEE Pedals_Susp_Sensors_CM_double 0 0 -1.7e+308 1.7e+308 ECU_ADDRESS 0x0 DISPLAY_IDENTIFIER Pedals_Susp_Sensors.Suspension_RL_Data_Conv.MATLAB_Function.ZeroExperimental /end MEASUREMENT
/begin MEASUREMENT Pedals_Susp_Sensors_B.sf_MATLABFunction_h.ZeroExperimental "" FLOAT64_IEEE Pedals_Susp_Sensors_CM_double 0 0 -1.7e+308 1.7e+308 ECU_ADDRESS 0x0 DISPLAY_IDENTIFIER Pedals_Susp_Sensors.Suspension_RR_Data_Conv.MATLAB_Function.ZeroExperimental /end MEASUREMENT
/begin MEASUREMENT Pedals_Susp_Sensors_B.sf_MATLABFunction_k.ZeroExperimental "" FLOAT64_IEEE Pedals_Susp_Sensors_CM_double 0 0 -1.7e+308 1.7e+308 ECU_ADDRESS 0x0 DISPLAY_IDENTIFIER Pedals_Susp_Sensors.Suspension_FR_Data_Conv.MATLAB_Function.ZeroExperimental /end MEASUREMENT
/begin MEASUREMENT Pedals_Susp_Sensors_DW.Z_E "" FLOAT64_IEEE Pedals_Susp_Sensors_CM_double 0 0 -1.7e+308 1.7e+308 ECU_ADDRESS 0x0 DISPLAY_IDENTIFIER Pedals_Susp_Sensors.Suspension_FL_Data_Conv.Data_Store_Memory.Z_E /end MEASUREMENT
/begin MEASUREMENT Pedals_Susp_Sensors_DW.Z_E_d "" FLOAT64_IEEE Pedals_Susp_Sensors_CM_double 0 0 -1.7e+308 1.7e+308 ECU_ADDRESS 0x0 DISPLAY_IDENTIFIER Pedals_Susp_Sensors.Suspension_FR_Data_Conv.Data_Store_Memory.Z_E_d /end MEASUREMENT
/begin MEASUREMENT Pedals_Susp_Sensors_DW.Z_E_h "" FLOAT64_IEEE Pedals_Susp_Sensors_CM_double 0 0 -1.7e+308 1.7e+308 ECU_ADDRESS 0x0 DISPLAY_IDENTIFIER Pedals_Susp_Sensors.Suspension_RL_Data_Conv.Data_Store_Memory.Z_E_h /end MEASUREMENT
/begin MEASUREMENT Pedals_Susp_Sensors_DW.Z_E_p "" FLOAT64_IEEE Pedals_Susp_Sensors_CM_double 0 0 -1.7e+308 1.7e+308 ECU_ADDRESS 0x0 DISPLAY_IDENTIFIER Pedals_Susp_Sensors.Suspension_RR_Data_Conv.Data_Store_Memory.Z_E_p /end MEASUREMENT
/begin CHARACTERISTIC Pedals_Susp_Sensors_P.Brake_Light_Threshold_Value "" VALUE 0x0 SCALAR_FLOAT64_IEEE 3.5e+305 Pedals_Susp_Sensors_CM_double -1.7e+308 1.7e+308 DISPLAY_IDENTIFIER Pedals_Susp_Sensors.Brake_Light.Brake_Light_Threshold.Value /end CHARACTERISTIC
/begin RECORD_LAYOUT SCALAR_FLOAT64_IEEE FNC_VALUES 1 FLOAT64_IEEE COLUMN_DIR DIRECT /end RECORD_LAYOUT
/begin CHARACTERISTIC Pedals_Susp_Sensors_P.Ctemuelles_Gain "" VALUE 0x0 SCALAR_FLOAT64_IEEE 3.5e+305 Pedals_Susp_Sensors_CM_double -1.7e+308 1.7e+308 DISPLAY_IDENTIFIER Pedals_Susp_Sensors.Suspension_FL_Data_Conv.Cte_muelles.Gain /end CHARACTERISTIC
/begin CHARACTERISTIC Pedals_Susp_Sensors_P.Ctemuelles_Gain_a "" VALUE 0x0 SCALAR_FLOAT64_IEEE 3.5e+305 Pedals_Susp_Sensors_CM_double -1.7e+308 1.7e+308 DISPLAY_IDENTIFIER Pedals_Susp_Sensors.Suspension_RL_Data_Conv.Cte_muelles.Gain /end CHARACTERISTIC
/begin CHARACTERISTIC Pedals_Susp_Sensors_P.Ctemuelles_Gain_e "" VALUE 0x0 SCALAR_FLOAT64_IEEE 3.5e+305 Pedals_Susp_Sensors_CM_double -1.7e+308 1.7e+308 DISPLAY_IDENTIFIER Pedals_Susp_Sensors.Suspension_FR_Data_Conv.Cte_muelles.Gain /end CHARACTERISTIC
/begin CHARACTERISTIC Pedals_Susp_Sensors_P.Ctemuelles_Gain_g "" VALUE 0x0 SCALAR_FLOAT64_IEEE 3.5e+305 Pedals_Susp_Sensors_CM_double -1.7e+308 1.7e+308 DISPLAY_IDENTIFIER Pedals_Susp_Sensors.Suspension_RR_Data_Conv.Cte_muelles.Gain /end CHARACTERISTIC
/begin CHARACTERISTIC Pedals_Susp_Sensors_P.DataStoreMemory_InitialValue "" VALUE 0x0 SCALAR_FLOAT64_IEEE 3.5e+305 Pedals_Susp_Sensors_CM_double -1.7e+308 1.7e+308 DISPLAY_IDENTIFIER Pedals_Susp_Sensors.Suspension_FL_Data_Conv.Data_Store_Memory.InitialValue /end CHARACTERISTIC
/begin CHARACTERISTIC Pedals_Susp_Sensors_P.DataStoreMemory_InitialValue_b "" VALUE 0x0 SCALAR_FLOAT64_IEEE 3.5e+305 Pedals_Susp_Sensors_CM_double -1.7e+308 1.7e+308 DISPLAY_IDENTIFIER Pedals_Susp_Sensors.Suspension_RL_Data_Conv.Data_Store_Memory.InitialValue /end CHARACTERISTIC
/begin CHARACTERISTIC Pedals_Susp_Sensors_P.DataStoreMemory_InitialValue_l "" VALUE 0x0 SCALAR_FLOAT64_IEEE 3.5e+305 Pedals_Susp_Sensors_CM_double -1.7e+308 1.7e+308 DISPLAY_IDENTIFIER Pedals_Susp_Sensors.Suspension_RR_Data_Conv.Data_Store_Memory.InitialValue /end CHARACTERISTIC
/begin CHARACTERISTIC Pedals_Susp_Sensors_P.DataStoreMemory_InitialValue_m "" VALUE 0x0 SCALAR_FLOAT64_IEEE 3.5e+305 Pedals_Susp_Sensors_CM_double -1.7e+308 1.7e+308 DISPLAY_IDENTIFIER Pedals_Susp_Sensors.Suspension_FR_Data_Conv.Data_Store_Memory.InitialValue /end CHARACTERISTIC
/begin CHARACTERISTIC Pedals_Susp_Sensors_P.Ltotal_Gain "" VALUE 0x0 SCALAR_FLOAT64_IEEE 3.5e+305 Pedals_Susp_Sensors_CM_double -1.7e+308 1.7e+308 DISPLAY_IDENTIFIER Pedals_Susp_Sensors.Suspension_FL_Data_Conv.Ltotal.Gain /end CHARACTERISTIC
/begin CHARACTERISTIC Pedals_Susp_Sensors_P.Ltotal_Gain_c "" VALUE 0x0 SCALAR_FLOAT64_IEEE 3.5e+305 Pedals_Susp_Sensors_CM_double -1.7e+308 1.7e+308 DISPLAY_IDENTIFIER Pedals_Susp_Sensors.Suspension_FR_Data_Conv.Ltotal.Gain /end CHARACTERISTIC
/begin CHARACTERISTIC Pedals_Susp_Sensors_P.Ltotal_Gain_h "" VALUE 0x0 SCALAR_FLOAT64_IEEE 3.5e+305 Pedals_Susp_Sensors_CM_double -1.7e+308 1.7e+308 DISPLAY_IDENTIFIER Pedals_Susp_Sensors.Suspension_RL_Data_Conv.Ltotal.Gain /end CHARACTERISTIC
/begin CHARACTERISTIC Pedals_Susp_Sensors_P.Ltotal_Gain_j "" VALUE 0x0 SCALAR_FLOAT64_IEEE 3.5e+305 Pedals_Susp_Sensors_CM_double -1.7e+308 1.7e+308 DISPLAY_IDENTIFIER Pedals_Susp_Sensors.Suspension_RR_Data_Conv.Ltotal.Gain /end CHARACTERISTIC
/begin CHARACTERISTIC Pedals_Susp_Sensors_P.ON_Value "" VALUE 0x0 SCALAR_FLOAT64_IEEE 3.5e+305 Pedals_Susp_Sensors_CM_double -1.7e+308 1.7e+308 DISPLAY_IDENTIFIER Pedals_Susp_Sensors.Brake_Light.Brake_Light_ON.ON.Value /end CHARACTERISTIC
/begin CHARACTERISTIC Pedals_Susp_Sensors_P.Off_Value "" VALUE 0x0 SCALAR_FLOAT64_IEEE 3.5e+305 Pedals_Susp_Sensors_CM_double -1.7e+308 1.7e+308 DISPLAY_IDENTIFIER Pedals_Susp_Sensors.Brake_Light.Brake_Light_OFF.Off.Value /end CHARACTERISTIC
/begin CHARACTERISTIC Pedals_Susp_Sensors_P.bitsmax_Value "" VALUE 0x0 SCALAR_FLOAT64_IEEE 3.5e+305 Pedals_Susp_Sensors_CM_double -1.7e+308 1.7e+308 DISPLAY_IDENTIFIER Pedals_Susp_Sensors.Suspension_FL_Data_Conv.bitsmax.Value /end CHARACTERISTIC
/begin CHARACTERISTIC Pedals_Susp_Sensors_P.bitsmax_Value_b "" VALUE 0x0 SCALAR_FLOAT64_IEEE 3.5e+305 Pedals_Susp_Sensors_CM_double -1.7e+308 1.7e+308 DISPLAY_IDENTIFIER Pedals_Susp_Sensors.Suspension_RR_Data_Conv.bitsmax.Value /end CHARACTERISTIC
/begin CHARACTERISTIC Pedals_Susp_Sensors_P.bitsmax_Value_e "" VALUE 0x0 SCALAR_FLOAT64_IEEE 3.5e+305 Pedals_Susp_Sensors_CM_double -1.7e+308 1.7e+308 DISPLAY_IDENTIFIER Pedals_Susp_Sensors.Suspension_FR_Data_Conv.bitsmax.Value /end CHARACTERISTIC
/begin CHARACTERISTIC Pedals_Susp_Sensors_P.bitsmax_Value_o "" VALUE 0x0 SCALAR_FLOAT64_IEEE 3.5e+305 Pedals_Susp_Sensors_CM_double -1.7e+308 1.7e+308 DISPLAY_IDENTIFIER Pedals_Susp_Sensors.Suspension_RL_Data_Conv.bitsmax.Value /end CHARACTERISTIC
/begin CHARACTERISTIC Pedals_Susp_Sensors_P.max_Value "" VALUE 0x0 SCALAR_FLOAT64_IEEE 3.5e+305 Pedals_Susp_Sensors_CM_double -1.7e+308 1.7e+308 DISPLAY_IDENTIFIER Pedals_Susp_Sensors.BRS_Data_Conv.max.Value /end CHARACTERISTIC
/begin CHARACTERISTIC Pedals_Susp_Sensors_P.max_Value_a "" VALUE 0x0 SCALAR_FLOAT64_IEEE 3.5e+305 Pedals_Susp_Sensors_CM_double -1.7e+308 1.7e+308 DISPLAY_IDENTIFIER Pedals_Susp_Sensors.APPS2_Data_Conv.max.Value /end CHARACTERISTIC
/begin CHARACTERISTIC Pedals_Susp_Sensors_P.max_Value_f "" VALUE 0x0 SCALAR_FLOAT64_IEEE 3.5e+305 Pedals_Susp_Sensors_CM_double -1.7e+308 1.7e+308 DISPLAY_IDENTIFIER Pedals_Susp_Sensors.APPS1_Data_Conv.max.Value /end CHARACTERISTIC
/begin CHARACTERISTIC Pedals_Susp_Sensors_P.min_Value "" VALUE 0x0 SCALAR_FLOAT64_IEEE 3.5e+305 Pedals_Susp_Sensors_CM_double -1.7e+308 1.7e+308 DISPLAY_IDENTIFIER Pedals_Susp_Sensors.BRS_Data_Conv.min.Value /end CHARACTERISTIC
/begin CHARACTERISTIC Pedals_Susp_Sensors_P.min_Value_a "" VALUE 0x0 SCALAR_FLOAT64_IEEE 3.5e+305 Pedals_Susp_Sensors_CM_double -1.7e+308 1.7e+308 DISPLAY_IDENTIFIER Pedals_Susp_Sensors.APPS1_Data_Conv.min.Value /end CHARACTERISTIC
/begin CHARACTERISTIC Pedals_Susp_Sensors_P.min_Value_g "" VALUE 0x0 SCALAR_FLOAT64_IEEE 3.5e+305 Pedals_Susp_Sensors_CM_double -1.7e+308 1.7e+308 DISPLAY_IDENTIFIER Pedals_Susp_Sensors.APPS2_Data_Conv.min.Value /end CHARACTERISTIC
/begin MEASUREMENT Pedals_Susp_Sensors_U.APPS1_Bits "" FLOAT64_IEEE Pedals_Susp_Sensors_CM_double 0 0 -1.7e+308 1.7e+308 ECU_ADDRESS 0x0 DISPLAY_IDENTIFIER Pedals_Susp_Sensors.APPS1_Bits /end MEASUREMENT
/begin MEASUREMENT Pedals_Susp_Sensors_U.APPS2_Bits "" FLOAT64_IEEE Pedals_Susp_Sensors_CM_double 0 0 -1.7e+308 1.7e+308 ECU_ADDRESS 0x0 DISPLAY_IDENTIFIER Pedals_Susp_Sensors.APPS2_Bits /end MEASUREMENT
/begin MEASUREMENT Pedals_Susp_Sensors_U.BrakeSensor_Bits "" FLOAT64_IEEE Pedals_Susp_Sensors_CM_double 0 0 -1.7e+308 1.7e+308 ECU_ADDRESS 0x0 DISPLAY_IDENTIFIER Pedals_Susp_Sensors.BrakeSensor_Bits /end MEASUREMENT
/begin MEASUREMENT Pedals_Susp_Sensors_U.Susp_F_L_Bits "" FLOAT64_IEEE Pedals_Susp_Sensors_CM_double 0 0 -1.7e+308 1.7e+308 ECU_ADDRESS 0x0 DISPLAY_IDENTIFIER Pedals_Susp_Sensors.Susp_F_L_Bits /end MEASUREMENT
/begin MEASUREMENT Pedals_Susp_Sensors_U.Susp_F_R_Bits "" FLOAT64_IEEE Pedals_Susp_Sensors_CM_double 0 0 -1.7e+308 1.7e+308 ECU_ADDRESS 0x0 DISPLAY_IDENTIFIER Pedals_Susp_Sensors.Susp_F_R_Bits /end MEASUREMENT
/begin MEASUREMENT Pedals_Susp_Sensors_U.Susp_R_L_Bits "" FLOAT64_IEEE Pedals_Susp_Sensors_CM_double 0 0 -1.7e+308 1.7e+308 ECU_ADDRESS 0x0 DISPLAY_IDENTIFIER Pedals_Susp_Sensors.Susp_R_L_Bits /end MEASUREMENT
/begin MEASUREMENT Pedals_Susp_Sensors_U.Susp_R_R_Bits "" FLOAT64_IEEE Pedals_Susp_Sensors_CM_double 0 0 -1.7e+308 1.7e+308 ECU_ADDRESS 0x0 DISPLAY_IDENTIFIER Pedals_Susp_Sensors.Susp_R_R_Bits /end MEASUREMENT
/begin MEASUREMENT Pedals_Susp_Sensors_Y.APPS1_Value "" FLOAT64_IEEE Pedals_Susp_Sensors_CM_double 0 0 -1.7e+308 1.7e+308 ECU_ADDRESS 0x0 DISPLAY_IDENTIFIER Pedals_Susp_Sensors.APPS1_Value /end MEASUREMENT
/begin MEASUREMENT Pedals_Susp_Sensors_Y.APPS2_Value "" FLOAT64_IEEE Pedals_Susp_Sensors_CM_double 0 0 -1.7e+308 1.7e+308 ECU_ADDRESS 0x0 DISPLAY_IDENTIFIER Pedals_Susp_Sensors.APPS2_Value /end MEASUREMENT
/begin MEASUREMENT Pedals_Susp_Sensors_Y.BrakeLight_Control "" FLOAT64_IEEE Pedals_Susp_Sensors_CM_double 0 0 -1.7e+308 1.7e+308 ECU_ADDRESS 0x0 DISPLAY_IDENTIFIER Pedals_Susp_Sensors.BrakeLight_Control /end MEASUREMENT
/begin MEASUREMENT Pedals_Susp_Sensors_Y.BrakeSensor_Value "" FLOAT64_IEEE Pedals_Susp_Sensors_CM_double 0 0 -1.7e+308 1.7e+308 ECU_ADDRESS 0x0 DISPLAY_IDENTIFIER Pedals_Susp_Sensors.BrakeSensor_Value /end MEASUREMENT
/begin MEASUREMENT Pedals_Susp_Sensors_Y.SUSP_F_L "" FLOAT64_IEEE Pedals_Susp_Sensors_CM_double 0 0 -1.7e+308 1.7e+308 ECU_ADDRESS 0x0 DISPLAY_IDENTIFIER Pedals_Susp_Sensors.SUSP_F_L /end MEASUREMENT
/begin MEASUREMENT Pedals_Susp_Sensors_Y.SUSP_F_R "" FLOAT64_IEEE Pedals_Susp_Sensors_CM_double 0 0 -1.7e+308 1.7e+308 ECU_ADDRESS 0x0 DISPLAY_IDENTIFIER Pedals_Susp_Sensors.SUSP_F_R /end MEASUREMENT
/begin MEASUREMENT Pedals_Susp_Sensors_Y.SUSP_R_L "" FLOAT64_IEEE Pedals_Susp_Sensors_CM_double 0 0 -1.7e+308 1.7e+308 ECU_ADDRESS 0x0 DISPLAY_IDENTIFIER Pedals_Susp_Sensors.SUSP_R_L /end MEASUREMENT
/begin MEASUREMENT Pedals_Susp_Sensors_Y.SUSP_R_R "" FLOAT64_IEEE Pedals_Susp_Sensors_CM_double 0 0 -1.7e+308 1.7e+308 ECU_ADDRESS 0x0 DISPLAY_IDENTIFIER Pedals_Susp_Sensors.SUSP_R_R /end MEASUREMENT
/end MODULE
/* Pedals_Susp_Sensors */
/end PROJECT
