ASAP2_VERSION
/begin PROJECT "Generated by ETAS from INTECRIO integration project"
/begin HEADER "" VERSION "" PROJECT_NO Y /end HEADER
/begin MODULE Car_State_ETR07 "Generated by ETAS from INTECRIO integration project"
/begin MOD_PAR "" VERSION "" ADDR_EPK 0x0 EPK "" SUPPLIER "ETAS GmbH" CUSTOMER "" CUSTOMER_NO "" USER "" PHONE_NO "" ECU "NO_ECU" CPU_TYPE "MPC750" NO_OF_INTERFACES 1 /end MOD_PAR
/begin MOD_COMMON "Common definitions" BYTE_ORDER MSB_FIRST ALIGNMENT_BYTE 1 ALIGNMENT_WORD 2 ALIGNMENT_LONG 4 ALIGNMENT_FLOAT32_IEEE 4 ALIGNMENT_FLOAT64_IEEE 8 /end MOD_COMMON
/begin MEASUREMENT Car_State_ETR07_B.Merge "" FLOAT64_IEEE Car_State_ETR07_CM_double 0 0 -1.7e+308 1.7e+308 ECU_ADDRESS 0x0 DISPLAY_IDENTIFIER Car_State_ETR07.AIRS_Request.Merge.Merge /end MEASUREMENT
/begin COMPU_METHOD Car_State_ETR07_CM_double "Q = V" /* ConversionType */ RAT_FUNC /* Format */ "%9.6" /* Unit */ "NO_PHYSICAL_QTY" COEFFS 0.0 1.0 0.0 0.0 0.0 1.0 /end COMPU_METHOD
/begin MEASUREMENT Car_State_ETR07_DW.A "" FLOAT64_IEEE Car_State_ETR07_CM_double 0 0 -1.7e+308 1.7e+308 ECU_ADDRESS 0x0 DISPLAY_IDENTIFIER Car_State_ETR07.CurrentPathDisconnection_Detection.Data_Store_Memory.A /end MEASUREMENT
/begin CHARACTERISTIC Car_State_ETR07_P.CompareToConstant_const "" VALUE 0x0 SCALAR_FLOAT64_IEEE 3.5e+305 Car_State_ETR07_CM_double -1.7e+308 1.7e+308 DISPLAY_IDENTIFIER Car_State_ETR07.CarOK_Checks.Compare_To_Constant.Constant.Value /end CHARACTERISTIC
/begin RECORD_LAYOUT SCALAR_FLOAT64_IEEE FNC_VALUES 1 FLOAT64_IEEE COLUMN_DIR DIRECT /end RECORD_LAYOUT
/begin CHARACTERISTIC Car_State_ETR07_P.Constant_Value "" VALUE 0x0 SCALAR_FLOAT64_IEEE 3.5e+305 Car_State_ETR07_CM_double -1.7e+308 1.7e+308 DISPLAY_IDENTIFIER Car_State_ETR07.AIRS_Request.Precharge.Constant.Value /end CHARACTERISTIC
/begin CHARACTERISTIC Car_State_ETR07_P.Constant_Value_f "" VALUE 0x0 SCALAR_FLOAT64_IEEE 3.5e+305 Car_State_ETR07_CM_double -1.7e+308 1.7e+308 DISPLAY_IDENTIFIER Car_State_ETR07.CurrentPathDisconnection_Detection.OK_or_latch.OK.Constant.Value /end CHARACTERISTIC
/begin CHARACTERISTIC Car_State_ETR07_P.Constant_Value_fl "" VALUE 0x0 SCALAR_FLOAT64_IEEE 3.5e+305 Car_State_ETR07_CM_double -1.7e+308 1.7e+308 DISPLAY_IDENTIFIER Car_State_ETR07.CarOK_Checks.Compare_To_Zero2.Constant.Value /end CHARACTERISTIC
/begin CHARACTERISTIC Car_State_ETR07_P.Constant_Value_k "" VALUE 0x0 SCALAR_FLOAT64_IEEE 3.5e+305 Car_State_ETR07_CM_double -1.7e+308 1.7e+308 DISPLAY_IDENTIFIER Car_State_ETR07.AIRS_Request.Tancar_Airs.Constant.Value /end CHARACTERISTIC
/begin CHARACTERISTIC Car_State_ETR07_P.Constant_Value_kb "" VALUE 0x0 SCALAR_FLOAT64_IEEE 3.5e+305 Car_State_ETR07_CM_double -1.7e+308 1.7e+308 DISPLAY_IDENTIFIER Car_State_ETR07.CarOK_Checks.Compare_To_Zero1.Constant.Value /end CHARACTERISTIC
/begin CHARACTERISTIC Car_State_ETR07_P.DataStoreMemory_InitialValue "" VALUE 0x0 SCALAR_FLOAT64_IEEE 3.5e+305 Car_State_ETR07_CM_double -1.7e+308 1.7e+308 DISPLAY_IDENTIFIER Car_State_ETR07.CurrentPathDisconnection_Detection.Data_Store_Memory.InitialValue /end CHARACTERISTIC
/begin CHARACTERISTIC Car_State_ETR07_P.Gain_Gain "" VALUE 0x0 SCALAR_FLOAT64_IEEE 3.5e+305 Car_State_ETR07_CM_double -1.7e+308 1.7e+308 DISPLAY_IDENTIFIER Car_State_ETR07.PrechargeAssert_Conditions.Gain.Gain /end CHARACTERISTIC
/begin CHARACTERISTIC Car_State_ETR07_P.IfDCBUSnotbits_Gain "" VALUE 0x0 SCALAR_FLOAT64_IEEE 3.5e+305 Car_State_ETR07_CM_double -1.7e+308 1.7e+308 DISPLAY_IDENTIFIER Car_State_ETR07.Precharge_Info.If_DC_BUS_not_bits.Gain /end CHARACTERISTIC
/begin CHARACTERISTIC Car_State_ETR07_P.Merge_InitialOutput "" VALUE 0x0 SCALAR_FLOAT64_IEEE 3.5e+305 Car_State_ETR07_CM_double -1.7e+308 1.7e+308 DISPLAY_IDENTIFIER Car_State_ETR07.AIRS_Request.Merge.InitialOutput /end CHARACTERISTIC
/begin CHARACTERISTIC Car_State_ETR07_P.Saturation_LowerSat "" VALUE 0x0 SCALAR_FLOAT64_IEEE 3.5e+305 Car_State_ETR07_CM_double -1.7e+308 1.7e+308 DISPLAY_IDENTIFIER Car_State_ETR07.Precharge_Info.Saturation.LowerLimit /end CHARACTERISTIC
/begin CHARACTERISTIC Car_State_ETR07_P.Saturation_UpperSat "" VALUE 0x0 SCALAR_FLOAT64_IEEE 3.5e+305 Car_State_ETR07_CM_double -1.7e+308 1.7e+308 DISPLAY_IDENTIFIER Car_State_ETR07.Precharge_Info.Saturation.UpperLimit /end CHARACTERISTIC
/begin MEASUREMENT Car_State_ETR07_U.AIRs_State "" FLOAT64_IEEE Car_State_ETR07_CM_double 0 0 -1.7e+308 1.7e+308 ECU_ADDRESS 0x0 DISPLAY_IDENTIFIER Car_State_ETR07.AIRs_State /end MEASUREMENT
/begin MEASUREMENT Car_State_ETR07_U.Accumulator_Voltage "" FLOAT64_IEEE Car_State_ETR07_CM_double 0 0 -1.7e+308 1.7e+308 ECU_ADDRESS 0x0 DISPLAY_IDENTIFIER Car_State_ETR07.Accumulator_Voltage /end MEASUREMENT
/begin MEASUREMENT Car_State_ETR07_U.BMSerror_CANDisconnection "" FLOAT64_IEEE Car_State_ETR07_CM_double 0 0 -1.7e+308 1.7e+308 ECU_ADDRESS 0x0 DISPLAY_IDENTIFIER Car_State_ETR07.BMSerror_CANDisconnection /end MEASUREMENT
/begin MEASUREMENT Car_State_ETR07_U.BMSerror_CurrentSensDisc "" FLOAT64_IEEE Car_State_ETR07_CM_double 0 0 -1.7e+308 1.7e+308 ECU_ADDRESS 0x0 DISPLAY_IDENTIFIER Car_State_ETR07.BMSerror_CurrentSensDisc /end MEASUREMENT
/begin MEASUREMENT Car_State_ETR07_U.BMSerror_NTCDisconnection "" FLOAT64_IEEE Car_State_ETR07_CM_double 0 0 -1.7e+308 1.7e+308 ECU_ADDRESS 0x0 DISPLAY_IDENTIFIER Car_State_ETR07.BMSerror_NTCDisconnection /end MEASUREMENT
/begin MEASUREMENT Car_State_ETR07_U.BMSerror_OverTemperature "" FLOAT64_IEEE Car_State_ETR07_CM_double 0 0 -1.7e+308 1.7e+308 ECU_ADDRESS 0x0 DISPLAY_IDENTIFIER Car_State_ETR07.BMSerror_OverTemperature /end MEASUREMENT
/begin MEASUREMENT Car_State_ETR07_U.BMSerror_OverVoltage "" FLOAT64_IEEE Car_State_ETR07_CM_double 0 0 -1.7e+308 1.7e+308 ECU_ADDRESS 0x0 DISPLAY_IDENTIFIER Car_State_ETR07.BMSerror_OverVoltage /end MEASUREMENT
/begin MEASUREMENT Car_State_ETR07_U.BMSerror_UnderTemperature "" FLOAT64_IEEE Car_State_ETR07_CM_double 0 0 -1.7e+308 1.7e+308 ECU_ADDRESS 0x0 DISPLAY_IDENTIFIER Car_State_ETR07.BMSerror_UnderTemperature /end MEASUREMENT
/begin MEASUREMENT Car_State_ETR07_U.BMSerror_UnderVoltage "" FLOAT64_IEEE Car_State_ETR07_CM_double 0 0 -1.7e+308 1.7e+308 ECU_ADDRESS 0x0 DISPLAY_IDENTIFIER Car_State_ETR07.BMSerror_UnderVoltage /end MEASUREMENT
/begin MEASUREMENT Car_State_ETR07_U.Critical_CAN_Disconnection "" FLOAT64_IEEE Car_State_ETR07_CM_double 0 0 -1.7e+308 1.7e+308 ECU_ADDRESS 0x0 DISPLAY_IDENTIFIER Car_State_ETR07.Critical_CAN_Disconnection /end MEASUREMENT
/begin MEASUREMENT Car_State_ETR07_U.DashPrechargeRequest "" FLOAT64_IEEE Car_State_ETR07_CM_double 0 0 -1.7e+308 1.7e+308 ECU_ADDRESS 0x0 DISPLAY_IDENTIFIER Car_State_ETR07.PrechargeRequest /end MEASUREMENT
/begin MEASUREMENT Car_State_ETR07_U.EnableDrive "" FLOAT64_IEEE Car_State_ETR07_CM_double 0 0 -1.7e+308 1.7e+308 ECU_ADDRESS 0x0 DISPLAY_IDENTIFIER Car_State_ETR07.EnableDrive_Order /end MEASUREMENT
/begin MEASUREMENT Car_State_ETR07_U.InvertersMinDCBus "" FLOAT64_IEEE Car_State_ETR07_CM_double 0 0 -1.7e+308 1.7e+308 ECU_ADDRESS 0x0 DISPLAY_IDENTIFIER Car_State_ETR07.InvertersMinDCBus /end MEASUREMENT
/begin MEASUREMENT Car_State_ETR07_U.InvertersSubscribed "" FLOAT64_IEEE Car_State_ETR07_CM_double 0 0 -1.7e+308 1.7e+308 ECU_ADDRESS 0x0 DISPLAY_IDENTIFIER Car_State_ETR07.InvertersSubscribed /end MEASUREMENT
/begin MEASUREMENT Car_State_ETR07_U.Lock "" FLOAT64_IEEE Car_State_ETR07_CM_double 0 0 -1.7e+308 1.7e+308 ECU_ADDRESS 0x0 DISPLAY_IDENTIFIER Car_State_ETR07.Torque_LockON /end MEASUREMENT
/begin MEASUREMENT Car_State_ETR07_U.Shutdown_BMS "" FLOAT64_IEEE Car_State_ETR07_CM_double 0 0 -1.7e+308 1.7e+308 ECU_ADDRESS 0x0 DISPLAY_IDENTIFIER Car_State_ETR07.Shutdown_BMS /end MEASUREMENT
/begin MEASUREMENT Car_State_ETR07_U.Shutdown_BOTS "" FLOAT64_IEEE Car_State_ETR07_CM_double 0 0 -1.7e+308 1.7e+308 ECU_ADDRESS 0x0 DISPLAY_IDENTIFIER Car_State_ETR07.Shutdown_BOTS /end MEASUREMENT
/begin MEASUREMENT Car_State_ETR07_U.Shutdown_BSPD "" FLOAT64_IEEE Car_State_ETR07_CM_double 0 0 -1.7e+308 1.7e+308 ECU_ADDRESS 0x0 DISPLAY_IDENTIFIER Car_State_ETR07.Shutdown_BSPD /end MEASUREMENT
/begin MEASUREMENT Car_State_ETR07_U.Shutdown_HVBOX "" FLOAT64_IEEE Car_State_ETR07_CM_double 0 0 -1.7e+308 1.7e+308 ECU_ADDRESS 0x0 DISPLAY_IDENTIFIER Car_State_ETR07.Shutdown_HVBOX /end MEASUREMENT
/begin MEASUREMENT Car_State_ETR07_U.Shutdown_HVD "" FLOAT64_IEEE Car_State_ETR07_CM_double 0 0 -1.7e+308 1.7e+308 ECU_ADDRESS 0x0 DISPLAY_IDENTIFIER Car_State_ETR07.Shutdown_HVD /end MEASUREMENT
/begin MEASUREMENT Car_State_ETR07_U.Shutdown_Inertia "" FLOAT64_IEEE Car_State_ETR07_CM_double 0 0 -1.7e+308 1.7e+308 ECU_ADDRESS 0x0 DISPLAY_IDENTIFIER Car_State_ETR07.Shutdown_Inertia /end MEASUREMENT
/begin MEASUREMENT Car_State_ETR07_U.Shutdown_InverterLIntck "" FLOAT64_IEEE Car_State_ETR07_CM_double 0 0 -1.7e+308 1.7e+308 ECU_ADDRESS 0x0 DISPLAY_IDENTIFIER Car_State_ETR07.Shutdown_InverterLIntck /end MEASUREMENT
/begin MEASUREMENT Car_State_ETR07_U.Shutdown_InverterRIntck "" FLOAT64_IEEE Car_State_ETR07_CM_double 0 0 -1.7e+308 1.7e+308 ECU_ADDRESS 0x0 DISPLAY_IDENTIFIER Car_State_ETR07.Shutdown_InverterRIntck /end MEASUREMENT
/begin MEASUREMENT Car_State_ETR07_U.Shutdown_PackageIntck "" FLOAT64_IEEE Car_State_ETR07_CM_double 0 0 -1.7e+308 1.7e+308 ECU_ADDRESS 0x0 DISPLAY_IDENTIFIER Car_State_ETR07.Shutdown_PackageIntck /end MEASUREMENT
/begin MEASUREMENT Car_State_ETR07_U.Shutdown_SetaCockpit "" FLOAT64_IEEE Car_State_ETR07_CM_double 0 0 -1.7e+308 1.7e+308 ECU_ADDRESS 0x0 DISPLAY_IDENTIFIER Car_State_ETR07.Shutdown_SetaCockpit /end MEASUREMENT
/begin MEASUREMENT Car_State_ETR07_U.Shutdown_SetaLeft "" FLOAT64_IEEE Car_State_ETR07_CM_double 0 0 -1.7e+308 1.7e+308 ECU_ADDRESS 0x0 DISPLAY_IDENTIFIER Car_State_ETR07.Shutdown_SetaLeft /end MEASUREMENT
/begin MEASUREMENT Car_State_ETR07_U.Shutdown_SetaRight "" FLOAT64_IEEE Car_State_ETR07_CM_double 0 0 -1.7e+308 1.7e+308 ECU_ADDRESS 0x0 DISPLAY_IDENTIFIER Car_State_ETR07.Shutdown_SetaRight /end MEASUREMENT
/begin MEASUREMENT Car_State_ETR07_U.Shutdown_TSMPIntck "" FLOAT64_IEEE Car_State_ETR07_CM_double 0 0 -1.7e+308 1.7e+308 ECU_ADDRESS 0x0 DISPLAY_IDENTIFIER Car_State_ETR07.Shutdown_TSMPIntck /end MEASUREMENT
/begin MEASUREMENT Car_State_ETR07_U.Shutdown_TSMS "" FLOAT64_IEEE Car_State_ETR07_CM_double 0 0 -1.7e+308 1.7e+308 ECU_ADDRESS 0x0 DISPLAY_IDENTIFIER Car_State_ETR07.Shutdown_TSMS /end MEASUREMENT
/begin MEASUREMENT Car_State_ETR07_Y.AIRs_Request "" FLOAT64_IEEE Car_State_ETR07_CM_double 0 0 -1.7e+308 1.7e+308 ECU_ADDRESS 0x0 DISPLAY_IDENTIFIER Car_State_ETR07.AIRs_Request /end MEASUREMENT
/begin MEASUREMENT Car_State_ETR07_Y.Car_OK "" UBYTE Car_State_ETR07_CM_boolean 0 0 0 1 ECU_ADDRESS 0x0 DISPLAY_IDENTIFIER Car_State_ETR07.Car_OK /end MEASUREMENT
/begin COMPU_METHOD Car_State_ETR07_CM_boolean "Q = V" /* ConversionType */ RAT_FUNC /* Format */ "%9.6" /* Unit */ "NO_PHYSICAL_QTY" COEFFS 0.0 1.0 0.0 0.0 0.0 1.0 /end COMPU_METHOD
/begin MEASUREMENT Car_State_ETR07_Y.Car_State "" FLOAT64_IEEE Car_State_ETR07_CM_double 0 0 -1.7e+308 1.7e+308 ECU_ADDRESS 0x0 DISPLAY_IDENTIFIER Car_State_ETR07.Car_State /end MEASUREMENT
/begin MEASUREMENT Car_State_ETR07_Y.CurrentPathDisconnectionFlag "" FLOAT64_IEEE Car_State_ETR07_CM_double 0 0 -1.7e+308 1.7e+308 ECU_ADDRESS 0x0 DISPLAY_IDENTIFIER Car_State_ETR07.CurrentPathDisconnectionFlag /end MEASUREMENT
/begin MEASUREMENT Car_State_ETR07_Y.InvertersAction "" FLOAT64_IEEE Car_State_ETR07_CM_double 0 0 -1.7e+308 1.7e+308 ECU_ADDRESS 0x0 DISPLAY_IDENTIFIER Car_State_ETR07.InvertersAction /end MEASUREMENT
/begin MEASUREMENT Car_State_ETR07_Y.PrechargeAssert "" FLOAT64_IEEE Car_State_ETR07_CM_double 0 0 -1.7e+308 1.7e+308 ECU_ADDRESS 0x0 DISPLAY_IDENTIFIER Car_State_ETR07.PrechargeAssert /end MEASUREMENT
/begin MEASUREMENT Car_State_ETR07_Y.Precharge_Percentage "" FLOAT64_IEEE Car_State_ETR07_CM_double 0 0 -1.7e+308 1.7e+308 ECU_ADDRESS 0x0 DISPLAY_IDENTIFIER Car_State_ETR07.Precharge_Percentage /end MEASUREMENT
/begin MEASUREMENT Car_State_ETR07_Y.Precharge_Voltage "" FLOAT64_IEEE Car_State_ETR07_CM_double 0 0 -1.7e+308 1.7e+308 ECU_ADDRESS 0x0 DISPLAY_IDENTIFIER Car_State_ETR07.Precharge_Voltage /end MEASUREMENT
/begin MEASUREMENT Car_State_ETR07_Y.ShutdownClosed "" FLOAT64_IEEE Car_State_ETR07_CM_double 0 0 -1.7e+308 1.7e+308 ECU_ADDRESS 0x0 DISPLAY_IDENTIFIER Car_State_ETR07.ShutdownClosed /end MEASUREMENT
/begin MEASUREMENT Car_State_ETR07_Y.TorqueEnable "" FLOAT64_IEEE Car_State_ETR07_CM_double 0 0 -1.7e+308 1.7e+308 ECU_ADDRESS 0x0 DISPLAY_IDENTIFIER Car_State_ETR07.TorqueEnable /end MEASUREMENT
/begin MEASUREMENT Car_State_ETR07_Y.errors "" FLOAT64_IEEE Car_State_ETR07_CM_double 0 0 -1.7e+308 1.7e+308 ECU_ADDRESS 0x0 DISPLAY_IDENTIFIER Car_State_ETR07.errors /end MEASUREMENT
/end MODULE
/* Car_State_ETR07 */
/end PROJECT
