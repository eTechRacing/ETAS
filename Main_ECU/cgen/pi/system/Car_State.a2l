ASAP2_VERSION
/begin PROJECT "Generated by ETAS from INTECRIO integration project"
/begin HEADER "" VERSION "" PROJECT_NO Y /end HEADER
/begin MODULE Car_State "Generated by ETAS from INTECRIO integration project"
/begin MOD_PAR "" VERSION "" ADDR_EPK 0x0 EPK "" SUPPLIER "ETAS GmbH" CUSTOMER "" CUSTOMER_NO "" USER "" PHONE_NO "" ECU "NO_ECU" CPU_TYPE "MPC750" NO_OF_INTERFACES 1 /end MOD_PAR
/begin MOD_COMMON "Common definitions" BYTE_ORDER MSB_FIRST ALIGNMENT_BYTE 1 ALIGNMENT_WORD 2 ALIGNMENT_LONG 4 ALIGNMENT_FLOAT32_IEEE 4 ALIGNMENT_FLOAT64_IEEE 8 /end MOD_COMMON
/begin MEASUREMENT Car_State_B.InvertersAction "" FLOAT64_IEEE Car_State_CM_double 0 0 -1.7e+308 1.7e+308 ECU_ADDRESS 0x0 DISPLAY_IDENTIFIER Car_State.Car_State_Manager.InvertersAction /end MEASUREMENT
/begin COMPU_METHOD Car_State_CM_double "Q = V" /* ConversionType */ RAT_FUNC /* Format */ "%9.6" /* Unit */ "NO_PHYSICAL_QTY" COEFFS 0.0 1.0 0.0 0.0 0.0 1.0 /end COMPU_METHOD
/begin MEASUREMENT Car_State_B.Merge "" FLOAT64_IEEE Car_State_CM_double 0 0 -1.7e+308 1.7e+308 ECU_ADDRESS 0x0 DISPLAY_IDENTIFIER Car_State.AIRS_Request.Merge.Merge /end MEASUREMENT
/begin MEASUREMENT Car_State_B.Merge_b "" FLOAT64_IEEE Car_State_CM_double 0 0 -1.7e+308 1.7e+308 ECU_ADDRESS 0x0 DISPLAY_IDENTIFIER Car_State.Inv_Action.Merge.Merge_b /end MEASUREMENT
/begin MEASUREMENT Car_State_DW.A "" FLOAT64_IEEE Car_State_CM_double 0 0 -1.7e+308 1.7e+308 ECU_ADDRESS 0x0 DISPLAY_IDENTIFIER Car_State.CurrentPathDisconnection_Detection.Subsystem.Data_Store_Memory.A /end MEASUREMENT
/begin MEASUREMENT Car_State_U.AIRs_State "" FLOAT64_IEEE Car_State_CM_double 0 0 -1.7e+308 1.7e+308 ECU_ADDRESS 0x0 DISPLAY_IDENTIFIER Car_State.AIRs_State /end MEASUREMENT
/begin MEASUREMENT Car_State_U.APPS1_Value "" FLOAT64_IEEE Car_State_CM_double 0 0 -1.7e+308 1.7e+308 ECU_ADDRESS 0x0 DISPLAY_IDENTIFIER Car_State.APPS1_Value /end MEASUREMENT
/begin MEASUREMENT Car_State_U.Accumulator_Voltage "" FLOAT64_IEEE Car_State_CM_double 0 0 -1.7e+308 1.7e+308 ECU_ADDRESS 0x0 DISPLAY_IDENTIFIER Car_State.Accumulator_Voltage /end MEASUREMENT
/begin MEASUREMENT Car_State_U.BrakePedal_Value "" FLOAT64_IEEE Car_State_CM_double 0 0 -1.7e+308 1.7e+308 ECU_ADDRESS 0x0 DISPLAY_IDENTIFIER Car_State.BrakePedal_Value /end MEASUREMENT
/begin MEASUREMENT Car_State_U.Critical_CAN_Disconnection "" FLOAT64_IEEE Car_State_CM_double 0 0 -1.7e+308 1.7e+308 ECU_ADDRESS 0x0 DISPLAY_IDENTIFIER Car_State.Critical_CAN_Disconnection /end MEASUREMENT
/begin MEASUREMENT Car_State_U.EnableDrive_Order "" UBYTE Car_State_CM_boolean 0 0 0 1 ECU_ADDRESS 0x0 DISPLAY_IDENTIFIER Car_State.EnableDrive_Order /end MEASUREMENT
/begin COMPU_METHOD Car_State_CM_boolean "Q = V" /* ConversionType */ RAT_FUNC /* Format */ "%9.6" /* Unit */ "NO_PHYSICAL_QTY" COEFFS 0.0 1.0 0.0 0.0 0.0 1.0 /end COMPU_METHOD
/begin MEASUREMENT Car_State_U.InvertersMinDCBus "" FLOAT64_IEEE Car_State_CM_double 0 0 -1.7e+308 1.7e+308 ECU_ADDRESS 0x0 DISPLAY_IDENTIFIER Car_State.InvertersMinDCBus /end MEASUREMENT
/begin MEASUREMENT Car_State_U.InvertersSubscribed "" FLOAT64_IEEE Car_State_CM_double 0 0 -1.7e+308 1.7e+308 ECU_ADDRESS 0x0 DISPLAY_IDENTIFIER Car_State.InvertersSubscribed /end MEASUREMENT
/begin MEASUREMENT Car_State_U.PrechargeRequest "" FLOAT64_IEEE Car_State_CM_double 0 0 -1.7e+308 1.7e+308 ECU_ADDRESS 0x0 DISPLAY_IDENTIFIER Car_State.PrechargeRequest /end MEASUREMENT
/begin MEASUREMENT Car_State_U.Shutdown_PackageIntck "" UBYTE Car_State_CM_boolean 0 0 0 1 ECU_ADDRESS 0x0 DISPLAY_IDENTIFIER Car_State.Shutdown_PackageIntck /end MEASUREMENT
/begin MEASUREMENT Car_State_Y.AIRs_Request "" FLOAT64_IEEE Car_State_CM_double 0 0 -1.7e+308 1.7e+308 ECU_ADDRESS 0x0 DISPLAY_IDENTIFIER Car_State.AIRs_Request /end MEASUREMENT
/begin MEASUREMENT Car_State_Y.Car_OK "" UBYTE Car_State_CM_boolean 0 0 0 1 ECU_ADDRESS 0x0 DISPLAY_IDENTIFIER Car_State.Car_OK /end MEASUREMENT
/begin MEASUREMENT Car_State_Y.Car_State_b "" FLOAT64_IEEE Car_State_CM_double 0 0 -1.7e+308 1.7e+308 ECU_ADDRESS 0x0 DISPLAY_IDENTIFIER Car_State.Car_State /end MEASUREMENT
/begin MEASUREMENT Car_State_Y.InvertersAction "" FLOAT64_IEEE Car_State_CM_double 0 0 -1.7e+308 1.7e+308 ECU_ADDRESS 0x0 DISPLAY_IDENTIFIER Car_State.InvertersAction /end MEASUREMENT
/begin MEASUREMENT Car_State_Y.PrechargeAssert "" FLOAT64_IEEE Car_State_CM_double 0 0 -1.7e+308 1.7e+308 ECU_ADDRESS 0x0 DISPLAY_IDENTIFIER Car_State.PrechargeAssert /end MEASUREMENT
/begin MEASUREMENT Car_State_Y.Precharge_Percentage "" FLOAT64_IEEE Car_State_CM_double 0 0 -1.7e+308 1.7e+308 ECU_ADDRESS 0x0 DISPLAY_IDENTIFIER Car_State.Precharge_Percentage /end MEASUREMENT
/begin MEASUREMENT Car_State_Y.Precharge_Voltage "" FLOAT64_IEEE Car_State_CM_double 0 0 -1.7e+308 1.7e+308 ECU_ADDRESS 0x0 DISPLAY_IDENTIFIER Car_State.Precharge_Voltage /end MEASUREMENT
/begin MEASUREMENT Car_State_Y.Relay_Error "" FLOAT64_IEEE Car_State_CM_double 0 0 -1.7e+308 1.7e+308 ECU_ADDRESS 0x0 DISPLAY_IDENTIFIER Car_State.Relay_Error /end MEASUREMENT
/begin MEASUREMENT Car_State_Y.TorqueEnable "" FLOAT64_IEEE Car_State_CM_double 0 0 -1.7e+308 1.7e+308 ECU_ADDRESS 0x0 DISPLAY_IDENTIFIER Car_State.TorqueEnable /end MEASUREMENT
/begin MEASUREMENT Car_State_Y.errors "" FLOAT64_IEEE Car_State_CM_double 0 0 -1.7e+308 1.7e+308 ECU_ADDRESS 0x0 DISPLAY_IDENTIFIER Car_State.errors /end MEASUREMENT
/end MODULE
/* Car_State */
/end PROJECT
