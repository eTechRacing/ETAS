ASAP2_VERSION
/begin PROJECT "Generated by ETAS from INTECRIO integration project"
/begin HEADER "" VERSION "" PROJECT_NO Y /end HEADER
/begin MODULE Synchronism_ETR07 "Generated by ETAS from INTECRIO integration project"
/begin MOD_PAR "" VERSION "" ADDR_EPK 0x0 EPK "" SUPPLIER "ETAS GmbH" CUSTOMER "" CUSTOMER_NO "" USER "" PHONE_NO "" ECU "NO_ECU" CPU_TYPE "MPC750" NO_OF_INTERFACES 1 /end MOD_PAR
/begin MOD_COMMON "Common definitions" BYTE_ORDER MSB_FIRST ALIGNMENT_BYTE 1 ALIGNMENT_WORD 2 ALIGNMENT_LONG 4 ALIGNMENT_FLOAT32_IEEE 4 ALIGNMENT_FLOAT64_IEEE 8 /end MOD_COMMON
/begin MEASUREMENT Synchronism_ETR07_DW.counter "" FLOAT64_IEEE Synchronism_ETR07_CM_double 0 0 -1.7e+308 1.7e+308 ECU_ADDRESS 0x0 DISPLAY_IDENTIFIER Synchronism_ETR07.Counter.Data_Store_Memory.counter /end MEASUREMENT
/begin COMPU_METHOD Synchronism_ETR07_CM_double "Q = V" /* ConversionType */ RAT_FUNC /* Format */ "%9.6" /* Unit */ "NO_PHYSICAL_QTY" COEFFS 0.0 1.0 0.0 0.0 0.0 1.0 /end COMPU_METHOD
/begin CHARACTERISTIC Synchronism_ETR07_P.Constant1_Value "" VALUE 0x0 SCALAR_FLOAT64_IEEE 3.5e+305 Synchronism_ETR07_CM_double -1.7e+308 1.7e+308 DISPLAY_IDENTIFIER Synchronism_ETR07.Constant1.Value /end CHARACTERISTIC
/begin RECORD_LAYOUT SCALAR_FLOAT64_IEEE FNC_VALUES 1 FLOAT64_IEEE COLUMN_DIR DIRECT /end RECORD_LAYOUT
/begin CHARACTERISTIC Synchronism_ETR07_P.Constant_Value "" VALUE 0x0 SCALAR_FLOAT64_IEEE 3.5e+305 Synchronism_ETR07_CM_double -1.7e+308 1.7e+308 DISPLAY_IDENTIFIER Synchronism_ETR07.Counter.Reset_counter.Constant.Value /end CHARACTERISTIC
/begin CHARACTERISTIC Synchronism_ETR07_P.Constant_Value_e "" VALUE 0x0 SCALAR_FLOAT64_IEEE 3.5e+305 Synchronism_ETR07_CM_double -1.7e+308 1.7e+308 DISPLAY_IDENTIFIER Synchronism_ETR07.Counter.Constant.Value /end CHARACTERISTIC
/begin CHARACTERISTIC Synchronism_ETR07_P.DataStoreMemory_InitialValue "" VALUE 0x0 SCALAR_FLOAT64_IEEE 3.5e+305 Synchronism_ETR07_CM_double -1.7e+308 1.7e+308 DISPLAY_IDENTIFIER Synchronism_ETR07.Counter.Data_Store_Memory.InitialValue /end CHARACTERISTIC
/begin MEASUREMENT Synchronism_ETR07_Y.Sync_CAN1 "" FLOAT64_IEEE Synchronism_ETR07_CM_double 0 0 -1.7e+308 1.7e+308 ECU_ADDRESS 0x0 DISPLAY_IDENTIFIER Synchronism_ETR07.Sync_CAN1 /end MEASUREMENT
/begin MEASUREMENT Synchronism_ETR07_Y.Sync_CAN2 "" FLOAT64_IEEE Synchronism_ETR07_CM_double 0 0 -1.7e+308 1.7e+308 ECU_ADDRESS 0x0 DISPLAY_IDENTIFIER Synchronism_ETR07.Sync_CAN2 /end MEASUREMENT
/end MODULE
/* Synchronism_ETR07 */
/end PROJECT
