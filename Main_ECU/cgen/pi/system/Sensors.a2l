ASAP2_VERSION
/begin PROJECT "Generated by ETAS from INTECRIO integration project"
/begin HEADER "" VERSION "" PROJECT_NO Y /end HEADER
/begin MODULE Sensors "Generated by ETAS from INTECRIO integration project"
/begin MOD_PAR "" VERSION "" ADDR_EPK 0x0 EPK "" SUPPLIER "ETAS GmbH" CUSTOMER "" CUSTOMER_NO "" USER "" PHONE_NO "" ECU "NO_ECU" CPU_TYPE "MPC750" NO_OF_INTERFACES 1 /end MOD_PAR
/begin MOD_COMMON "Common definitions" BYTE_ORDER MSB_FIRST ALIGNMENT_BYTE 1 ALIGNMENT_WORD 2 ALIGNMENT_LONG 4 ALIGNMENT_FLOAT32_IEEE 4 ALIGNMENT_FLOAT64_IEEE 8 /end MOD_COMMON
/begin MEASUREMENT Sensors_ConstB.Square "" FLOAT64_IEEE Sensors_CM_double 0 0 -1.7e+308 1.7e+308 ECU_ADDRESS 0x0 DISPLAY_IDENTIFIER Sensors.Suspension_FL_Data_Conv.T._del_coseno.Square.Square /end MEASUREMENT
/begin COMPU_METHOD Sensors_CM_double "Q = V" /* ConversionType */ RAT_FUNC /* Format */ "%9.6" /* Unit */ "NO_PHYSICAL_QTY" COEFFS 0.0 1.0 0.0 0.0 0.0 1.0 /end COMPU_METHOD
/begin MEASUREMENT Sensors_ConstB.Square1 "" FLOAT64_IEEE Sensors_CM_double 0 0 -1.7e+308 1.7e+308 ECU_ADDRESS 0x0 DISPLAY_IDENTIFIER Sensors.Suspension_FL_Data_Conv.T._del_coseno.Square1.Square1 /end MEASUREMENT
/begin MEASUREMENT Sensors_ConstB.Square1_e "" FLOAT64_IEEE Sensors_CM_double 0 0 -1.7e+308 1.7e+308 ECU_ADDRESS 0x0 DISPLAY_IDENTIFIER Sensors.Suspension_FR_Data_Conv.T._del_coseno.Square1.Square1_e /end MEASUREMENT
/begin MEASUREMENT Sensors_ConstB.Square_m "" FLOAT64_IEEE Sensors_CM_double 0 0 -1.7e+308 1.7e+308 ECU_ADDRESS 0x0 DISPLAY_IDENTIFIER Sensors.Suspension_FR_Data_Conv.T._del_coseno.Square.Square_m /end MEASUREMENT
/begin MEASUREMENT Sensors_ConstB.Subtract "" FLOAT64_IEEE Sensors_CM_double 0 0 -1.7e+308 1.7e+308 ECU_ADDRESS 0x0 DISPLAY_IDENTIFIER Sensors.Suspension_FL_Data_Conv.Subtract.Subtract /end MEASUREMENT
/begin MEASUREMENT Sensors_ConstB.Subtract_a "" FLOAT64_IEEE Sensors_CM_double 0 0 -1.7e+308 1.7e+308 ECU_ADDRESS 0x0 DISPLAY_IDENTIFIER Sensors.Suspension_RR_Data_Conv.Subtract.Subtract_a /end MEASUREMENT
/begin MEASUREMENT Sensors_ConstB.Subtract_h "" FLOAT64_IEEE Sensors_CM_double 0 0 -1.7e+308 1.7e+308 ECU_ADDRESS 0x0 DISPLAY_IDENTIFIER Sensors.Suspension_FR_Data_Conv.Subtract.Subtract_h /end MEASUREMENT
/begin MEASUREMENT Sensors_ConstB.Subtract_m "" FLOAT64_IEEE Sensors_CM_double 0 0 -1.7e+308 1.7e+308 ECU_ADDRESS 0x0 DISPLAY_IDENTIFIER Sensors.Suspension_RL_Data_Conv.Subtract.Subtract_m /end MEASUREMENT
/begin MEASUREMENT Sensors_ConstB.Subtract_p "" FLOAT64_IEEE Sensors_CM_double 0 0 -1.7e+308 1.7e+308 ECU_ADDRESS 0x0 DISPLAY_IDENTIFIER Sensors.Steering_Data_Conv.Low_Pass.Subtract.Subtract_p /end MEASUREMENT
/begin MEASUREMENT Sensors_ConstB.Sum1 "" FLOAT64_IEEE Sensors_CM_double 0 0 -1.7e+308 1.7e+308 ECU_ADDRESS 0x0 DISPLAY_IDENTIFIER Sensors.APPS1_Data_Conv.Sum1.Sum1 /end MEASUREMENT
/begin MEASUREMENT Sensors_ConstB.Sum1_c "" FLOAT64_IEEE Sensors_CM_double 0 0 -1.7e+308 1.7e+308 ECU_ADDRESS 0x0 DISPLAY_IDENTIFIER Sensors.Brake_Pedal_Data_Conv.Sum1.Sum1_c /end MEASUREMENT
/begin MEASUREMENT Sensors_ConstB.Sum1_d "" FLOAT64_IEEE Sensors_CM_double 0 0 -1.7e+308 1.7e+308 ECU_ADDRESS 0x0 DISPLAY_IDENTIFIER Sensors.APPS1_Data_Conv1.Sum1.Sum1_d /end MEASUREMENT
/begin MEASUREMENT Sensors_DW.Previous_IN "" FLOAT64_IEEE Sensors_CM_double 0 0 -1.7e+308 1.7e+308 ECU_ADDRESS 0x0 DISPLAY_IDENTIFIER Sensors.Steering_Data_Conv.Low_Pass.Data_Store_Memory.Previous_IN /end MEASUREMENT
/begin MEASUREMENT Sensors_DW.Previous_OUT "" FLOAT64_IEEE Sensors_CM_double 0 0 -1.7e+308 1.7e+308 ECU_ADDRESS 0x0 DISPLAY_IDENTIFIER Sensors.Steering_Data_Conv.Low_Pass.Data_Store_Memory1.Previous_OUT /end MEASUREMENT
/begin MEASUREMENT Sensors_U.APPS1_Bits "" FLOAT64_IEEE Sensors_CM_double 0 0 -1.7e+308 1.7e+308 ECU_ADDRESS 0x0 DISPLAY_IDENTIFIER Sensors.APPS1_Bits /end MEASUREMENT
/begin MEASUREMENT Sensors_U.APPS2_Bits "" FLOAT64_IEEE Sensors_CM_double 0 0 -1.7e+308 1.7e+308 ECU_ADDRESS 0x0 DISPLAY_IDENTIFIER Sensors.APPS2_Bits /end MEASUREMENT
/begin MEASUREMENT Sensors_U.BrakePedal_Bits "" FLOAT64_IEEE Sensors_CM_double 0 0 -1.7e+308 1.7e+308 ECU_ADDRESS 0x0 DISPLAY_IDENTIFIER Sensors.BrakePedal_Bits /end MEASUREMENT
/begin MEASUREMENT Sensors_U.Disconnection_APPS1 "" FLOAT64_IEEE Sensors_CM_double 0 0 -1.7e+308 1.7e+308 ECU_ADDRESS 0x0 DISPLAY_IDENTIFIER Sensors.Disconnection_APPS1 /end MEASUREMENT
/begin MEASUREMENT Sensors_U.Disconnection_APPS2 "" FLOAT64_IEEE Sensors_CM_double 0 0 -1.7e+308 1.7e+308 ECU_ADDRESS 0x0 DISPLAY_IDENTIFIER Sensors.Disconnection_APPS2 /end MEASUREMENT
/begin MEASUREMENT Sensors_U.SteeringSensor_Bits "" FLOAT64_IEEE Sensors_CM_double 0 0 -1.7e+308 1.7e+308 ECU_ADDRESS 0x0 DISPLAY_IDENTIFIER Sensors.SteeringSensor_Bits /end MEASUREMENT
/begin MEASUREMENT Sensors_U.Susp_F_L_Bits "" FLOAT64_IEEE Sensors_CM_double 0 0 -1.7e+308 1.7e+308 ECU_ADDRESS 0x0 DISPLAY_IDENTIFIER Sensors.Susp_F_L_Bits /end MEASUREMENT
/begin MEASUREMENT Sensors_U.Susp_F_R_Bits "" FLOAT64_IEEE Sensors_CM_double 0 0 -1.7e+308 1.7e+308 ECU_ADDRESS 0x0 DISPLAY_IDENTIFIER Sensors.Susp_F_R_Bits /end MEASUREMENT
/begin MEASUREMENT Sensors_U.Susp_R_L_Bits "" FLOAT64_IEEE Sensors_CM_double 0 0 -1.7e+308 1.7e+308 ECU_ADDRESS 0x0 DISPLAY_IDENTIFIER Sensors.Susp_R_L_Bits /end MEASUREMENT
/begin MEASUREMENT Sensors_U.Susp_R_R_Bits "" FLOAT64_IEEE Sensors_CM_double 0 0 -1.7e+308 1.7e+308 ECU_ADDRESS 0x0 DISPLAY_IDENTIFIER Sensors.Susp_R_R_Bits /end MEASUREMENT
/begin MEASUREMENT Sensors_Y.APPS1_Value "" FLOAT64_IEEE Sensors_CM_double 0 0 -1.7e+308 1.7e+308 ECU_ADDRESS 0x0 DISPLAY_IDENTIFIER Sensors.APPS1_Value /end MEASUREMENT
/begin MEASUREMENT Sensors_Y.APPS2_Value "" FLOAT64_IEEE Sensors_CM_double 0 0 -1.7e+308 1.7e+308 ECU_ADDRESS 0x0 DISPLAY_IDENTIFIER Sensors.APPS2_Value /end MEASUREMENT
/begin MEASUREMENT Sensors_Y.BrakePedal_Value "" FLOAT64_IEEE Sensors_CM_double 0 0 -1.7e+308 1.7e+308 ECU_ADDRESS 0x0 DISPLAY_IDENTIFIER Sensors.BrakePedal_Value /end MEASUREMENT
/begin MEASUREMENT Sensors_Y.SUSP_F_L "" FLOAT64_IEEE Sensors_CM_double 0 0 -1.7e+308 1.7e+308 ECU_ADDRESS 0x0 DISPLAY_IDENTIFIER Sensors.SUSP_F_L /end MEASUREMENT
/begin MEASUREMENT Sensors_Y.SUSP_F_R "" FLOAT64_IEEE Sensors_CM_double 0 0 -1.7e+308 1.7e+308 ECU_ADDRESS 0x0 DISPLAY_IDENTIFIER Sensors.SUSP_F_R /end MEASUREMENT
/begin MEASUREMENT Sensors_Y.SUSP_R_L "" FLOAT64_IEEE Sensors_CM_double 0 0 -1.7e+308 1.7e+308 ECU_ADDRESS 0x0 DISPLAY_IDENTIFIER Sensors.SUSP_R_L /end MEASUREMENT
/begin MEASUREMENT Sensors_Y.SUSP_R_R "" FLOAT64_IEEE Sensors_CM_double 0 0 -1.7e+308 1.7e+308 ECU_ADDRESS 0x0 DISPLAY_IDENTIFIER Sensors.SUSP_R_R /end MEASUREMENT
/begin MEASUREMENT Sensors_Y.SteeringSensor_Value "" FLOAT64_IEEE Sensors_CM_double 0 0 -1.7e+308 1.7e+308 ECU_ADDRESS 0x0 DISPLAY_IDENTIFIER Sensors.SteeringSensor_Value /end MEASUREMENT
/end MODULE
/* Sensors */
/end PROJECT
