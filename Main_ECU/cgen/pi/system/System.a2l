ASAP2_VERSION 1 41
/begin PROJECT ETAS "Generated by ETAS from INTECRIO V4.7.0.1005 integration project"
/begin HEADER "" VERSION "" PROJECT_NO Y /end HEADER
/begin MODULE INTECRIO_MERGED "Generated by ETAS INTECRIO V4.7.0.1005 for M/C interface ETARGET"
/begin MOD_PAR "" VERSION "" ADDR_EPK 0x0 EPK "" SUPPLIER "ETAS GmbH" CUSTOMER "" CUSTOMER_NO "" USER "" PHONE_NO "" ECU "NO_ECU" CPU_TYPE "MPC750" NO_OF_INTERFACES 1 /end MOD_PAR
/begin MOD_COMMON "Common definitions" BYTE_ORDER MSB_FIRST ALIGNMENT_BYTE 1 ALIGNMENT_WORD 2 ALIGNMENT_LONG 4 ALIGNMENT_FLOAT32_IEEE 4 ALIGNMENT_FLOAT64_IEEE 8 /end MOD_COMMON
/begin IF_DATA E_TARGET
 /begin SOURCE "Timer_Inv" 0 3000 QP_BLOB 41 /end SOURCE
 /begin SOURCE "SWT_CAN1_AP_BMS_AIRs_State" 0 1000 QP_BLOB 1 /end SOURCE
 /begin SOURCE "SWT_CAN1_AP_BMS_BatteryTemperatures" 0 1000 QP_BLOB 2 /end SOURCE
 /begin SOURCE "SWT_CAN1_AP_BMS_ChargerParameters" 0 1000 QP_BLOB 3 /end SOURCE
 /begin SOURCE "SWT_CAN1_AP_BMS_Current_SOC_SOH" 0 1000 QP_BLOB 4 /end SOURCE
 /begin SOURCE "SWT_CAN1_AP_BMS_OnBoardTemperatures" 0 1000 QP_BLOB 5 /end SOURCE
 /begin SOURCE "SWT_CAN1_AP_BMS_StateAndFailReport" 0 1000 QP_BLOB 6 /end SOURCE
 /begin SOURCE "SWT_CAN1_AP_BMS_Voltages" 0 1000 QP_BLOB 7 /end SOURCE
 /begin SOURCE "SWT_CAN1_AP_DASH_CustomMode" 0 1000 QP_BLOB 8 /end SOURCE
 /begin SOURCE "SWT_CAN1_AP_DASH_EnableDrive" 0 1000 QP_BLOB 9 /end SOURCE
 /begin SOURCE "SWT_CAN1_AP_DASH_Mode" 0 1000 QP_BLOB 10 /end SOURCE
 /begin SOURCE "SWT_CAN1_AP_DASH_PrechargeRequest" 0 1000 QP_BLOB 11 /end SOURCE
 /begin SOURCE "SWT_CAN1_AP_DASH_TorqueLockOn" 0 1000 QP_BLOB 12 /end SOURCE
 /begin SOURCE "SWT_CAN1_AP_Inverter_L_Tx" 0 1000 QP_BLOB 13 /end SOURCE
 /begin SOURCE "SWT_CAN1_AP_Inverter_R_Tx" 0 1000 QP_BLOB 14 /end SOURCE
 /begin SOURCE "SWT_CAN1_AP_SHUTDOWN_State" 0 1000 QP_BLOB 15 /end SOURCE
 /begin SOURCE "SWT_CAN1_NM_BMS_Keep_Alive" 0 1000 QP_BLOB 16 /end SOURCE
 /begin SOURCE "SWT_CAN1_NM_DASH_Keep_Alive" 0 1000 QP_BLOB 17 /end SOURCE
 /begin SOURCE "SWT_CAN1_NM_SHUTDOWN_Keep_Alive" 0 1000 QP_BLOB 18 /end SOURCE
 /begin SOURCE "SWT_CAN2_AP_ACCEL_F_Data" 0 1000 QP_BLOB 19 /end SOURCE
 /begin SOURCE "SWT_CAN2_AP_ACCEL_R_Data2" 0 1000 QP_BLOB 21 /end SOURCE
 /begin SOURCE "SWT_CAN2_AP_ACCEL_R_Data" 0 1000 QP_BLOB 20 /end SOURCE
 /begin SOURCE "SWT_CAN2_AP_ADCAN_Data1" 0 1000 QP_BLOB 22 /end SOURCE
 /begin SOURCE "SWT_CAN2_AP_ADCAN_Data2" 0 1000 QP_BLOB 23 /end SOURCE
 /begin SOURCE "SWT_CAN2_AP_ELLIPSE_EKF_EULER" 0 1000 QP_BLOB 24 /end SOURCE
 /begin SOURCE "SWT_CAN2_AP_ELLIPSE_EKF_POS" 0 1000 QP_BLOB 25 /end SOURCE
 /begin SOURCE "SWT_CAN2_AP_ELLIPSE_EKF_VEL_BODY" 0 1000 QP_BLOB 26 /end SOURCE
 /begin SOURCE "SWT_CAN2_AP_ELLIPSE_IMU_ACCEL" 0 1000 QP_BLOB 27 /end SOURCE
 /begin SOURCE "SWT_CAN2_AP_ELLIPSE_IMU_GYRO" 0 1000 QP_BLOB 28 /end SOURCE
 /begin SOURCE "SWT_CAN2_AP_ELLIPSE_MAG" 0 1000 QP_BLOB 29 /end SOURCE
 /begin SOURCE "SWT_CAN2_AP_ELLIPSE_SLIP_CURV" 0 1000 QP_BLOB 30 /end SOURCE
 /begin SOURCE "SWT_CAN2_AP_LV_Derivation_LVData" 0 1000 QP_BLOB 31 /end SOURCE
 /begin SOURCE "SWT_CAN2_NM_ACCEL_F_Keep_Alive" 0 1000 QP_BLOB 32 /end SOURCE
 /begin SOURCE "SWT_CAN2_NM_ACCEL_R_Keep_Alive" 0 1000 QP_BLOB 33 /end SOURCE
 /begin SOURCE "SWT_CAN2_NM_ADCAN_Keep_Alive" 0 1000 QP_BLOB 34 /end SOURCE
 /begin SOURCE "SWT_CAN2_NM_ELLIPSE_Status" 0 1000 QP_BLOB 35 /end SOURCE
 /begin SOURCE "SWT_CAN2_NM_LV_Derivation_Keep_Alive" 0 1000 QP_BLOB 36 /end SOURCE
 /begin SOURCE "Sync_25ms" 0 25000 QP_BLOB 37 /end SOURCE
 /begin SOURCE "Timer_1000ms" 0 1000000 QP_BLOB 38 /end SOURCE
 /begin SOURCE "Timer_100ms" 0 100000 QP_BLOB 39 /end SOURCE
 /begin SOURCE "Timer_25ms" 0 25000 QP_BLOB 40 /end SOURCE
 /begin TP_BLOB /* Program identifier */ 3480014753 /* HW target identifier */ 0x6 /* Skip flag */ 0 /* Skip to link */ 2 /* Loader identifier */ 0x02000001 /end TP_BLOB
/end IF_DATA
/begin MEASUREMENT Ellipse.Ellipse_U.ACCEL_X_IMU "" FLOAT64_IEEE Ellipse_CM_double 0 0 -1.7e+308 1.7e+308 ECU_ADDRESS 0x0 DISPLAY_IDENTIFIER Ellipse.ACCEL_X_IMU /end MEASUREMENT
/begin MEASUREMENT Ellipse.Ellipse_U.ACCEL_X_MAG "" FLOAT64_IEEE Ellipse_CM_double 0 0 -1.7e+308 1.7e+308 ECU_ADDRESS 0x0 DISPLAY_IDENTIFIER Ellipse.ACCEL_X_MAG /end MEASUREMENT
/begin MEASUREMENT Ellipse.Ellipse_U.ACCEL_Y_IMU "" FLOAT64_IEEE Ellipse_CM_double 0 0 -1.7e+308 1.7e+308 ECU_ADDRESS 0x0 DISPLAY_IDENTIFIER Ellipse.ACCEL_Y_IMU /end MEASUREMENT
/begin MEASUREMENT Ellipse.Ellipse_U.ACCEL_Y_MAG "" FLOAT64_IEEE Ellipse_CM_double 0 0 -1.7e+308 1.7e+308 ECU_ADDRESS 0x0 DISPLAY_IDENTIFIER Ellipse.ACCEL_Y_MAG /end MEASUREMENT
/begin MEASUREMENT Ellipse.Ellipse_U.ACCEL_Z_IMU "" FLOAT64_IEEE Ellipse_CM_double 0 0 -1.7e+308 1.7e+308 ECU_ADDRESS 0x0 DISPLAY_IDENTIFIER Ellipse.ACCEL_Z_IMU /end MEASUREMENT
/begin MEASUREMENT Ellipse.Ellipse_U.ACCEL_Z_MAG "" FLOAT64_IEEE Ellipse_CM_double 0 0 -1.7e+308 1.7e+308 ECU_ADDRESS 0x0 DISPLAY_IDENTIFIER Ellipse.ACCEL_Z_MAG /end MEASUREMENT
/begin MEASUREMENT Ellipse.Ellipse_U.ANGLE_SLIP "" FLOAT64_IEEE Ellipse_CM_double 0 0 -1.7e+308 1.7e+308 ECU_ADDRESS 0x0 DISPLAY_IDENTIFIER Ellipse.ANGLE_SLIP /end MEASUREMENT
/begin MEASUREMENT Ellipse.Ellipse_U.ANGLE_TRACK "" FLOAT64_IEEE Ellipse_CM_double 0 0 -1.7e+308 1.7e+308 ECU_ADDRESS 0x0 DISPLAY_IDENTIFIER Ellipse.ANGLE_TRACK /end MEASUREMENT
/begin MEASUREMENT Ellipse.Ellipse_U.AUTO_STATUS "" FLOAT64_IEEE Ellipse_CM_double 0 0 -1.7e+308 1.7e+308 ECU_ADDRESS 0x0 DISPLAY_IDENTIFIER Ellipse.AUTO_STATUS /end MEASUREMENT
/begin MEASUREMENT Ellipse.Ellipse_U.CLOCK "" FLOAT64_IEEE Ellipse_CM_double 0 0 -1.7e+308 1.7e+308 ECU_ADDRESS 0x0 DISPLAY_IDENTIFIER Ellipse.CLOCK /end MEASUREMENT
/begin MEASUREMENT Ellipse.Ellipse_U.CURVATURE_RADIUS "" FLOAT64_IEEE Ellipse_CM_double 0 0 -1.7e+308 1.7e+308 ECU_ADDRESS 0x0 DISPLAY_IDENTIFIER Ellipse.CURVATURE_RADIUS /end MEASUREMENT
/begin MEASUREMENT Ellipse.Ellipse_U.GENERAL "" FLOAT64_IEEE Ellipse_CM_double 0 0 -1.7e+308 1.7e+308 ECU_ADDRESS 0x0 DISPLAY_IDENTIFIER Ellipse.GENERAL /end MEASUREMENT
/begin MEASUREMENT Ellipse.Ellipse_U.GYRO_X "" FLOAT64_IEEE Ellipse_CM_double 0 0 -1.7e+308 1.7e+308 ECU_ADDRESS 0x0 DISPLAY_IDENTIFIER Ellipse.GYRO_X /end MEASUREMENT
/begin MEASUREMENT Ellipse.Ellipse_U.GYRO_Y "" FLOAT64_IEEE Ellipse_CM_double 0 0 -1.7e+308 1.7e+308 ECU_ADDRESS 0x0 DISPLAY_IDENTIFIER Ellipse.GYRO_Y /end MEASUREMENT
/begin MEASUREMENT Ellipse.Ellipse_U.GYRO_Z "" FLOAT64_IEEE Ellipse_CM_double 0 0 -1.7e+308 1.7e+308 ECU_ADDRESS 0x0 DISPLAY_IDENTIFIER Ellipse.GYRO_Z /end MEASUREMENT
/begin MEASUREMENT Ellipse.Ellipse_U.LATITUDE_EKF "" FLOAT64_IEEE Ellipse_CM_double 0 0 -1.7e+308 1.7e+308 ECU_ADDRESS 0x0 DISPLAY_IDENTIFIER Ellipse.LATITUDE_EKF /end MEASUREMENT
/begin MEASUREMENT Ellipse.Ellipse_U.LONGITUDE_EKF "" FLOAT64_IEEE Ellipse_CM_double 0 0 -1.7e+308 1.7e+308 ECU_ADDRESS 0x0 DISPLAY_IDENTIFIER Ellipse.LONGITUDE_EKF /end MEASUREMENT
/begin MEASUREMENT Ellipse.Ellipse_U.PITCH "" FLOAT64_IEEE Ellipse_CM_double 0 0 -1.7e+308 1.7e+308 ECU_ADDRESS 0x0 DISPLAY_IDENTIFIER Ellipse.PITCH /end MEASUREMENT
/begin MEASUREMENT Ellipse.Ellipse_U.ROLL "" FLOAT64_IEEE Ellipse_CM_double 0 0 -1.7e+308 1.7e+308 ECU_ADDRESS 0x0 DISPLAY_IDENTIFIER Ellipse.ROLL /end MEASUREMENT
/begin MEASUREMENT Ellipse.Ellipse_U.TIME_STAMP "" FLOAT64_IEEE Ellipse_CM_double 0 0 -1.7e+308 1.7e+308 ECU_ADDRESS 0x0 DISPLAY_IDENTIFIER Ellipse.TIME_STAMP /end MEASUREMENT
/begin MEASUREMENT Ellipse.Ellipse_U.YAW "" FLOAT64_IEEE Ellipse_CM_double 0 0 -1.7e+308 1.7e+308 ECU_ADDRESS 0x0 DISPLAY_IDENTIFIER Ellipse.YAW /end MEASUREMENT
/begin MEASUREMENT Ellipse.Ellipse_U.el_Vel_X "" FLOAT64_IEEE Ellipse_CM_double 0 0 -1.7e+308 1.7e+308 ECU_ADDRESS 0x0 DISPLAY_IDENTIFIER Ellipse.el_Vel_X /end MEASUREMENT
/begin MEASUREMENT Ellipse.Ellipse_U.el_Vel_Y "" FLOAT64_IEEE Ellipse_CM_double 0 0 -1.7e+308 1.7e+308 ECU_ADDRESS 0x0 DISPLAY_IDENTIFIER Ellipse.el_Vel_Y /end MEASUREMENT
/begin MEASUREMENT Ellipse.Ellipse_U.el_Vel_Z "" FLOAT64_IEEE Ellipse_CM_double 0 0 -1.7e+308 1.7e+308 ECU_ADDRESS 0x0 DISPLAY_IDENTIFIER Ellipse.el_Vel_Z /end MEASUREMENT
/begin MEASUREMENT Ellipse.Ellipse_Y.Accel_X_IMU_Tx "" FLOAT64_IEEE Ellipse_CM_double 0 0 -1.7e+308 1.7e+308 ECU_ADDRESS 0x0 DISPLAY_IDENTIFIER Ellipse.Accel_X_IMU_Tx /end MEASUREMENT
/begin MEASUREMENT Ellipse.Ellipse_Y.Accel_X_Mag_Tx "" FLOAT64_IEEE Ellipse_CM_double 0 0 -1.7e+308 1.7e+308 ECU_ADDRESS 0x0 DISPLAY_IDENTIFIER Ellipse.Accel_X_Mag_Tx /end MEASUREMENT
/begin MEASUREMENT Ellipse.Ellipse_Y.Accel_Y_IMU_Tx "" FLOAT64_IEEE Ellipse_CM_double 0 0 -1.7e+308 1.7e+308 ECU_ADDRESS 0x0 DISPLAY_IDENTIFIER Ellipse.Accel_Y_IMU_Tx /end MEASUREMENT
/begin MEASUREMENT Ellipse.Ellipse_Y.Accel_Y_Mag_Tx "" FLOAT64_IEEE Ellipse_CM_double 0 0 -1.7e+308 1.7e+308 ECU_ADDRESS 0x0 DISPLAY_IDENTIFIER Ellipse.Accel_Y_Mag_Tx /end MEASUREMENT
/begin MEASUREMENT Ellipse.Ellipse_Y.Accel_Z_IMU_Tx "" FLOAT64_IEEE Ellipse_CM_double 0 0 -1.7e+308 1.7e+308 ECU_ADDRESS 0x0 DISPLAY_IDENTIFIER Ellipse.Accel_Z_IMU_Tx /end MEASUREMENT
/begin MEASUREMENT Ellipse.Ellipse_Y.Accel_Z_Mag_Tx "" FLOAT64_IEEE Ellipse_CM_double 0 0 -1.7e+308 1.7e+308 ECU_ADDRESS 0x0 DISPLAY_IDENTIFIER Ellipse.Accel_Z_Mag_Tx /end MEASUREMENT
/begin MEASUREMENT Ellipse.Ellipse_Y.Clock_Tx "" FLOAT64_IEEE Ellipse_CM_double 0 0 -1.7e+308 1.7e+308 ECU_ADDRESS 0x0 DISPLAY_IDENTIFIER Ellipse.Clock_Tx /end MEASUREMENT
/begin MEASUREMENT Ellipse.Ellipse_Y.CurvRadius "" FLOAT64_IEEE Ellipse_CM_double 0 0 -1.7e+308 1.7e+308 ECU_ADDRESS 0x0 DISPLAY_IDENTIFIER Ellipse.CurvRadius /end MEASUREMENT
/begin MEASUREMENT Ellipse.Ellipse_Y.General_Tx "" FLOAT64_IEEE Ellipse_CM_double 0 0 -1.7e+308 1.7e+308 ECU_ADDRESS 0x0 DISPLAY_IDENTIFIER Ellipse.General_Tx /end MEASUREMENT
/begin MEASUREMENT Ellipse.Ellipse_Y.Gyro_X_Tx "" FLOAT64_IEEE Ellipse_CM_double 0 0 -1.7e+308 1.7e+308 ECU_ADDRESS 0x0 DISPLAY_IDENTIFIER Ellipse.Gyro_X_Tx /end MEASUREMENT
/begin MEASUREMENT Ellipse.Ellipse_Y.Gyro_Y_Tx "" FLOAT64_IEEE Ellipse_CM_double 0 0 -1.7e+308 1.7e+308 ECU_ADDRESS 0x0 DISPLAY_IDENTIFIER Ellipse.Gyro_Y_Tx /end MEASUREMENT
/begin MEASUREMENT Ellipse.Ellipse_Y.Gyro_Z_Tx "" FLOAT64_IEEE Ellipse_CM_double 0 0 -1.7e+308 1.7e+308 ECU_ADDRESS 0x0 DISPLAY_IDENTIFIER Ellipse.Gyro_Z_Tx /end MEASUREMENT
/begin MEASUREMENT Ellipse.Ellipse_Y.Lat_EKF "" FLOAT64_IEEE Ellipse_CM_double 0 0 -1.7e+308 1.7e+308 ECU_ADDRESS 0x0 DISPLAY_IDENTIFIER Ellipse.Lat_EKF /end MEASUREMENT
/begin MEASUREMENT Ellipse.Ellipse_Y.Long_EKF "" FLOAT64_IEEE Ellipse_CM_double 0 0 -1.7e+308 1.7e+308 ECU_ADDRESS 0x0 DISPLAY_IDENTIFIER Ellipse.Long_EKF /end MEASUREMENT
/begin MEASUREMENT Ellipse.Ellipse_Y.Pitch_Tx "" FLOAT64_IEEE Ellipse_CM_double 0 0 -1.7e+308 1.7e+308 ECU_ADDRESS 0x0 DISPLAY_IDENTIFIER Ellipse.Pitch_Tx /end MEASUREMENT
/begin MEASUREMENT Ellipse.Ellipse_Y.Roll_Tx "" FLOAT64_IEEE Ellipse_CM_double 0 0 -1.7e+308 1.7e+308 ECU_ADDRESS 0x0 DISPLAY_IDENTIFIER Ellipse.Roll_Tx /end MEASUREMENT
/begin MEASUREMENT Ellipse.Ellipse_Y.SlipAngle "" FLOAT64_IEEE Ellipse_CM_double 0 0 -1.7e+308 1.7e+308 ECU_ADDRESS 0x0 DISPLAY_IDENTIFIER Ellipse.SlipAngle /end MEASUREMENT
/begin MEASUREMENT Ellipse.Ellipse_Y.Status_Auto "" FLOAT64_IEEE Ellipse_CM_double 0 0 -1.7e+308 1.7e+308 ECU_ADDRESS 0x0 DISPLAY_IDENTIFIER Ellipse.Status_Auto /end MEASUREMENT
/begin MEASUREMENT Ellipse.Ellipse_Y.Time "" FLOAT64_IEEE Ellipse_CM_double 0 0 -1.7e+308 1.7e+308 ECU_ADDRESS 0x0 DISPLAY_IDENTIFIER Ellipse.Time /end MEASUREMENT
/begin MEASUREMENT Ellipse.Ellipse_Y.TrackAngle "" FLOAT64_IEEE Ellipse_CM_double 0 0 -1.7e+308 1.7e+308 ECU_ADDRESS 0x0 DISPLAY_IDENTIFIER Ellipse.TrackAngle /end MEASUREMENT
/begin MEASUREMENT Ellipse.Ellipse_Y.Vel_X "" FLOAT64_IEEE Ellipse_CM_double 0 0 -1.7e+308 1.7e+308 ECU_ADDRESS 0x0 DISPLAY_IDENTIFIER Ellipse.Vel_X /end MEASUREMENT
/begin MEASUREMENT Ellipse.Ellipse_Y.Vel_Y "" FLOAT64_IEEE Ellipse_CM_double 0 0 -1.7e+308 1.7e+308 ECU_ADDRESS 0x0 DISPLAY_IDENTIFIER Ellipse.Vel_Y /end MEASUREMENT
/begin MEASUREMENT Ellipse.Ellipse_Y.Vel_Z "" FLOAT64_IEEE Ellipse_CM_double 0 0 -1.7e+308 1.7e+308 ECU_ADDRESS 0x0 DISPLAY_IDENTIFIER Ellipse.Vel_Z /end MEASUREMENT
/begin MEASUREMENT Ellipse.Ellipse_Y.Yaw_Tx "" FLOAT64_IEEE Ellipse_CM_double 0 0 -1.7e+308 1.7e+308 ECU_ADDRESS 0x0 DISPLAY_IDENTIFIER Ellipse.Yaw_Tx /end MEASUREMENT
/begin MEASUREMENT Inverters_Action.Inverters_Action_B.Merge "" UBYTE Inverters_Action_CM_boolean 0 0 0 1 ECU_ADDRESS 0x0 DISPLAY_IDENTIFIER Inverters_Action.Merge.Merge /end MEASUREMENT
/begin MEASUREMENT Inverters_Action.Inverters_Action_B.Merge2 "" UBYTE Inverters_Action_CM_uint8 0 0 0.0 255.0 ECU_ADDRESS 0x0 DISPLAY_IDENTIFIER Inverters_Action.Subsystem9.Merge2.Merge2 /end MEASUREMENT
/begin MEASUREMENT Inverters_Action.Inverters_Action_B.Merge2_p "" UBYTE Inverters_Action_CM_uint8 0 0 0.0 255.0 ECU_ADDRESS 0x0 DISPLAY_IDENTIFIER Inverters_Action.Subsystem10.Merge2.Merge2_p /end MEASUREMENT
/begin MEASUREMENT Inverters_Action.Inverters_Action_B.subscribed "" UBYTE Inverters_Action_CM_boolean 0 0 0 1 ECU_ADDRESS 0x0 DISPLAY_IDENTIFIER Inverters_Action.Subsystem9.Unsubscribe__Subscribe.subscribed_.subscribed /end MEASUREMENT
/begin MEASUREMENT Inverters_Action.Inverters_Action_B.subscribed_b "" UBYTE Inverters_Action_CM_boolean 0 0 0 1 ECU_ADDRESS 0x0 DISPLAY_IDENTIFIER Inverters_Action.Subsystem10.Unsubscribe__Subscribe.subscribed_.subscribed_b /end MEASUREMENT
/begin MEASUREMENT Inverters_Action.Inverters_Action_DW.EnumerationCounter "" FLOAT64_IEEE Inverters_Action_CM_double 0 0 -1.7e+308 1.7e+308 ECU_ADDRESS 0x0 DISPLAY_IDENTIFIER Inverters_Action.Subsystem10.Data_Store_Memory2.EnumerationCounter /end MEASUREMENT
/begin MEASUREMENT Inverters_Action.Inverters_Action_DW.EnumerationCounter_m "" FLOAT64_IEEE Inverters_Action_CM_double 0 0 -1.7e+308 1.7e+308 ECU_ADDRESS 0x0 DISPLAY_IDENTIFIER Inverters_Action.Subsystem9.Data_Store_Memory2.EnumerationCounter_m /end MEASUREMENT
/begin MEASUREMENT Inverters_Action.Inverters_Action_DW.LastAction "" FLOAT64_IEEE Inverters_Action_CM_double 0 0 -1.7e+308 1.7e+308 ECU_ADDRESS 0x0 DISPLAY_IDENTIFIER Inverters_Action.Subsystem10.Data_Store_Memory1.LastAction /end MEASUREMENT
/begin MEASUREMENT Inverters_Action.Inverters_Action_DW.LastAction_k "" FLOAT64_IEEE Inverters_Action_CM_double 0 0 -1.7e+308 1.7e+308 ECU_ADDRESS 0x0 DISPLAY_IDENTIFIER Inverters_Action.Subsystem9.Data_Store_Memory1.LastAction_k /end MEASUREMENT
/begin MEASUREMENT Inverters_Action.Inverters_Action_U.InvertersAction "" FLOAT64_IEEE Inverters_Action_CM_double 0 0 -1.7e+308 1.7e+308 ECU_ADDRESS 0x0 DISPLAY_IDENTIFIER Inverters_Action.InvertersAction /end MEASUREMENT
/begin MEASUREMENT Inverters_Action.Inverters_Action_U.current_L "" FLOAT64_IEEE Inverters_Action_CM_double 0 0 -1.7e+308 1.7e+308 ECU_ADDRESS 0x0 DISPLAY_IDENTIFIER Inverters_Action.current_L /end MEASUREMENT
/begin MEASUREMENT Inverters_Action.Inverters_Action_U.current_R "" FLOAT64_IEEE Inverters_Action_CM_double 0 0 -1.7e+308 1.7e+308 ECU_ADDRESS 0x0 DISPLAY_IDENTIFIER Inverters_Action.current_R /end MEASUREMENT
/begin MEASUREMENT Inverters_Action.Inverters_Action_Y.Inverter_L_RegID "" UBYTE Inverters_Action_CM_uint8 0 0 0.0 255.0 ECU_ADDRESS 0x0 DISPLAY_IDENTIFIER Inverters_Action.Inverter_L_RegID /end MEASUREMENT
/begin MEASUREMENT Inverters_Action.Inverters_Action_Y.Inverter_L_b15tob8 "" UBYTE Inverters_Action_CM_uint8 0 0 0.0 255.0 ECU_ADDRESS 0x0 DISPLAY_IDENTIFIER Inverters_Action.Inverter_L_b15tob8 /end MEASUREMENT
/begin MEASUREMENT Inverters_Action.Inverters_Action_Y.Inverter_L_b7tob0 "" UBYTE Inverters_Action_CM_uint8 0 0 0.0 255.0 ECU_ADDRESS 0x0 DISPLAY_IDENTIFIER Inverters_Action.Inverter_L_b7tob0 /end MEASUREMENT
/begin MEASUREMENT Inverters_Action.Inverters_Action_Y.Inverter_R_RegID "" UBYTE Inverters_Action_CM_uint8 0 0 0.0 255.0 ECU_ADDRESS 0x0 DISPLAY_IDENTIFIER Inverters_Action.Inverter_R_RegID /end MEASUREMENT
/begin MEASUREMENT Inverters_Action.Inverters_Action_Y.Inverter_R_b15tob8 "" UBYTE Inverters_Action_CM_uint8 0 0 0.0 255.0 ECU_ADDRESS 0x0 DISPLAY_IDENTIFIER Inverters_Action.Inverter_R_b15tob8 /end MEASUREMENT
/begin MEASUREMENT Inverters_Action.Inverters_Action_Y.Inverter_R_b7tob0 "" UBYTE Inverters_Action_CM_uint8 0 0 0.0 255.0 ECU_ADDRESS 0x0 DISPLAY_IDENTIFIER Inverters_Action.Inverter_R_b7tob0 /end MEASUREMENT
/begin MEASUREMENT Inverters_Action.Inverters_Action_Y.InvertersSubscribed "" UBYTE Inverters_Action_CM_boolean 0 0 0 1 ECU_ADDRESS 0x0 DISPLAY_IDENTIFIER Inverters_Action.InvertersSubscribed /end MEASUREMENT
/begin MEASUREMENT Inverters_Data.Inverters_Data_U.Inv_L_RegID_M235_Inv_L_DCBus "" FLOAT64_IEEE Inverters_Data_CM_double 0 0 -1.7e+308 1.7e+308 ECU_ADDRESS 0x0 DISPLAY_IDENTIFIER Inverters_Data.Inv_L_RegID_M235_Inv_L_DCBus /end MEASUREMENT
/begin MEASUREMENT Inverters_Data.Inverters_Data_U.Inv_L_RegID_M32_Inv_L_Iactual "" FLOAT64_IEEE Inverters_Data_CM_double 0 0 -1.7e+308 1.7e+308 ECU_ADDRESS 0x0 DISPLAY_IDENTIFIER Inverters_Data.Inv_L_RegID_M32_Inv_L_Iactual /end MEASUREMENT
/begin MEASUREMENT Inverters_Data.Inverters_Data_U.Inv_L_RegID_M38_Inv_L_Icommand "" FLOAT64_IEEE Inverters_Data_CM_double 0 0 -1.7e+308 1.7e+308 ECU_ADDRESS 0x0 DISPLAY_IDENTIFIER Inverters_Data.Inv_L_RegID_M38_Inv_L_Icommand /end MEASUREMENT
/begin MEASUREMENT Inverters_Data.Inverters_Data_U.Inv_L_RegID_M39_Inv_L_Iq "" FLOAT64_IEEE Inverters_Data_CM_double 0 0 -1.7e+308 1.7e+308 ECU_ADDRESS 0x0 DISPLAY_IDENTIFIER Inverters_Data.Inv_L_RegID_M39_Inv_L_Iq /end MEASUREMENT
/begin MEASUREMENT Inverters_Data.Inverters_Data_U.Inv_L_RegID_M48_Inv_L_Speed "" FLOAT64_IEEE Inverters_Data_CM_double 0 0 -1.7e+308 1.7e+308 ECU_ADDRESS 0x0 DISPLAY_IDENTIFIER Inverters_Data.Inv_L_RegID_M48_Inv_L_Speed /end MEASUREMENT
/begin MEASUREMENT Inverters_Data.Inverters_Data_U.Inv_L_RegID_M73_Inv_L_TempMotor "" FLOAT64_IEEE Inverters_Data_CM_double 0 0 -1.7e+308 1.7e+308 ECU_ADDRESS 0x0 DISPLAY_IDENTIFIER Inverters_Data.Inv_L_RegID_M73_Inv_L_TempMotor /end MEASUREMENT
/begin MEASUREMENT Inverters_Data.Inverters_Data_U.Inv_L_RegID_M74_Inv_L_TempIGBT "" FLOAT64_IEEE Inverters_Data_CM_double 0 0 -1.7e+308 1.7e+308 ECU_ADDRESS 0x0 DISPLAY_IDENTIFIER Inverters_Data.Inv_L_RegID_M74_Inv_L_TempIGBT /end MEASUREMENT
/begin MEASUREMENT Inverters_Data.Inverters_Data_U.Inv_R_RegID_M235_Inv_R_DCBus "" FLOAT64_IEEE Inverters_Data_CM_double 0 0 -1.7e+308 1.7e+308 ECU_ADDRESS 0x0 DISPLAY_IDENTIFIER Inverters_Data.Inv_R_RegID_M235_Inv_R_DCBus /end MEASUREMENT
/begin MEASUREMENT Inverters_Data.Inverters_Data_U.Inv_R_RegID_M32_Inv_R_Iactual "" FLOAT64_IEEE Inverters_Data_CM_double 0 0 -1.7e+308 1.7e+308 ECU_ADDRESS 0x0 DISPLAY_IDENTIFIER Inverters_Data.Inv_R_RegID_M32_Inv_R_Iactual /end MEASUREMENT
/begin MEASUREMENT Inverters_Data.Inverters_Data_U.Inv_R_RegID_M38_Inv_R_Icommand "" FLOAT64_IEEE Inverters_Data_CM_double 0 0 -1.7e+308 1.7e+308 ECU_ADDRESS 0x0 DISPLAY_IDENTIFIER Inverters_Data.Inv_R_RegID_M38_Inv_R_Icommand /end MEASUREMENT
/begin MEASUREMENT Inverters_Data.Inverters_Data_U.Inv_R_RegID_M39_Inv_R_Iq "" FLOAT64_IEEE Inverters_Data_CM_double 0 0 -1.7e+308 1.7e+308 ECU_ADDRESS 0x0 DISPLAY_IDENTIFIER Inverters_Data.Inv_R_RegID_M39_Inv_R_Iq /end MEASUREMENT
/begin MEASUREMENT Inverters_Data.Inverters_Data_U.Inv_R_RegID_M48_Inv_R_Speed "" FLOAT64_IEEE Inverters_Data_CM_double 0 0 -1.7e+308 1.7e+308 ECU_ADDRESS 0x0 DISPLAY_IDENTIFIER Inverters_Data.Inv_R_RegID_M48_Inv_R_Speed /end MEASUREMENT
/begin MEASUREMENT Inverters_Data.Inverters_Data_U.Inv_R_RegID_M73_Inv_R_TempMotor "" FLOAT64_IEEE Inverters_Data_CM_double 0 0 -1.7e+308 1.7e+308 ECU_ADDRESS 0x0 DISPLAY_IDENTIFIER Inverters_Data.Inv_R_RegID_M73_Inv_R_TempMotor /end MEASUREMENT
/begin MEASUREMENT Inverters_Data.Inverters_Data_U.Inv_R_RegID_M74_Inv_R_TempIGBT "" FLOAT64_IEEE Inverters_Data_CM_double 0 0 -1.7e+308 1.7e+308 ECU_ADDRESS 0x0 DISPLAY_IDENTIFIER Inverters_Data.Inv_R_RegID_M74_Inv_R_TempIGBT /end MEASUREMENT
/begin MEASUREMENT Inverters_Data.Inverters_Data_U.Torque_L "" FLOAT64_IEEE Inverters_Data_CM_double 0 0 -1.7e+308 1.7e+308 ECU_ADDRESS 0x0 DISPLAY_IDENTIFIER Inverters_Data.Torque_L /end MEASUREMENT
/begin MEASUREMENT Inverters_Data.Inverters_Data_U.Torque_R "" FLOAT64_IEEE Inverters_Data_CM_double 0 0 -1.7e+308 1.7e+308 ECU_ADDRESS 0x0 DISPLAY_IDENTIFIER Inverters_Data.Torque_R /end MEASUREMENT
/begin MEASUREMENT Inverters_Data.Inverters_Data_Y.Inv_L_Iactual "" FLOAT64_IEEE Inverters_Data_CM_double 0 0 -1.7e+308 1.7e+308 ECU_ADDRESS 0x0 DISPLAY_IDENTIFIER Inverters_Data.Inv_L_Iactual /end MEASUREMENT
/begin MEASUREMENT Inverters_Data.Inverters_Data_Y.Inv_L_Icommand "" FLOAT64_IEEE Inverters_Data_CM_double 0 0 -1.7e+308 1.7e+308 ECU_ADDRESS 0x0 DISPLAY_IDENTIFIER Inverters_Data.Inv_L_Icommand /end MEASUREMENT
/begin MEASUREMENT Inverters_Data.Inverters_Data_Y.Inv_L_Iq "" FLOAT64_IEEE Inverters_Data_CM_double 0 0 -1.7e+308 1.7e+308 ECU_ADDRESS 0x0 DISPLAY_IDENTIFIER Inverters_Data.Inv_L_Iq /end MEASUREMENT
/begin MEASUREMENT Inverters_Data.Inverters_Data_Y.Inv_L_Speed "" FLOAT64_IEEE Inverters_Data_CM_double 0 0 -1.7e+308 1.7e+308 ECU_ADDRESS 0x0 DISPLAY_IDENTIFIER Inverters_Data.Inv_L_Speed /end MEASUREMENT
/begin MEASUREMENT Inverters_Data.Inverters_Data_Y.Inv_L_TempIGBT "" FLOAT64_IEEE Inverters_Data_CM_double 0 0 -1.7e+308 1.7e+308 ECU_ADDRESS 0x0 DISPLAY_IDENTIFIER Inverters_Data.Inv_L_TempIGBT /end MEASUREMENT
/begin MEASUREMENT Inverters_Data.Inverters_Data_Y.Inv_L_TempMotor "" FLOAT64_IEEE Inverters_Data_CM_double 0 0 -1.7e+308 1.7e+308 ECU_ADDRESS 0x0 DISPLAY_IDENTIFIER Inverters_Data.Inv_L_TempMotor /end MEASUREMENT
/begin MEASUREMENT Inverters_Data.Inverters_Data_Y.Inv_L_VdcBus "" FLOAT64_IEEE Inverters_Data_CM_double 0 0 -1.7e+308 1.7e+308 ECU_ADDRESS 0x0 DISPLAY_IDENTIFIER Inverters_Data.Inv_L_VdcBus /end MEASUREMENT
/begin MEASUREMENT Inverters_Data.Inverters_Data_Y.Inv_R_Iactual "" FLOAT64_IEEE Inverters_Data_CM_double 0 0 -1.7e+308 1.7e+308 ECU_ADDRESS 0x0 DISPLAY_IDENTIFIER Inverters_Data.Inv_R_Iactual /end MEASUREMENT
/begin MEASUREMENT Inverters_Data.Inverters_Data_Y.Inv_R_Icommand "" FLOAT64_IEEE Inverters_Data_CM_double 0 0 -1.7e+308 1.7e+308 ECU_ADDRESS 0x0 DISPLAY_IDENTIFIER Inverters_Data.Inv_R_Icommand /end MEASUREMENT
/begin MEASUREMENT Inverters_Data.Inverters_Data_Y.Inv_R_Iq "" FLOAT64_IEEE Inverters_Data_CM_double 0 0 -1.7e+308 1.7e+308 ECU_ADDRESS 0x0 DISPLAY_IDENTIFIER Inverters_Data.Inv_R_Iq /end MEASUREMENT
/begin MEASUREMENT Inverters_Data.Inverters_Data_Y.Inv_R_Speed "" FLOAT64_IEEE Inverters_Data_CM_double 0 0 -1.7e+308 1.7e+308 ECU_ADDRESS 0x0 DISPLAY_IDENTIFIER Inverters_Data.Inv_R_Speed /end MEASUREMENT
/begin MEASUREMENT Inverters_Data.Inverters_Data_Y.Inv_R_TempIGBT "" FLOAT64_IEEE Inverters_Data_CM_double 0 0 -1.7e+308 1.7e+308 ECU_ADDRESS 0x0 DISPLAY_IDENTIFIER Inverters_Data.Inv_R_TempIGBT /end MEASUREMENT
/begin MEASUREMENT Inverters_Data.Inverters_Data_Y.Inv_R_TempMotor "" FLOAT64_IEEE Inverters_Data_CM_double 0 0 -1.7e+308 1.7e+308 ECU_ADDRESS 0x0 DISPLAY_IDENTIFIER Inverters_Data.Inv_R_TempMotor /end MEASUREMENT
/begin MEASUREMENT Inverters_Data.Inverters_Data_Y.Inv_R_VdcBus "" FLOAT64_IEEE Inverters_Data_CM_double 0 0 -1.7e+308 1.7e+308 ECU_ADDRESS 0x0 DISPLAY_IDENTIFIER Inverters_Data.Inv_R_VdcBus /end MEASUREMENT
/begin MEASUREMENT Inverters_Data.Inverters_Data_Y.InvertersMinDCBus "" FLOAT64_IEEE Inverters_Data_CM_double 0 0 -1.7e+308 1.7e+308 ECU_ADDRESS 0x0 DISPLAY_IDENTIFIER Inverters_Data.InvertersMinDCBus /end MEASUREMENT
/begin MEASUREMENT Inverters_Data.Inverters_Data_Y.Mech_Power "" FLOAT64_IEEE Inverters_Data_CM_double 0 0 -1.7e+308 1.7e+308 ECU_ADDRESS 0x0 DISPLAY_IDENTIFIER Inverters_Data.Mech_Power /end MEASUREMENT
/begin MEASUREMENT Inverters_Data.Inverters_Data_Y.RL_rads "" FLOAT64_IEEE Inverters_Data_CM_double 0 0 -1.7e+308 1.7e+308 ECU_ADDRESS 0x0 DISPLAY_IDENTIFIER Inverters_Data.RL_rads /end MEASUREMENT
/begin MEASUREMENT Inverters_Data.Inverters_Data_Y.RR_rads "" FLOAT64_IEEE Inverters_Data_CM_double 0 0 -1.7e+308 1.7e+308 ECU_ADDRESS 0x0 DISPLAY_IDENTIFIER Inverters_Data.RR_rads /end MEASUREMENT
/begin MEASUREMENT Inverters_Data.Inverters_Data_Y.Speed "" FLOAT64_IEEE Inverters_Data_CM_double 0 0 -1.7e+308 1.7e+308 ECU_ADDRESS 0x0 DISPLAY_IDENTIFIER Inverters_Data.Speed /end MEASUREMENT
/begin MEASUREMENT Inverters_Data.Inverters_Data_Y.Temp_IGBT "" FLOAT64_IEEE Inverters_Data_CM_double 0 0 -1.7e+308 1.7e+308 ECU_ADDRESS 0x0 DISPLAY_IDENTIFIER Inverters_Data.Temp_IGBT /end MEASUREMENT
/begin MEASUREMENT Inverters_Data.Inverters_Data_Y.Temp_Motors "" FLOAT64_IEEE Inverters_Data_CM_double 0 0 -1.7e+308 1.7e+308 ECU_ADDRESS 0x0 DISPLAY_IDENTIFIER Inverters_Data.Temp_Motors /end MEASUREMENT
/begin MEASUREMENT Inverters_Data.Inverters_Data_Y.Vel_RL_kmh "" FLOAT64_IEEE Inverters_Data_CM_double 0 0 -1.7e+308 1.7e+308 ECU_ADDRESS 0x0 DISPLAY_IDENTIFIER Inverters_Data.Vel_RL_kmh /end MEASUREMENT
/begin MEASUREMENT Inverters_Data.Inverters_Data_Y.Vel_RR_kmh "" FLOAT64_IEEE Inverters_Data_CM_double 0 0 -1.7e+308 1.7e+308 ECU_ADDRESS 0x0 DISPLAY_IDENTIFIER Inverters_Data.Vel_RR_kmh /end MEASUREMENT
/begin MEASUREMENT LVD_Data.LVD_Data_DW.Previous_IN "" FLOAT64_IEEE LVD_Data_CM_double 0 0 -1.7e+308 1.7e+308 ECU_ADDRESS 0x0 DISPLAY_IDENTIFIER LVD_Data.Low_Pass.Data_Store_Memory.Previous_IN /end MEASUREMENT
/begin MEASUREMENT LVD_Data.LVD_Data_DW.Previous_OUT "" FLOAT64_IEEE LVD_Data_CM_double 0 0 -1.7e+308 1.7e+308 ECU_ADDRESS 0x0 DISPLAY_IDENTIFIER LVD_Data.Low_Pass.Data_Store_Memory1.Previous_OUT /end MEASUREMENT
/begin MEASUREMENT LVD_Data.LVD_Data_U.LVBattery_Voltage_Bits "" FLOAT64_IEEE LVD_Data_CM_double 0 0 -1.7e+308 1.7e+308 ECU_ADDRESS 0x0 DISPLAY_IDENTIFIER LVD_Data.LVBattery_Voltage_Bits /end MEASUREMENT
/begin MEASUREMENT LVD_Data.LVD_Data_Y.LVbattery_Voltage "" FLOAT64_IEEE LVD_Data_CM_double 0 0 -1.7e+308 1.7e+308 ECU_ADDRESS 0x0 DISPLAY_IDENTIFIER LVD_Data.LVbattery_Voltage /end MEASUREMENT
/begin MEASUREMENT Racing_Mode.Racing_Mode_B.Apps_Sat_Dwn.Gain "" FLOAT64_IEEE Racing_Mode_CM_double 0 0 -1.7e+308 1.7e+308 ECU_ADDRESS 0x0 DISPLAY_IDENTIFIER Racing_Mode.Custom_Dash__11_.Apps_Sat_Dwn.Gain.Gain /end MEASUREMENT
/begin MEASUREMENT Racing_Mode.Racing_Mode_B.Apps_Sat_Up.Gain "" FLOAT64_IEEE Racing_Mode_CM_double 0 0 -1.7e+308 1.7e+308 ECU_ADDRESS 0x0 DISPLAY_IDENTIFIER Racing_Mode.Custom_Dash__11_.Apps_Sat_Up.Gain.Gain /end MEASUREMENT
/begin MEASUREMENT Racing_Mode.Racing_Mode_B.CKF_Initial.Gain "" FLOAT64_IEEE Racing_Mode_CM_double 0 0 -1.7e+308 1.7e+308 ECU_ADDRESS 0x0 DISPLAY_IDENTIFIER Racing_Mode.Custom_Dash__11_.CKF_Initial.Gain.Gain /end MEASUREMENT
/begin MEASUREMENT Racing_Mode.Racing_Mode_B.Cte_CKF.Gain "" FLOAT64_IEEE Racing_Mode_CM_double 0 0 -1.7e+308 1.7e+308 ECU_ADDRESS 0x0 DISPLAY_IDENTIFIER Racing_Mode.Custom_Dash__11_.Cte_CKF.Gain.Gain /end MEASUREMENT
/begin MEASUREMENT Racing_Mode.Racing_Mode_B.Cte_SKF.Gain "" FLOAT64_IEEE Racing_Mode_CM_double 0 0 -1.7e+308 1.7e+308 ECU_ADDRESS 0x0 DISPLAY_IDENTIFIER Racing_Mode.Custom_Dash__11_.Cte_SKF.Gain.Gain /end MEASUREMENT
/begin MEASUREMENT Racing_Mode.Racing_Mode_B.K_Reduction_P.Gain "" FLOAT64_IEEE Racing_Mode_CM_double 0 0 -1.7e+308 1.7e+308 ECU_ADDRESS 0x0 DISPLAY_IDENTIFIER Racing_Mode.Custom_Dash__11_.K_Reduction_P.Gain.Gain /end MEASUREMENT
/begin MEASUREMENT Racing_Mode.Racing_Mode_B.K_Reduction_Temperature.Gain "" FLOAT64_IEEE Racing_Mode_CM_double 0 0 -1.7e+308 1.7e+308 ECU_ADDRESS 0x0 DISPLAY_IDENTIFIER Racing_Mode.Custom_Dash__11_.K_Reduction_Temperature.Gain.Gain /end MEASUREMENT
/begin MEASUREMENT Racing_Mode.Racing_Mode_B.Max_Regenerative_Torque.In1 "" FLOAT64_IEEE Racing_Mode_CM_double 0 0 -1.7e+308 1.7e+308 ECU_ADDRESS 0x0 DISPLAY_IDENTIFIER Racing_Mode.Custom_Dash__11_.Max_Regenerative_Torque.In1.In1 /end MEASUREMENT
/begin MEASUREMENT Racing_Mode.Racing_Mode_B.Merge "" FLOAT64_IEEE Racing_Mode_CM_double 0 0 -1.7e+308 1.7e+308 ECU_ADDRESS 0x0 DISPLAY_IDENTIFIER Racing_Mode.Merge.Merge ARRAY_SIZE 10 /end MEASUREMENT
/begin MEASUREMENT Racing_Mode.Racing_Mode_B.Power_Limit.In1 "" FLOAT64_IEEE Racing_Mode_CM_double 0 0 -1.7e+308 1.7e+308 ECU_ADDRESS 0x0 DISPLAY_IDENTIFIER Racing_Mode.Custom_Dash__11_.Power_Limit.In1.In1 /end MEASUREMENT
/begin MEASUREMENT Racing_Mode.Racing_Mode_B.SKF_Initial.Gain "" FLOAT64_IEEE Racing_Mode_CM_double 0 0 -1.7e+308 1.7e+308 ECU_ADDRESS 0x0 DISPLAY_IDENTIFIER Racing_Mode.Custom_Dash__11_.SKF_Initial.Gain.Gain /end MEASUREMENT
/begin MEASUREMENT Racing_Mode.Racing_Mode_U.CustomMode_Data "" FLOAT64_IEEE Racing_Mode_CM_double 0 0 -1.7e+308 1.7e+308 ECU_ADDRESS 0x0 DISPLAY_IDENTIFIER Racing_Mode.CustomMode_Data /end MEASUREMENT
/begin MEASUREMENT Racing_Mode.Racing_Mode_U.CustomMode_Identifier "" FLOAT64_IEEE Racing_Mode_CM_double 0 0 -1.7e+308 1.7e+308 ECU_ADDRESS 0x0 DISPLAY_IDENTIFIER Racing_Mode.CustomMode_Identifier /end MEASUREMENT
/begin MEASUREMENT Racing_Mode.Racing_Mode_U.RacingMode "" UBYTE Racing_Mode_CM_uint8 0 0 0.0 255.0 ECU_ADDRESS 0x0 DISPLAY_IDENTIFIER Racing_Mode.RacingMode /end MEASUREMENT
/begin MEASUREMENT Racing_Mode.Racing_Mode_Y.VDC_Apps_Sat_Down "" FLOAT64_IEEE Racing_Mode_CM_double 0 0 -1.7e+308 1.7e+308 ECU_ADDRESS 0x0 DISPLAY_IDENTIFIER Racing_Mode.VDC_Apps_Sat_Down /end MEASUREMENT
/begin MEASUREMENT Racing_Mode.Racing_Mode_Y.VDC_Apps_Sat_Up "" FLOAT64_IEEE Racing_Mode_CM_double 0 0 -1.7e+308 1.7e+308 ECU_ADDRESS 0x0 DISPLAY_IDENTIFIER Racing_Mode.VDC_Apps_Sat_Up /end MEASUREMENT
/begin MEASUREMENT Racing_Mode.Racing_Mode_Y.VDC_CKF_Initial "" FLOAT64_IEEE Racing_Mode_CM_double 0 0 -1.7e+308 1.7e+308 ECU_ADDRESS 0x0 DISPLAY_IDENTIFIER Racing_Mode.VDC_CKF_Initial /end MEASUREMENT
/begin MEASUREMENT Racing_Mode.Racing_Mode_Y.VDC_Cte_CKF "" FLOAT64_IEEE Racing_Mode_CM_double 0 0 -1.7e+308 1.7e+308 ECU_ADDRESS 0x0 DISPLAY_IDENTIFIER Racing_Mode.VDC_Cte_CKF /end MEASUREMENT
/begin MEASUREMENT Racing_Mode.Racing_Mode_Y.VDC_Cte_SKF "" FLOAT64_IEEE Racing_Mode_CM_double 0 0 -1.7e+308 1.7e+308 ECU_ADDRESS 0x0 DISPLAY_IDENTIFIER Racing_Mode.VDC_Cte_SKF /end MEASUREMENT
/begin MEASUREMENT Racing_Mode.Racing_Mode_Y.VDC_K_Reduction_P "" FLOAT64_IEEE Racing_Mode_CM_double 0 0 -1.7e+308 1.7e+308 ECU_ADDRESS 0x0 DISPLAY_IDENTIFIER Racing_Mode.VDC_K_Reduction_P /end MEASUREMENT
/begin MEASUREMENT Racing_Mode.Racing_Mode_Y.VDC_K_Reduction_Temperature "" FLOAT64_IEEE Racing_Mode_CM_double 0 0 -1.7e+308 1.7e+308 ECU_ADDRESS 0x0 DISPLAY_IDENTIFIER Racing_Mode.VDC_K_Reduction_Temperature /end MEASUREMENT
/begin MEASUREMENT Racing_Mode.Racing_Mode_Y.VDC_Max_Regenerative_Torque "" FLOAT64_IEEE Racing_Mode_CM_double 0 0 -1.7e+308 1.7e+308 ECU_ADDRESS 0x0 DISPLAY_IDENTIFIER Racing_Mode.VDC_Max_Regenerative_Torque /end MEASUREMENT
/begin MEASUREMENT Racing_Mode.Racing_Mode_Y.VDC_Power_Limit "" FLOAT64_IEEE Racing_Mode_CM_double 0 0 -1.7e+308 1.7e+308 ECU_ADDRESS 0x0 DISPLAY_IDENTIFIER Racing_Mode.VDC_Power_Limit /end MEASUREMENT
/begin MEASUREMENT Racing_Mode.Racing_Mode_Y.VDC_SKF_Initial "" FLOAT64_IEEE Racing_Mode_CM_double 0 0 -1.7e+308 1.7e+308 ECU_ADDRESS 0x0 DISPLAY_IDENTIFIER Racing_Mode.VDC_SKF_Initial /end MEASUREMENT
/begin MEASUREMENT Racing_Mode.Racing_Mode_Y.Workshop_Mode_Enable "" UBYTE Racing_Mode_CM_boolean 0 0 0 1 ECU_ADDRESS 0x0 DISPLAY_IDENTIFIER Racing_Mode.Workshop_Mode_Enable /end MEASUREMENT
/begin MEASUREMENT Synchronism.Synchronism_DW.counter "" FLOAT64_IEEE Synchronism_CM_double 0 0 -1.7e+308 1.7e+308 ECU_ADDRESS 0x0 DISPLAY_IDENTIFIER Synchronism.Counter.Data_Store_Memory.counter /end MEASUREMENT
/begin MEASUREMENT Synchronism.Synchronism_Y.Sync_CAN1 "" FLOAT64_IEEE Synchronism_CM_double 0 0 -1.7e+308 1.7e+308 ECU_ADDRESS 0x0 DISPLAY_IDENTIFIER Synchronism.Sync_CAN1 /end MEASUREMENT
/begin MEASUREMENT Synchronism.Synchronism_Y.Sync_CAN2 "" FLOAT64_IEEE Synchronism_CM_double 0 0 -1.7e+308 1.7e+308 ECU_ADDRESS 0x0 DISPLAY_IDENTIFIER Synchronism.Sync_CAN2 /end MEASUREMENT
/begin CHARACTERISTIC Inverters_Action.Inverters_Action_P.Constant_Value "" VALUE 0x0 SCALAR_UBYTE 255.0 Inverters_Action_CM_uint8 0.0 255.0 DISPLAY_IDENTIFIER Inverters_Action.Subsystem10.Unsubscribe__Subscribe.Constant.Value /end CHARACTERISTIC
/begin CHARACTERISTIC Inverters_Action.Inverters_Action_P.Constant_Value_m "" VALUE 0x0 SCALAR_UBYTE 255.0 Inverters_Action_CM_uint8 0.0 255.0 DISPLAY_IDENTIFIER Inverters_Action.Subsystem9.Unsubscribe__Subscribe.Constant.Value /end CHARACTERISTIC
/begin CHARACTERISTIC Inverters_Action.Inverters_Action_P.DataStoreMemory1_InitialValue "" VALUE 0x0 SCALAR_FLOAT64_IEEE 3.5e+305 Inverters_Action_CM_double -1.7e+308 1.7e+308 DISPLAY_IDENTIFIER Inverters_Action.Subsystem10.Data_Store_Memory1.InitialValue /end CHARACTERISTIC
/begin CHARACTERISTIC Inverters_Action.Inverters_Action_P.DataStoreMemory1_InitialValue_m "" VALUE 0x0 SCALAR_FLOAT64_IEEE 3.5e+305 Inverters_Action_CM_double -1.7e+308 1.7e+308 DISPLAY_IDENTIFIER Inverters_Action.Subsystem9.Data_Store_Memory1.InitialValue /end CHARACTERISTIC
/begin CHARACTERISTIC Inverters_Action.Inverters_Action_P.DataStoreMemory2_InitialValue "" VALUE 0x0 SCALAR_FLOAT64_IEEE 3.5e+305 Inverters_Action_CM_double -1.7e+308 1.7e+308 DISPLAY_IDENTIFIER Inverters_Action.Subsystem10.Data_Store_Memory2.InitialValue /end CHARACTERISTIC
/begin CHARACTERISTIC Inverters_Action.Inverters_Action_P.DataStoreMemory2_InitialValue_c "" VALUE 0x0 SCALAR_FLOAT64_IEEE 3.5e+305 Inverters_Action_CM_double -1.7e+308 1.7e+308 DISPLAY_IDENTIFIER Inverters_Action.Subsystem9.Data_Store_Memory2.InitialValue /end CHARACTERISTIC
/begin CHARACTERISTIC Inverters_Action.Inverters_Action_P.Delay_DelayLength "" VALUE 0x0 SCALAR_ULONG 4294967295.0 Inverters_Action_CM_uint32 0.0 4294967295.0 DISPLAY_IDENTIFIER Inverters_Action.Subsystem10.edge_detection.Delay.DelayLength /end CHARACTERISTIC
/begin CHARACTERISTIC Inverters_Action.Inverters_Action_P.Delay_DelayLength_h "" VALUE 0x0 SCALAR_ULONG 4294967295.0 Inverters_Action_CM_uint32 0.0 4294967295.0 DISPLAY_IDENTIFIER Inverters_Action.Subsystem9.edge_detection.Delay.DelayLength /end CHARACTERISTIC
/begin CHARACTERISTIC Inverters_Action.Inverters_Action_P.Delay_InitialCondition "" VALUE 0x0 SCALAR_FLOAT64_IEEE 3.5e+305 Inverters_Action_CM_double -1.7e+308 1.7e+308 DISPLAY_IDENTIFIER Inverters_Action.Subsystem10.edge_detection.Delay.InitialCondition /end CHARACTERISTIC
/begin CHARACTERISTIC Inverters_Action.Inverters_Action_P.Delay_InitialCondition_o "" VALUE 0x0 SCALAR_FLOAT64_IEEE 3.5e+305 Inverters_Action_CM_double -1.7e+308 1.7e+308 DISPLAY_IDENTIFIER Inverters_Action.Subsystem9.edge_detection.Delay.InitialCondition /end CHARACTERISTIC
/begin CHARACTERISTIC Inverters_Action.Inverters_Action_P.Merge_InitialOutput "" VALUE 0x0 SCALAR_UBYTE 1.0 Inverters_Action_CM_boolean 0 1 DISPLAY_IDENTIFIER Inverters_Action.Merge.InitialOutput /end CHARACTERISTIC
/begin CHARACTERISTIC Inverters_Action.Inverters_Action_P.TimeInterval_Value "" VALUE 0x0 SCALAR_UBYTE 255.0 Inverters_Action_CM_uint8 0.0 255.0 DISPLAY_IDENTIFIER Inverters_Action.Subsystem10.Unsubscribe__Subscribe.Subscribe.Time_Interval.Value /end CHARACTERISTIC
/begin CHARACTERISTIC Inverters_Action.Inverters_Action_P.TimeInterval_Value_d "" VALUE 0x0 SCALAR_UBYTE 255.0 Inverters_Action_CM_uint8 0.0 255.0 DISPLAY_IDENTIFIER Inverters_Action.Subsystem9.Unsubscribe__Subscribe.Subscribe.Time_Interval.Value /end CHARACTERISTIC
/begin CHARACTERISTIC Inverters_Action.Inverters_Action_P._Value "" VALUE 0x0 SCALAR_UBYTE 1.0 Inverters_Action_CM_boolean 0 1 DISPLAY_IDENTIFIER Inverters_Action.Subsystem10.Unsubscribe__Subscribe.Subscribe._.Value /end CHARACTERISTIC
/begin CHARACTERISTIC Inverters_Action.Inverters_Action_P.subscribed_InitialOutput "" VALUE 0x0 SCALAR_UBYTE 1.0 Inverters_Action_CM_boolean 0 1 DISPLAY_IDENTIFIER Inverters_Action.Subsystem10.Unsubscribe__Subscribe.subscribed_.InitialOutput /end CHARACTERISTIC
/begin CHARACTERISTIC Inverters_Action.Inverters_Action_P.subscribed_InitialOutput_k "" VALUE 0x0 SCALAR_UBYTE 1.0 Inverters_Action_CM_boolean 0 1 DISPLAY_IDENTIFIER Inverters_Action.Subsystem9.Unsubscribe__Subscribe.subscribed_.InitialOutput /end CHARACTERISTIC
/begin CHARACTERISTIC Inverters_Action.Inverters_Action_P.u_Value "" VALUE 0x0 SCALAR_UBYTE 1.0 Inverters_Action_CM_boolean 0 1 DISPLAY_IDENTIFIER Inverters_Action.Subsystem9.Unsubscribe__Subscribe.Subscribe.1.Value /end CHARACTERISTIC
/begin CHARACTERISTIC Inverters_Data.Inverters_Data_P.A1_Value "" VALUE 0x0 SCALAR_FLOAT64_IEEE 3.5e+305 Inverters_Data_CM_double -1.7e+308 1.7e+308 DISPLAY_IDENTIFIER Inverters_Data.Subsystem4.A1.Value /end CHARACTERISTIC
/begin CHARACTERISTIC Inverters_Data.Inverters_Data_P.A1_Value_e "" VALUE 0x0 SCALAR_FLOAT64_IEEE 3.5e+305 Inverters_Data_CM_double -1.7e+308 1.7e+308 DISPLAY_IDENTIFIER Inverters_Data.Subsystem5.A1.Value /end CHARACTERISTIC
/begin CHARACTERISTIC Inverters_Data.Inverters_Data_P.B1_Value "" VALUE 0x0 SCALAR_FLOAT64_IEEE 3.5e+305 Inverters_Data_CM_double -1.7e+308 1.7e+308 DISPLAY_IDENTIFIER Inverters_Data.Subsystem4.B1.Value /end CHARACTERISTIC
/begin CHARACTERISTIC Inverters_Data.Inverters_Data_P.B1_Value_i "" VALUE 0x0 SCALAR_FLOAT64_IEEE 3.5e+305 Inverters_Data_CM_double -1.7e+308 1.7e+308 DISPLAY_IDENTIFIER Inverters_Data.Subsystem5.B1.Value /end CHARACTERISTIC
/begin CHARACTERISTIC Inverters_Data.Inverters_Data_P.Bitct_Value "" VALUE 0x0 SCALAR_FLOAT64_IEEE 3.5e+305 Inverters_Data_CM_double -1.7e+308 1.7e+308 DISPLAY_IDENTIFIER Inverters_Data.IL1.Bit_ct.Value /end CHARACTERISTIC
/begin CHARACTERISTIC Inverters_Data.Inverters_Data_P.Bitct_Value_h "" VALUE 0x0 SCALAR_FLOAT64_IEEE 3.5e+305 Inverters_Data_CM_double -1.7e+308 1.7e+308 DISPLAY_IDENTIFIER Inverters_Data.IL.Bit_ct.Value /end CHARACTERISTIC
/begin CHARACTERISTIC Inverters_Data.Inverters_Data_P.C1_Value "" VALUE 0x0 SCALAR_FLOAT64_IEEE 3.5e+305 Inverters_Data_CM_double -1.7e+308 1.7e+308 DISPLAY_IDENTIFIER Inverters_Data.Subsystem4.C1.Value /end CHARACTERISTIC
/begin CHARACTERISTIC Inverters_Data.Inverters_Data_P.C1_Value_d "" VALUE 0x0 SCALAR_FLOAT64_IEEE 3.5e+305 Inverters_Data_CM_double -1.7e+308 1.7e+308 DISPLAY_IDENTIFIER Inverters_Data.Subsystem6.C1.Value /end CHARACTERISTIC
/begin CHARACTERISTIC Inverters_Data.Inverters_Data_P.C1_Value_n "" VALUE 0x0 SCALAR_FLOAT64_IEEE 3.5e+305 Inverters_Data_CM_double -1.7e+308 1.7e+308 DISPLAY_IDENTIFIER Inverters_Data.Subsystem5.C1.Value /end CHARACTERISTIC
/begin CHARACTERISTIC Inverters_Data.Inverters_Data_P.C1_Value_n0 "" VALUE 0x0 SCALAR_FLOAT64_IEEE 3.5e+305 Inverters_Data_CM_double -1.7e+308 1.7e+308 DISPLAY_IDENTIFIER Inverters_Data.Subsystem7.C1.Value /end CHARACTERISTIC
/begin CHARACTERISTIC Inverters_Data.Inverters_Data_P.Constant1_Value "" VALUE 0x0 SCALAR_FLOAT64_IEEE 3.5e+305 Inverters_Data_CM_double -1.7e+308 1.7e+308 DISPLAY_IDENTIFIER Inverters_Data.Subsystem4.Constant1.Value /end CHARACTERISTIC
/begin CHARACTERISTIC Inverters_Data.Inverters_Data_P.Constant1_Value_e "" VALUE 0x0 SCALAR_FLOAT64_IEEE 3.5e+305 Inverters_Data_CM_double -1.7e+308 1.7e+308 DISPLAY_IDENTIFIER Inverters_Data.Subsystem5.Constant1.Value /end CHARACTERISTIC
/begin CHARACTERISTIC Inverters_Data.Inverters_Data_P.D1_Value "" VALUE 0x0 SCALAR_FLOAT64_IEEE 3.5e+305 Inverters_Data_CM_double -1.7e+308 1.7e+308 DISPLAY_IDENTIFIER Inverters_Data.Subsystem4.D1.Value /end CHARACTERISTIC
/begin CHARACTERISTIC Inverters_Data.Inverters_Data_P.D1_Value_d "" VALUE 0x0 SCALAR_FLOAT64_IEEE 3.5e+305 Inverters_Data_CM_double -1.7e+308 1.7e+308 DISPLAY_IDENTIFIER Inverters_Data.Subsystem6.D1.Value /end CHARACTERISTIC
/begin CHARACTERISTIC Inverters_Data.Inverters_Data_P.D1_Value_f "" VALUE 0x0 SCALAR_FLOAT64_IEEE 3.5e+305 Inverters_Data_CM_double -1.7e+308 1.7e+308 DISPLAY_IDENTIFIER Inverters_Data.Subsystem5.D1.Value /end CHARACTERISTIC
/begin CHARACTERISTIC Inverters_Data.Inverters_Data_P.D1_Value_j "" VALUE 0x0 SCALAR_FLOAT64_IEEE 3.5e+305 Inverters_Data_CM_double -1.7e+308 1.7e+308 DISPLAY_IDENTIFIER Inverters_Data.Subsystem7.D1.Value /end CHARACTERISTIC
/begin CHARACTERISTIC Inverters_Data.Inverters_Data_P.Diameterm_Gain "" VALUE 0x0 SCALAR_FLOAT64_IEEE 3.5e+305 Inverters_Data_CM_double -1.7e+308 1.7e+308 DISPLAY_IDENTIFIER Inverters_Data.Subsystem2.Wheel.Diameter_[m].Gain /end CHARACTERISTIC
/begin CHARACTERISTIC Inverters_Data.Inverters_Data_P.Diameterm_Gain_p "" VALUE 0x0 SCALAR_FLOAT64_IEEE 3.5e+305 Inverters_Data_CM_double -1.7e+308 1.7e+308 DISPLAY_IDENTIFIER Inverters_Data.Subsystem1.Wheel.Diameter_[m].Gain /end CHARACTERISTIC
/begin CHARACTERISTIC Inverters_Data.Inverters_Data_P.Gain_Gain "" VALUE 0x0 SCALAR_FLOAT64_IEEE 3.5e+305 Inverters_Data_CM_double -1.7e+308 1.7e+308 DISPLAY_IDENTIFIER Inverters_Data.Subsystem2.Transmission.Gain.Gain /end CHARACTERISTIC
/begin CHARACTERISTIC Inverters_Data.Inverters_Data_P.Gain_Gain_a "" VALUE 0x0 SCALAR_FLOAT64_IEEE 3.5e+305 Inverters_Data_CM_double -1.7e+308 1.7e+308 DISPLAY_IDENTIFIER Inverters_Data.Subsystem1.Transmission.Gain.Gain /end CHARACTERISTIC
/begin CHARACTERISTIC Inverters_Data.Inverters_Data_P.Gain_Gain_e "" VALUE 0x0 SCALAR_FLOAT64_IEEE 3.5e+305 Inverters_Data_CM_double -1.7e+308 1.7e+308 DISPLAY_IDENTIFIER Inverters_Data.Subsystem.Gain.Gain /end CHARACTERISTIC
/begin CHARACTERISTIC Inverters_Data.Inverters_Data_P.Gain_Gain_f "" VALUE 0x0 SCALAR_FLOAT64_IEEE 3.5e+305 Inverters_Data_CM_double -1.7e+308 1.7e+308 DISPLAY_IDENTIFIER Inverters_Data.Subsystem3.Gain.Gain /end CHARACTERISTIC
/begin CHARACTERISTIC Inverters_Data.Inverters_Data_P.Gain_Gain_m "" VALUE 0x0 SCALAR_FLOAT64_IEEE 3.5e+305 Inverters_Data_CM_double -1.7e+308 1.7e+308 DISPLAY_IDENTIFIER Inverters_Data.Average.Gain.Gain /end CHARACTERISTIC
/begin CHARACTERISTIC Inverters_Data.Inverters_Data_P.MaxRPM_Value "" VALUE 0x0 SCALAR_FLOAT64_IEEE 3.5e+305 Inverters_Data_CM_double -1.7e+308 1.7e+308 DISPLAY_IDENTIFIER Inverters_Data.IL1.Max_RPM.Value /end CHARACTERISTIC
/begin CHARACTERISTIC Inverters_Data.Inverters_Data_P.MaxRPM_Value_m "" VALUE 0x0 SCALAR_FLOAT64_IEEE 3.5e+305 Inverters_Data_CM_double -1.7e+308 1.7e+308 DISPLAY_IDENTIFIER Inverters_Data.IL.Max_RPM.Value /end CHARACTERISTIC
/begin CHARACTERISTIC Inverters_Data.Inverters_Data_P.conversionratio1_Gain "" VALUE 0x0 SCALAR_FLOAT64_IEEE 3.5e+305 Inverters_Data_CM_double -1.7e+308 1.7e+308 DISPLAY_IDENTIFIER Inverters_Data.IL2.conversion_ratio1.Gain /end CHARACTERISTIC
/begin CHARACTERISTIC Inverters_Data.Inverters_Data_P.conversionratio_Gain "" VALUE 0x0 SCALAR_FLOAT64_IEEE 3.5e+305 Inverters_Data_CM_double -1.7e+308 1.7e+308 DISPLAY_IDENTIFIER Inverters_Data.IL_4.conversion_ratio.Gain /end CHARACTERISTIC
/begin CHARACTERISTIC Inverters_Data.Inverters_Data_P.conversionratio_Gain_c "" VALUE 0x0 SCALAR_FLOAT64_IEEE 3.5e+305 Inverters_Data_CM_double -1.7e+308 1.7e+308 DISPLAY_IDENTIFIER Inverters_Data.IL_2.conversion_ratio.Gain /end CHARACTERISTIC
/begin CHARACTERISTIC Inverters_Data.Inverters_Data_P.conversionratio_Gain_j "" VALUE 0x0 SCALAR_FLOAT64_IEEE 3.5e+305 Inverters_Data_CM_double -1.7e+308 1.7e+308 DISPLAY_IDENTIFIER Inverters_Data.IL_1.conversion_ratio.Gain /end CHARACTERISTIC
/begin CHARACTERISTIC Inverters_Data.Inverters_Data_P.conversionratio_Gain_k "" VALUE 0x0 SCALAR_FLOAT64_IEEE 3.5e+305 Inverters_Data_CM_double -1.7e+308 1.7e+308 DISPLAY_IDENTIFIER Inverters_Data.IL_3.conversion_ratio.Gain /end CHARACTERISTIC
/begin CHARACTERISTIC Inverters_Data.Inverters_Data_P.conversionratio_Gain_o "" VALUE 0x0 SCALAR_FLOAT64_IEEE 3.5e+305 Inverters_Data_CM_double -1.7e+308 1.7e+308 DISPLAY_IDENTIFIER Inverters_Data.IL_5.conversion_ratio.Gain /end CHARACTERISTIC
/begin CHARACTERISTIC Inverters_Data.Inverters_Data_P.direction_Gain "" VALUE 0x0 SCALAR_FLOAT64_IEEE 3.5e+305 Inverters_Data_CM_double -1.7e+308 1.7e+308 DISPLAY_IDENTIFIER Inverters_Data.IL1.direction.Gain /end CHARACTERISTIC
/begin CHARACTERISTIC Inverters_Data.Inverters_Data_P.direction_Gain_f "" VALUE 0x0 SCALAR_FLOAT64_IEEE 3.5e+305 Inverters_Data_CM_double -1.7e+308 1.7e+308 DISPLAY_IDENTIFIER Inverters_Data.IL.direction.Gain /end CHARACTERISTIC
/begin CHARACTERISTIC Inverters_Data.Inverters_Data_P.ratio_Gain "" VALUE 0x0 SCALAR_FLOAT64_IEEE 3.5e+305 Inverters_Data_CM_double -1.7e+308 1.7e+308 DISPLAY_IDENTIFIER Inverters_Data.Subsystem2.m__s_to_km__h.ratio.Gain /end CHARACTERISTIC
/begin CHARACTERISTIC Inverters_Data.Inverters_Data_P.ratio_Gain_k "" VALUE 0x0 SCALAR_FLOAT64_IEEE 3.5e+305 Inverters_Data_CM_double -1.7e+308 1.7e+308 DISPLAY_IDENTIFIER Inverters_Data.Subsystem1.m__s_to_km__h.ratio.Gain /end CHARACTERISTIC
/begin CHARACTERISTIC Inverters_Data.Inverters_Data_P.upi60_Gain "" VALUE 0x0 SCALAR_FLOAT64_IEEE 3.5e+305 Inverters_Data_CM_double -1.7e+308 1.7e+308 DISPLAY_IDENTIFIER Inverters_Data.Subsystem2.RPM_to_rad__s.2_pi__60.Gain /end CHARACTERISTIC
/begin CHARACTERISTIC Inverters_Data.Inverters_Data_P.upi60_Gain_i "" VALUE 0x0 SCALAR_FLOAT64_IEEE 3.5e+305 Inverters_Data_CM_double -1.7e+308 1.7e+308 DISPLAY_IDENTIFIER Inverters_Data.Subsystem1.RPM_to_rad__s.2_pi__60.Gain /end CHARACTERISTIC
/begin CHARACTERISTIC LVD_Data.LVD_Data_P.DataStoreMemory1_InitialValue "" VALUE 0x0 SCALAR_FLOAT64_IEEE 3.5e+305 LVD_Data_CM_double -1.7e+308 1.7e+308 DISPLAY_IDENTIFIER LVD_Data.Low_Pass.Data_Store_Memory1.InitialValue /end CHARACTERISTIC
/begin CHARACTERISTIC LVD_Data.LVD_Data_P.DataStoreMemory_InitialValue "" VALUE 0x0 SCALAR_FLOAT64_IEEE 3.5e+305 LVD_Data_CM_double -1.7e+308 1.7e+308 DISPLAY_IDENTIFIER LVD_Data.Low_Pass.Data_Store_Memory.InitialValue /end CHARACTERISTIC
/begin CHARACTERISTIC LVD_Data.LVD_Data_P.MaxBits2_Value "" VALUE 0x0 SCALAR_FLOAT64_IEEE 3.5e+305 LVD_Data_CM_double -1.7e+308 1.7e+308 DISPLAY_IDENTIFIER LVD_Data.MaxBits2.Value /end CHARACTERISTIC
/begin CHARACTERISTIC LVD_Data.LVD_Data_P.MaxBits_Value "" VALUE 0x0 SCALAR_FLOAT64_IEEE 3.5e+305 LVD_Data_CM_double -1.7e+308 1.7e+308 DISPLAY_IDENTIFIER LVD_Data.MaxBits.Value /end CHARACTERISTIC
/begin CHARACTERISTIC LVD_Data.LVD_Data_P.Vmax_Value "" VALUE 0x0 SCALAR_FLOAT64_IEEE 3.5e+305 LVD_Data_CM_double -1.7e+308 1.7e+308 DISPLAY_IDENTIFIER LVD_Data.Vmax.Value /end CHARACTERISTIC
/begin CHARACTERISTIC LVD_Data.LVD_Data_P.Vmin_Value "" VALUE 0x0 SCALAR_FLOAT64_IEEE 3.5e+305 LVD_Data_CM_double -1.7e+308 1.7e+308 DISPLAY_IDENTIFIER LVD_Data.Vmin.Value /end CHARACTERISTIC
/begin CHARACTERISTIC LVD_Data.LVD_Data_P.ct_Value "" VALUE 0x0 SCALAR_FLOAT64_IEEE 3.5e+305 LVD_Data_CM_double -1.7e+308 1.7e+308 DISPLAY_IDENTIFIER LVD_Data.Low_Pass.ct.Value /end CHARACTERISTIC
/begin CHARACTERISTIC LVD_Data.LVD_Data_P.exptcycletau1_Value "" VALUE 0x0 SCALAR_FLOAT64_IEEE 3.5e+305 LVD_Data_CM_double -1.7e+308 1.7e+308 DISPLAY_IDENTIFIER LVD_Data.Low_Pass.exp__tcycle__tau_1.Value /end CHARACTERISTIC
/begin CHARACTERISTIC Racing_Mode.Racing_Mode_P.Apps_Sat_DwnSaturation_LowerSat "" VALUE 0x0 SCALAR_FLOAT64_IEEE 3.5e+305 Racing_Mode_CM_double -1.7e+308 1.7e+308 DISPLAY_IDENTIFIER Racing_Mode.Apps_Sat_Dwn_Saturation.LowerLimit /end CHARACTERISTIC
/begin CHARACTERISTIC Racing_Mode.Racing_Mode_P.Apps_Sat_DwnSaturation_UpperSat "" VALUE 0x0 SCALAR_FLOAT64_IEEE 3.5e+305 Racing_Mode_CM_double -1.7e+308 1.7e+308 DISPLAY_IDENTIFIER Racing_Mode.Apps_Sat_Dwn_Saturation.UpperLimit /end CHARACTERISTIC
/begin CHARACTERISTIC Racing_Mode.Racing_Mode_P.Apps_Sat_UpSaturation_LowerSat "" VALUE 0x0 SCALAR_FLOAT64_IEEE 3.5e+305 Racing_Mode_CM_double -1.7e+308 1.7e+308 DISPLAY_IDENTIFIER Racing_Mode.Apps_Sat_Up_Saturation.LowerLimit /end CHARACTERISTIC
/begin CHARACTERISTIC Racing_Mode.Racing_Mode_P.Apps_Sat_UpSaturation_UpperSat "" VALUE 0x0 SCALAR_FLOAT64_IEEE 3.5e+305 Racing_Mode_CM_double -1.7e+308 1.7e+308 DISPLAY_IDENTIFIER Racing_Mode.Apps_Sat_Up_Saturation.UpperLimit /end CHARACTERISTIC
/begin CHARACTERISTIC Racing_Mode.Racing_Mode_P.CEE_Apps_Sat_Dwn_Value "" VALUE 0x0 SCALAR_FLOAT64_IEEE 3.5e+305 Racing_Mode_CM_double -1.7e+308 1.7e+308 DISPLAY_IDENTIFIER Racing_Mode.Tuning.CEE_Apps_Sat_Dwn.Value /end CHARACTERISTIC
/begin CHARACTERISTIC Racing_Mode.Racing_Mode_P.CEE_Apps_Sat_Up_Value "" VALUE 0x0 SCALAR_FLOAT64_IEEE 3.5e+305 Racing_Mode_CM_double -1.7e+308 1.7e+308 DISPLAY_IDENTIFIER Racing_Mode.Tuning.CEE_Apps_Sat_Up.Value /end CHARACTERISTIC
/begin CHARACTERISTIC Racing_Mode.Racing_Mode_P.CEE_CKF_Initial_Value "" VALUE 0x0 SCALAR_FLOAT64_IEEE 3.5e+305 Racing_Mode_CM_double -1.7e+308 1.7e+308 DISPLAY_IDENTIFIER Racing_Mode.Tuning.CEE_CKF_Initial.Value /end CHARACTERISTIC
/begin CHARACTERISTIC Racing_Mode.Racing_Mode_P.CEE_Cte_CKF_Value "" VALUE 0x0 SCALAR_FLOAT64_IEEE 3.5e+305 Racing_Mode_CM_double -1.7e+308 1.7e+308 DISPLAY_IDENTIFIER Racing_Mode.Tuning.CEE_Cte_CKF.Value /end CHARACTERISTIC
/begin CHARACTERISTIC Racing_Mode.Racing_Mode_P.CEE_Cte_SKF_Value "" VALUE 0x0 SCALAR_FLOAT64_IEEE 3.5e+305 Racing_Mode_CM_double -1.7e+308 1.7e+308 DISPLAY_IDENTIFIER Racing_Mode.Tuning.CEE_Cte_SKF.Value /end CHARACTERISTIC
/begin CHARACTERISTIC Racing_Mode.Racing_Mode_P.CEE_K_Reduction_P_Value "" VALUE 0x0 SCALAR_FLOAT64_IEEE 3.5e+305 Racing_Mode_CM_double -1.7e+308 1.7e+308 DISPLAY_IDENTIFIER Racing_Mode.Tuning.CEE_K_Reduction_P.Value /end CHARACTERISTIC
/begin CHARACTERISTIC Racing_Mode.Racing_Mode_P.CEE_K_Reduction_Temperature_Val "" VALUE 0x0 SCALAR_FLOAT64_IEEE 3.5e+305 Racing_Mode_CM_double -1.7e+308 1.7e+308 DISPLAY_IDENTIFIER Racing_Mode.Tuning.CEE_K_Reduction_Temperature.Value /end CHARACTERISTIC
/begin CHARACTERISTIC Racing_Mode.Racing_Mode_P.CEE_Max_Regenerative_Torque_Val "" VALUE 0x0 SCALAR_FLOAT64_IEEE 3.5e+305 Racing_Mode_CM_double -1.7e+308 1.7e+308 DISPLAY_IDENTIFIER Racing_Mode.Tuning.CEE_Max_Regenerative_Torque.Value /end CHARACTERISTIC
/begin CHARACTERISTIC Racing_Mode.Racing_Mode_P.CEE_Power_Limit_Value "" VALUE 0x0 SCALAR_FLOAT64_IEEE 3.5e+305 Racing_Mode_CM_double -1.7e+308 1.7e+308 DISPLAY_IDENTIFIER Racing_Mode.Tuning.CEE_Power_Limit.Value /end CHARACTERISTIC
/begin CHARACTERISTIC Racing_Mode.Racing_Mode_P.CEE_SKF_Initial_Value "" VALUE 0x0 SCALAR_FLOAT64_IEEE 3.5e+305 Racing_Mode_CM_double -1.7e+308 1.7e+308 DISPLAY_IDENTIFIER Racing_Mode.Tuning.CEE_SKF_Initial.Value /end CHARACTERISTIC
/begin CHARACTERISTIC Racing_Mode.Racing_Mode_P.CKF_InitialSaturation_LowerSat "" VALUE 0x0 SCALAR_FLOAT64_IEEE 3.5e+305 Racing_Mode_CM_double -1.7e+308 1.7e+308 DISPLAY_IDENTIFIER Racing_Mode.CKF_Initial_Saturation.LowerLimit /end CHARACTERISTIC
/begin CHARACTERISTIC Racing_Mode.Racing_Mode_P.CKF_InitialSaturation_UpperSat "" VALUE 0x0 SCALAR_FLOAT64_IEEE 3.5e+305 Racing_Mode_CM_double -1.7e+308 1.7e+308 DISPLAY_IDENTIFIER Racing_Mode.CKF_Initial_Saturation.UpperLimit /end CHARACTERISTIC
/begin CHARACTERISTIC Racing_Mode.Racing_Mode_P.CompareToConstant_const "" VALUE 0x0 SCALAR_UBYTE 255.0 Racing_Mode_CM_uint8 0.0 255.0 DISPLAY_IDENTIFIER Racing_Mode.Compare_To_Constant.Constant.Value /end CHARACTERISTIC
/begin CHARACTERISTIC Racing_Mode.Racing_Mode_P.Cte_CKFSaturation_LowerSat "" VALUE 0x0 SCALAR_FLOAT64_IEEE 3.5e+305 Racing_Mode_CM_double -1.7e+308 1.7e+308 DISPLAY_IDENTIFIER Racing_Mode.Cte_CKF_Saturation.LowerLimit /end CHARACTERISTIC
/begin CHARACTERISTIC Racing_Mode.Racing_Mode_P.Cte_CKFSaturation_UpperSat "" VALUE 0x0 SCALAR_FLOAT64_IEEE 3.5e+305 Racing_Mode_CM_double -1.7e+308 1.7e+308 DISPLAY_IDENTIFIER Racing_Mode.Cte_CKF_Saturation.UpperLimit /end CHARACTERISTIC
/begin CHARACTERISTIC Racing_Mode.Racing_Mode_P.Cte_SKFSaturation_LowerSat "" VALUE 0x0 SCALAR_FLOAT64_IEEE 3.5e+305 Racing_Mode_CM_double -1.7e+308 1.7e+308 DISPLAY_IDENTIFIER Racing_Mode.Cte_SKF_Saturation.LowerLimit /end CHARACTERISTIC
/begin CHARACTERISTIC Racing_Mode.Racing_Mode_P.Cte_SKFSaturation_UpperSat "" VALUE 0x0 SCALAR_FLOAT64_IEEE 3.5e+305 Racing_Mode_CM_double -1.7e+308 1.7e+308 DISPLAY_IDENTIFIER Racing_Mode.Cte_SKF_Saturation.UpperLimit /end CHARACTERISTIC
/begin CHARACTERISTIC Racing_Mode.Racing_Mode_P.K_Reduction_PSaturation_LowerSa "" VALUE 0x0 SCALAR_FLOAT64_IEEE 3.5e+305 Racing_Mode_CM_double -1.7e+308 1.7e+308 DISPLAY_IDENTIFIER Racing_Mode.K_Reduction_P_Saturation.LowerLimit /end CHARACTERISTIC
/begin CHARACTERISTIC Racing_Mode.Racing_Mode_P.K_Reduction_PSaturation_UpperSa "" VALUE 0x0 SCALAR_FLOAT64_IEEE 3.5e+305 Racing_Mode_CM_double -1.7e+308 1.7e+308 DISPLAY_IDENTIFIER Racing_Mode.K_Reduction_P_Saturation.UpperLimit /end CHARACTERISTIC
/begin CHARACTERISTIC Racing_Mode.Racing_Mode_P.K_Reduction_TemperatureSatura_m "" VALUE 0x0 SCALAR_FLOAT64_IEEE 3.5e+305 Racing_Mode_CM_double -1.7e+308 1.7e+308 DISPLAY_IDENTIFIER Racing_Mode.K_Reduction_Temperature_Saturation.LowerLimit /end CHARACTERISTIC
/begin CHARACTERISTIC Racing_Mode.Racing_Mode_P.K_Reduction_TemperatureSaturati "" VALUE 0x0 SCALAR_FLOAT64_IEEE 3.5e+305 Racing_Mode_CM_double -1.7e+308 1.7e+308 DISPLAY_IDENTIFIER Racing_Mode.K_Reduction_Temperature_Saturation.UpperLimit /end CHARACTERISTIC
/begin CHARACTERISTIC Racing_Mode.Racing_Mode_P.Max_Regenerative_TorqueSatura_o "" VALUE 0x0 SCALAR_FLOAT64_IEEE 3.5e+305 Racing_Mode_CM_double -1.7e+308 1.7e+308 DISPLAY_IDENTIFIER Racing_Mode.Max_Regenerative_Torque_Saturation.LowerLimit /end CHARACTERISTIC
/begin CHARACTERISTIC Racing_Mode.Racing_Mode_P.Max_Regenerative_TorqueSaturati "" VALUE 0x0 SCALAR_FLOAT64_IEEE 3.5e+305 Racing_Mode_CM_double -1.7e+308 1.7e+308 DISPLAY_IDENTIFIER Racing_Mode.Max_Regenerative_Torque_Saturation.UpperLimit /end CHARACTERISTIC
/begin CHARACTERISTIC Racing_Mode.Racing_Mode_P.Merge_InitialOutput "" VALUE 0x0 SCALAR_FLOAT64_IEEE 3.5e+305 Racing_Mode_CM_double -1.7e+308 1.7e+308 DISPLAY_IDENTIFIER Racing_Mode.Merge.InitialOutput /end CHARACTERISTIC
/begin CHARACTERISTIC Racing_Mode.Racing_Mode_P.Power_LimitSaturation_LowerSat "" VALUE 0x0 SCALAR_FLOAT64_IEEE 3.5e+305 Racing_Mode_CM_double -1.7e+308 1.7e+308 DISPLAY_IDENTIFIER Racing_Mode.Power_Limit_Saturation.LowerLimit /end CHARACTERISTIC
/begin CHARACTERISTIC Racing_Mode.Racing_Mode_P.Power_LimitSaturation_UpperSat "" VALUE 0x0 SCALAR_FLOAT64_IEEE 3.5e+305 Racing_Mode_CM_double -1.7e+308 1.7e+308 DISPLAY_IDENTIFIER Racing_Mode.Power_Limit_Saturation.UpperLimit /end CHARACTERISTIC
/begin CHARACTERISTIC Racing_Mode.Racing_Mode_P.SKF_InitialSaturation_LowerSat "" VALUE 0x0 SCALAR_FLOAT64_IEEE 3.5e+305 Racing_Mode_CM_double -1.7e+308 1.7e+308 DISPLAY_IDENTIFIER Racing_Mode.SKF_Initial_Saturation.LowerLimit /end CHARACTERISTIC
/begin CHARACTERISTIC Racing_Mode.Racing_Mode_P.SKF_InitialSaturation_UpperSat "" VALUE 0x0 SCALAR_FLOAT64_IEEE 3.5e+305 Racing_Mode_CM_double -1.7e+308 1.7e+308 DISPLAY_IDENTIFIER Racing_Mode.SKF_Initial_Saturation.UpperLimit /end CHARACTERISTIC
/begin CHARACTERISTIC Synchronism.Synchronism_P.Constant1_Value "" VALUE 0x0 SCALAR_FLOAT64_IEEE 3.5e+305 Synchronism_CM_double -1.7e+308 1.7e+308 DISPLAY_IDENTIFIER Synchronism.Constant1.Value /end CHARACTERISTIC
/begin CHARACTERISTIC Synchronism.Synchronism_P.Constant_Value "" VALUE 0x0 SCALAR_FLOAT64_IEEE 3.5e+305 Synchronism_CM_double -1.7e+308 1.7e+308 DISPLAY_IDENTIFIER Synchronism.Counter.Reset_counter.Constant.Value /end CHARACTERISTIC
/begin CHARACTERISTIC Synchronism.Synchronism_P.Constant_Value_e "" VALUE 0x0 SCALAR_FLOAT64_IEEE 3.5e+305 Synchronism_CM_double -1.7e+308 1.7e+308 DISPLAY_IDENTIFIER Synchronism.Counter.Constant.Value /end CHARACTERISTIC
/begin CHARACTERISTIC Synchronism.Synchronism_P.DataStoreMemory_InitialValue "" VALUE 0x0 SCALAR_FLOAT64_IEEE 3.5e+305 Synchronism_CM_double -1.7e+308 1.7e+308 DISPLAY_IDENTIFIER Synchronism.Counter.Data_Store_Memory.InitialValue /end CHARACTERISTIC
/begin CHARACTERISTIC Torque_Control.Torque_Control_P.ANm_Gain "" VALUE 0x0 SCALAR_FLOAT64_IEEE 3.5e+305 Torque_Control_CM_double -1.7e+308 1.7e+308 DISPLAY_IDENTIFIER Torque_Control.Calculate_Current_Conversion.KT_L_TORKY.A__Nm.Gain /end CHARACTERISTIC
/begin CHARACTERISTIC Torque_Control.Torque_Control_P.ANm_Gain_b "" VALUE 0x0 SCALAR_FLOAT64_IEEE 3.5e+305 Torque_Control_CM_double -1.7e+308 1.7e+308 DISPLAY_IDENTIFIER Torque_Control.Calculate_Current_Conversion.KT_R_EMY.A__Nm.Gain /end CHARACTERISTIC
/begin CHARACTERISTIC Torque_Control.Torque_Control_P.Accu_Temperature_Limitation_Fla "" VALUE 0x0 SCALAR_UBYTE 1.0 Torque_Control_CM_boolean 0 1 DISPLAY_IDENTIFIER Torque_Control.Controls_Temperature_by_limiting_Torque.Accu_Temperature_Limitation_Flag.InitialOutput /end CHARACTERISTIC
/begin CHARACTERISTIC Torque_Control.Torque_Control_P.CKF_act_Y0 "" VALUE 0x0 SCALAR_FLOAT64_IEEE 3.5e+305 Torque_Control_CM_double -1.7e+308 1.7e+308 DISPLAY_IDENTIFIER Torque_Control.VDC.Vehicle_Dynamics_Control_Modes.VDC_Complete.Optimization_SKF__amp__CKF.Subsystem.CKF.CKF_act.InitialOutput /end CHARACTERISTIC
/begin CHARACTERISTIC Torque_Control.Torque_Control_P.CKF_act_Y0_j "" VALUE 0x0 SCALAR_FLOAT64_IEEE 3.5e+305 Torque_Control_CM_double -1.7e+308 1.7e+308 DISPLAY_IDENTIFIER Torque_Control.VDC.Vehicle_Dynamics_Control_Modes.Steering_TV_with_TC.Optimization_SKF__amp__CKF.Subsystem.CKF.CKF_act.InitialOutput /end CHARACTERISTIC
/begin CHARACTERISTIC Torque_Control.Torque_Control_P.CompareToConstant1_const "" VALUE 0x0 SCALAR_FLOAT64_IEEE 3.5e+305 Torque_Control_CM_double -1.7e+308 1.7e+308 DISPLAY_IDENTIFIER Torque_Control.Pumps_Controller.Compare_To_Constant1.Constant.Value /end CHARACTERISTIC
/begin CHARACTERISTIC Torque_Control.Torque_Control_P.CompareToConstant_const "" VALUE 0x0 SCALAR_FLOAT64_IEEE 3.5e+305 Torque_Control_CM_double -1.7e+308 1.7e+308 DISPLAY_IDENTIFIER Torque_Control.SAFETY_BLOCK.Compare_To_Constant.Constant.Value /end CHARACTERISTIC
/begin CHARACTERISTIC Torque_Control.Torque_Control_P.CompareToConstant_const_p "" VALUE 0x0 SCALAR_FLOAT64_IEEE 3.5e+305 Torque_Control_CM_double -1.7e+308 1.7e+308 DISPLAY_IDENTIFIER Torque_Control.Pumps_Controller.Compare_To_Constant.Constant.Value /end CHARACTERISTIC
/begin CHARACTERISTIC Torque_Control.Torque_Control_P.Constant14_Value "" VALUE 0x0 SCALAR_FLOAT64_IEEE 3.5e+305 Torque_Control_CM_double -1.7e+308 1.7e+308 DISPLAY_IDENTIFIER Torque_Control.Constant14.Value /end CHARACTERISTIC
/begin CHARACTERISTIC Torque_Control.Torque_Control_P.Constant1_Value "" VALUE 0x0 SCALAR_FLOAT64_IEEE 3.5e+305 Torque_Control_CM_double -1.7e+308 1.7e+308 DISPLAY_IDENTIFIER Torque_Control.Controls_Temperature_by_limiting_Torque.temperature_SoP.temperature_rise_limitator_Accu.Constant1.Value /end CHARACTERISTIC
/begin CHARACTERISTIC Torque_Control.Torque_Control_P.Constant1_Value_a "" VALUE 0x0 SCALAR_FLOAT64_IEEE 3.5e+305 Torque_Control_CM_double -1.7e+308 1.7e+308 DISPLAY_IDENTIFIER Torque_Control.VDC.Vehicle_Dynamics_Control_Modes.VDC_Complete.Lateral_Dynamics.Constant1.Value /end CHARACTERISTIC
/begin CHARACTERISTIC Torque_Control.Torque_Control_P.Constant1_Value_ab "" VALUE 0x0 SCALAR_FLOAT64_IEEE 3.5e+305 Torque_Control_CM_double -1.7e+308 1.7e+308 DISPLAY_IDENTIFIER Torque_Control.VDC.Vehicle_Dynamics_Control_Modes.VDC_Complete.Wheel_to_motor.Constant1.Value /end CHARACTERISTIC
/begin CHARACTERISTIC Torque_Control.Torque_Control_P.Constant1_Value_b "" VALUE 0x0 SCALAR_FLOAT64_IEEE 3.5e+305 Torque_Control_CM_double -1.7e+308 1.7e+308 DISPLAY_IDENTIFIER Torque_Control.VDC.Vehicle_Dynamics_Control_Modes.VDC_Complete.In_Numbers.Constant1.Value /end CHARACTERISTIC
/begin CHARACTERISTIC Torque_Control.Torque_Control_P.Constant1_Value_c "" VALUE 0x0 SCALAR_FLOAT64_IEEE 3.5e+305 Torque_Control_CM_double -1.7e+308 1.7e+308 DISPLAY_IDENTIFIER Torque_Control.VDC.Vehicle_Dynamics_Control_Modes.VDC_without_Longitudinal.Kamm_Circle_Lateral.Constant1.Value /end CHARACTERISTIC
/begin CHARACTERISTIC Torque_Control.Torque_Control_P.Constant1_Value_e "" VALUE 0x0 SCALAR_FLOAT64_IEEE 3.5e+305 Torque_Control_CM_double -1.7e+308 1.7e+308 DISPLAY_IDENTIFIER Torque_Control.power_limitation.temperature_SoP.temperature_rise_limitator_Accu.Constant1.Value /end CHARACTERISTIC
/begin CHARACTERISTIC Torque_Control.Torque_Control_P.Constant1_Value_f "" VALUE 0x0 SCALAR_FLOAT64_IEEE 3.5e+305 Torque_Control_CM_double -1.7e+308 1.7e+308 DISPLAY_IDENTIFIER Torque_Control.VDC.Vehicle_Dynamics_Control_Modes.VDC_Complete.Longitudinal_Dynamics.Constant1.Value /end CHARACTERISTIC
/begin CHARACTERISTIC Torque_Control.Torque_Control_P.Constant1_Value_fp "" VALUE 0x0 SCALAR_FLOAT64_IEEE 3.5e+305 Torque_Control_CM_double -1.7e+308 1.7e+308 DISPLAY_IDENTIFIER Torque_Control.power_limitation.temperature_SoP.temperature_rise_limitator_Inverters.Constant1.Value /end CHARACTERISTIC
/begin CHARACTERISTIC Torque_Control.Torque_Control_P.Constant1_Value_l "" VALUE 0x0 SCALAR_FLOAT64_IEEE 3.5e+305 Torque_Control_CM_double -1.7e+308 1.7e+308 DISPLAY_IDENTIFIER Torque_Control.VDC.Vehicle_Dynamics_Control_Modes.VDC_without_Longitudinal.Force_to_Tq.Constant1.Value /end CHARACTERISTIC
/begin CHARACTERISTIC Torque_Control.Torque_Control_P.Constant1_Value_ln "" VALUE 0x0 SCALAR_FLOAT64_IEEE 3.5e+305 Torque_Control_CM_double -1.7e+308 1.7e+308 DISPLAY_IDENTIFIER Torque_Control.VDC.TEST_MODE_IN.TEST_CONSTANTS.Constant1.Value /end CHARACTERISTIC
/begin CHARACTERISTIC Torque_Control.Torque_Control_P.Constant1_Value_o "" VALUE 0x0 SCALAR_FLOAT64_IEEE 3.5e+305 Torque_Control_CM_double -1.7e+308 1.7e+308 DISPLAY_IDENTIFIER Torque_Control.Controls_Temperature_by_limiting_Torque.temperature_SoP.temperature_rise_limitator_Inverters.Constant1.Value /end CHARACTERISTIC
/begin CHARACTERISTIC Torque_Control.Torque_Control_P.Constant1_Value_p "" VALUE 0x0 SCALAR_FLOAT64_IEEE 3.5e+305 Torque_Control_CM_double -1.7e+308 1.7e+308 DISPLAY_IDENTIFIER Torque_Control.Controls_Temperature_by_limiting_Torque.temperature_SoP.temperature_rise_limitator_Motors.Constant1.Value /end CHARACTERISTIC
/begin CHARACTERISTIC Torque_Control.Torque_Control_P.Constant1_Value_p2 "" VALUE 0x0 SCALAR_FLOAT64_IEEE 3.5e+305 Torque_Control_CM_double -1.7e+308 1.7e+308 DISPLAY_IDENTIFIER Torque_Control.power_limitation.temperature_SoP.temperature_rise_limitator_Motors.Constant1.Value /end CHARACTERISTIC
/begin CHARACTERISTIC Torque_Control.Torque_Control_P.Constant2_Value "" VALUE 0x0 SCALAR_FLOAT64_IEEE 3.5e+305 Torque_Control_CM_double -1.7e+308 1.7e+308 DISPLAY_IDENTIFIER Torque_Control.Controls_Temperature_by_limiting_Torque.temperature_SoP.temperature_rise_limitator_Accu.Constant2.Value /end CHARACTERISTIC
/begin CHARACTERISTIC Torque_Control.Torque_Control_P.Constant2_Value_b "" VALUE 0x0 SCALAR_FLOAT64_IEEE 3.5e+305 Torque_Control_CM_double -1.7e+308 1.7e+308 DISPLAY_IDENTIFIER Torque_Control.power_limitation.temperature_SoP.temperature_rise_limitator_Inverters.Constant2.Value /end CHARACTERISTIC
/begin CHARACTERISTIC Torque_Control.Torque_Control_P.Constant2_Value_d "" VALUE 0x0 SCALAR_FLOAT64_IEEE 3.5e+305 Torque_Control_CM_double -1.7e+308 1.7e+308 DISPLAY_IDENTIFIER Torque_Control.VDC.Vehicle_Dynamics_Control_Modes.VDC_Complete.Longitudinal_Dynamics.Constant2.Value /end CHARACTERISTIC
/begin CHARACTERISTIC Torque_Control.Torque_Control_P.Constant2_Value_g "" VALUE 0x0 SCALAR_FLOAT64_IEEE 3.5e+305 Torque_Control_CM_double -1.7e+308 1.7e+308 DISPLAY_IDENTIFIER Torque_Control.VDC.Vehicle_Dynamics_Control_Modes.VDC_Complete.Lateral_Dynamics.Constant2.Value /end CHARACTERISTIC
/begin CHARACTERISTIC Torque_Control.Torque_Control_P.Constant2_Value_g1 "" VALUE 0x0 SCALAR_FLOAT64_IEEE 3.5e+305 Torque_Control_CM_double -1.7e+308 1.7e+308 DISPLAY_IDENTIFIER Torque_Control.VDC.TEST_MODE_IN.TEST_CONSTANTS.Constant2.Value /end CHARACTERISTIC
/begin CHARACTERISTIC Torque_Control.Torque_Control_P.Constant2_Value_h "" VALUE 0x0 SCALAR_FLOAT64_IEEE 3.5e+305 Torque_Control_CM_double -1.7e+308 1.7e+308 DISPLAY_IDENTIFIER Torque_Control.Controls_Temperature_by_limiting_Torque.temperature_SoP.temperature_rise_limitator_Inverters.Constant2.Value /end CHARACTERISTIC
/begin CHARACTERISTIC Torque_Control.Torque_Control_P.Constant2_Value_hv "" VALUE 0x0 SCALAR_FLOAT64_IEEE 3.5e+305 Torque_Control_CM_double -1.7e+308 1.7e+308 DISPLAY_IDENTIFIER Torque_Control.power_limitation.temperature_SoP.temperature_rise_limitator_Motors.Constant2.Value /end CHARACTERISTIC
/begin CHARACTERISTIC Torque_Control.Torque_Control_P.Constant2_Value_m "" VALUE 0x0 SCALAR_FLOAT64_IEEE 3.5e+305 Torque_Control_CM_double -1.7e+308 1.7e+308 DISPLAY_IDENTIFIER Torque_Control.Controls_Temperature_by_limiting_Torque.temperature_SoP.temperature_rise_limitator_Motors.Constant2.Value /end CHARACTERISTIC
/begin CHARACTERISTIC Torque_Control.Torque_Control_P.Constant2_Value_mw "" VALUE 0x0 SCALAR_FLOAT64_IEEE 3.5e+305 Torque_Control_CM_double -1.7e+308 1.7e+308 DISPLAY_IDENTIFIER Torque_Control.power_limitation.temperature_SoP.temperature_rise_limitator_Accu.Constant2.Value /end CHARACTERISTIC
/begin CHARACTERISTIC Torque_Control.Torque_Control_P.Constant3_Value "" VALUE 0x0 SCALAR_FLOAT64_IEEE 3.5e+305 Torque_Control_CM_double -1.7e+308 1.7e+308 DISPLAY_IDENTIFIER Torque_Control.Controls_Temperature_by_limiting_Torque.temperature_SoP.temperature_rise_limitator_Accu.Constant3.Value /end CHARACTERISTIC
/begin CHARACTERISTIC Torque_Control.Torque_Control_P.Constant3_Value_c "" VALUE 0x0 SCALAR_FLOAT64_IEEE 3.5e+305 Torque_Control_CM_double -1.7e+308 1.7e+308 DISPLAY_IDENTIFIER Torque_Control.power_limitation.temperature_SoP.temperature_rise_limitator_Inverters.Constant3.Value /end CHARACTERISTIC
/begin CHARACTERISTIC Torque_Control.Torque_Control_P.Constant3_Value_d "" VALUE 0x0 SCALAR_FLOAT64_IEEE 3.5e+305 Torque_Control_CM_double -1.7e+308 1.7e+308 DISPLAY_IDENTIFIER Torque_Control.Controls_Temperature_by_limiting_Torque.temperature_SoP.temperature_rise_limitator_Inverters.Constant3.Value /end CHARACTERISTIC
/begin CHARACTERISTIC Torque_Control.Torque_Control_P.Constant3_Value_e "" VALUE 0x0 SCALAR_FLOAT64_IEEE 3.5e+305 Torque_Control_CM_double -1.7e+308 1.7e+308 DISPLAY_IDENTIFIER Torque_Control.Controls_Temperature_by_limiting_Torque.temperature_SoP.temperature_rise_limitator_Motors.Constant3.Value /end CHARACTERISTIC
/begin CHARACTERISTIC Torque_Control.Torque_Control_P.Constant3_Value_h "" VALUE 0x0 SCALAR_FLOAT64_IEEE 3.5e+305 Torque_Control_CM_double -1.7e+308 1.7e+308 DISPLAY_IDENTIFIER Torque_Control.power_limitation.temperature_SoP.temperature_rise_limitator_Accu.Constant3.Value /end CHARACTERISTIC
/begin CHARACTERISTIC Torque_Control.Torque_Control_P.Constant3_Value_i "" VALUE 0x0 SCALAR_FLOAT64_IEEE 3.5e+305 Torque_Control_CM_double -1.7e+308 1.7e+308 DISPLAY_IDENTIFIER Torque_Control.power_limitation.temperature_SoP.temperature_rise_limitator_Motors.Constant3.Value /end CHARACTERISTIC
/begin CHARACTERISTIC Torque_Control.Torque_Control_P.Constant3_Value_k "" VALUE 0x0 SCALAR_FLOAT64_IEEE 3.5e+305 Torque_Control_CM_double -1.7e+308 1.7e+308 DISPLAY_IDENTIFIER Torque_Control.VDC.Vehicle_Dynamics_Control_Modes.VDC_Complete.Longitudinal_Dynamics.Constant3.Value /end CHARACTERISTIC
/begin CHARACTERISTIC Torque_Control.Torque_Control_P.Constant3_Value_n "" VALUE 0x0 SCALAR_FLOAT64_IEEE 3.5e+305 Torque_Control_CM_double -1.7e+308 1.7e+308 DISPLAY_IDENTIFIER Torque_Control.VDC.TEST_MODE_IN.TEST_CONSTANTS.Constant3.Value /end CHARACTERISTIC
/begin CHARACTERISTIC Torque_Control.Torque_Control_P.Constant3_Value_o "" VALUE 0x0 SCALAR_FLOAT64_IEEE 3.5e+305 Torque_Control_CM_double -1.7e+308 1.7e+308 DISPLAY_IDENTIFIER Torque_Control.VDC.Vehicle_Dynamics_Control_Modes.VDC_Complete.Lateral_Dynamics.Constant3.Value /end CHARACTERISTIC
/begin CHARACTERISTIC Torque_Control.Torque_Control_P.Constant4_Value "" VALUE 0x0 SCALAR_FLOAT64_IEEE 3.5e+305 Torque_Control_CM_double -1.7e+308 1.7e+308 DISPLAY_IDENTIFIER Torque_Control.VDC.Vehicle_Dynamics_Control_Modes.VDC_Complete.Longitudinal_Dynamics.Constant4.Value /end CHARACTERISTIC
/begin CHARACTERISTIC Torque_Control.Torque_Control_P.Constant4_Value_p "" VALUE 0x0 SCALAR_FLOAT64_IEEE 3.5e+305 Torque_Control_CM_double -1.7e+308 1.7e+308 DISPLAY_IDENTIFIER Torque_Control.VDC.Vehicle_Dynamics_Control_Modes.VDC_Complete.Lateral_Dynamics.Constant4.Value /end CHARACTERISTIC
/begin CHARACTERISTIC Torque_Control.Torque_Control_P.Constant5_Value "" VALUE 0x0 SCALAR_FLOAT64_IEEE 3.5e+305 Torque_Control_CM_double -1.7e+308 1.7e+308 DISPLAY_IDENTIFIER Torque_Control.VDC.Vehicle_Dynamics_Control_Modes.VDC_Complete.Longitudinal_Dynamics.Constant5.Value /end CHARACTERISTIC
/begin CHARACTERISTIC Torque_Control.Torque_Control_P.Constant6_Value "" VALUE 0x0 SCALAR_FLOAT64_IEEE 3.5e+305 Torque_Control_CM_double -1.7e+308 1.7e+308 DISPLAY_IDENTIFIER Torque_Control.VDC.Vehicle_Dynamics_Control_Modes.VDC_Complete.Longitudinal_Dynamics.Constant6.Value /end CHARACTERISTIC
/begin CHARACTERISTIC Torque_Control.Torque_Control_P.Constant6_Value_p "" VALUE 0x0 SCALAR_FLOAT64_IEEE 3.5e+305 Torque_Control_CM_double -1.7e+308 1.7e+308 DISPLAY_IDENTIFIER Torque_Control.VDC.Vehicle_Dynamics_Control_Modes.VDC_Complete.Lateral_Dynamics.Constant6.Value /end CHARACTERISTIC
/begin CHARACTERISTIC Torque_Control.Torque_Control_P.Constant7_Value "" VALUE 0x0 SCALAR_FLOAT64_IEEE 3.5e+305 Torque_Control_CM_double -1.7e+308 1.7e+308 DISPLAY_IDENTIFIER Torque_Control.VDC.Vehicle_Dynamics_Control_Modes.VDC_Complete.Lateral_Dynamics.Yaw_Rate_Reference.Constant7.Value /end CHARACTERISTIC
/begin CHARACTERISTIC Torque_Control.Torque_Control_P.Constant8_Value "" VALUE 0x0 SCALAR_FLOAT64_IEEE 3.5e+305 Torque_Control_CM_double -1.7e+308 1.7e+308 DISPLAY_IDENTIFIER Torque_Control.VDC.Vehicle_Dynamics_Control_Modes.VDC_Complete.Lateral_Dynamics.Yaw_Rate_Reference.Constant8.Value /end CHARACTERISTIC
/begin CHARACTERISTIC Torque_Control.Torque_Control_P.Constant_Value "" VALUE 0x0 SCALAR_FLOAT64_IEEE 3.5e+305 Torque_Control_CM_double -1.7e+308 1.7e+308 DISPLAY_IDENTIFIER Torque_Control.Current_0.Constant.Value /end CHARACTERISTIC
/begin CHARACTERISTIC Torque_Control.Torque_Control_P.Constant_Value_a "" VALUE 0x0 SCALAR_FLOAT64_IEEE 3.5e+305 Torque_Control_CM_double -1.7e+308 1.7e+308 DISPLAY_IDENTIFIER Torque_Control.VDC.Vehicle_Dynamics_Control_Modes.VDC_Complete.Optimization_SKF__amp__CKF.Subsystem.SKF.Spin.Constant.Value /end CHARACTERISTIC
/begin CHARACTERISTIC Torque_Control.Torque_Control_P.Constant_Value_ad "" VALUE 0x0 SCALAR_FLOAT64_IEEE 3.5e+305 Torque_Control_CM_double -1.7e+308 1.7e+308 DISPLAY_IDENTIFIER Torque_Control.VDC.Vehicle_Dynamics_Control_Modes.VDC_Complete.Lateral_Dynamics.Tire_Longitudinal_Force_Difference.Momentum_Z_to_Longitudinal_Force_Difference.Constant.Value /end CHARACTERISTIC
/begin CHARACTERISTIC Torque_Control.Torque_Control_P.Constant_Value_ae "" VALUE 0x0 SCALAR_FLOAT64_IEEE 3.5e+305 Torque_Control_CM_double -1.7e+308 1.7e+308 DISPLAY_IDENTIFIER Torque_Control.VDC.Vehicle_Dynamics_Control_Modes.VDC_without_Longitudinal.Kamm_Circle_Lateral.Constant.Value /end CHARACTERISTIC
/begin CHARACTERISTIC Torque_Control.Torque_Control_P.Constant_Value_b "" VALUE 0x0 SCALAR_FLOAT64_IEEE 3.5e+305 Torque_Control_CM_double -1.7e+308 1.7e+308 DISPLAY_IDENTIFIER Torque_Control.VDC.Vehicle_Dynamics_Control_Modes.VDC_Complete.Constant.Value /end CHARACTERISTIC
/begin CHARACTERISTIC Torque_Control.Torque_Control_P.Constant_Value_d "" VALUE 0x0 SCALAR_FLOAT64_IEEE 3.5e+305 Torque_Control_CM_double -1.7e+308 1.7e+308 DISPLAY_IDENTIFIER Torque_Control.VDC.Vehicle_Dynamics_Control_Modes.VDC_without_Longitudinal.Optimization_SKF__amp__CKF.Subsystem.CKF.Spin.Constant.Value /end CHARACTERISTIC
/begin CHARACTERISTIC Torque_Control.Torque_Control_P.Constant_Value_dl "" VALUE 0x0 SCALAR_FLOAT64_IEEE 3.5e+305 Torque_Control_CM_double -1.7e+308 1.7e+308 DISPLAY_IDENTIFIER Torque_Control.VDC.Vehicle_Dynamics_Control_Modes.Steering_TV_with_TC.Optimization_SKF__amp__CKF.Subsystem.CKF.Spin.Constant.Value /end CHARACTERISTIC
/begin CHARACTERISTIC Torque_Control.Torque_Control_P.Constant_Value_dm "" VALUE 0x0 SCALAR_FLOAT64_IEEE 3.5e+305 Torque_Control_CM_double -1.7e+308 1.7e+308 DISPLAY_IDENTIFIER Torque_Control.VDC.WORKSHOP_MODE_RESTRICTIONS.Torque_Reduction.Constant.Value /end CHARACTERISTIC
/begin CHARACTERISTIC Torque_Control.Torque_Control_P.Constant_Value_f "" VALUE 0x0 SCALAR_FLOAT64_IEEE 3.5e+305 Torque_Control_CM_double -1.7e+308 1.7e+308 DISPLAY_IDENTIFIER Torque_Control.VDC.Vehicle_Dynamics_Control_Modes.VDC_Complete.Optimization_SKF__amp__CKF.Subsystem.CKF.Spin.Constant.Value /end CHARACTERISTIC
/begin CHARACTERISTIC Torque_Control.Torque_Control_P.Constant_Value_f0 "" VALUE 0x0 SCALAR_FLOAT64_IEEE 3.5e+305 Torque_Control_CM_double -1.7e+308 1.7e+308 DISPLAY_IDENTIFIER Torque_Control.VDC.Vehicle_Dynamics_Control_Modes.VDC_Complete.Longitudinal_Dynamics.Constant.Value /end CHARACTERISTIC
/begin CHARACTERISTIC Torque_Control.Torque_Control_P.Constant_Value_h "" VALUE 0x0 SCALAR_FLOAT64_IEEE 3.5e+305 Torque_Control_CM_double -1.7e+308 1.7e+308 DISPLAY_IDENTIFIER Torque_Control.VDC.Vehicle_Dynamics_Control_Modes.VDC_Complete.Constraints_and_motor_to_wheel_Tq.Acelerating_and_braking_without_Regenerative.Constant.Value /end CHARACTERISTIC
/begin CHARACTERISTIC Torque_Control.Torque_Control_P.Constant_Value_i "" VALUE 0x0 SCALAR_FLOAT64_IEEE 3.5e+305 Torque_Control_CM_double -1.7e+308 1.7e+308 DISPLAY_IDENTIFIER Torque_Control.Pumps_Controller.Pumps_Control_ON.Constant.Value /end CHARACTERISTIC
/begin CHARACTERISTIC Torque_Control.Torque_Control_P.Constant_Value_ib "" VALUE 0x0 SCALAR_FLOAT64_IEEE 3.5e+305 Torque_Control_CM_double -1.7e+308 1.7e+308 DISPLAY_IDENTIFIER Torque_Control.VDC.Vehicle_Dynamics_Control_Modes.VDC_without_Longitudinal.Force_to_Tq.Constant.Value /end CHARACTERISTIC
/begin CHARACTERISTIC Torque_Control.Torque_Control_P.Constant_Value_k "" VALUE 0x0 SCALAR_FLOAT64_IEEE 3.5e+305 Torque_Control_CM_double -1.7e+308 1.7e+308 DISPLAY_IDENTIFIER Torque_Control.VDC.Vehicle_Dynamics_Control_Modes.Constant.Value /end CHARACTERISTIC
/begin CHARACTERISTIC Torque_Control.Torque_Control_P.Constant_Value_k4 "" VALUE 0x0 SCALAR_FLOAT64_IEEE 3.5e+305 Torque_Control_CM_double -1.7e+308 1.7e+308 DISPLAY_IDENTIFIER Torque_Control.VDC.TEST_MODE_IN.TEST_CONSTANTS.Constant.Value /end CHARACTERISTIC
/begin CHARACTERISTIC Torque_Control.Torque_Control_P.Constant_Value_l "" VALUE 0x0 SCALAR_FLOAT64_IEEE 3.5e+305 Torque_Control_CM_double -1.7e+308 1.7e+308 DISPLAY_IDENTIFIER Torque_Control.VDC.Vehicle_Dynamics_Control_Modes.VDC_Complete.Wheel_to_motor.Constant.Value /end CHARACTERISTIC
/begin CHARACTERISTIC Torque_Control.Torque_Control_P.Constant_Value_m "" VALUE 0x0 SCALAR_FLOAT64_IEEE 3.5e+305 Torque_Control_CM_double -1.7e+308 1.7e+308 DISPLAY_IDENTIFIER Torque_Control.VDC.Regeneration_Enable.Constant.Value /end CHARACTERISTIC
/begin CHARACTERISTIC Torque_Control.Torque_Control_P.Constant_Value_n "" VALUE 0x0 SCALAR_FLOAT64_IEEE 3.5e+305 Torque_Control_CM_double -1.7e+308 1.7e+308 DISPLAY_IDENTIFIER Torque_Control.Pumps_Controller.Pumps_Control_OFF.Constant.Value /end CHARACTERISTIC
/begin CHARACTERISTIC Torque_Control.Torque_Control_P.Constant_Value_n5 "" VALUE 0x0 SCALAR_FLOAT64_IEEE 3.5e+305 Torque_Control_CM_double -1.7e+308 1.7e+308 DISPLAY_IDENTIFIER Torque_Control.VDC.Vehicle_Dynamics_Control_Modes.Steering_TV_with_TC.Optimization_SKF__amp__CKF.Subsystem.SKF.Spin.Constant.Value /end CHARACTERISTIC
/begin CHARACTERISTIC Torque_Control.Torque_Control_P.Cornering_Stiffness_FN_Value "" VALUE 0x0 SCALAR_FLOAT64_IEEE 3.5e+305 Torque_Control_CM_double -1.7e+308 1.7e+308 DISPLAY_IDENTIFIER Torque_Control.VDC.Vehicle_Dynamics_Control_Modes.VDC_Complete.Lateral_Dynamics.Yaw_Rate_Reference.Cornering_Stiffness_F_N___.Value /end CHARACTERISTIC
/begin CHARACTERISTIC Torque_Control.Torque_Control_P.Cornering_Stiffness_RN_Value "" VALUE 0x0 SCALAR_FLOAT64_IEEE 3.5e+305 Torque_Control_CM_double -1.7e+308 1.7e+308 DISPLAY_IDENTIFIER Torque_Control.VDC.Vehicle_Dynamics_Control_Modes.VDC_Complete.Lateral_Dynamics.Yaw_Rate_Reference.Cornering_Stiffness_R_N___.Value /end CHARACTERISTIC
/begin CHARACTERISTIC Torque_Control.Torque_Control_P.DataStoreMemory10_InitialValue "" VALUE 0x0 SCALAR_FLOAT64_IEEE 3.5e+305 Torque_Control_CM_double -1.7e+308 1.7e+308 DISPLAY_IDENTIFIER Torque_Control.Accumulator_Power.PowerLimitDetection.Data_Store_Memory10.InitialValue /end CHARACTERISTIC
/begin CHARACTERISTIC Torque_Control.Torque_Control_P.DataStoreMemory1_InitialValu_fl "" VALUE 0x0 SCALAR_UBYTE 1.0 Torque_Control_CM_boolean 0 1 DISPLAY_IDENTIFIER Torque_Control.SAFETY_BLOCK.BRAKE_IMPLAUSIBILITY.Data_Store_Memory1.InitialValue /end CHARACTERISTIC
/begin CHARACTERISTIC Torque_Control.Torque_Control_P.DataStoreMemory1_InitialValue "" VALUE 0x0 SCALAR_FLOAT64_IEEE 3.5e+305 Torque_Control_CM_double -1.7e+308 1.7e+308 DISPLAY_IDENTIFIER Torque_Control.Steering_Data_Conv.Low_Pass.Data_Store_Memory1.InitialValue /end CHARACTERISTIC
/begin CHARACTERISTIC Torque_Control.Torque_Control_P.DataStoreMemory1_InitialValue_f "" VALUE 0x0 SCALAR_FLOAT64_IEEE 3.5e+305 Torque_Control_CM_double -1.7e+308 1.7e+308 DISPLAY_IDENTIFIER Torque_Control.VDC.Vehicle_Dynamics_Control_Modes.Steering_TV_with_TC.Optimization_SKF__amp__CKF.Data_Store_Memory1.InitialValue /end CHARACTERISTIC
/begin CHARACTERISTIC Torque_Control.Torque_Control_P.DataStoreMemory1_InitialValue_i "" VALUE 0x0 SCALAR_FLOAT64_IEEE 3.5e+305 Torque_Control_CM_double -1.7e+308 1.7e+308 DISPLAY_IDENTIFIER Torque_Control.VDC.Vehicle_Dynamics_Control_Modes.VDC_Complete.Optimization_SKF__amp__CKF.Data_Store_Memory1.InitialValue /end CHARACTERISTIC
/begin CHARACTERISTIC Torque_Control.Torque_Control_P.DataStoreMemory1_InitialValue_m "" VALUE 0x0 SCALAR_FLOAT64_IEEE 3.5e+305 Torque_Control_CM_double -1.7e+308 1.7e+308 DISPLAY_IDENTIFIER Torque_Control.VDC.Vehicle_Dynamics_Control_Modes.VDC_without_Longitudinal.Optimization_SKF__amp__CKF.Data_Store_Memory1.InitialValue /end CHARACTERISTIC
/begin CHARACTERISTIC Torque_Control.Torque_Control_P.DataStoreMemory_InitialValue "" VALUE 0x0 SCALAR_FLOAT64_IEEE 3.5e+305 Torque_Control_CM_double -1.7e+308 1.7e+308 DISPLAY_IDENTIFIER Torque_Control.Steering_Data_Conv.Low_Pass.Data_Store_Memory.InitialValue /end CHARACTERISTIC
/begin CHARACTERISTIC Torque_Control.Torque_Control_P.DataStoreMemory_InitialValue_c "" VALUE 0x0 SCALAR_FLOAT64_IEEE 3.5e+305 Torque_Control_CM_double -1.7e+308 1.7e+308 DISPLAY_IDENTIFIER Torque_Control.VDC.Vehicle_Dynamics_Control_Modes.VDC_Complete.Optimization_SKF__amp__CKF.Data_Store_Memory.InitialValue /end CHARACTERISTIC
/begin CHARACTERISTIC Torque_Control.Torque_Control_P.DataStoreMemory_InitialValue_m "" VALUE 0x0 SCALAR_FLOAT64_IEEE 3.5e+305 Torque_Control_CM_double -1.7e+308 1.7e+308 DISPLAY_IDENTIFIER Torque_Control.VDC.Vehicle_Dynamics_Control_Modes.Steering_TV_with_TC.Optimization_SKF__amp__CKF.Data_Store_Memory.InitialValue /end CHARACTERISTIC
/begin CHARACTERISTIC Torque_Control.Torque_Control_P.DiametertoRadius_Gain "" VALUE 0x0 SCALAR_FLOAT64_IEEE 3.5e+305 Torque_Control_CM_double -1.7e+308 1.7e+308 DISPLAY_IDENTIFIER Torque_Control.VDC.Vehicle_Dynamics_Control_Modes.VDC_Complete.In_Numbers.Diameter_to_Radius.Gain /end CHARACTERISTIC
/begin CHARACTERISTIC Torque_Control.Torque_Control_P.DiametertoRadius_Gain_h "" VALUE 0x0 SCALAR_FLOAT64_IEEE 3.5e+305 Torque_Control_CM_double -1.7e+308 1.7e+308 DISPLAY_IDENTIFIER Torque_Control.VDC.Vehicle_Dynamics_Control_Modes.VDC_without_Longitudinal.In_Numbers.Diameter_to_Radius.Gain /end CHARACTERISTIC
/begin CHARACTERISTIC Torque_Control.Torque_Control_P.EffectiveRollingDiameterinch_Va "" VALUE 0x0 SCALAR_FLOAT64_IEEE 3.5e+305 Torque_Control_CM_double -1.7e+308 1.7e+308 DISPLAY_IDENTIFIER Torque_Control.VDC.Vehicle_Dynamics_Control_Modes.VDC_Complete.In_Numbers.Effective_Rolling_Diameter[inch].Value /end CHARACTERISTIC
/begin CHARACTERISTIC Torque_Control.Torque_Control_P.EffectiveRollingDiameterinch__b "" VALUE 0x0 SCALAR_FLOAT64_IEEE 3.5e+305 Torque_Control_CM_double -1.7e+308 1.7e+308 DISPLAY_IDENTIFIER Torque_Control.VDC.Vehicle_Dynamics_Control_Modes.VDC_without_Longitudinal.In_Numbers.Effective_Rolling_Diameter[inch].Value /end CHARACTERISTIC
/begin CHARACTERISTIC Torque_Control.Torque_Control_P.Enabled_Value "" VALUE 0x0 SCALAR_FLOAT64_IEEE 3.5e+305 Torque_Control_CM_double -1.7e+308 1.7e+308 DISPLAY_IDENTIFIER Torque_Control.VDC.Regeneration_Enable.Enabled.Value /end CHARACTERISTIC
/begin CHARACTERISTIC Torque_Control.Torque_Control_P.Flag_Accu_const "" VALUE 0x0 SCALAR_FLOAT64_IEEE 3.5e+305 Torque_Control_CM_double -1.7e+308 1.7e+308 DISPLAY_IDENTIFIER Torque_Control.Controls_Temperature_by_limiting_Torque.temperature_SoP.Flag_Accu.Constant.Value /end CHARACTERISTIC
/begin CHARACTERISTIC Torque_Control.Torque_Control_P.Flag_Accu_const_h "" VALUE 0x0 SCALAR_FLOAT64_IEEE 3.5e+305 Torque_Control_CM_double -1.7e+308 1.7e+308 DISPLAY_IDENTIFIER Torque_Control.power_limitation.temperature_SoP.Flag_Accu.Constant.Value /end CHARACTERISTIC
/begin CHARACTERISTIC Torque_Control.Torque_Control_P.Flag_Inv_const "" VALUE 0x0 SCALAR_FLOAT64_IEEE 3.5e+305 Torque_Control_CM_double -1.7e+308 1.7e+308 DISPLAY_IDENTIFIER Torque_Control.Controls_Temperature_by_limiting_Torque.temperature_SoP.Flag_Inv.Constant.Value /end CHARACTERISTIC
/begin CHARACTERISTIC Torque_Control.Torque_Control_P.Flag_Inv_const_e "" VALUE 0x0 SCALAR_FLOAT64_IEEE 3.5e+305 Torque_Control_CM_double -1.7e+308 1.7e+308 DISPLAY_IDENTIFIER Torque_Control.power_limitation.temperature_SoP.Flag_Inv.Constant.Value /end CHARACTERISTIC
/begin CHARACTERISTIC Torque_Control.Torque_Control_P.Flag_Mot_const "" VALUE 0x0 SCALAR_FLOAT64_IEEE 3.5e+305 Torque_Control_CM_double -1.7e+308 1.7e+308 DISPLAY_IDENTIFIER Torque_Control.Controls_Temperature_by_limiting_Torque.temperature_SoP.Flag_Mot.Constant.Value /end CHARACTERISTIC
/begin CHARACTERISTIC Torque_Control.Torque_Control_P.Flag_Mot_const_n "" VALUE 0x0 SCALAR_FLOAT64_IEEE 3.5e+305 Torque_Control_CM_double -1.7e+308 1.7e+308 DISPLAY_IDENTIFIER Torque_Control.power_limitation.temperature_SoP.Flag_Mot.Constant.Value /end CHARACTERISTIC
/begin CHARACTERISTIC Torque_Control.Torque_Control_P.Flags_num5_Y0 "" VALUE 0x0 SCALAR_FLOAT64_IEEE 3.5e+305 Torque_Control_CM_double -1.7e+308 1.7e+308 DISPLAY_IDENTIFIER Torque_Control.VDC.Vehicle_Dynamics_Control_Modes.VDC_Complete.Flags_[num5].InitialOutput /end CHARACTERISTIC
/begin CHARACTERISTIC Torque_Control.Torque_Control_P.Fy_RN0inf_Y0 "" VALUE 0x0 SCALAR_FLOAT64_IEEE 3.5e+305 Torque_Control_CM_double -1.7e+308 1.7e+308 DISPLAY_IDENTIFIER Torque_Control.VDC.Vehicle_Dynamics_Control_Modes.VDC_without_Longitudinal.Fy_R_[N]__0_inf_.InitialOutput /end CHARACTERISTIC
/begin CHARACTERISTIC Torque_Control.Torque_Control_P.Fyperwheel_Gain "" VALUE 0x0 SCALAR_FLOAT64_IEEE 3.5e+305 Torque_Control_CM_double -1.7e+308 1.7e+308 DISPLAY_IDENTIFIER Torque_Control.VDC.Vehicle_Dynamics_Control_Modes.VDC_Complete.Lateral_Dynamics.Fy_per_wheel.Gain /end CHARACTERISTIC
/begin CHARACTERISTIC Torque_Control.Torque_Control_P.Fyperwheel_Gain_e "" VALUE 0x0 SCALAR_FLOAT64_IEEE 3.5e+305 Torque_Control_CM_double -1.7e+308 1.7e+308 DISPLAY_IDENTIFIER Torque_Control.VDC.Vehicle_Dynamics_Control_Modes.VDC_without_Longitudinal.Lateral_Dynamics.Fy_per_wheel.Gain /end CHARACTERISTIC
/begin CHARACTERISTIC Torque_Control.Torque_Control_P.Gain1_Gain "" VALUE 0x0 SCALAR_FLOAT64_IEEE 3.5e+305 Torque_Control_CM_double -1.7e+308 1.7e+308 DISPLAY_IDENTIFIER Torque_Control.VDC.Vehicle_Dynamics_Control_Modes.Steering_TV_with_TC.Accelerating__Braking_or_Regen_Braking.Regenerative_Mech_Braking.Gain1.Gain /end CHARACTERISTIC
/begin CHARACTERISTIC Torque_Control.Torque_Control_P.Gain1_Gain_m "" VALUE 0x0 SCALAR_FLOAT64_IEEE 3.5e+305 Torque_Control_CM_double -1.7e+308 1.7e+308 DISPLAY_IDENTIFIER Torque_Control.Gain1.Gain /end CHARACTERISTIC
/begin CHARACTERISTIC Torque_Control.Torque_Control_P.Gain1_Gain_o "" VALUE 0x0 SCALAR_FLOAT64_IEEE 3.5e+305 Torque_Control_CM_double -1.7e+308 1.7e+308 DISPLAY_IDENTIFIER Torque_Control.VDC.Gain1.Gain /end CHARACTERISTIC
/begin CHARACTERISTIC Torque_Control.Torque_Control_P.Gain5_Gain "" VALUE 0x0 SCALAR_FLOAT64_IEEE 3.5e+305 Torque_Control_CM_double -1.7e+308 1.7e+308 DISPLAY_IDENTIFIER Torque_Control.Controls_Temperature_by_limiting_Torque.SoC_SoP.Gain5.Gain /end CHARACTERISTIC
/begin CHARACTERISTIC Torque_Control.Torque_Control_P.Gain5_Gain_n "" VALUE 0x0 SCALAR_FLOAT64_IEEE 3.5e+305 Torque_Control_CM_double -1.7e+308 1.7e+308 DISPLAY_IDENTIFIER Torque_Control.power_limitation.SoC_SoP.Gain5.Gain /end CHARACTERISTIC
/begin CHARACTERISTIC Torque_Control.Torque_Control_P.Gain6_Gain "" VALUE 0x0 SCALAR_FLOAT64_IEEE 3.5e+305 Torque_Control_CM_double -1.7e+308 1.7e+308 DISPLAY_IDENTIFIER Torque_Control.Controls_Temperature_by_limiting_Torque.SoC_SoP.Gain6.Gain /end CHARACTERISTIC
/begin CHARACTERISTIC Torque_Control.Torque_Control_P.Gain6_Gain_f "" VALUE 0x0 SCALAR_FLOAT64_IEEE 3.5e+305 Torque_Control_CM_double -1.7e+308 1.7e+308 DISPLAY_IDENTIFIER Torque_Control.power_limitation.SoC_SoP.Gain6.Gain /end CHARACTERISTIC
/begin CHARACTERISTIC Torque_Control.Torque_Control_P.Gain_Gain "" VALUE 0x0 SCALAR_FLOAT64_IEEE 3.5e+305 Torque_Control_CM_double -1.7e+308 1.7e+308 DISPLAY_IDENTIFIER Torque_Control.Calculate_Current_Conversion.Gain.Gain /end CHARACTERISTIC
/begin CHARACTERISTIC Torque_Control.Torque_Control_P.Gain_Gain_b "" VALUE 0x0 SCALAR_FLOAT64_IEEE 3.5e+305 Torque_Control_CM_double -1.7e+308 1.7e+308 DISPLAY_IDENTIFIER Torque_Control.VDC.Vehicle_Dynamics_Control_Modes.Steering_TV_with_TC.Accelerating__Braking_or_Regen_Braking.Regenerative_Mech_Braking.Gain.Gain /end CHARACTERISTIC
/begin CHARACTERISTIC Torque_Control.Torque_Control_P.Gain_Gain_c "" VALUE 0x0 SCALAR_FLOAT64_IEEE 3.5e+305 Torque_Control_CM_double -1.7e+308 1.7e+308 DISPLAY_IDENTIFIER Torque_Control.Steering_Data_Conv.Low_Pass.Gain.Gain /end CHARACTERISTIC
/begin CHARACTERISTIC Torque_Control.Torque_Control_P.Gain_Gain_co "" VALUE 0x0 SCALAR_FLOAT64_IEEE 3.5e+305 Torque_Control_CM_double -1.7e+308 1.7e+308 DISPLAY_IDENTIFIER Torque_Control.VDC.Vehicle_Dynamics_Control_Modes.VDC_Complete.Constraints_and_motor_to_wheel_Tq.Acelerating_and_braking_without_Regenerative.Gain.Gain /end CHARACTERISTIC
/begin CHARACTERISTIC Torque_Control.Torque_Control_P.Gain_Gain_cv "" VALUE 0x0 SCALAR_FLOAT64_IEEE 3.5e+305 Torque_Control_CM_double -1.7e+308 1.7e+308 DISPLAY_IDENTIFIER Torque_Control.VDC.Vehicle_Dynamics_Control_Modes.VDC_without_Longitudinal.Constraints.Acelerating_and_braking_without_Regenerative.Gain.Gain /end CHARACTERISTIC
/begin CHARACTERISTIC Torque_Control.Torque_Control_P.Gain_Gain_f "" VALUE 0x0 SCALAR_FLOAT64_IEEE 3.5e+305 Torque_Control_CM_double -1.7e+308 1.7e+308 DISPLAY_IDENTIFIER Torque_Control.VDC.Vehicle_Dynamics_Control_Modes.Gain.Gain /end CHARACTERISTIC
/begin CHARACTERISTIC Torque_Control.Torque_Control_P.Gain_Gain_g "" VALUE 0x0 SCALAR_FLOAT64_IEEE 3.5e+305 Torque_Control_CM_double -1.7e+308 1.7e+308 DISPLAY_IDENTIFIER Torque_Control.Gain.Gain /end CHARACTERISTIC
/begin CHARACTERISTIC Torque_Control.Torque_Control_P.Gain_Gain_k "" VALUE 0x0 SCALAR_FLOAT64_IEEE 3.5e+305 Torque_Control_CM_double -1.7e+308 1.7e+308 DISPLAY_IDENTIFIER Torque_Control.VDC.Vehicle_Dynamics_Control_Modes.VDC_Complete.Longitudinal_Dynamics.Gain.Gain /end CHARACTERISTIC
/begin CHARACTERISTIC Torque_Control.Torque_Control_P.Gain_Gain_o "" VALUE 0x0 SCALAR_FLOAT64_IEEE 3.5e+305 Torque_Control_CM_double -1.7e+308 1.7e+308 DISPLAY_IDENTIFIER Torque_Control.Steering_Data_Conv.Gain.Gain /end CHARACTERISTIC
/begin CHARACTERISTIC Torque_Control.Torque_Control_P.GearRatio_Value "" VALUE 0x0 SCALAR_FLOAT64_IEEE 3.5e+305 Torque_Control_CM_double -1.7e+308 1.7e+308 DISPLAY_IDENTIFIER Torque_Control.Gear_Ratio.Value /end CHARACTERISTIC
/begin CHARACTERISTIC Torque_Control.Torque_Control_P.Gravity1_Gain "" VALUE 0x0 SCALAR_FLOAT64_IEEE 3.5e+305 Torque_Control_CM_double -1.7e+308 1.7e+308 DISPLAY_IDENTIFIER Torque_Control.VDC.Vehicle_Dynamics_Control_Modes.VDC_Complete.Lateral_Dynamics.Gravity1.Gain /end CHARACTERISTIC
/begin CHARACTERISTIC Torque_Control.Torque_Control_P.Gravity1_Gain_g "" VALUE 0x0 SCALAR_FLOAT64_IEEE 3.5e+305 Torque_Control_CM_double -1.7e+308 1.7e+308 DISPLAY_IDENTIFIER Torque_Control.VDC.Vehicle_Dynamics_Control_Modes.VDC_without_Longitudinal.Lateral_Dynamics.Gravity1.Gain /end CHARACTERISTIC
/begin CHARACTERISTIC Torque_Control.Torque_Control_P.Gravity_Gain "" VALUE 0x0 SCALAR_FLOAT64_IEEE 3.5e+305 Torque_Control_CM_double -1.7e+308 1.7e+308 DISPLAY_IDENTIFIER Torque_Control.VDC.Vehicle_Dynamics_Control_Modes.VDC_Complete.Lateral_Dynamics.Gravity.Gain /end CHARACTERISTIC
/begin CHARACTERISTIC Torque_Control.Torque_Control_P.Handlinginfinf_Y0 "" VALUE 0x0 SCALAR_FLOAT64_IEEE 3.5e+305 Torque_Control_CM_double -1.7e+308 1.7e+308 DISPLAY_IDENTIFIER Torque_Control.VDC.Vehicle_Dynamics_Control_Modes.VDC_without_Longitudinal.Handling_______inf_inf_.InitialOutput /end CHARACTERISTIC
/begin CHARACTERISTIC Torque_Control.Torque_Control_P.Integrator_IC "" VALUE 0x0 SCALAR_FLOAT64_IEEE 3.5e+305 Torque_Control_CM_double -1.7e+308 1.7e+308 DISPLAY_IDENTIFIER Torque_Control.VDC.Vehicle_Dynamics_Control_Modes.VDC_Complete.Lateral_Dynamics.Integrator.InitialCondition /end CHARACTERISTIC
/begin CHARACTERISTIC Torque_Control.Torque_Control_P.Inverters_Temperature_Limitatio "" VALUE 0x0 SCALAR_UBYTE 1.0 Torque_Control_CM_boolean 0 1 DISPLAY_IDENTIFIER Torque_Control.Controls_Temperature_by_limiting_Torque.Inverters_Temperature_Limitation_Flag.InitialOutput /end CHARACTERISTIC
/begin CHARACTERISTIC Torque_Control.Torque_Control_P.Lookup_SoC_SoP_chg_bp01Data "" VAL_BLK 0x0 SCALAR_FLOAT64_IEEE 3.5e+305 Torque_Control_CM_double -1.7e+308 1.7e+308 DISPLAY_IDENTIFIER Torque_Control.Controls_Temperature_by_limiting_Torque.SoC_SoP.Lookup_SoC_SoP_chg.BreakpointsForDimension1 NUMBER 8 /end CHARACTERISTIC
/begin CHARACTERISTIC Torque_Control.Torque_Control_P.Lookup_SoC_SoP_chg_bp01Data_b "" VAL_BLK 0x0 SCALAR_FLOAT64_IEEE 3.5e+305 Torque_Control_CM_double -1.7e+308 1.7e+308 DISPLAY_IDENTIFIER Torque_Control.power_limitation.SoC_SoP.Lookup_SoC_SoP_chg.BreakpointsForDimension1 NUMBER 8 /end CHARACTERISTIC
/begin CHARACTERISTIC Torque_Control.Torque_Control_P.Lookup_SoC_SoP_chg_tableData "" VAL_BLK 0x0 SCALAR_FLOAT64_IEEE 3.5e+305 Torque_Control_CM_double -1.7e+308 1.7e+308 DISPLAY_IDENTIFIER Torque_Control.Controls_Temperature_by_limiting_Torque.SoC_SoP.Lookup_SoC_SoP_chg.Table NUMBER 8 /end CHARACTERISTIC
/begin CHARACTERISTIC Torque_Control.Torque_Control_P.Lookup_SoC_SoP_chg_tableData_p "" VAL_BLK 0x0 SCALAR_FLOAT64_IEEE 3.5e+305 Torque_Control_CM_double -1.7e+308 1.7e+308 DISPLAY_IDENTIFIER Torque_Control.power_limitation.SoC_SoP.Lookup_SoC_SoP_chg.Table NUMBER 8 /end CHARACTERISTIC
/begin CHARACTERISTIC Torque_Control.Torque_Control_P.Lookup_SoC_SoP_dischg_bp01Dat_m "" VAL_BLK 0x0 SCALAR_FLOAT64_IEEE 3.5e+305 Torque_Control_CM_double -1.7e+308 1.7e+308 DISPLAY_IDENTIFIER Torque_Control.power_limitation.SoC_SoP.Lookup_SoC_SoP_dischg.BreakpointsForDimension1 NUMBER 8 /end CHARACTERISTIC
/begin CHARACTERISTIC Torque_Control.Torque_Control_P.Lookup_SoC_SoP_dischg_bp01Data "" VAL_BLK 0x0 SCALAR_FLOAT64_IEEE 3.5e+305 Torque_Control_CM_double -1.7e+308 1.7e+308 DISPLAY_IDENTIFIER Torque_Control.Controls_Temperature_by_limiting_Torque.SoC_SoP.Lookup_SoC_SoP_dischg.BreakpointsForDimension1 NUMBER 8 /end CHARACTERISTIC
/begin CHARACTERISTIC Torque_Control.Torque_Control_P.Lookup_SoC_SoP_dischg_tableDa_g "" VAL_BLK 0x0 SCALAR_FLOAT64_IEEE 3.5e+305 Torque_Control_CM_double -1.7e+308 1.7e+308 DISPLAY_IDENTIFIER Torque_Control.power_limitation.SoC_SoP.Lookup_SoC_SoP_dischg.Table NUMBER 8 /end CHARACTERISTIC
/begin CHARACTERISTIC Torque_Control.Torque_Control_P.Lookup_SoC_SoP_dischg_tableData "" VAL_BLK 0x0 SCALAR_FLOAT64_IEEE 3.5e+305 Torque_Control_CM_double -1.7e+308 1.7e+308 DISPLAY_IDENTIFIER Torque_Control.Controls_Temperature_by_limiting_Torque.SoC_SoP.Lookup_SoC_SoP_dischg.Table NUMBER 8 /end CHARACTERISTIC
/begin CHARACTERISTIC Torque_Control.Torque_Control_P.Lookup_Temp_SoP_chg_bp01Data "" VAL_BLK 0x0 SCALAR_FLOAT64_IEEE 3.5e+305 Torque_Control_CM_double -1.7e+308 1.7e+308 DISPLAY_IDENTIFIER Torque_Control.Controls_Temperature_by_limiting_Torque.SoC_SoP.Lookup_Temp_SoP_chg.BreakpointsForDimension1 NUMBER 5 /end CHARACTERISTIC
/begin CHARACTERISTIC Torque_Control.Torque_Control_P.Lookup_Temp_SoP_chg_bp01Data_i "" VAL_BLK 0x0 SCALAR_FLOAT64_IEEE 3.5e+305 Torque_Control_CM_double -1.7e+308 1.7e+308 DISPLAY_IDENTIFIER Torque_Control.power_limitation.SoC_SoP.Lookup_Temp_SoP_chg.BreakpointsForDimension1 NUMBER 5 /end CHARACTERISTIC
/begin CHARACTERISTIC Torque_Control.Torque_Control_P.Lookup_Temp_SoP_chg_tableData "" VAL_BLK 0x0 SCALAR_FLOAT64_IEEE 3.5e+305 Torque_Control_CM_double -1.7e+308 1.7e+308 DISPLAY_IDENTIFIER Torque_Control.Controls_Temperature_by_limiting_Torque.SoC_SoP.Lookup_Temp_SoP_chg.Table NUMBER 5 /end CHARACTERISTIC
/begin CHARACTERISTIC Torque_Control.Torque_Control_P.Lookup_Temp_SoP_chg_tableData_m "" VAL_BLK 0x0 SCALAR_FLOAT64_IEEE 3.5e+305 Torque_Control_CM_double -1.7e+308 1.7e+308 DISPLAY_IDENTIFIER Torque_Control.power_limitation.SoC_SoP.Lookup_Temp_SoP_chg.Table NUMBER 5 /end CHARACTERISTIC
/begin CHARACTERISTIC Torque_Control.Torque_Control_P.Masskg0inf_Y0 "" VALUE 0x0 SCALAR_FLOAT64_IEEE 3.5e+305 Torque_Control_CM_double -1.7e+308 1.7e+308 DISPLAY_IDENTIFIER Torque_Control.VDC.Vehicle_Dynamics_Control_Modes.VDC_without_Longitudinal.Mass_[kg]__0_inf_.InitialOutput /end CHARACTERISTIC
/begin CHARACTERISTIC Torque_Control.Torque_Control_P.MaxFx_RLN0inf_Y0 "" VALUE 0x0 SCALAR_FLOAT64_IEEE 3.5e+305 Torque_Control_CM_double -1.7e+308 1.7e+308 DISPLAY_IDENTIFIER Torque_Control.VDC.Vehicle_Dynamics_Control_Modes.VDC_without_Longitudinal.MaxFx_RL_[N]__0_inf_.InitialOutput /end CHARACTERISTIC
/begin CHARACTERISTIC Torque_Control.Torque_Control_P.MaxFx_RRN0inf_Y0 "" VALUE 0x0 SCALAR_FLOAT64_IEEE 3.5e+305 Torque_Control_CM_double -1.7e+308 1.7e+308 DISPLAY_IDENTIFIER Torque_Control.VDC.Vehicle_Dynamics_Control_Modes.VDC_without_Longitudinal.MaxFx_RR_[N]__0_inf_.InitialOutput /end CHARACTERISTIC
/begin CHARACTERISTIC Torque_Control.Torque_Control_P.MaxTq_RLNm0inf_Y0 "" VALUE 0x0 SCALAR_FLOAT64_IEEE 3.5e+305 Torque_Control_CM_double -1.7e+308 1.7e+308 DISPLAY_IDENTIFIER Torque_Control.VDC.Vehicle_Dynamics_Control_Modes.VDC_Complete.MaxTq_RL_[Nm]__0_inf_.InitialOutput /end CHARACTERISTIC
/begin CHARACTERISTIC Torque_Control.Torque_Control_P.MaxTq_RLNm0inf_Y0_d "" VALUE 0x0 SCALAR_FLOAT64_IEEE 3.5e+305 Torque_Control_CM_double -1.7e+308 1.7e+308 DISPLAY_IDENTIFIER Torque_Control.VDC.Vehicle_Dynamics_Control_Modes.VDC_without_Longitudinal.MaxTq_RL_[Nm]__0_inf_.InitialOutput /end CHARACTERISTIC
/begin CHARACTERISTIC Torque_Control.Torque_Control_P.MaxTq_RRNm0inf_Y0 "" VALUE 0x0 SCALAR_FLOAT64_IEEE 3.5e+305 Torque_Control_CM_double -1.7e+308 1.7e+308 DISPLAY_IDENTIFIER Torque_Control.VDC.Vehicle_Dynamics_Control_Modes.VDC_Complete.MaxTq_RR_[Nm]__0_inf_.InitialOutput /end CHARACTERISTIC
/begin CHARACTERISTIC Torque_Control.Torque_Control_P.MaxTq_RRNm0inf_Y0_o "" VALUE 0x0 SCALAR_FLOAT64_IEEE 3.5e+305 Torque_Control_CM_double -1.7e+308 1.7e+308 DISPLAY_IDENTIFIER Torque_Control.VDC.Vehicle_Dynamics_Control_Modes.VDC_without_Longitudinal.MaxTq_RR_[Nm]__0_inf_.InitialOutput /end CHARACTERISTIC
/begin CHARACTERISTIC Torque_Control.Torque_Control_P.MaxTqpermotorNm_Value "" VALUE 0x0 SCALAR_FLOAT64_IEEE 3.5e+305 Torque_Control_CM_double -1.7e+308 1.7e+308 DISPLAY_IDENTIFIER Torque_Control.Max_Tq_per_motor_[Nm].Value /end CHARACTERISTIC
/begin CHARACTERISTIC Torque_Control.Torque_Control_P.Max_Power_chargekW_Value "" VALUE 0x0 SCALAR_FLOAT64_IEEE 3.5e+305 Torque_Control_CM_double -1.7e+308 1.7e+308 DISPLAY_IDENTIFIER Torque_Control.Power_limitation.Max_Power_charge_[kW].Value /end CHARACTERISTIC
/begin CHARACTERISTIC Torque_Control.Torque_Control_P.Max_Power_dischargekW_Value "" VALUE 0x0 SCALAR_FLOAT64_IEEE 3.5e+305 Torque_Control_CM_double -1.7e+308 1.7e+308 DISPLAY_IDENTIFIER Torque_Control.Power_limitation.Max_Power_discharge_[kW].Value /end CHARACTERISTIC
/begin CHARACTERISTIC Torque_Control.Torque_Control_P.Max_Tq_per_motor_Value "" VALUE 0x0 SCALAR_FLOAT64_IEEE 3.5e+305 Torque_Control_CM_double -1.7e+308 1.7e+308 DISPLAY_IDENTIFIER Torque_Control.Controls_Temperature_by_limiting_Torque.Max_Tq_per_motor.Value /end CHARACTERISTIC
/begin CHARACTERISTIC Torque_Control.Torque_Control_P.MaximumTorqueperengineNm_Value "" VALUE 0x0 SCALAR_FLOAT64_IEEE 3.5e+305 Torque_Control_CM_double -1.7e+308 1.7e+308 DISPLAY_IDENTIFIER Torque_Control.VDC.Vehicle_Dynamics_Control_Modes.VDC_Complete.In_Numbers.Maximum_Torque_per_engine_[Nm].Value /end CHARACTERISTIC
/begin CHARACTERISTIC Torque_Control.Torque_Control_P.MaximumTorquepermotorNm_Value "" VALUE 0x0 SCALAR_FLOAT64_IEEE 3.5e+305 Torque_Control_CM_double -1.7e+308 1.7e+308 DISPLAY_IDENTIFIER Torque_Control.VDC.Vehicle_Dynamics_Control_Modes.VDC_without_Longitudinal.In_Numbers.Maximum_Torque_per_motor_[Nm].Value /end CHARACTERISTIC
/begin CHARACTERISTIC Torque_Control.Torque_Control_P.MaximumTransmissionTorqueDyna_a "" VALUE 0x0 SCALAR_FLOAT64_IEEE 3.5e+305 Torque_Control_CM_double -1.7e+308 1.7e+308 DISPLAY_IDENTIFIER Torque_Control.VDC.Vehicle_Dynamics_Control_Modes.VDC_without_Longitudinal.In_Numbers.Maximum_Transmission_Torque_Dynamic_[Nm].Value /end CHARACTERISTIC
/begin CHARACTERISTIC Torque_Control.Torque_Control_P.MaximumTransmissionTorqueDynami "" VALUE 0x0 SCALAR_FLOAT64_IEEE 3.5e+305 Torque_Control_CM_double -1.7e+308 1.7e+308 DISPLAY_IDENTIFIER Torque_Control.VDC.Vehicle_Dynamics_Control_Modes.VDC_Complete.In_Numbers.Maximum_Transmission_Torque_Dynamic_[Nm].Value /end CHARACTERISTIC
/begin CHARACTERISTIC Torque_Control.Torque_Control_P.MaximumTransmissionTorqueStat_n "" VALUE 0x0 SCALAR_FLOAT64_IEEE 3.5e+305 Torque_Control_CM_double -1.7e+308 1.7e+308 DISPLAY_IDENTIFIER Torque_Control.VDC.Vehicle_Dynamics_Control_Modes.VDC_without_Longitudinal.In_Numbers.Maximum_Transmission_Torque_Static_[Nm].Value /end CHARACTERISTIC
/begin CHARACTERISTIC Torque_Control.Torque_Control_P.MaximumTransmissionTorqueStatic "" VALUE 0x0 SCALAR_FLOAT64_IEEE 3.5e+305 Torque_Control_CM_double -1.7e+308 1.7e+308 DISPLAY_IDENTIFIER Torque_Control.VDC.Vehicle_Dynamics_Control_Modes.VDC_Complete.In_Numbers.Maximum_Transmission_Torque_Static_[Nm].Value /end CHARACTERISTIC
/begin CHARACTERISTIC Torque_Control.Torque_Control_P.Merge1_InitialOutput "" VALUE 0x0 SCALAR_FLOAT64_IEEE 3.5e+305 Torque_Control_CM_double -1.7e+308 1.7e+308 DISPLAY_IDENTIFIER Torque_Control.VDC.Vehicle_Dynamics_Control_Modes.VDC_Complete.Driver____CarBehaviours.Merge1.InitialOutput /end CHARACTERISTIC
/begin CHARACTERISTIC Torque_Control.Torque_Control_P.Merge1_InitialOutput_e "" VALUE 0x0 SCALAR_FLOAT64_IEEE 3.5e+305 Torque_Control_CM_double -1.7e+308 1.7e+308 DISPLAY_IDENTIFIER Torque_Control.VDC.Vehicle_Dynamics_Control_Modes.Steering_TV_with_TC.Accelerating__Braking_or_Regen_Braking.Merge1.InitialOutput /end CHARACTERISTIC
/begin CHARACTERISTIC Torque_Control.Torque_Control_P.Merge1_InitialOutput_k "" VALUE 0x0 SCALAR_FLOAT64_IEEE 3.5e+305 Torque_Control_CM_double -1.7e+308 1.7e+308 DISPLAY_IDENTIFIER Torque_Control.VDC.Vehicle_Dynamics_Control_Modes.VDC_without_Longitudinal.Driver____CarBehaviours.Merge1.InitialOutput /end CHARACTERISTIC
/begin CHARACTERISTIC Torque_Control.Torque_Control_P.Merge2_InitialOutput "" VALUE 0x0 SCALAR_FLOAT64_IEEE 3.5e+305 Torque_Control_CM_double -1.7e+308 1.7e+308 DISPLAY_IDENTIFIER Torque_Control.VDC.Vehicle_Dynamics_Control_Modes.VDC_Complete.Merge2.InitialOutput /end CHARACTERISTIC
/begin CHARACTERISTIC Torque_Control.Torque_Control_P.Merge2_InitialOutput_o "" VALUE 0x0 SCALAR_FLOAT64_IEEE 3.5e+305 Torque_Control_CM_double -1.7e+308 1.7e+308 DISPLAY_IDENTIFIER Torque_Control.VDC.Vehicle_Dynamics_Control_Modes.Merge2.InitialOutput /end CHARACTERISTIC
/begin CHARACTERISTIC Torque_Control.Torque_Control_P.Merge3_InitialOutput "" VALUE 0x0 SCALAR_FLOAT64_IEEE 3.5e+305 Torque_Control_CM_double -1.7e+308 1.7e+308 DISPLAY_IDENTIFIER Torque_Control.VDC.Vehicle_Dynamics_Control_Modes.VDC_Complete.Merge3.InitialOutput /end CHARACTERISTIC
/begin CHARACTERISTIC Torque_Control.Torque_Control_P.Merge3_InitialOutput_n "" VALUE 0x0 SCALAR_FLOAT64_IEEE 3.5e+305 Torque_Control_CM_double -1.7e+308 1.7e+308 DISPLAY_IDENTIFIER Torque_Control.VDC.Vehicle_Dynamics_Control_Modes.Merge3.InitialOutput /end CHARACTERISTIC
/begin CHARACTERISTIC Torque_Control.Torque_Control_P.Merge4_InitialOutput "" VALUE 0x0 SCALAR_FLOAT64_IEEE 3.5e+305 Torque_Control_CM_double -1.7e+308 1.7e+308 DISPLAY_IDENTIFIER Torque_Control.VDC.Vehicle_Dynamics_Control_Modes.VDC_Complete.Merge4.InitialOutput /end CHARACTERISTIC
/begin CHARACTERISTIC Torque_Control.Torque_Control_P.Merge5_InitialOutput "" VALUE 0x0 SCALAR_FLOAT64_IEEE 3.5e+305 Torque_Control_CM_double -1.7e+308 1.7e+308 DISPLAY_IDENTIFIER Torque_Control.VDC.Vehicle_Dynamics_Control_Modes.VDC_Complete.Merge5.InitialOutput /end CHARACTERISTIC
/begin CHARACTERISTIC Torque_Control.Torque_Control_P.Merge6_InitialOutput "" VALUE 0x0 SCALAR_FLOAT64_IEEE 3.5e+305 Torque_Control_CM_double -1.7e+308 1.7e+308 DISPLAY_IDENTIFIER Torque_Control.VDC.Vehicle_Dynamics_Control_Modes.VDC_Complete.Merge6.InitialOutput /end CHARACTERISTIC
/begin CHARACTERISTIC Torque_Control.Torque_Control_P.Merge7_InitialOutput "" VALUE 0x0 SCALAR_FLOAT64_IEEE 3.5e+305 Torque_Control_CM_double -1.7e+308 1.7e+308 DISPLAY_IDENTIFIER Torque_Control.VDC.Vehicle_Dynamics_Control_Modes.VDC_Complete.Merge7.InitialOutput /end CHARACTERISTIC
/begin CHARACTERISTIC Torque_Control.Torque_Control_P.MergeTq_RL_InitialOutput "" VALUE 0x0 SCALAR_FLOAT64_IEEE 3.5e+305 Torque_Control_CM_double -1.7e+308 1.7e+308 DISPLAY_IDENTIFIER Torque_Control.VDC.Vehicle_Dynamics_Control_Modes.Merge_Tq_RL.InitialOutput /end CHARACTERISTIC
/begin CHARACTERISTIC Torque_Control.Torque_Control_P.MergeTq_RR_InitialOutput "" VALUE 0x0 SCALAR_FLOAT64_IEEE 3.5e+305 Torque_Control_CM_double -1.7e+308 1.7e+308 DISPLAY_IDENTIFIER Torque_Control.VDC.Vehicle_Dynamics_Control_Modes.Merge_Tq_RR.InitialOutput /end CHARACTERISTIC
/begin CHARACTERISTIC Torque_Control.Torque_Control_P.Merge_InitialOutput "" VALUE 0x0 SCALAR_FLOAT64_IEEE 3.5e+305 Torque_Control_CM_double -1.7e+308 1.7e+308 DISPLAY_IDENTIFIER Torque_Control.VDC.Vehicle_Dynamics_Control_Modes.VDC_Complete.Optimization_SKF__amp__CKF.Subsystem.SKF.Merge.InitialOutput /end CHARACTERISTIC
/begin CHARACTERISTIC Torque_Control.Torque_Control_P.Merge_InitialOutput_a "" VALUE 0x0 SCALAR_FLOAT64_IEEE 3.5e+305 Torque_Control_CM_double -1.7e+308 1.7e+308 DISPLAY_IDENTIFIER Torque_Control.VDC.Vehicle_Dynamics_Control_Modes.Steering_TV_with_TC.Optimization_SKF__amp__CKF.Subsystem.CKF.Merge.InitialOutput /end CHARACTERISTIC
/begin CHARACTERISTIC Torque_Control.Torque_Control_P.Merge_InitialOutput_e "" VALUE 0x0 SCALAR_FLOAT64_IEEE 3.5e+305 Torque_Control_CM_double -1.7e+308 1.7e+308 DISPLAY_IDENTIFIER Torque_Control.VDC.Vehicle_Dynamics_Control_Modes.Steering_TV_with_TC.Accelerating__Braking_or_Regen_Braking.Merge.InitialOutput /end CHARACTERISTIC
/begin CHARACTERISTIC Torque_Control.Torque_Control_P.Merge_InitialOutput_h "" VALUE 0x0 SCALAR_FLOAT64_IEEE 3.5e+305 Torque_Control_CM_double -1.7e+308 1.7e+308 DISPLAY_IDENTIFIER Torque_Control.VDC.Vehicle_Dynamics_Control_Modes.VDC_without_Longitudinal.Optimization_SKF__amp__CKF.Subsystem.CKF.Merge.InitialOutput /end CHARACTERISTIC
/begin CHARACTERISTIC Torque_Control.Torque_Control_P.Merge_InitialOutput_i "" VALUE 0x0 SCALAR_FLOAT64_IEEE 3.5e+305 Torque_Control_CM_double -1.7e+308 1.7e+308 DISPLAY_IDENTIFIER Torque_Control.VDC.Vehicle_Dynamics_Control_Modes.VDC_Complete.Driver____CarBehaviours.Merge.InitialOutput /end CHARACTERISTIC
/begin CHARACTERISTIC Torque_Control.Torque_Control_P.Merge_InitialOutput_j "" VALUE 0x0 SCALAR_FLOAT64_IEEE 3.5e+305 Torque_Control_CM_double -1.7e+308 1.7e+308 DISPLAY_IDENTIFIER Torque_Control.VDC.Vehicle_Dynamics_Control_Modes.VDC_Complete.Optimization_SKF__amp__CKF.Subsystem.CKF.Merge.InitialOutput /end CHARACTERISTIC
/begin CHARACTERISTIC Torque_Control.Torque_Control_P.Merge_InitialOutput_l "" VALUE 0x0 SCALAR_FLOAT64_IEEE 3.5e+305 Torque_Control_CM_double -1.7e+308 1.7e+308 DISPLAY_IDENTIFIER Torque_Control.VDC.Vehicle_Dynamics_Control_Modes.VDC_without_Longitudinal.Driver____CarBehaviours.Merge.InitialOutput /end CHARACTERISTIC
/begin CHARACTERISTIC Torque_Control.Torque_Control_P.Merge_InitialOutput_p "" VALUE 0x0 SCALAR_FLOAT64_IEEE 3.5e+305 Torque_Control_CM_double -1.7e+308 1.7e+308 DISPLAY_IDENTIFIER Torque_Control.VDC.Vehicle_Dynamics_Control_Modes.Steering_TV_with_TC.Optimization_SKF__amp__CKF.Subsystem.SKF.Merge.InitialOutput /end CHARACTERISTIC
/begin COMPU_METHOD Ellipse_CM_double "Q = V" RAT_FUNC "%9.6" "NO_PHYSICAL_QTY" COEFFS 0.0 1.0 0.0 0.0 0.0 1.0 /end COMPU_METHOD
/begin COMPU_METHOD Inverters_Action_CM_boolean "Q = V" RAT_FUNC "%9.6" "NO_PHYSICAL_QTY" COEFFS 0.0 1.0 0.0 0.0 0.0 1.0 /end COMPU_METHOD
/begin COMPU_METHOD Inverters_Action_CM_uint8 "Q = V" RAT_FUNC "%9.6" "NO_PHYSICAL_QTY" COEFFS 0.0 1.0 0.0 0.0 0.0 1.0 /end COMPU_METHOD
/begin COMPU_METHOD Inverters_Action_CM_double "Q = V" RAT_FUNC "%9.6" "NO_PHYSICAL_QTY" COEFFS 0.0 1.0 0.0 0.0 0.0 1.0 /end COMPU_METHOD
/begin COMPU_METHOD Inverters_Action_CM_uint32 "Q = V" RAT_FUNC "%9.6" "NO_PHYSICAL_QTY" COEFFS 0.0 1.0 0.0 0.0 0.0 1.0 /end COMPU_METHOD
/begin COMPU_METHOD Inverters_Data_CM_double "Q = V" RAT_FUNC "%9.6" "NO_PHYSICAL_QTY" COEFFS 0.0 1.0 0.0 0.0 0.0 1.0 /end COMPU_METHOD
/begin COMPU_METHOD LVD_Data_CM_double "Q = V" RAT_FUNC "%9.6" "NO_PHYSICAL_QTY" COEFFS 0.0 1.0 0.0 0.0 0.0 1.0 /end COMPU_METHOD
/begin COMPU_METHOD Racing_Mode_CM_double "Q = V" RAT_FUNC "%9.6" "NO_PHYSICAL_QTY" COEFFS 0.0 1.0 0.0 0.0 0.0 1.0 /end COMPU_METHOD
/begin COMPU_METHOD Racing_Mode_CM_uint8 "Q = V" RAT_FUNC "%9.6" "NO_PHYSICAL_QTY" COEFFS 0.0 1.0 0.0 0.0 0.0 1.0 /end COMPU_METHOD
/begin COMPU_METHOD Racing_Mode_CM_boolean "Q = V" RAT_FUNC "%9.6" "NO_PHYSICAL_QTY" COEFFS 0.0 1.0 0.0 0.0 0.0 1.0 /end COMPU_METHOD
/begin COMPU_METHOD Synchronism_CM_double "Q = V" RAT_FUNC "%9.6" "NO_PHYSICAL_QTY" COEFFS 0.0 1.0 0.0 0.0 0.0 1.0 /end COMPU_METHOD
/begin COMPU_METHOD Torque_Control_CM_double "Q = V" RAT_FUNC "%9.6" "NO_PHYSICAL_QTY" COEFFS 0.0 1.0 0.0 0.0 0.0 1.0 /end COMPU_METHOD
/begin COMPU_METHOD Torque_Control_CM_boolean "Q = V" RAT_FUNC "%9.6" "NO_PHYSICAL_QTY" COEFFS 0.0 1.0 0.0 0.0 0.0 1.0 /end COMPU_METHOD
/begin RECORD_LAYOUT SCALAR_UBYTE FNC_VALUES 1 UBYTE COLUMN_DIR DIRECT /end RECORD_LAYOUT
/begin RECORD_LAYOUT SCALAR_FLOAT64_IEEE FNC_VALUES 1 FLOAT64_IEEE COLUMN_DIR DIRECT /end RECORD_LAYOUT
/begin RECORD_LAYOUT SCALAR_ULONG FNC_VALUES 1 ULONG COLUMN_DIR DIRECT /end RECORD_LAYOUT
/begin GROUP Ellipse "" ROOT
 /begin REF_MEASUREMENT Ellipse.Ellipse_U.ACCEL_X_IMU Ellipse.Ellipse_U.ACCEL_X_MAG Ellipse.Ellipse_U.ACCEL_Y_IMU Ellipse.Ellipse_U.ACCEL_Y_MAG Ellipse.Ellipse_U.ACCEL_Z_IMU Ellipse.Ellipse_U.ACCEL_Z_MAG Ellipse.Ellipse_U.ANGLE_SLIP Ellipse.Ellipse_U.ANGLE_TRACK Ellipse.Ellipse_U.AUTO_STATUS Ellipse.Ellipse_U.CLOCK Ellipse.Ellipse_U.CURVATURE_RADIUS Ellipse.Ellipse_U.GENERAL Ellipse.Ellipse_U.GYRO_X Ellipse.Ellipse_U.GYRO_Y Ellipse.Ellipse_U.GYRO_Z Ellipse.Ellipse_U.LATITUDE_EKF Ellipse.Ellipse_U.LONGITUDE_EKF Ellipse.Ellipse_U.PITCH Ellipse.Ellipse_U.ROLL Ellipse.Ellipse_U.TIME_STAMP Ellipse.Ellipse_U.YAW Ellipse.Ellipse_U.el_Vel_X Ellipse.Ellipse_U.el_Vel_Y Ellipse.Ellipse_U.el_Vel_Z Ellipse.Ellipse_Y.Accel_X_IMU_Tx Ellipse.Ellipse_Y.Accel_X_Mag_Tx Ellipse.Ellipse_Y.Accel_Y_IMU_Tx Ellipse.Ellipse_Y.Accel_Y_Mag_Tx Ellipse.Ellipse_Y.Accel_Z_IMU_Tx Ellipse.Ellipse_Y.Accel_Z_Mag_Tx Ellipse.Ellipse_Y.Clock_Tx Ellipse.Ellipse_Y.CurvRadius Ellipse.Ellipse_Y.General_Tx Ellipse.Ellipse_Y.Gyro_X_Tx Ellipse.Ellipse_Y.Gyro_Y_Tx Ellipse.Ellipse_Y.Gyro_Z_Tx Ellipse.Ellipse_Y.Lat_EKF Ellipse.Ellipse_Y.Long_EKF Ellipse.Ellipse_Y.Pitch_Tx Ellipse.Ellipse_Y.Roll_Tx Ellipse.Ellipse_Y.SlipAngle Ellipse.Ellipse_Y.Status_Auto Ellipse.Ellipse_Y.Time Ellipse.Ellipse_Y.TrackAngle Ellipse.Ellipse_Y.Vel_X Ellipse.Ellipse_Y.Vel_Y Ellipse.Ellipse_Y.Vel_Z Ellipse.Ellipse_Y.Yaw_Tx /end REF_MEASUREMENT
 /begin SUB_GROUP Ellipse.Ellipse_U Ellipse.Ellipse_Y /end SUB_GROUP
/end GROUP
/begin GROUP Ellipse.Ellipse_U ""
 /begin REF_MEASUREMENT Ellipse.Ellipse_U.ACCEL_X_IMU Ellipse.Ellipse_U.ACCEL_X_MAG Ellipse.Ellipse_U.ACCEL_Y_IMU Ellipse.Ellipse_U.ACCEL_Y_MAG Ellipse.Ellipse_U.ACCEL_Z_IMU Ellipse.Ellipse_U.ACCEL_Z_MAG Ellipse.Ellipse_U.ANGLE_SLIP Ellipse.Ellipse_U.ANGLE_TRACK Ellipse.Ellipse_U.AUTO_STATUS Ellipse.Ellipse_U.CLOCK Ellipse.Ellipse_U.CURVATURE_RADIUS Ellipse.Ellipse_U.GENERAL Ellipse.Ellipse_U.GYRO_X Ellipse.Ellipse_U.GYRO_Y Ellipse.Ellipse_U.GYRO_Z Ellipse.Ellipse_U.LATITUDE_EKF Ellipse.Ellipse_U.LONGITUDE_EKF Ellipse.Ellipse_U.PITCH Ellipse.Ellipse_U.ROLL Ellipse.Ellipse_U.TIME_STAMP Ellipse.Ellipse_U.YAW Ellipse.Ellipse_U.el_Vel_X Ellipse.Ellipse_U.el_Vel_Y Ellipse.Ellipse_U.el_Vel_Z /end REF_MEASUREMENT
/end GROUP
/begin GROUP Ellipse.Ellipse_Y ""
 /begin REF_MEASUREMENT Ellipse.Ellipse_Y.Accel_X_IMU_Tx Ellipse.Ellipse_Y.Accel_X_Mag_Tx Ellipse.Ellipse_Y.Accel_Y_IMU_Tx Ellipse.Ellipse_Y.Accel_Y_Mag_Tx Ellipse.Ellipse_Y.Accel_Z_IMU_Tx Ellipse.Ellipse_Y.Accel_Z_Mag_Tx Ellipse.Ellipse_Y.Clock_Tx Ellipse.Ellipse_Y.CurvRadius Ellipse.Ellipse_Y.General_Tx Ellipse.Ellipse_Y.Gyro_X_Tx Ellipse.Ellipse_Y.Gyro_Y_Tx Ellipse.Ellipse_Y.Gyro_Z_Tx Ellipse.Ellipse_Y.Lat_EKF Ellipse.Ellipse_Y.Long_EKF Ellipse.Ellipse_Y.Pitch_Tx Ellipse.Ellipse_Y.Roll_Tx Ellipse.Ellipse_Y.SlipAngle Ellipse.Ellipse_Y.Status_Auto Ellipse.Ellipse_Y.Time Ellipse.Ellipse_Y.TrackAngle Ellipse.Ellipse_Y.Vel_X Ellipse.Ellipse_Y.Vel_Y Ellipse.Ellipse_Y.Vel_Z Ellipse.Ellipse_Y.Yaw_Tx /end REF_MEASUREMENT
/end GROUP
/begin GROUP Inverters_Action "" ROOT
 /begin REF_MEASUREMENT Inverters_Action.Inverters_Action_B.Merge Inverters_Action.Inverters_Action_B.Merge2 Inverters_Action.Inverters_Action_B.Merge2_p Inverters_Action.Inverters_Action_B.subscribed Inverters_Action.Inverters_Action_B.subscribed_b Inverters_Action.Inverters_Action_DW.EnumerationCounter Inverters_Action.Inverters_Action_DW.EnumerationCounter_m Inverters_Action.Inverters_Action_DW.LastAction Inverters_Action.Inverters_Action_DW.LastAction_k Inverters_Action.Inverters_Action_U.InvertersAction Inverters_Action.Inverters_Action_U.current_L Inverters_Action.Inverters_Action_U.current_R Inverters_Action.Inverters_Action_Y.Inverter_L_RegID Inverters_Action.Inverters_Action_Y.Inverter_L_b15tob8 Inverters_Action.Inverters_Action_Y.Inverter_L_b7tob0 Inverters_Action.Inverters_Action_Y.Inverter_R_RegID Inverters_Action.Inverters_Action_Y.Inverter_R_b15tob8 Inverters_Action.Inverters_Action_Y.Inverter_R_b7tob0 Inverters_Action.Inverters_Action_Y.InvertersSubscribed /end REF_MEASUREMENT
 /begin REF_CHARACTERISTIC Inverters_Action.Inverters_Action_P.Constant_Value Inverters_Action.Inverters_Action_P.Constant_Value_m Inverters_Action.Inverters_Action_P.DataStoreMemory1_InitialValue Inverters_Action.Inverters_Action_P.DataStoreMemory1_InitialValue_m Inverters_Action.Inverters_Action_P.DataStoreMemory2_InitialValue Inverters_Action.Inverters_Action_P.DataStoreMemory2_InitialValue_c Inverters_Action.Inverters_Action_P.Delay_DelayLength Inverters_Action.Inverters_Action_P.Delay_DelayLength_h Inverters_Action.Inverters_Action_P.Delay_InitialCondition Inverters_Action.Inverters_Action_P.Delay_InitialCondition_o Inverters_Action.Inverters_Action_P.Merge_InitialOutput Inverters_Action.Inverters_Action_P.TimeInterval_Value Inverters_Action.Inverters_Action_P.TimeInterval_Value_d Inverters_Action.Inverters_Action_P._Value Inverters_Action.Inverters_Action_P.subscribed_InitialOutput Inverters_Action.Inverters_Action_P.subscribed_InitialOutput_k Inverters_Action.Inverters_Action_P.u_Value /end REF_CHARACTERISTIC
 /begin SUB_GROUP Inverters_Action.Inverters_Action_B Inverters_Action.Inverters_Action_DW Inverters_Action.Inverters_Action_U Inverters_Action.Inverters_Action_Y Inverters_Action.Inverters_Action_P /end SUB_GROUP
/end GROUP
/begin GROUP Inverters_Action.Inverters_Action_B ""
 /begin REF_MEASUREMENT Inverters_Action.Inverters_Action_B.Merge Inverters_Action.Inverters_Action_B.Merge2 Inverters_Action.Inverters_Action_B.Merge2_p Inverters_Action.Inverters_Action_B.subscribed Inverters_Action.Inverters_Action_B.subscribed_b /end REF_MEASUREMENT
/end GROUP
/begin GROUP Inverters_Action.Inverters_Action_DW ""
 /begin REF_MEASUREMENT Inverters_Action.Inverters_Action_DW.EnumerationCounter Inverters_Action.Inverters_Action_DW.EnumerationCounter_m Inverters_Action.Inverters_Action_DW.LastAction Inverters_Action.Inverters_Action_DW.LastAction_k /end REF_MEASUREMENT
/end GROUP
/begin GROUP Inverters_Action.Inverters_Action_U ""
 /begin REF_MEASUREMENT Inverters_Action.Inverters_Action_U.InvertersAction Inverters_Action.Inverters_Action_U.current_L Inverters_Action.Inverters_Action_U.current_R /end REF_MEASUREMENT
/end GROUP
/begin GROUP Inverters_Action.Inverters_Action_Y ""
 /begin REF_MEASUREMENT Inverters_Action.Inverters_Action_Y.Inverter_L_RegID Inverters_Action.Inverters_Action_Y.Inverter_L_b15tob8 Inverters_Action.Inverters_Action_Y.Inverter_L_b7tob0 Inverters_Action.Inverters_Action_Y.Inverter_R_RegID Inverters_Action.Inverters_Action_Y.Inverter_R_b15tob8 Inverters_Action.Inverters_Action_Y.Inverter_R_b7tob0 Inverters_Action.Inverters_Action_Y.InvertersSubscribed /end REF_MEASUREMENT
/end GROUP
/begin GROUP Inverters_Action.Inverters_Action_P ""
 /begin REF_CHARACTERISTIC Inverters_Action.Inverters_Action_P.Constant_Value Inverters_Action.Inverters_Action_P.Constant_Value_m Inverters_Action.Inverters_Action_P.DataStoreMemory1_InitialValue Inverters_Action.Inverters_Action_P.DataStoreMemory1_InitialValue_m Inverters_Action.Inverters_Action_P.DataStoreMemory2_InitialValue Inverters_Action.Inverters_Action_P.DataStoreMemory2_InitialValue_c Inverters_Action.Inverters_Action_P.Delay_DelayLength Inverters_Action.Inverters_Action_P.Delay_DelayLength_h Inverters_Action.Inverters_Action_P.Delay_InitialCondition Inverters_Action.Inverters_Action_P.Delay_InitialCondition_o Inverters_Action.Inverters_Action_P.Merge_InitialOutput Inverters_Action.Inverters_Action_P.TimeInterval_Value Inverters_Action.Inverters_Action_P.TimeInterval_Value_d Inverters_Action.Inverters_Action_P._Value Inverters_Action.Inverters_Action_P.subscribed_InitialOutput Inverters_Action.Inverters_Action_P.subscribed_InitialOutput_k Inverters_Action.Inverters_Action_P.u_Value /end REF_CHARACTERISTIC
/end GROUP
/begin GROUP Inverters_Data "" ROOT
 /begin REF_MEASUREMENT Inverters_Data.Inverters_Data_U.Inv_L_RegID_M235_Inv_L_DCBus Inverters_Data.Inverters_Data_U.Inv_L_RegID_M32_Inv_L_Iactual Inverters_Data.Inverters_Data_U.Inv_L_RegID_M38_Inv_L_Icommand Inverters_Data.Inverters_Data_U.Inv_L_RegID_M39_Inv_L_Iq Inverters_Data.Inverters_Data_U.Inv_L_RegID_M48_Inv_L_Speed Inverters_Data.Inverters_Data_U.Inv_L_RegID_M73_Inv_L_TempMotor Inverters_Data.Inverters_Data_U.Inv_L_RegID_M74_Inv_L_TempIGBT Inverters_Data.Inverters_Data_U.Inv_R_RegID_M235_Inv_R_DCBus Inverters_Data.Inverters_Data_U.Inv_R_RegID_M32_Inv_R_Iactual Inverters_Data.Inverters_Data_U.Inv_R_RegID_M38_Inv_R_Icommand Inverters_Data.Inverters_Data_U.Inv_R_RegID_M39_Inv_R_Iq Inverters_Data.Inverters_Data_U.Inv_R_RegID_M48_Inv_R_Speed Inverters_Data.Inverters_Data_U.Inv_R_RegID_M73_Inv_R_TempMotor Inverters_Data.Inverters_Data_U.Inv_R_RegID_M74_Inv_R_TempIGBT Inverters_Data.Inverters_Data_U.Torque_L Inverters_Data.Inverters_Data_U.Torque_R Inverters_Data.Inverters_Data_Y.Inv_L_Iactual Inverters_Data.Inverters_Data_Y.Inv_L_Icommand Inverters_Data.Inverters_Data_Y.Inv_L_Iq Inverters_Data.Inverters_Data_Y.Inv_L_Speed Inverters_Data.Inverters_Data_Y.Inv_L_TempIGBT Inverters_Data.Inverters_Data_Y.Inv_L_TempMotor Inverters_Data.Inverters_Data_Y.Inv_L_VdcBus Inverters_Data.Inverters_Data_Y.Inv_R_Iactual Inverters_Data.Inverters_Data_Y.Inv_R_Icommand Inverters_Data.Inverters_Data_Y.Inv_R_Iq Inverters_Data.Inverters_Data_Y.Inv_R_Speed Inverters_Data.Inverters_Data_Y.Inv_R_TempIGBT Inverters_Data.Inverters_Data_Y.Inv_R_TempMotor Inverters_Data.Inverters_Data_Y.Inv_R_VdcBus Inverters_Data.Inverters_Data_Y.InvertersMinDCBus Inverters_Data.Inverters_Data_Y.Mech_Power Inverters_Data.Inverters_Data_Y.RL_rads Inverters_Data.Inverters_Data_Y.RR_rads Inverters_Data.Inverters_Data_Y.Speed Inverters_Data.Inverters_Data_Y.Temp_IGBT Inverters_Data.Inverters_Data_Y.Temp_Motors Inverters_Data.Inverters_Data_Y.Vel_RL_kmh Inverters_Data.Inverters_Data_Y.Vel_RR_kmh /end REF_MEASUREMENT
 /begin REF_CHARACTERISTIC Inverters_Data.Inverters_Data_P.A1_Value Inverters_Data.Inverters_Data_P.A1_Value_e Inverters_Data.Inverters_Data_P.B1_Value Inverters_Data.Inverters_Data_P.B1_Value_i Inverters_Data.Inverters_Data_P.Bitct_Value Inverters_Data.Inverters_Data_P.Bitct_Value_h Inverters_Data.Inverters_Data_P.C1_Value Inverters_Data.Inverters_Data_P.C1_Value_d Inverters_Data.Inverters_Data_P.C1_Value_n Inverters_Data.Inverters_Data_P.C1_Value_n0 Inverters_Data.Inverters_Data_P.Constant1_Value Inverters_Data.Inverters_Data_P.Constant1_Value_e Inverters_Data.Inverters_Data_P.D1_Value Inverters_Data.Inverters_Data_P.D1_Value_d Inverters_Data.Inverters_Data_P.D1_Value_f Inverters_Data.Inverters_Data_P.D1_Value_j Inverters_Data.Inverters_Data_P.Diameterm_Gain Inverters_Data.Inverters_Data_P.Diameterm_Gain_p Inverters_Data.Inverters_Data_P.Gain_Gain Inverters_Data.Inverters_Data_P.Gain_Gain_a Inverters_Data.Inverters_Data_P.Gain_Gain_e Inverters_Data.Inverters_Data_P.Gain_Gain_f Inverters_Data.Inverters_Data_P.Gain_Gain_m Inverters_Data.Inverters_Data_P.MaxRPM_Value Inverters_Data.Inverters_Data_P.MaxRPM_Value_m Inverters_Data.Inverters_Data_P.conversionratio1_Gain Inverters_Data.Inverters_Data_P.conversionratio_Gain Inverters_Data.Inverters_Data_P.conversionratio_Gain_c Inverters_Data.Inverters_Data_P.conversionratio_Gain_j Inverters_Data.Inverters_Data_P.conversionratio_Gain_k Inverters_Data.Inverters_Data_P.conversionratio_Gain_o Inverters_Data.Inverters_Data_P.direction_Gain Inverters_Data.Inverters_Data_P.direction_Gain_f Inverters_Data.Inverters_Data_P.ratio_Gain Inverters_Data.Inverters_Data_P.ratio_Gain_k Inverters_Data.Inverters_Data_P.upi60_Gain Inverters_Data.Inverters_Data_P.upi60_Gain_i /end REF_CHARACTERISTIC
 /begin SUB_GROUP Inverters_Data.Inverters_Data_U Inverters_Data.Inverters_Data_Y Inverters_Data.Inverters_Data_P /end SUB_GROUP
/end GROUP
/begin GROUP Inverters_Data.Inverters_Data_U ""
 /begin REF_MEASUREMENT Inverters_Data.Inverters_Data_U.Inv_L_RegID_M235_Inv_L_DCBus Inverters_Data.Inverters_Data_U.Inv_L_RegID_M32_Inv_L_Iactual Inverters_Data.Inverters_Data_U.Inv_L_RegID_M38_Inv_L_Icommand Inverters_Data.Inverters_Data_U.Inv_L_RegID_M39_Inv_L_Iq Inverters_Data.Inverters_Data_U.Inv_L_RegID_M48_Inv_L_Speed Inverters_Data.Inverters_Data_U.Inv_L_RegID_M73_Inv_L_TempMotor Inverters_Data.Inverters_Data_U.Inv_L_RegID_M74_Inv_L_TempIGBT Inverters_Data.Inverters_Data_U.Inv_R_RegID_M235_Inv_R_DCBus Inverters_Data.Inverters_Data_U.Inv_R_RegID_M32_Inv_R_Iactual Inverters_Data.Inverters_Data_U.Inv_R_RegID_M38_Inv_R_Icommand Inverters_Data.Inverters_Data_U.Inv_R_RegID_M39_Inv_R_Iq Inverters_Data.Inverters_Data_U.Inv_R_RegID_M48_Inv_R_Speed Inverters_Data.Inverters_Data_U.Inv_R_RegID_M73_Inv_R_TempMotor Inverters_Data.Inverters_Data_U.Inv_R_RegID_M74_Inv_R_TempIGBT Inverters_Data.Inverters_Data_U.Torque_L Inverters_Data.Inverters_Data_U.Torque_R /end REF_MEASUREMENT
/end GROUP
/begin GROUP Inverters_Data.Inverters_Data_Y ""
 /begin REF_MEASUREMENT Inverters_Data.Inverters_Data_Y.Inv_L_Iactual Inverters_Data.Inverters_Data_Y.Inv_L_Icommand Inverters_Data.Inverters_Data_Y.Inv_L_Iq Inverters_Data.Inverters_Data_Y.Inv_L_Speed Inverters_Data.Inverters_Data_Y.Inv_L_TempIGBT Inverters_Data.Inverters_Data_Y.Inv_L_TempMotor Inverters_Data.Inverters_Data_Y.Inv_L_VdcBus Inverters_Data.Inverters_Data_Y.Inv_R_Iactual Inverters_Data.Inverters_Data_Y.Inv_R_Icommand Inverters_Data.Inverters_Data_Y.Inv_R_Iq Inverters_Data.Inverters_Data_Y.Inv_R_Speed Inverters_Data.Inverters_Data_Y.Inv_R_TempIGBT Inverters_Data.Inverters_Data_Y.Inv_R_TempMotor Inverters_Data.Inverters_Data_Y.Inv_R_VdcBus Inverters_Data.Inverters_Data_Y.InvertersMinDCBus Inverters_Data.Inverters_Data_Y.Mech_Power Inverters_Data.Inverters_Data_Y.RL_rads Inverters_Data.Inverters_Data_Y.RR_rads Inverters_Data.Inverters_Data_Y.Speed Inverters_Data.Inverters_Data_Y.Temp_IGBT Inverters_Data.Inverters_Data_Y.Temp_Motors Inverters_Data.Inverters_Data_Y.Vel_RL_kmh Inverters_Data.Inverters_Data_Y.Vel_RR_kmh /end REF_MEASUREMENT
/end GROUP
/begin GROUP Inverters_Data.Inverters_Data_P ""
 /begin REF_CHARACTERISTIC Inverters_Data.Inverters_Data_P.A1_Value Inverters_Data.Inverters_Data_P.A1_Value_e Inverters_Data.Inverters_Data_P.B1_Value Inverters_Data.Inverters_Data_P.B1_Value_i Inverters_Data.Inverters_Data_P.Bitct_Value Inverters_Data.Inverters_Data_P.Bitct_Value_h Inverters_Data.Inverters_Data_P.C1_Value Inverters_Data.Inverters_Data_P.C1_Value_d Inverters_Data.Inverters_Data_P.C1_Value_n Inverters_Data.Inverters_Data_P.C1_Value_n0 Inverters_Data.Inverters_Data_P.Constant1_Value Inverters_Data.Inverters_Data_P.Constant1_Value_e Inverters_Data.Inverters_Data_P.D1_Value Inverters_Data.Inverters_Data_P.D1_Value_d Inverters_Data.Inverters_Data_P.D1_Value_f Inverters_Data.Inverters_Data_P.D1_Value_j Inverters_Data.Inverters_Data_P.Diameterm_Gain Inverters_Data.Inverters_Data_P.Diameterm_Gain_p Inverters_Data.Inverters_Data_P.Gain_Gain Inverters_Data.Inverters_Data_P.Gain_Gain_a Inverters_Data.Inverters_Data_P.Gain_Gain_e Inverters_Data.Inverters_Data_P.Gain_Gain_f Inverters_Data.Inverters_Data_P.Gain_Gain_m Inverters_Data.Inverters_Data_P.MaxRPM_Value Inverters_Data.Inverters_Data_P.MaxRPM_Value_m Inverters_Data.Inverters_Data_P.conversionratio1_Gain Inverters_Data.Inverters_Data_P.conversionratio_Gain Inverters_Data.Inverters_Data_P.conversionratio_Gain_c Inverters_Data.Inverters_Data_P.conversionratio_Gain_j Inverters_Data.Inverters_Data_P.conversionratio_Gain_k Inverters_Data.Inverters_Data_P.conversionratio_Gain_o Inverters_Data.Inverters_Data_P.direction_Gain Inverters_Data.Inverters_Data_P.direction_Gain_f Inverters_Data.Inverters_Data_P.ratio_Gain Inverters_Data.Inverters_Data_P.ratio_Gain_k Inverters_Data.Inverters_Data_P.upi60_Gain Inverters_Data.Inverters_Data_P.upi60_Gain_i /end REF_CHARACTERISTIC
/end GROUP
/begin GROUP LVD_Data "" ROOT
 /begin REF_MEASUREMENT LVD_Data.LVD_Data_DW.Previous_IN LVD_Data.LVD_Data_DW.Previous_OUT LVD_Data.LVD_Data_U.LVBattery_Voltage_Bits LVD_Data.LVD_Data_Y.LVbattery_Voltage /end REF_MEASUREMENT
 /begin REF_CHARACTERISTIC LVD_Data.LVD_Data_P.DataStoreMemory1_InitialValue LVD_Data.LVD_Data_P.DataStoreMemory_InitialValue LVD_Data.LVD_Data_P.MaxBits2_Value LVD_Data.LVD_Data_P.MaxBits_Value LVD_Data.LVD_Data_P.Vmax_Value LVD_Data.LVD_Data_P.Vmin_Value LVD_Data.LVD_Data_P.ct_Value LVD_Data.LVD_Data_P.exptcycletau1_Value /end REF_CHARACTERISTIC
 /begin SUB_GROUP LVD_Data.LVD_Data_DW LVD_Data.LVD_Data_U LVD_Data.LVD_Data_Y LVD_Data.LVD_Data_P /end SUB_GROUP
/end GROUP
/begin GROUP LVD_Data.LVD_Data_DW ""
 /begin REF_MEASUREMENT LVD_Data.LVD_Data_DW.Previous_IN LVD_Data.LVD_Data_DW.Previous_OUT /end REF_MEASUREMENT
/end GROUP
/begin GROUP LVD_Data.LVD_Data_U "" /begin REF_MEASUREMENT LVD_Data.LVD_Data_U.LVBattery_Voltage_Bits /end REF_MEASUREMENT /end GROUP
/begin GROUP LVD_Data.LVD_Data_Y "" /begin REF_MEASUREMENT LVD_Data.LVD_Data_Y.LVbattery_Voltage /end REF_MEASUREMENT /end GROUP
/begin GROUP LVD_Data.LVD_Data_P ""
 /begin REF_CHARACTERISTIC LVD_Data.LVD_Data_P.DataStoreMemory1_InitialValue LVD_Data.LVD_Data_P.DataStoreMemory_InitialValue LVD_Data.LVD_Data_P.MaxBits2_Value LVD_Data.LVD_Data_P.MaxBits_Value LVD_Data.LVD_Data_P.Vmax_Value LVD_Data.LVD_Data_P.Vmin_Value LVD_Data.LVD_Data_P.ct_Value LVD_Data.LVD_Data_P.exptcycletau1_Value /end REF_CHARACTERISTIC
/end GROUP
/begin GROUP Racing_Mode "" ROOT
 /begin REF_MEASUREMENT Racing_Mode.Racing_Mode_B.Apps_Sat_Dwn.Gain Racing_Mode.Racing_Mode_B.Apps_Sat_Up.Gain Racing_Mode.Racing_Mode_B.CKF_Initial.Gain Racing_Mode.Racing_Mode_B.Cte_CKF.Gain Racing_Mode.Racing_Mode_B.Cte_SKF.Gain Racing_Mode.Racing_Mode_B.K_Reduction_P.Gain Racing_Mode.Racing_Mode_B.K_Reduction_Temperature.Gain Racing_Mode.Racing_Mode_B.Max_Regenerative_Torque.In1 Racing_Mode.Racing_Mode_B.Merge Racing_Mode.Racing_Mode_B.Power_Limit.In1 Racing_Mode.Racing_Mode_B.SKF_Initial.Gain Racing_Mode.Racing_Mode_U.CustomMode_Data Racing_Mode.Racing_Mode_U.CustomMode_Identifier Racing_Mode.Racing_Mode_U.RacingMode Racing_Mode.Racing_Mode_Y.VDC_Apps_Sat_Down Racing_Mode.Racing_Mode_Y.VDC_Apps_Sat_Up Racing_Mode.Racing_Mode_Y.VDC_CKF_Initial Racing_Mode.Racing_Mode_Y.VDC_Cte_CKF Racing_Mode.Racing_Mode_Y.VDC_Cte_SKF Racing_Mode.Racing_Mode_Y.VDC_K_Reduction_P Racing_Mode.Racing_Mode_Y.VDC_K_Reduction_Temperature Racing_Mode.Racing_Mode_Y.VDC_Max_Regenerative_Torque Racing_Mode.Racing_Mode_Y.VDC_Power_Limit Racing_Mode.Racing_Mode_Y.VDC_SKF_Initial Racing_Mode.Racing_Mode_Y.Workshop_Mode_Enable /end REF_MEASUREMENT
 /begin REF_CHARACTERISTIC Racing_Mode.Racing_Mode_P.Apps_Sat_DwnSaturation_LowerSat Racing_Mode.Racing_Mode_P.Apps_Sat_DwnSaturation_UpperSat Racing_Mode.Racing_Mode_P.Apps_Sat_UpSaturation_LowerSat Racing_Mode.Racing_Mode_P.Apps_Sat_UpSaturation_UpperSat Racing_Mode.Racing_Mode_P.CEE_Apps_Sat_Dwn_Value Racing_Mode.Racing_Mode_P.CEE_Apps_Sat_Up_Value Racing_Mode.Racing_Mode_P.CEE_CKF_Initial_Value Racing_Mode.Racing_Mode_P.CEE_Cte_CKF_Value Racing_Mode.Racing_Mode_P.CEE_Cte_SKF_Value Racing_Mode.Racing_Mode_P.CEE_K_Reduction_P_Value Racing_Mode.Racing_Mode_P.CEE_K_Reduction_Temperature_Val Racing_Mode.Racing_Mode_P.CEE_Max_Regenerative_Torque_Val Racing_Mode.Racing_Mode_P.CEE_Power_Limit_Value Racing_Mode.Racing_Mode_P.CEE_SKF_Initial_Value Racing_Mode.Racing_Mode_P.CKF_InitialSaturation_LowerSat Racing_Mode.Racing_Mode_P.CKF_InitialSaturation_UpperSat Racing_Mode.Racing_Mode_P.CompareToConstant_const Racing_Mode.Racing_Mode_P.Cte_CKFSaturation_LowerSat Racing_Mode.Racing_Mode_P.Cte_CKFSaturation_UpperSat Racing_Mode.Racing_Mode_P.Cte_SKFSaturation_LowerSat Racing_Mode.Racing_Mode_P.Cte_SKFSaturation_UpperSat Racing_Mode.Racing_Mode_P.K_Reduction_PSaturation_LowerSa Racing_Mode.Racing_Mode_P.K_Reduction_PSaturation_UpperSa Racing_Mode.Racing_Mode_P.K_Reduction_TemperatureSatura_m Racing_Mode.Racing_Mode_P.K_Reduction_TemperatureSaturati Racing_Mode.Racing_Mode_P.Max_Regenerative_TorqueSatura_o Racing_Mode.Racing_Mode_P.Max_Regenerative_TorqueSaturati Racing_Mode.Racing_Mode_P.Merge_InitialOutput Racing_Mode.Racing_Mode_P.Power_LimitSaturation_LowerSat Racing_Mode.Racing_Mode_P.Power_LimitSaturation_UpperSat Racing_Mode.Racing_Mode_P.SKF_InitialSaturation_LowerSat Racing_Mode.Racing_Mode_P.SKF_InitialSaturation_UpperSat /end REF_CHARACTERISTIC
 /begin SUB_GROUP Racing_Mode.Racing_Mode_B Racing_Mode.Racing_Mode_B.Apps_Sat_Dwn Racing_Mode.Racing_Mode_B.Apps_Sat_Up Racing_Mode.Racing_Mode_B.CKF_Initial Racing_Mode.Racing_Mode_B.Cte_CKF Racing_Mode.Racing_Mode_B.Cte_SKF Racing_Mode.Racing_Mode_B.K_Reduction_P Racing_Mode.Racing_Mode_B.K_Reduction_Temperature Racing_Mode.Racing_Mode_B.Max_Regenerative_Torque Racing_Mode.Racing_Mode_B.Power_Limit Racing_Mode.Racing_Mode_B.SKF_Initial Racing_Mode.Racing_Mode_U Racing_Mode.Racing_Mode_Y Racing_Mode.Racing_Mode_P /end SUB_GROUP
/end GROUP
/begin GROUP Racing_Mode.Racing_Mode_B ""
 /begin REF_MEASUREMENT Racing_Mode.Racing_Mode_B.Apps_Sat_Dwn.Gain Racing_Mode.Racing_Mode_B.Apps_Sat_Up.Gain Racing_Mode.Racing_Mode_B.CKF_Initial.Gain Racing_Mode.Racing_Mode_B.Cte_CKF.Gain Racing_Mode.Racing_Mode_B.Cte_SKF.Gain Racing_Mode.Racing_Mode_B.K_Reduction_P.Gain Racing_Mode.Racing_Mode_B.K_Reduction_Temperature.Gain Racing_Mode.Racing_Mode_B.Max_Regenerative_Torque.In1 Racing_Mode.Racing_Mode_B.Merge Racing_Mode.Racing_Mode_B.Power_Limit.In1 Racing_Mode.Racing_Mode_B.SKF_Initial.Gain /end REF_MEASUREMENT
/end GROUP
/begin GROUP Racing_Mode.Racing_Mode_B.Apps_Sat_Dwn "" /begin REF_MEASUREMENT Racing_Mode.Racing_Mode_B.Apps_Sat_Dwn.Gain /end REF_MEASUREMENT /end GROUP
/begin GROUP Racing_Mode.Racing_Mode_B.Apps_Sat_Up "" /begin REF_MEASUREMENT Racing_Mode.Racing_Mode_B.Apps_Sat_Up.Gain /end REF_MEASUREMENT /end GROUP
/begin GROUP Racing_Mode.Racing_Mode_B.CKF_Initial "" /begin REF_MEASUREMENT Racing_Mode.Racing_Mode_B.CKF_Initial.Gain /end REF_MEASUREMENT /end GROUP
/begin GROUP Racing_Mode.Racing_Mode_B.Cte_CKF "" /begin REF_MEASUREMENT Racing_Mode.Racing_Mode_B.Cte_CKF.Gain /end REF_MEASUREMENT /end GROUP
/begin GROUP Racing_Mode.Racing_Mode_B.Cte_SKF "" /begin REF_MEASUREMENT Racing_Mode.Racing_Mode_B.Cte_SKF.Gain /end REF_MEASUREMENT /end GROUP
/begin GROUP Racing_Mode.Racing_Mode_B.K_Reduction_P "" /begin REF_MEASUREMENT Racing_Mode.Racing_Mode_B.K_Reduction_P.Gain /end REF_MEASUREMENT /end GROUP
/begin GROUP Racing_Mode.Racing_Mode_B.K_Reduction_Temperature "" /begin REF_MEASUREMENT Racing_Mode.Racing_Mode_B.K_Reduction_Temperature.Gain /end REF_MEASUREMENT /end GROUP
/begin GROUP Racing_Mode.Racing_Mode_B.Max_Regenerative_Torque "" /begin REF_MEASUREMENT Racing_Mode.Racing_Mode_B.Max_Regenerative_Torque.In1 /end REF_MEASUREMENT /end GROUP
/begin GROUP Racing_Mode.Racing_Mode_B.Power_Limit "" /begin REF_MEASUREMENT Racing_Mode.Racing_Mode_B.Power_Limit.In1 /end REF_MEASUREMENT /end GROUP
/begin GROUP Racing_Mode.Racing_Mode_B.SKF_Initial "" /begin REF_MEASUREMENT Racing_Mode.Racing_Mode_B.SKF_Initial.Gain /end REF_MEASUREMENT /end GROUP
/begin GROUP Racing_Mode.Racing_Mode_U ""
 /begin REF_MEASUREMENT Racing_Mode.Racing_Mode_U.CustomMode_Data Racing_Mode.Racing_Mode_U.CustomMode_Identifier Racing_Mode.Racing_Mode_U.RacingMode /end REF_MEASUREMENT
/end GROUP
/begin GROUP Racing_Mode.Racing_Mode_Y ""
 /begin REF_MEASUREMENT Racing_Mode.Racing_Mode_Y.VDC_Apps_Sat_Down Racing_Mode.Racing_Mode_Y.VDC_Apps_Sat_Up Racing_Mode.Racing_Mode_Y.VDC_CKF_Initial Racing_Mode.Racing_Mode_Y.VDC_Cte_CKF Racing_Mode.Racing_Mode_Y.VDC_Cte_SKF Racing_Mode.Racing_Mode_Y.VDC_K_Reduction_P Racing_Mode.Racing_Mode_Y.VDC_K_Reduction_Temperature Racing_Mode.Racing_Mode_Y.VDC_Max_Regenerative_Torque Racing_Mode.Racing_Mode_Y.VDC_Power_Limit Racing_Mode.Racing_Mode_Y.VDC_SKF_Initial Racing_Mode.Racing_Mode_Y.Workshop_Mode_Enable /end REF_MEASUREMENT
/end GROUP
/begin GROUP Racing_Mode.Racing_Mode_P ""
 /begin REF_CHARACTERISTIC Racing_Mode.Racing_Mode_P.Apps_Sat_DwnSaturation_LowerSat Racing_Mode.Racing_Mode_P.Apps_Sat_DwnSaturation_UpperSat Racing_Mode.Racing_Mode_P.Apps_Sat_UpSaturation_LowerSat Racing_Mode.Racing_Mode_P.Apps_Sat_UpSaturation_UpperSat Racing_Mode.Racing_Mode_P.CEE_Apps_Sat_Dwn_Value Racing_Mode.Racing_Mode_P.CEE_Apps_Sat_Up_Value Racing_Mode.Racing_Mode_P.CEE_CKF_Initial_Value Racing_Mode.Racing_Mode_P.CEE_Cte_CKF_Value Racing_Mode.Racing_Mode_P.CEE_Cte_SKF_Value Racing_Mode.Racing_Mode_P.CEE_K_Reduction_P_Value Racing_Mode.Racing_Mode_P.CEE_K_Reduction_Temperature_Val Racing_Mode.Racing_Mode_P.CEE_Max_Regenerative_Torque_Val Racing_Mode.Racing_Mode_P.CEE_Power_Limit_Value Racing_Mode.Racing_Mode_P.CEE_SKF_Initial_Value Racing_Mode.Racing_Mode_P.CKF_InitialSaturation_LowerSat Racing_Mode.Racing_Mode_P.CKF_InitialSaturation_UpperSat Racing_Mode.Racing_Mode_P.CompareToConstant_const Racing_Mode.Racing_Mode_P.Cte_CKFSaturation_LowerSat Racing_Mode.Racing_Mode_P.Cte_CKFSaturation_UpperSat Racing_Mode.Racing_Mode_P.Cte_SKFSaturation_LowerSat Racing_Mode.Racing_Mode_P.Cte_SKFSaturation_UpperSat Racing_Mode.Racing_Mode_P.K_Reduction_PSaturation_LowerSa Racing_Mode.Racing_Mode_P.K_Reduction_PSaturation_UpperSa Racing_Mode.Racing_Mode_P.K_Reduction_TemperatureSatura_m Racing_Mode.Racing_Mode_P.K_Reduction_TemperatureSaturati Racing_Mode.Racing_Mode_P.Max_Regenerative_TorqueSatura_o Racing_Mode.Racing_Mode_P.Max_Regenerative_TorqueSaturati Racing_Mode.Racing_Mode_P.Merge_InitialOutput Racing_Mode.Racing_Mode_P.Power_LimitSaturation_LowerSat Racing_Mode.Racing_Mode_P.Power_LimitSaturation_UpperSat Racing_Mode.Racing_Mode_P.SKF_InitialSaturation_LowerSat Racing_Mode.Racing_Mode_P.SKF_InitialSaturation_UpperSat /end REF_CHARACTERISTIC
/end GROUP
/begin GROUP Synchronism "" ROOT
 /begin REF_MEASUREMENT Synchronism.Synchronism_DW.counter Synchronism.Synchronism_Y.Sync_CAN1 Synchronism.Synchronism_Y.Sync_CAN2 /end REF_MEASUREMENT
 /begin REF_CHARACTERISTIC Synchronism.Synchronism_P.Constant1_Value Synchronism.Synchronism_P.Constant_Value Synchronism.Synchronism_P.Constant_Value_e Synchronism.Synchronism_P.DataStoreMemory_InitialValue /end REF_CHARACTERISTIC
 /begin SUB_GROUP Synchronism.Synchronism_DW Synchronism.Synchronism_Y Synchronism.Synchronism_P /end SUB_GROUP
/end GROUP
/begin GROUP Synchronism.Synchronism_DW "" /begin REF_MEASUREMENT Synchronism.Synchronism_DW.counter /end REF_MEASUREMENT /end GROUP
/begin GROUP Synchronism.Synchronism_Y ""
 /begin REF_MEASUREMENT Synchronism.Synchronism_Y.Sync_CAN1 Synchronism.Synchronism_Y.Sync_CAN2 /end REF_MEASUREMENT
/end GROUP
/begin GROUP Synchronism.Synchronism_P ""
 /begin REF_CHARACTERISTIC Synchronism.Synchronism_P.Constant1_Value Synchronism.Synchronism_P.Constant_Value Synchronism.Synchronism_P.Constant_Value_e Synchronism.Synchronism_P.DataStoreMemory_InitialValue /end REF_CHARACTERISTIC
/end GROUP
/begin GROUP Torque_Control "" ROOT
 /begin REF_CHARACTERISTIC Torque_Control.Torque_Control_P.ANm_Gain Torque_Control.Torque_Control_P.ANm_Gain_b Torque_Control.Torque_Control_P.Accu_Temperature_Limitation_Fla Torque_Control.Torque_Control_P.CKF_act_Y0 Torque_Control.Torque_Control_P.CKF_act_Y0_j Torque_Control.Torque_Control_P.CompareToConstant1_const Torque_Control.Torque_Control_P.CompareToConstant_const Torque_Control.Torque_Control_P.CompareToConstant_const_p Torque_Control.Torque_Control_P.Constant14_Value Torque_Control.Torque_Control_P.Constant1_Value Torque_Control.Torque_Control_P.Constant1_Value_a Torque_Control.Torque_Control_P.Constant1_Value_ab Torque_Control.Torque_Control_P.Constant1_Value_b Torque_Control.Torque_Control_P.Constant1_Value_c Torque_Control.Torque_Control_P.Constant1_Value_e Torque_Control.Torque_Control_P.Constant1_Value_f Torque_Control.Torque_Control_P.Constant1_Value_fp Torque_Control.Torque_Control_P.Constant1_Value_l Torque_Control.Torque_Control_P.Constant1_Value_ln Torque_Control.Torque_Control_P.Constant1_Value_o Torque_Control.Torque_Control_P.Constant1_Value_p Torque_Control.Torque_Control_P.Constant1_Value_p2 Torque_Control.Torque_Control_P.Constant2_Value Torque_Control.Torque_Control_P.Constant2_Value_b Torque_Control.Torque_Control_P.Constant2_Value_d Torque_Control.Torque_Control_P.Constant2_Value_g Torque_Control.Torque_Control_P.Constant2_Value_g1 Torque_Control.Torque_Control_P.Constant2_Value_h Torque_Control.Torque_Control_P.Constant2_Value_hv Torque_Control.Torque_Control_P.Constant2_Value_m Torque_Control.Torque_Control_P.Constant2_Value_mw Torque_Control.Torque_Control_P.Constant3_Value Torque_Control.Torque_Control_P.Constant3_Value_c Torque_Control.Torque_Control_P.Constant3_Value_d Torque_Control.Torque_Control_P.Constant3_Value_e Torque_Control.Torque_Control_P.Constant3_Value_h Torque_Control.Torque_Control_P.Constant3_Value_i Torque_Control.Torque_Control_P.Constant3_Value_k Torque_Control.Torque_Control_P.Constant3_Value_n Torque_Control.Torque_Control_P.Constant3_Value_o Torque_Control.Torque_Control_P.Constant4_Value Torque_Control.Torque_Control_P.Constant4_Value_p Torque_Control.Torque_Control_P.Constant5_Value Torque_Control.Torque_Control_P.Constant6_Value Torque_Control.Torque_Control_P.Constant6_Value_p Torque_Control.Torque_Control_P.Constant7_Value Torque_Control.Torque_Control_P.Constant8_Value Torque_Control.Torque_Control_P.Constant_Value Torque_Control.Torque_Control_P.Constant_Value_a Torque_Control.Torque_Control_P.Constant_Value_ad Torque_Control.Torque_Control_P.Constant_Value_ae Torque_Control.Torque_Control_P.Constant_Value_b Torque_Control.Torque_Control_P.Constant_Value_d Torque_Control.Torque_Control_P.Constant_Value_dl Torque_Control.Torque_Control_P.Constant_Value_dm Torque_Control.Torque_Control_P.Constant_Value_f Torque_Control.Torque_Control_P.Constant_Value_f0 Torque_Control.Torque_Control_P.Constant_Value_h Torque_Control.Torque_Control_P.Constant_Value_i Torque_Control.Torque_Control_P.Constant_Value_ib Torque_Control.Torque_Control_P.Constant_Value_k Torque_Control.Torque_Control_P.Constant_Value_k4 Torque_Control.Torque_Control_P.Constant_Value_l Torque_Control.Torque_Control_P.Constant_Value_m Torque_Control.Torque_Control_P.Constant_Value_n Torque_Control.Torque_Control_P.Constant_Value_n5 Torque_Control.Torque_Control_P.Cornering_Stiffness_FN_Value Torque_Control.Torque_Control_P.Cornering_Stiffness_RN_Value Torque_Control.Torque_Control_P.DataStoreMemory10_InitialValue Torque_Control.Torque_Control_P.DataStoreMemory1_InitialValu_fl Torque_Control.Torque_Control_P.DataStoreMemory1_InitialValue Torque_Control.Torque_Control_P.DataStoreMemory1_InitialValue_f Torque_Control.Torque_Control_P.DataStoreMemory1_InitialValue_i Torque_Control.Torque_Control_P.DataStoreMemory1_InitialValue_m Torque_Control.Torque_Control_P.DataStoreMemory_InitialValue Torque_Control.Torque_Control_P.DataStoreMemory_InitialValue_c Torque_Control.Torque_Control_P.DataStoreMemory_InitialValue_m Torque_Control.Torque_Control_P.DiametertoRadius_Gain Torque_Control.Torque_Control_P.DiametertoRadius_Gain_h Torque_Control.Torque_Control_P.EffectiveRollingDiameterinch_Va Torque_Control.Torque_Control_P.EffectiveRollingDiameterinch__b Torque_Control.Torque_Control_P.Enabled_Value Torque_Control.Torque_Control_P.Flag_Accu_const Torque_Control.Torque_Control_P.Flag_Accu_const_h Torque_Control.Torque_Control_P.Flag_Inv_const Torque_Control.Torque_Control_P.Flag_Inv_const_e Torque_Control.Torque_Control_P.Flag_Mot_const Torque_Control.Torque_Control_P.Flag_Mot_const_n Torque_Control.Torque_Control_P.Flags_num5_Y0 Torque_Control.Torque_Control_P.Fy_RN0inf_Y0 Torque_Control.Torque_Control_P.Fyperwheel_Gain Torque_Control.Torque_Control_P.Fyperwheel_Gain_e Torque_Control.Torque_Control_P.Gain1_Gain Torque_Control.Torque_Control_P.Gain1_Gain_m Torque_Control.Torque_Control_P.Gain1_Gain_o Torque_Control.Torque_Control_P.Gain5_Gain Torque_Control.Torque_Control_P.Gain5_Gain_n Torque_Control.Torque_Control_P.Gain6_Gain Torque_Control.Torque_Control_P.Gain6_Gain_f Torque_Control.Torque_Control_P.Gain_Gain Torque_Control.Torque_Control_P.Gain_Gain_b Torque_Control.Torque_Control_P.Gain_Gain_c Torque_Control.Torque_Control_P.Gain_Gain_co Torque_Control.Torque_Control_P.Gain_Gain_cv Torque_Control.Torque_Control_P.Gain_Gain_f Torque_Control.Torque_Control_P.Gain_Gain_g Torque_Control.Torque_Control_P.Gain_Gain_k Torque_Control.Torque_Control_P.Gain_Gain_o Torque_Control.Torque_Control_P.GearRatio_Value Torque_Control.Torque_Control_P.Gravity1_Gain Torque_Control.Torque_Control_P.Gravity1_Gain_g Torque_Control.Torque_Control_P.Gravity_Gain Torque_Control.Torque_Control_P.Handlinginfinf_Y0 Torque_Control.Torque_Control_P.Integrator_IC Torque_Control.Torque_Control_P.Inverters_Temperature_Limitatio Torque_Control.Torque_Control_P.Lookup_SoC_SoP_chg_bp01Data Torque_Control.Torque_Control_P.Lookup_SoC_SoP_chg_bp01Data_b Torque_Control.Torque_Control_P.Lookup_SoC_SoP_chg_tableData Torque_Control.Torque_Control_P.Lookup_SoC_SoP_chg_tableData_p Torque_Control.Torque_Control_P.Lookup_SoC_SoP_dischg_bp01Dat_m Torque_Control.Torque_Control_P.Lookup_SoC_SoP_dischg_bp01Data Torque_Control.Torque_Control_P.Lookup_SoC_SoP_dischg_tableDa_g Torque_Control.Torque_Control_P.Lookup_SoC_SoP_dischg_tableData Torque_Control.Torque_Control_P.Lookup_Temp_SoP_chg_bp01Data Torque_Control.Torque_Control_P.Lookup_Temp_SoP_chg_bp01Data_i Torque_Control.Torque_Control_P.Lookup_Temp_SoP_chg_tableData Torque_Control.Torque_Control_P.Lookup_Temp_SoP_chg_tableData_m Torque_Control.Torque_Control_P.Masskg0inf_Y0 Torque_Control.Torque_Control_P.MaxFx_RLN0inf_Y0 Torque_Control.Torque_Control_P.MaxFx_RRN0inf_Y0 Torque_Control.Torque_Control_P.MaxTq_RLNm0inf_Y0 Torque_Control.Torque_Control_P.MaxTq_RLNm0inf_Y0_d Torque_Control.Torque_Control_P.MaxTq_RRNm0inf_Y0 Torque_Control.Torque_Control_P.MaxTq_RRNm0inf_Y0_o Torque_Control.Torque_Control_P.MaxTqpermotorNm_Value Torque_Control.Torque_Control_P.Max_Power_chargekW_Value Torque_Control.Torque_Control_P.Max_Power_dischargekW_Value Torque_Control.Torque_Control_P.Max_Tq_per_motor_Value Torque_Control.Torque_Control_P.MaximumTorqueperengineNm_Value Torque_Control.Torque_Control_P.MaximumTorquepermotorNm_Value Torque_Control.Torque_Control_P.MaximumTransmissionTorqueDyna_a Torque_Control.Torque_Control_P.MaximumTransmissionTorqueDynami Torque_Control.Torque_Control_P.MaximumTransmissionTorqueStat_n Torque_Control.Torque_Control_P.MaximumTransmissionTorqueStatic Torque_Control.Torque_Control_P.Merge1_InitialOutput Torque_Control.Torque_Control_P.Merge1_InitialOutput_e Torque_Control.Torque_Control_P.Merge1_InitialOutput_k Torque_Control.Torque_Control_P.Merge2_InitialOutput Torque_Control.Torque_Control_P.Merge2_InitialOutput_o Torque_Control.Torque_Control_P.Merge3_InitialOutput Torque_Control.Torque_Control_P.Merge3_InitialOutput_n Torque_Control.Torque_Control_P.Merge4_InitialOutput Torque_Control.Torque_Control_P.Merge5_InitialOutput Torque_Control.Torque_Control_P.Merge6_InitialOutput Torque_Control.Torque_Control_P.Merge7_InitialOutput Torque_Control.Torque_Control_P.MergeTq_RL_InitialOutput Torque_Control.Torque_Control_P.MergeTq_RR_InitialOutput Torque_Control.Torque_Control_P.Merge_InitialOutput Torque_Control.Torque_Control_P.Merge_InitialOutput_a Torque_Control.Torque_Control_P.Merge_InitialOutput_e Torque_Control.Torque_Control_P.Merge_InitialOutput_h Torque_Control.Torque_Control_P.Merge_InitialOutput_i Torque_Control.Torque_Control_P.Merge_InitialOutput_j Torque_Control.Torque_Control_P.Merge_InitialOutput_l Torque_Control.Torque_Control_P.Merge_InitialOutput_p /end REF_CHARACTERISTIC
 /begin SUB_GROUP Torque_Control.Torque_Control_B Torque_Control.Torque_Control_B.BrakingwithRegenerative Torque_Control.Torque_Control_B.BrakingwithRegenerative.sf_MATLABFunction Torque_Control.Torque_Control_B.BrakingwithRegenerative_b Torque_Control.Torque_Control_B.BrakingwithRegenerative_b.sf_MATLABFunction Torque_Control.Torque_Control_B.sf_Acceleratorbehaviour Torque_Control.Torque_Control_B.sf_Acceleratorbehaviour_b Torque_Control.Torque_Control_B.sf_Acceleratorbehaviour_br Torque_Control.Torque_Control_B.sf_Acceleratorbehaviour_o Torque_Control.Torque_Control_B.sf_MATLABFunction1_b Torque_Control.Torque_Control_B.sf_MATLABFunction1_f Torque_Control.Torque_Control_B.sf_MATLABFunction1_g Torque_Control.Torque_Control_B.sf_MATLABFunction1_gm Torque_Control.Torque_Control_B.sf_MATLABFunction1_h Torque_Control.Torque_Control_B.sf_MATLABFunction1_m Torque_Control.Torque_Control_B.sf_MATLABFunction1_mk Torque_Control.Torque_Control_B.sf_MATLABFunction1_ny Torque_Control.Torque_Control_B.sf_MATLABFunction2 Torque_Control.Torque_Control_B.sf_MATLABFunction2_b Torque_Control.Torque_Control_B.sf_MATLABFunction2_e Torque_Control.Torque_Control_B.sf_MATLABFunction2_l Torque_Control.Torque_Control_B.sf_MATLABFunction2_m Torque_Control.Torque_Control_B.sf_MATLABFunction_a Torque_Control.Torque_Control_B.sf_MATLABFunction_ab Torque_Control.Torque_Control_B.sf_MATLABFunction_d Torque_Control.Torque_Control_B.sf_MATLABFunction_e Torque_Control.Torque_Control_B.sf_MATLABFunction_fa Torque_Control.Torque_Control_B.sf_MATLABFunction_fq Torque_Control.Torque_Control_B.sf_MATLABFunction_i1 Torque_Control.Torque_Control_B.sf_MATLABFunction_k2 Torque_Control.Torque_Control_B.sf_MATLABFunction_mt Torque_Control.Torque_Control_B.sf_MATLABFunction_n Torque_Control.Torque_Control_DW Torque_Control.Torque_Control_U Torque_Control.Torque_Control_Y Torque_Control.Torque_Control_P /end SUB_GROUP
/end GROUP
/begin GROUP Torque_Control.Torque_Control_P ""
 /begin REF_CHARACTERISTIC Torque_Control.Torque_Control_P.ANm_Gain Torque_Control.Torque_Control_P.ANm_Gain_b Torque_Control.Torque_Control_P.Accu_Temperature_Limitation_Fla Torque_Control.Torque_Control_P.CKF_act_Y0 Torque_Control.Torque_Control_P.CKF_act_Y0_j Torque_Control.Torque_Control_P.CompareToConstant1_const Torque_Control.Torque_Control_P.CompareToConstant_const Torque_Control.Torque_Control_P.CompareToConstant_const_p Torque_Control.Torque_Control_P.Constant14_Value Torque_Control.Torque_Control_P.Constant1_Value Torque_Control.Torque_Control_P.Constant1_Value_a Torque_Control.Torque_Control_P.Constant1_Value_ab Torque_Control.Torque_Control_P.Constant1_Value_b Torque_Control.Torque_Control_P.Constant1_Value_c Torque_Control.Torque_Control_P.Constant1_Value_e Torque_Control.Torque_Control_P.Constant1_Value_f Torque_Control.Torque_Control_P.Constant1_Value_fp Torque_Control.Torque_Control_P.Constant1_Value_l Torque_Control.Torque_Control_P.Constant1_Value_ln Torque_Control.Torque_Control_P.Constant1_Value_o Torque_Control.Torque_Control_P.Constant1_Value_p Torque_Control.Torque_Control_P.Constant1_Value_p2 Torque_Control.Torque_Control_P.Constant2_Value Torque_Control.Torque_Control_P.Constant2_Value_b Torque_Control.Torque_Control_P.Constant2_Value_d Torque_Control.Torque_Control_P.Constant2_Value_g Torque_Control.Torque_Control_P.Constant2_Value_g1 Torque_Control.Torque_Control_P.Constant2_Value_h Torque_Control.Torque_Control_P.Constant2_Value_hv Torque_Control.Torque_Control_P.Constant2_Value_m Torque_Control.Torque_Control_P.Constant2_Value_mw Torque_Control.Torque_Control_P.Constant3_Value Torque_Control.Torque_Control_P.Constant3_Value_c Torque_Control.Torque_Control_P.Constant3_Value_d Torque_Control.Torque_Control_P.Constant3_Value_e Torque_Control.Torque_Control_P.Constant3_Value_h Torque_Control.Torque_Control_P.Constant3_Value_i Torque_Control.Torque_Control_P.Constant3_Value_k Torque_Control.Torque_Control_P.Constant3_Value_n Torque_Control.Torque_Control_P.Constant3_Value_o Torque_Control.Torque_Control_P.Constant4_Value Torque_Control.Torque_Control_P.Constant4_Value_p Torque_Control.Torque_Control_P.Constant5_Value Torque_Control.Torque_Control_P.Constant6_Value Torque_Control.Torque_Control_P.Constant6_Value_p Torque_Control.Torque_Control_P.Constant7_Value Torque_Control.Torque_Control_P.Constant8_Value Torque_Control.Torque_Control_P.Constant_Value Torque_Control.Torque_Control_P.Constant_Value_a Torque_Control.Torque_Control_P.Constant_Value_ad Torque_Control.Torque_Control_P.Constant_Value_ae Torque_Control.Torque_Control_P.Constant_Value_b Torque_Control.Torque_Control_P.Constant_Value_d Torque_Control.Torque_Control_P.Constant_Value_dl Torque_Control.Torque_Control_P.Constant_Value_dm Torque_Control.Torque_Control_P.Constant_Value_f Torque_Control.Torque_Control_P.Constant_Value_f0 Torque_Control.Torque_Control_P.Constant_Value_h Torque_Control.Torque_Control_P.Constant_Value_i Torque_Control.Torque_Control_P.Constant_Value_ib Torque_Control.Torque_Control_P.Constant_Value_k Torque_Control.Torque_Control_P.Constant_Value_k4 Torque_Control.Torque_Control_P.Constant_Value_l Torque_Control.Torque_Control_P.Constant_Value_m Torque_Control.Torque_Control_P.Constant_Value_n Torque_Control.Torque_Control_P.Constant_Value_n5 Torque_Control.Torque_Control_P.Cornering_Stiffness_FN_Value Torque_Control.Torque_Control_P.Cornering_Stiffness_RN_Value Torque_Control.Torque_Control_P.DataStoreMemory10_InitialValue Torque_Control.Torque_Control_P.DataStoreMemory1_InitialValu_fl Torque_Control.Torque_Control_P.DataStoreMemory1_InitialValue Torque_Control.Torque_Control_P.DataStoreMemory1_InitialValue_f Torque_Control.Torque_Control_P.DataStoreMemory1_InitialValue_i Torque_Control.Torque_Control_P.DataStoreMemory1_InitialValue_m Torque_Control.Torque_Control_P.DataStoreMemory_InitialValue Torque_Control.Torque_Control_P.DataStoreMemory_InitialValue_c Torque_Control.Torque_Control_P.DataStoreMemory_InitialValue_m Torque_Control.Torque_Control_P.DiametertoRadius_Gain Torque_Control.Torque_Control_P.DiametertoRadius_Gain_h Torque_Control.Torque_Control_P.EffectiveRollingDiameterinch_Va Torque_Control.Torque_Control_P.EffectiveRollingDiameterinch__b Torque_Control.Torque_Control_P.Enabled_Value Torque_Control.Torque_Control_P.Flag_Accu_const Torque_Control.Torque_Control_P.Flag_Accu_const_h Torque_Control.Torque_Control_P.Flag_Inv_const Torque_Control.Torque_Control_P.Flag_Inv_const_e Torque_Control.Torque_Control_P.Flag_Mot_const Torque_Control.Torque_Control_P.Flag_Mot_const_n Torque_Control.Torque_Control_P.Flags_num5_Y0 Torque_Control.Torque_Control_P.Fy_RN0inf_Y0 Torque_Control.Torque_Control_P.Fyperwheel_Gain Torque_Control.Torque_Control_P.Fyperwheel_Gain_e Torque_Control.Torque_Control_P.Gain1_Gain Torque_Control.Torque_Control_P.Gain1_Gain_m Torque_Control.Torque_Control_P.Gain1_Gain_o Torque_Control.Torque_Control_P.Gain5_Gain Torque_Control.Torque_Control_P.Gain5_Gain_n Torque_Control.Torque_Control_P.Gain6_Gain Torque_Control.Torque_Control_P.Gain6_Gain_f Torque_Control.Torque_Control_P.Gain_Gain Torque_Control.Torque_Control_P.Gain_Gain_b Torque_Control.Torque_Control_P.Gain_Gain_c Torque_Control.Torque_Control_P.Gain_Gain_co Torque_Control.Torque_Control_P.Gain_Gain_cv Torque_Control.Torque_Control_P.Gain_Gain_f Torque_Control.Torque_Control_P.Gain_Gain_g Torque_Control.Torque_Control_P.Gain_Gain_k Torque_Control.Torque_Control_P.Gain_Gain_o Torque_Control.Torque_Control_P.GearRatio_Value Torque_Control.Torque_Control_P.Gravity1_Gain Torque_Control.Torque_Control_P.Gravity1_Gain_g Torque_Control.Torque_Control_P.Gravity_Gain Torque_Control.Torque_Control_P.Handlinginfinf_Y0 Torque_Control.Torque_Control_P.Integrator_IC Torque_Control.Torque_Control_P.Inverters_Temperature_Limitatio Torque_Control.Torque_Control_P.Lookup_SoC_SoP_chg_bp01Data Torque_Control.Torque_Control_P.Lookup_SoC_SoP_chg_bp01Data_b Torque_Control.Torque_Control_P.Lookup_SoC_SoP_chg_tableData Torque_Control.Torque_Control_P.Lookup_SoC_SoP_chg_tableData_p Torque_Control.Torque_Control_P.Lookup_SoC_SoP_dischg_bp01Dat_m Torque_Control.Torque_Control_P.Lookup_SoC_SoP_dischg_bp01Data Torque_Control.Torque_Control_P.Lookup_SoC_SoP_dischg_tableDa_g Torque_Control.Torque_Control_P.Lookup_SoC_SoP_dischg_tableData Torque_Control.Torque_Control_P.Lookup_Temp_SoP_chg_bp01Data Torque_Control.Torque_Control_P.Lookup_Temp_SoP_chg_bp01Data_i Torque_Control.Torque_Control_P.Lookup_Temp_SoP_chg_tableData Torque_Control.Torque_Control_P.Lookup_Temp_SoP_chg_tableData_m Torque_Control.Torque_Control_P.Masskg0inf_Y0 Torque_Control.Torque_Control_P.MaxFx_RLN0inf_Y0 Torque_Control.Torque_Control_P.MaxFx_RRN0inf_Y0 Torque_Control.Torque_Control_P.MaxTq_RLNm0inf_Y0 Torque_Control.Torque_Control_P.MaxTq_RLNm0inf_Y0_d Torque_Control.Torque_Control_P.MaxTq_RRNm0inf_Y0 Torque_Control.Torque_Control_P.MaxTq_RRNm0inf_Y0_o Torque_Control.Torque_Control_P.MaxTqpermotorNm_Value Torque_Control.Torque_Control_P.Max_Power_chargekW_Value Torque_Control.Torque_Control_P.Max_Power_dischargekW_Value Torque_Control.Torque_Control_P.Max_Tq_per_motor_Value Torque_Control.Torque_Control_P.MaximumTorqueperengineNm_Value Torque_Control.Torque_Control_P.MaximumTorquepermotorNm_Value Torque_Control.Torque_Control_P.MaximumTransmissionTorqueDyna_a Torque_Control.Torque_Control_P.MaximumTransmissionTorqueDynami Torque_Control.Torque_Control_P.MaximumTransmissionTorqueStat_n Torque_Control.Torque_Control_P.MaximumTransmissionTorqueStatic Torque_Control.Torque_Control_P.Merge1_InitialOutput Torque_Control.Torque_Control_P.Merge1_InitialOutput_e Torque_Control.Torque_Control_P.Merge1_InitialOutput_k Torque_Control.Torque_Control_P.Merge2_InitialOutput Torque_Control.Torque_Control_P.Merge2_InitialOutput_o Torque_Control.Torque_Control_P.Merge3_InitialOutput Torque_Control.Torque_Control_P.Merge3_InitialOutput_n Torque_Control.Torque_Control_P.Merge4_InitialOutput Torque_Control.Torque_Control_P.Merge5_InitialOutput Torque_Control.Torque_Control_P.Merge6_InitialOutput Torque_Control.Torque_Control_P.Merge7_InitialOutput Torque_Control.Torque_Control_P.MergeTq_RL_InitialOutput Torque_Control.Torque_Control_P.MergeTq_RR_InitialOutput Torque_Control.Torque_Control_P.Merge_InitialOutput Torque_Control.Torque_Control_P.Merge_InitialOutput_a Torque_Control.Torque_Control_P.Merge_InitialOutput_e Torque_Control.Torque_Control_P.Merge_InitialOutput_h Torque_Control.Torque_Control_P.Merge_InitialOutput_i Torque_Control.Torque_Control_P.Merge_InitialOutput_j Torque_Control.Torque_Control_P.Merge_InitialOutput_l Torque_Control.Torque_Control_P.Merge_InitialOutput_p /end REF_CHARACTERISTIC
/end GROUP
/end MODULE
/* INTECRIO_MERGED */
/end PROJECT
/* ETAS */
