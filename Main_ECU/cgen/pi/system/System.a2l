ASAP2_VERSION 1 41
/begin PROJECT ETAS "Generated by ETAS from INTECRIO V4.7.0.1005 integration project"
/begin HEADER "" VERSION "" PROJECT_NO Y /end HEADER
/begin MODULE INTECRIO_MERGED "Generated by ETAS INTECRIO V4.7.0.1005 for M/C interface ETARGET"
/begin MOD_COMMON "Common definitions" BYTE_ORDER MSB_FIRST ALIGNMENT_BYTE 1 ALIGNMENT_WORD 2 ALIGNMENT_LONG 4 ALIGNMENT_FLOAT32_IEEE 4 ALIGNMENT_FLOAT64_IEEE 8 /end MOD_COMMON
/begin MEASUREMENT Car_State.Car_State_B.Merge "" FLOAT64_IEEE Car_State_CM_double 0 0 -1.7e+308 1.7e+308 ECU_ADDRESS 0x0 DISPLAY_IDENTIFIER Car_State.AIRS_Request.Merge.Merge /end MEASUREMENT
/begin MEASUREMENT Car_State.Car_State_DW.A "" FLOAT64_IEEE Car_State_CM_double 0 0 -1.7e+308 1.7e+308 ECU_ADDRESS 0x0 DISPLAY_IDENTIFIER Car_State.CurrentPathDisconnection_Detection.Data_Store_Memory.A /end MEASUREMENT
/begin MEASUREMENT Car_State.Car_State_U.AIRs_State "" FLOAT64_IEEE Car_State_CM_double 0 0 -1.7e+308 1.7e+308 ECU_ADDRESS 0x0 DISPLAY_IDENTIFIER Car_State.AIRs_State /end MEASUREMENT
/begin MEASUREMENT Car_State.Car_State_U.Accumulator_Voltage "" FLOAT64_IEEE Car_State_CM_double 0 0 -1.7e+308 1.7e+308 ECU_ADDRESS 0x0 DISPLAY_IDENTIFIER Car_State.Accumulator_Voltage /end MEASUREMENT
/begin MEASUREMENT Car_State.Car_State_U.BMSerror_CANDisconnection "" FLOAT64_IEEE Car_State_CM_double 0 0 -1.7e+308 1.7e+308 ECU_ADDRESS 0x0 DISPLAY_IDENTIFIER Car_State.BMSerror_CANDisconnection /end MEASUREMENT
/begin MEASUREMENT Car_State.Car_State_U.BMSerror_CurrentSensDisc "" FLOAT64_IEEE Car_State_CM_double 0 0 -1.7e+308 1.7e+308 ECU_ADDRESS 0x0 DISPLAY_IDENTIFIER Car_State.BMSerror_CurrentSensDisc /end MEASUREMENT
/begin MEASUREMENT Car_State.Car_State_U.BMSerror_NTCDisconnection "" FLOAT64_IEEE Car_State_CM_double 0 0 -1.7e+308 1.7e+308 ECU_ADDRESS 0x0 DISPLAY_IDENTIFIER Car_State.BMSerror_NTCDisconnection /end MEASUREMENT
/begin MEASUREMENT Car_State.Car_State_U.BMSerror_OverTemperature "" FLOAT64_IEEE Car_State_CM_double 0 0 -1.7e+308 1.7e+308 ECU_ADDRESS 0x0 DISPLAY_IDENTIFIER Car_State.BMSerror_OverTemperature /end MEASUREMENT
/begin MEASUREMENT Car_State.Car_State_U.BMSerror_OverVoltage "" FLOAT64_IEEE Car_State_CM_double 0 0 -1.7e+308 1.7e+308 ECU_ADDRESS 0x0 DISPLAY_IDENTIFIER Car_State.BMSerror_OverVoltage /end MEASUREMENT
/begin MEASUREMENT Car_State.Car_State_U.BMSerror_UnderTemperature "" FLOAT64_IEEE Car_State_CM_double 0 0 -1.7e+308 1.7e+308 ECU_ADDRESS 0x0 DISPLAY_IDENTIFIER Car_State.BMSerror_UnderTemperature /end MEASUREMENT
/begin MEASUREMENT Car_State.Car_State_U.BMSerror_UnderVoltage "" FLOAT64_IEEE Car_State_CM_double 0 0 -1.7e+308 1.7e+308 ECU_ADDRESS 0x0 DISPLAY_IDENTIFIER Car_State.BMSerror_UnderVoltage /end MEASUREMENT
/begin MEASUREMENT Car_State.Car_State_U.Critical_CAN_Disconnection "" FLOAT64_IEEE Car_State_CM_double 0 0 -1.7e+308 1.7e+308 ECU_ADDRESS 0x0 DISPLAY_IDENTIFIER Car_State.Critical_CAN_Disconnection /end MEASUREMENT
/begin MEASUREMENT Car_State.Car_State_U.DashPrechargeRequest "" FLOAT64_IEEE Car_State_CM_double 0 0 -1.7e+308 1.7e+308 ECU_ADDRESS 0x0 DISPLAY_IDENTIFIER Car_State.PrechargeRequest /end MEASUREMENT
/begin MEASUREMENT Car_State.Car_State_U.EnableDrive "" FLOAT64_IEEE Car_State_CM_double 0 0 -1.7e+308 1.7e+308 ECU_ADDRESS 0x0 DISPLAY_IDENTIFIER Car_State.EnableDrive_Order /end MEASUREMENT
/begin MEASUREMENT Car_State.Car_State_U.InvertersMinDCBus "" FLOAT64_IEEE Car_State_CM_double 0 0 -1.7e+308 1.7e+308 ECU_ADDRESS 0x0 DISPLAY_IDENTIFIER Car_State.InvertersMinDCBus /end MEASUREMENT
/begin MEASUREMENT Car_State.Car_State_U.InvertersSubscribed "" FLOAT64_IEEE Car_State_CM_double 0 0 -1.7e+308 1.7e+308 ECU_ADDRESS 0x0 DISPLAY_IDENTIFIER Car_State.InvertersSubscribed /end MEASUREMENT
/begin MEASUREMENT Car_State.Car_State_U.Lock "" FLOAT64_IEEE Car_State_CM_double 0 0 -1.7e+308 1.7e+308 ECU_ADDRESS 0x0 DISPLAY_IDENTIFIER Car_State.Torque_LockON /end MEASUREMENT
/begin MEASUREMENT Car_State.Car_State_U.Shutdown_BMS "" FLOAT64_IEEE Car_State_CM_double 0 0 -1.7e+308 1.7e+308 ECU_ADDRESS 0x0 DISPLAY_IDENTIFIER Car_State.Shutdown_BMS /end MEASUREMENT
/begin MEASUREMENT Car_State.Car_State_U.Shutdown_BOTS "" FLOAT64_IEEE Car_State_CM_double 0 0 -1.7e+308 1.7e+308 ECU_ADDRESS 0x0 DISPLAY_IDENTIFIER Car_State.Shutdown_BOTS /end MEASUREMENT
/begin MEASUREMENT Car_State.Car_State_U.Shutdown_BSPD "" FLOAT64_IEEE Car_State_CM_double 0 0 -1.7e+308 1.7e+308 ECU_ADDRESS 0x0 DISPLAY_IDENTIFIER Car_State.Shutdown_BSPD /end MEASUREMENT
/begin MEASUREMENT Car_State.Car_State_U.Shutdown_HVBOX "" FLOAT64_IEEE Car_State_CM_double 0 0 -1.7e+308 1.7e+308 ECU_ADDRESS 0x0 DISPLAY_IDENTIFIER Car_State.Shutdown_HVBOX /end MEASUREMENT
/begin MEASUREMENT Car_State.Car_State_U.Shutdown_HVD "" FLOAT64_IEEE Car_State_CM_double 0 0 -1.7e+308 1.7e+308 ECU_ADDRESS 0x0 DISPLAY_IDENTIFIER Car_State.Shutdown_HVD /end MEASUREMENT
/begin MEASUREMENT Car_State.Car_State_U.Shutdown_Inertia "" FLOAT64_IEEE Car_State_CM_double 0 0 -1.7e+308 1.7e+308 ECU_ADDRESS 0x0 DISPLAY_IDENTIFIER Car_State.Shutdown_Inertia /end MEASUREMENT
/begin MEASUREMENT Car_State.Car_State_U.Shutdown_InverterLIntck "" FLOAT64_IEEE Car_State_CM_double 0 0 -1.7e+308 1.7e+308 ECU_ADDRESS 0x0 DISPLAY_IDENTIFIER Car_State.Shutdown_InverterLIntck /end MEASUREMENT
/begin MEASUREMENT Car_State.Car_State_U.Shutdown_InverterRIntck "" FLOAT64_IEEE Car_State_CM_double 0 0 -1.7e+308 1.7e+308 ECU_ADDRESS 0x0 DISPLAY_IDENTIFIER Car_State.Shutdown_InverterRIntck /end MEASUREMENT
/begin MEASUREMENT Car_State.Car_State_U.Shutdown_PackageIntck "" FLOAT64_IEEE Car_State_CM_double 0 0 -1.7e+308 1.7e+308 ECU_ADDRESS 0x0 DISPLAY_IDENTIFIER Car_State.Shutdown_PackageIntck /end MEASUREMENT
/begin MEASUREMENT Car_State.Car_State_U.Shutdown_SetaCockpit "" FLOAT64_IEEE Car_State_CM_double 0 0 -1.7e+308 1.7e+308 ECU_ADDRESS 0x0 DISPLAY_IDENTIFIER Car_State.Shutdown_SetaCockpit /end MEASUREMENT
/begin MEASUREMENT Car_State.Car_State_U.Shutdown_SetaLeft "" FLOAT64_IEEE Car_State_CM_double 0 0 -1.7e+308 1.7e+308 ECU_ADDRESS 0x0 DISPLAY_IDENTIFIER Car_State.Shutdown_SetaLeft /end MEASUREMENT
/begin MEASUREMENT Car_State.Car_State_U.Shutdown_SetaRight "" FLOAT64_IEEE Car_State_CM_double 0 0 -1.7e+308 1.7e+308 ECU_ADDRESS 0x0 DISPLAY_IDENTIFIER Car_State.Shutdown_SetaRight /end MEASUREMENT
/begin MEASUREMENT Car_State.Car_State_U.Shutdown_TSMPIntck "" FLOAT64_IEEE Car_State_CM_double 0 0 -1.7e+308 1.7e+308 ECU_ADDRESS 0x0 DISPLAY_IDENTIFIER Car_State.Shutdown_TSMPIntck /end MEASUREMENT
/begin MEASUREMENT Car_State.Car_State_U.Shutdown_TSMS "" FLOAT64_IEEE Car_State_CM_double 0 0 -1.7e+308 1.7e+308 ECU_ADDRESS 0x0 DISPLAY_IDENTIFIER Car_State.Shutdown_TSMS /end MEASUREMENT
/begin MEASUREMENT Car_State.Car_State_Y.AIRs_Request "" FLOAT64_IEEE Car_State_CM_double 0 0 -1.7e+308 1.7e+308 ECU_ADDRESS 0x0 DISPLAY_IDENTIFIER Car_State.AIRs_Request /end MEASUREMENT
/begin MEASUREMENT Car_State.Car_State_Y.Car_OK "" UBYTE Car_State_CM_boolean 0 0 0 1 ECU_ADDRESS 0x0 DISPLAY_IDENTIFIER Car_State.Car_OK /end MEASUREMENT
/begin MEASUREMENT Car_State.Car_State_Y.Car_State_f "" FLOAT64_IEEE Car_State_CM_double 0 0 -1.7e+308 1.7e+308 ECU_ADDRESS 0x0 DISPLAY_IDENTIFIER Car_State.Car_State /end MEASUREMENT
/begin MEASUREMENT Car_State.Car_State_Y.CurrentPathDisconnectionFlag "" FLOAT64_IEEE Car_State_CM_double 0 0 -1.7e+308 1.7e+308 ECU_ADDRESS 0x0 DISPLAY_IDENTIFIER Car_State.CurrentPathDisconnectionFlag /end MEASUREMENT
/begin MEASUREMENT Car_State.Car_State_Y.InvertersAction "" FLOAT64_IEEE Car_State_CM_double 0 0 -1.7e+308 1.7e+308 ECU_ADDRESS 0x0 DISPLAY_IDENTIFIER Car_State.InvertersAction /end MEASUREMENT
/begin MEASUREMENT Car_State.Car_State_Y.PrechargeAssert "" FLOAT64_IEEE Car_State_CM_double 0 0 -1.7e+308 1.7e+308 ECU_ADDRESS 0x0 DISPLAY_IDENTIFIER Car_State.PrechargeAssert /end MEASUREMENT
/begin MEASUREMENT Car_State.Car_State_Y.Precharge_Percentage "" FLOAT64_IEEE Car_State_CM_double 0 0 -1.7e+308 1.7e+308 ECU_ADDRESS 0x0 DISPLAY_IDENTIFIER Car_State.Precharge_Percentage /end MEASUREMENT
/begin MEASUREMENT Car_State.Car_State_Y.Precharge_Voltage "" FLOAT64_IEEE Car_State_CM_double 0 0 -1.7e+308 1.7e+308 ECU_ADDRESS 0x0 DISPLAY_IDENTIFIER Car_State.Precharge_Voltage /end MEASUREMENT
/begin MEASUREMENT Car_State.Car_State_Y.ShutdownClosed "" FLOAT64_IEEE Car_State_CM_double 0 0 -1.7e+308 1.7e+308 ECU_ADDRESS 0x0 DISPLAY_IDENTIFIER Car_State.ShutdownClosed /end MEASUREMENT
/begin MEASUREMENT Car_State.Car_State_Y.TorqueEnable "" FLOAT64_IEEE Car_State_CM_double 0 0 -1.7e+308 1.7e+308 ECU_ADDRESS 0x0 DISPLAY_IDENTIFIER Car_State.TorqueEnable /end MEASUREMENT
/begin MEASUREMENT Car_State.Car_State_Y.errors "" FLOAT64_IEEE Car_State_CM_double 0 0 -1.7e+308 1.7e+308 ECU_ADDRESS 0x0 DISPLAY_IDENTIFIER Car_State.errors /end MEASUREMENT
/begin MEASUREMENT Disconnections.Disconnections_B.Merge "" FLOAT64_IEEE Disconnections_CM_double 0 0 -1.7e+308 1.7e+308 ECU_ADDRESS 0x0 DISPLAY_IDENTIFIER Disconnections.ECU_Disconections.LifeCheck_BMS.Merge.Merge /end MEASUREMENT
/begin MEASUREMENT Disconnections.Disconnections_B.Merge_b "" FLOAT64_IEEE Disconnections_CM_double 0 0 -1.7e+308 1.7e+308 ECU_ADDRESS 0x0 DISPLAY_IDENTIFIER Disconnections.ECU_Disconections.LifeCheck_AccFront.Merge.Merge_b /end MEASUREMENT
/begin MEASUREMENT Disconnections.Disconnections_B.Merge_d "" FLOAT64_IEEE Disconnections_CM_double 0 0 -1.7e+308 1.7e+308 ECU_ADDRESS 0x0 DISPLAY_IDENTIFIER Disconnections.ECU_Disconections.LifeCheck_AccRear.Merge.Merge_d /end MEASUREMENT
/begin MEASUREMENT Disconnections.Disconnections_B.Merge_f "" FLOAT64_IEEE Disconnections_CM_double 0 0 -1.7e+308 1.7e+308 ECU_ADDRESS 0x0 DISPLAY_IDENTIFIER Disconnections.ECU_Disconections.Life_check4.Merge.Merge_f /end MEASUREMENT
/begin MEASUREMENT Disconnections.Disconnections_B.Merge_h "" FLOAT64_IEEE Disconnections_CM_double 0 0 -1.7e+308 1.7e+308 ECU_ADDRESS 0x0 DISPLAY_IDENTIFIER Disconnections.ECU_Disconections.LifeCheck_Dash.Merge.Merge_h /end MEASUREMENT
/begin MEASUREMENT Disconnections.Disconnections_B.Merge_he "" FLOAT64_IEEE Disconnections_CM_double 0 0 -1.7e+308 1.7e+308 ECU_ADDRESS 0x0 DISPLAY_IDENTIFIER Disconnections.ECU_Disconections.LifeCheck_ADCAN.Merge.Merge_he /end MEASUREMENT
/begin MEASUREMENT Disconnections.Disconnections_B.Merge_j "" FLOAT64_IEEE Disconnections_CM_double 0 0 -1.7e+308 1.7e+308 ECU_ADDRESS 0x0 DISPLAY_IDENTIFIER Disconnections.ECU_Disconections.LifeCheck_Shutdown.Merge.Merge_j /end MEASUREMENT
/begin MEASUREMENT Disconnections.Disconnections_DW.A "" FLOAT64_IEEE Disconnections_CM_double 0 0 -1.7e+308 1.7e+308 ECU_ADDRESS 0x0 DISPLAY_IDENTIFIER Disconnections.Counter.Data_Store_Memory.A /end MEASUREMENT
/begin MEASUREMENT Disconnections.Disconnections_DW.Last_alive "" FLOAT64_IEEE Disconnections_CM_double 0 0 -1.7e+308 1.7e+308 ECU_ADDRESS 0x0 DISPLAY_IDENTIFIER Disconnections.Pedal_Box_Disconnections__Noise_.Life_check3.Data_Store_Memory.Last_alive /end MEASUREMENT
/begin MEASUREMENT Disconnections.Disconnections_DW.Last_alive_a "" FLOAT64_IEEE Disconnections_CM_double 0 0 -1.7e+308 1.7e+308 ECU_ADDRESS 0x0 DISPLAY_IDENTIFIER Disconnections.ECU_Disconections.LifeCheck_AccFront.Data_Store_Memory.Last_alive_a /end MEASUREMENT
/begin MEASUREMENT Disconnections.Disconnections_DW.Last_alive_ar "" FLOAT64_IEEE Disconnections_CM_double 0 0 -1.7e+308 1.7e+308 ECU_ADDRESS 0x0 DISPLAY_IDENTIFIER Disconnections.ECU_Disconections.LifeCheck_ADCAN.Data_Store_Memory.Last_alive_ar /end MEASUREMENT
/begin MEASUREMENT Disconnections.Disconnections_DW.Last_alive_c "" FLOAT64_IEEE Disconnections_CM_double 0 0 -1.7e+308 1.7e+308 ECU_ADDRESS 0x0 DISPLAY_IDENTIFIER Disconnections.Pedal_Box_Disconnections__Noise_.Life_check2.Data_Store_Memory.Last_alive_c /end MEASUREMENT
/begin MEASUREMENT Disconnections.Disconnections_DW.Last_alive_c0 "" FLOAT64_IEEE Disconnections_CM_double 0 0 -1.7e+308 1.7e+308 ECU_ADDRESS 0x0 DISPLAY_IDENTIFIER Disconnections.ECU_Disconections.LifeCheck_BMS.Data_Store_Memory.Last_alive_c0 /end MEASUREMENT
/begin MEASUREMENT Disconnections.Disconnections_DW.Last_alive_g "" FLOAT64_IEEE Disconnections_CM_double 0 0 -1.7e+308 1.7e+308 ECU_ADDRESS 0x0 DISPLAY_IDENTIFIER Disconnections.Pedal_Box_Disconnections__Noise_.Life_check1.Data_Store_Memory.Last_alive_g /end MEASUREMENT
/begin MEASUREMENT Disconnections.Disconnections_DW.Last_alive_gx "" FLOAT64_IEEE Disconnections_CM_double 0 0 -1.7e+308 1.7e+308 ECU_ADDRESS 0x0 DISPLAY_IDENTIFIER Disconnections.ECU_Disconections.LifeCheck_AccRear.Data_Store_Memory.Last_alive_gx /end MEASUREMENT
/begin MEASUREMENT Disconnections.Disconnections_DW.Last_alive_j "" FLOAT64_IEEE Disconnections_CM_double 0 0 -1.7e+308 1.7e+308 ECU_ADDRESS 0x0 DISPLAY_IDENTIFIER Disconnections.ECU_Disconections.LifeCheck_Shutdown.Data_Store_Memory.Last_alive_j /end MEASUREMENT
/begin MEASUREMENT Disconnections.Disconnections_DW.Last_alive_je "" FLOAT64_IEEE Disconnections_CM_double 0 0 -1.7e+308 1.7e+308 ECU_ADDRESS 0x0 DISPLAY_IDENTIFIER Disconnections.ECU_Disconections.Life_check4.Data_Store_Memory.Last_alive_je /end MEASUREMENT
/begin MEASUREMENT Disconnections.Disconnections_DW.Last_alive_l "" FLOAT64_IEEE Disconnections_CM_double 0 0 -1.7e+308 1.7e+308 ECU_ADDRESS 0x0 DISPLAY_IDENTIFIER Disconnections.Gyro_Disconnections__Noise_.Life_check6.Data_Store_Memory.Last_alive_l /end MEASUREMENT
/begin MEASUREMENT Disconnections.Disconnections_DW.Last_alive_m "" FLOAT64_IEEE Disconnections_CM_double 0 0 -1.7e+308 1.7e+308 ECU_ADDRESS 0x0 DISPLAY_IDENTIFIER Disconnections.Gyro_Disconnections__Noise_.Life_check8.Data_Store_Memory.Last_alive_m /end MEASUREMENT
/begin MEASUREMENT Disconnections.Disconnections_DW.Last_alive_o "" FLOAT64_IEEE Disconnections_CM_double 0 0 -1.7e+308 1.7e+308 ECU_ADDRESS 0x0 DISPLAY_IDENTIFIER Disconnections.ECU_Disconections.LifeCheck_Dash.Data_Store_Memory.Last_alive_o /end MEASUREMENT
/begin MEASUREMENT Disconnections.Disconnections_DW.Tot_Errors "" FLOAT64_IEEE Disconnections_CM_double 0 0 -1.7e+308 1.7e+308 ECU_ADDRESS 0x0 DISPLAY_IDENTIFIER Disconnections.Pedal_Box_Disconnections__Noise_.Life_check3.Data_Store_Memory1.Tot_Errors /end MEASUREMENT
/begin MEASUREMENT Disconnections.Disconnections_DW.Tot_Errors_h "" FLOAT64_IEEE Disconnections_CM_double 0 0 -1.7e+308 1.7e+308 ECU_ADDRESS 0x0 DISPLAY_IDENTIFIER Disconnections.Gyro_Disconnections__Noise_.Life_check6.Data_Store_Memory1.Tot_Errors_h /end MEASUREMENT
/begin MEASUREMENT Disconnections.Disconnections_DW.Tot_Errors_j "" FLOAT64_IEEE Disconnections_CM_double 0 0 -1.7e+308 1.7e+308 ECU_ADDRESS 0x0 DISPLAY_IDENTIFIER Disconnections.Pedal_Box_Disconnections__Noise_.Life_check2.Data_Store_Memory1.Tot_Errors_j /end MEASUREMENT
/begin MEASUREMENT Disconnections.Disconnections_DW.Tot_Errors_k "" FLOAT64_IEEE Disconnections_CM_double 0 0 -1.7e+308 1.7e+308 ECU_ADDRESS 0x0 DISPLAY_IDENTIFIER Disconnections.Pedal_Box_Disconnections__Noise_.Life_check1.Data_Store_Memory1.Tot_Errors_k /end MEASUREMENT
/begin MEASUREMENT Disconnections.Disconnections_DW.Tot_Errors_m "" FLOAT64_IEEE Disconnections_CM_double 0 0 -1.7e+308 1.7e+308 ECU_ADDRESS 0x0 DISPLAY_IDENTIFIER Disconnections.Gyro_Disconnections__Noise_.Life_check8.Data_Store_Memory1.Tot_Errors_m /end MEASUREMENT
/begin MEASUREMENT Disconnections.Disconnections_U.ADCAN_Alive "" FLOAT64_IEEE Disconnections_CM_double 0 0 -1.7e+308 1.7e+308 ECU_ADDRESS 0x0 DISPLAY_IDENTIFIER Disconnections.ADCAN_Alive /end MEASUREMENT
/begin MEASUREMENT Disconnections.Disconnections_U.APPS1_Bits "" FLOAT64_IEEE Disconnections_CM_double 0 0 -1.7e+308 1.7e+308 ECU_ADDRESS 0x0 DISPLAY_IDENTIFIER Disconnections.APPS1_Bits /end MEASUREMENT
/begin MEASUREMENT Disconnections.Disconnections_U.APPS2_Bits "" FLOAT64_IEEE Disconnections_CM_double 0 0 -1.7e+308 1.7e+308 ECU_ADDRESS 0x0 DISPLAY_IDENTIFIER Disconnections.APPS2_Bits /end MEASUREMENT
/begin MEASUREMENT Disconnections.Disconnections_U.Accel_F_Alive "" FLOAT64_IEEE Disconnections_CM_double 0 0 -1.7e+308 1.7e+308 ECU_ADDRESS 0x0 DISPLAY_IDENTIFIER Disconnections.Accel_F_Alive /end MEASUREMENT
/begin MEASUREMENT Disconnections.Disconnections_U.Accel_R_Alive "" FLOAT64_IEEE Disconnections_CM_double 0 0 -1.7e+308 1.7e+308 ECU_ADDRESS 0x0 DISPLAY_IDENTIFIER Disconnections.Accel_R_Alive /end MEASUREMENT
/begin MEASUREMENT Disconnections.Disconnections_U.BMS_Alive "" FLOAT64_IEEE Disconnections_CM_double 0 0 -1.7e+308 1.7e+308 ECU_ADDRESS 0x0 DISPLAY_IDENTIFIER Disconnections.BMS_Alive /end MEASUREMENT
/begin MEASUREMENT Disconnections.Disconnections_U.BrakeSensor_Bits "" FLOAT64_IEEE Disconnections_CM_double 0 0 -1.7e+308 1.7e+308 ECU_ADDRESS 0x0 DISPLAY_IDENTIFIER Disconnections.BrakeSensor_Bits /end MEASUREMENT
/begin MEASUREMENT Disconnections.Disconnections_U.Dash_Alive "" FLOAT64_IEEE Disconnections_CM_double 0 0 -1.7e+308 1.7e+308 ECU_ADDRESS 0x0 DISPLAY_IDENTIFIER Disconnections.Dash_Alive /end MEASUREMENT
/begin MEASUREMENT Disconnections.Disconnections_U.Gyroscope_F "" FLOAT64_IEEE Disconnections_CM_double 0 0 -1.7e+308 1.7e+308 ECU_ADDRESS 0x0 DISPLAY_IDENTIFIER Disconnections.Gyroscope_F /end MEASUREMENT
/begin MEASUREMENT Disconnections.Disconnections_U.Gyroscope_R "" FLOAT64_IEEE Disconnections_CM_double 0 0 -1.7e+308 1.7e+308 ECU_ADDRESS 0x0 DISPLAY_IDENTIFIER Disconnections.Gyroscope_R /end MEASUREMENT
/begin MEASUREMENT Disconnections.Disconnections_U.LV_Derivation_Alive "" FLOAT64_IEEE Disconnections_CM_double 0 0 -1.7e+308 1.7e+308 ECU_ADDRESS 0x0 DISPLAY_IDENTIFIER Disconnections.LV_Derivation_Alive /end MEASUREMENT
/begin MEASUREMENT Disconnections.Disconnections_U.Shutdown_Alive "" FLOAT64_IEEE Disconnections_CM_double 0 0 -1.7e+308 1.7e+308 ECU_ADDRESS 0x0 DISPLAY_IDENTIFIER Disconnections.Shutdown_Alive /end MEASUREMENT
/begin MEASUREMENT Disconnections.Disconnections_U.SteeringSensor_Bits "" FLOAT64_IEEE Disconnections_CM_double 0 0 -1.7e+308 1.7e+308 ECU_ADDRESS 0x0 DISPLAY_IDENTIFIER Disconnections.SteeringSensor_Bits /end MEASUREMENT
/begin MEASUREMENT Disconnections.Disconnections_U.Susp_F_L_Bits "" FLOAT64_IEEE Disconnections_CM_double 0 0 -1.7e+308 1.7e+308 ECU_ADDRESS 0x0 DISPLAY_IDENTIFIER Disconnections.Susp_F_L_Bits /end MEASUREMENT
/begin MEASUREMENT Disconnections.Disconnections_U.Susp_F_R_Bits "" FLOAT64_IEEE Disconnections_CM_double 0 0 -1.7e+308 1.7e+308 ECU_ADDRESS 0x0 DISPLAY_IDENTIFIER Disconnections.Susp_F_R_Bits /end MEASUREMENT
/begin MEASUREMENT Disconnections.Disconnections_U.Susp_R_L_Bits "" FLOAT64_IEEE Disconnections_CM_double 0 0 -1.7e+308 1.7e+308 ECU_ADDRESS 0x0 DISPLAY_IDENTIFIER Disconnections.Susp_R_L_Bits /end MEASUREMENT
/begin MEASUREMENT Disconnections.Disconnections_U.Susp_R_R_Bits "" FLOAT64_IEEE Disconnections_CM_double 0 0 -1.7e+308 1.7e+308 ECU_ADDRESS 0x0 DISPLAY_IDENTIFIER Disconnections.Susp_R_R_Bits /end MEASUREMENT
/begin MEASUREMENT Disconnections.Disconnections_Y.CounterOut "" FLOAT64_IEEE Disconnections_CM_double 0 0 -1.7e+308 1.7e+308 ECU_ADDRESS 0x0 DISPLAY_IDENTIFIER Disconnections.CounterOut /end MEASUREMENT
/begin MEASUREMENT Disconnections.Disconnections_Y.CriticalDisconnection "" UBYTE Disconnections_CM_uint8 0 0 0.0 255.0 ECU_ADDRESS 0x0 DISPLAY_IDENTIFIER Disconnections.CriticalDisconnection /end MEASUREMENT
/begin MEASUREMENT Disconnections.Disconnections_Y.Critical_CAN_Disconnection "" UBYTE Disconnections_CM_boolean 0 0 0 1 ECU_ADDRESS 0x0 DISPLAY_IDENTIFIER Disconnections.Critical_CAN_Disconnection /end MEASUREMENT
/begin MEASUREMENT Disconnections.Disconnections_Y.Critical_Signal_Disconnection "" UBYTE Disconnections_CM_boolean 0 0 0 1 ECU_ADDRESS 0x0 DISPLAY_IDENTIFIER Disconnections.Critical_Signal_Disconnection /end MEASUREMENT
/begin MEASUREMENT Disconnections.Disconnections_Y.Disconnection_ADCAN "" FLOAT64_IEEE Disconnections_CM_double 0 0 -1.7e+308 1.7e+308 ECU_ADDRESS 0x0 DISPLAY_IDENTIFIER Disconnections.Disconnection_ADCAN /end MEASUREMENT
/begin MEASUREMENT Disconnections.Disconnections_Y.Disconnection_APPS1 "" FLOAT64_IEEE Disconnections_CM_double 0 0 -1.7e+308 1.7e+308 ECU_ADDRESS 0x0 DISPLAY_IDENTIFIER Disconnections.Disconnection_APPS1 /end MEASUREMENT
/begin MEASUREMENT Disconnections.Disconnections_Y.Disconnection_APPS2 "" FLOAT64_IEEE Disconnections_CM_double 0 0 -1.7e+308 1.7e+308 ECU_ADDRESS 0x0 DISPLAY_IDENTIFIER Disconnections.Disconnection_APPS2 /end MEASUREMENT
/begin MEASUREMENT Disconnections.Disconnections_Y.Disconnection_Accel_F "" FLOAT64_IEEE Disconnections_CM_double 0 0 -1.7e+308 1.7e+308 ECU_ADDRESS 0x0 DISPLAY_IDENTIFIER Disconnections.Disconnection_Accel_F /end MEASUREMENT
/begin MEASUREMENT Disconnections.Disconnections_Y.Disconnection_Accel_R "" FLOAT64_IEEE Disconnections_CM_double 0 0 -1.7e+308 1.7e+308 ECU_ADDRESS 0x0 DISPLAY_IDENTIFIER Disconnections.Disconnection_Accel_R /end MEASUREMENT
/begin MEASUREMENT Disconnections.Disconnections_Y.Disconnection_BMS "" FLOAT64_IEEE Disconnections_CM_double 0 0 -1.7e+308 1.7e+308 ECU_ADDRESS 0x0 DISPLAY_IDENTIFIER Disconnections.Disconnection_BMS /end MEASUREMENT
/begin MEASUREMENT Disconnections.Disconnections_Y.Disconnection_Brake_Sensor "" FLOAT64_IEEE Disconnections_CM_double 0 0 -1.7e+308 1.7e+308 ECU_ADDRESS 0x0 DISPLAY_IDENTIFIER Disconnections.Disconnection_Brake_Sensor /end MEASUREMENT
/begin MEASUREMENT Disconnections.Disconnections_Y.Disconnection_DashBoard "" FLOAT64_IEEE Disconnections_CM_double 0 0 -1.7e+308 1.7e+308 ECU_ADDRESS 0x0 DISPLAY_IDENTIFIER Disconnections.Disconnection_DashBoard /end MEASUREMENT
/begin MEASUREMENT Disconnections.Disconnections_Y.Disconnection_Gyroscope_F "" FLOAT64_IEEE Disconnections_CM_double 0 0 -1.7e+308 1.7e+308 ECU_ADDRESS 0x0 DISPLAY_IDENTIFIER Disconnections.Disconnection_Gyroscope_F /end MEASUREMENT
/begin MEASUREMENT Disconnections.Disconnections_Y.Disconnection_Gyroscope_R "" FLOAT64_IEEE Disconnections_CM_double 0 0 -1.7e+308 1.7e+308 ECU_ADDRESS 0x0 DISPLAY_IDENTIFIER Disconnections.Disconnection_Gyroscope_R /end MEASUREMENT
/begin MEASUREMENT Disconnections.Disconnections_Y.Disconnection_LV_Derivation "" FLOAT64_IEEE Disconnections_CM_double 0 0 -1.7e+308 1.7e+308 ECU_ADDRESS 0x0 DISPLAY_IDENTIFIER Disconnections.Disconnection_LV_Derivation /end MEASUREMENT
/begin MEASUREMENT Disconnections.Disconnections_Y.Disconnection_Shutdown "" FLOAT64_IEEE Disconnections_CM_double 0 0 -1.7e+308 1.7e+308 ECU_ADDRESS 0x0 DISPLAY_IDENTIFIER Disconnections.Disconnection_Shutdown /end MEASUREMENT
/begin MEASUREMENT Disconnections.Disconnections_Y.Disconnection_SteeringSensor "" UBYTE Disconnections_CM_uint8 0 0 0.0 255.0 ECU_ADDRESS 0x0 DISPLAY_IDENTIFIER Disconnections.Disconnection_SteeringSensor /end MEASUREMENT
/begin MEASUREMENT Disconnections.Disconnections_Y.Disconnection_Susp_F_L "" UBYTE Disconnections_CM_uint8 0 0 0.0 255.0 ECU_ADDRESS 0x0 DISPLAY_IDENTIFIER Disconnections.Disconnection_Susp_F_L /end MEASUREMENT
/begin MEASUREMENT Disconnections.Disconnections_Y.Disconnection_Susp_F_R "" UBYTE Disconnections_CM_uint8 0 0 0.0 255.0 ECU_ADDRESS 0x0 DISPLAY_IDENTIFIER Disconnections.Disconnection_Susp_F_R /end MEASUREMENT
/begin MEASUREMENT Disconnections.Disconnections_Y.Disconnection_Susp_R_L "" UBYTE Disconnections_CM_uint8 0 0 0.0 255.0 ECU_ADDRESS 0x0 DISPLAY_IDENTIFIER Disconnections.Disconnection_Susp_R_L /end MEASUREMENT
/begin MEASUREMENT Disconnections.Disconnections_Y.Disconnection_Susp_R_R "" UBYTE Disconnections_CM_uint8 0 0 0.0 255.0 ECU_ADDRESS 0x0 DISPLAY_IDENTIFIER Disconnections.Disconnection_Susp_R_R /end MEASUREMENT
/begin MEASUREMENT Disconnections.Disconnections_Y.TV_mode "" FLOAT64_IEEE Disconnections_CM_double 0 0 -1.7e+308 1.7e+308 ECU_ADDRESS 0x0 DISPLAY_IDENTIFIER Disconnections.TV_mode /end MEASUREMENT
/begin MEASUREMENT Pedals_Susp_Sensors.Pedals_Susp_Sensors_U.APPS1_Bits "" FLOAT64_IEEE Pedals_Susp_Sensors_CM_double 0 0 -1.7e+308 1.7e+308 ECU_ADDRESS 0x0 DISPLAY_IDENTIFIER Pedals_Susp_Sensors.APPS1_Bits /end MEASUREMENT
/begin MEASUREMENT Pedals_Susp_Sensors.Pedals_Susp_Sensors_U.APPS2_Bits "" FLOAT64_IEEE Pedals_Susp_Sensors_CM_double 0 0 -1.7e+308 1.7e+308 ECU_ADDRESS 0x0 DISPLAY_IDENTIFIER Pedals_Susp_Sensors.APPS2_Bits /end MEASUREMENT
/begin MEASUREMENT Pedals_Susp_Sensors.Pedals_Susp_Sensors_U.BrakeSensor_Bits "" FLOAT64_IEEE Pedals_Susp_Sensors_CM_double 0 0 -1.7e+308 1.7e+308 ECU_ADDRESS 0x0 DISPLAY_IDENTIFIER Pedals_Susp_Sensors.BrakeSensor_Bits /end MEASUREMENT
/begin MEASUREMENT Pedals_Susp_Sensors.Pedals_Susp_Sensors_U.Susp_F_L_Bits "" FLOAT64_IEEE Pedals_Susp_Sensors_CM_double 0 0 -1.7e+308 1.7e+308 ECU_ADDRESS 0x0 DISPLAY_IDENTIFIER Pedals_Susp_Sensors.Susp_F_L_Bits /end MEASUREMENT
/begin MEASUREMENT Pedals_Susp_Sensors.Pedals_Susp_Sensors_U.Susp_F_R_Bits "" FLOAT64_IEEE Pedals_Susp_Sensors_CM_double 0 0 -1.7e+308 1.7e+308 ECU_ADDRESS 0x0 DISPLAY_IDENTIFIER Pedals_Susp_Sensors.Susp_F_R_Bits /end MEASUREMENT
/begin MEASUREMENT Pedals_Susp_Sensors.Pedals_Susp_Sensors_U.Susp_R_L_Bits "" FLOAT64_IEEE Pedals_Susp_Sensors_CM_double 0 0 -1.7e+308 1.7e+308 ECU_ADDRESS 0x0 DISPLAY_IDENTIFIER Pedals_Susp_Sensors.Susp_R_L_Bits /end MEASUREMENT
/begin MEASUREMENT Pedals_Susp_Sensors.Pedals_Susp_Sensors_U.Susp_R_R_Bits "" FLOAT64_IEEE Pedals_Susp_Sensors_CM_double 0 0 -1.7e+308 1.7e+308 ECU_ADDRESS 0x0 DISPLAY_IDENTIFIER Pedals_Susp_Sensors.Susp_R_R_Bits /end MEASUREMENT
/begin MEASUREMENT Pedals_Susp_Sensors.Pedals_Susp_Sensors_Y.APPS1_Value "" FLOAT64_IEEE Pedals_Susp_Sensors_CM_double 0 0 -1.7e+308 1.7e+308 ECU_ADDRESS 0x0 DISPLAY_IDENTIFIER Pedals_Susp_Sensors.APPS1_Value /end MEASUREMENT
/begin MEASUREMENT Pedals_Susp_Sensors.Pedals_Susp_Sensors_Y.APPS2_Value "" FLOAT64_IEEE Pedals_Susp_Sensors_CM_double 0 0 -1.7e+308 1.7e+308 ECU_ADDRESS 0x0 DISPLAY_IDENTIFIER Pedals_Susp_Sensors.APPS2_Value /end MEASUREMENT
/begin MEASUREMENT Pedals_Susp_Sensors.Pedals_Susp_Sensors_Y.BrakeLight_Control "" FLOAT64_IEEE Pedals_Susp_Sensors_CM_double 0 0 -1.7e+308 1.7e+308 ECU_ADDRESS 0x0 DISPLAY_IDENTIFIER Pedals_Susp_Sensors.BrakeLight_Control /end MEASUREMENT
/begin MEASUREMENT Pedals_Susp_Sensors.Pedals_Susp_Sensors_Y.BrakeSensor_Value "" FLOAT64_IEEE Pedals_Susp_Sensors_CM_double 0 0 -1.7e+308 1.7e+308 ECU_ADDRESS 0x0 DISPLAY_IDENTIFIER Pedals_Susp_Sensors.BrakeSensor_Value /end MEASUREMENT
/begin MEASUREMENT Pedals_Susp_Sensors.Pedals_Susp_Sensors_Y.SUSP_F_L "" FLOAT64_IEEE Pedals_Susp_Sensors_CM_double 0 0 -1.7e+308 1.7e+308 ECU_ADDRESS 0x0 DISPLAY_IDENTIFIER Pedals_Susp_Sensors.SUSP_F_L /end MEASUREMENT
/begin MEASUREMENT Pedals_Susp_Sensors.Pedals_Susp_Sensors_Y.SUSP_F_R "" FLOAT64_IEEE Pedals_Susp_Sensors_CM_double 0 0 -1.7e+308 1.7e+308 ECU_ADDRESS 0x0 DISPLAY_IDENTIFIER Pedals_Susp_Sensors.SUSP_F_R /end MEASUREMENT
/begin MEASUREMENT Pedals_Susp_Sensors.Pedals_Susp_Sensors_Y.SUSP_R_L "" FLOAT64_IEEE Pedals_Susp_Sensors_CM_double 0 0 -1.7e+308 1.7e+308 ECU_ADDRESS 0x0 DISPLAY_IDENTIFIER Pedals_Susp_Sensors.SUSP_R_L /end MEASUREMENT
/begin MEASUREMENT Pedals_Susp_Sensors.Pedals_Susp_Sensors_Y.SUSP_R_R "" FLOAT64_IEEE Pedals_Susp_Sensors_CM_double 0 0 -1.7e+308 1.7e+308 ECU_ADDRESS 0x0 DISPLAY_IDENTIFIER Pedals_Susp_Sensors.SUSP_R_R /end MEASUREMENT
/begin MEASUREMENT Accel_Data.Accel_Data_B.AccDataConversionFX.Gain "" FLOAT64_IEEE Accel_Data_CM_double 0 0 -1.7e+308 1.7e+308 ECU_ADDRESS 0x0 DISPLAY_IDENTIFIER Accel_Data.Acc_Data_Conversion_F_X.Gain.Gain /end MEASUREMENT
/begin MEASUREMENT Accel_Data.Accel_Data_B.AccDataConversionFY.Gain "" FLOAT64_IEEE Accel_Data_CM_double 0 0 -1.7e+308 1.7e+308 ECU_ADDRESS 0x0 DISPLAY_IDENTIFIER Accel_Data.Acc_Data_Conversion_F_Y.Gain.Gain /end MEASUREMENT
/begin MEASUREMENT Accel_Data.Accel_Data_B.AccDataConversionFZ.Gain "" FLOAT64_IEEE Accel_Data_CM_double 0 0 -1.7e+308 1.7e+308 ECU_ADDRESS 0x0 DISPLAY_IDENTIFIER Accel_Data.Acc_Data_Conversion_F_Z.Gain.Gain /end MEASUREMENT
/begin MEASUREMENT Accel_Data.Accel_Data_B.AccDataConversionRX.Gain "" FLOAT64_IEEE Accel_Data_CM_double 0 0 -1.7e+308 1.7e+308 ECU_ADDRESS 0x0 DISPLAY_IDENTIFIER Accel_Data.Acc_Data_Conversion_R_X.Gain.Gain /end MEASUREMENT
/begin MEASUREMENT Accel_Data.Accel_Data_B.AccDataConversionRY.Gain "" FLOAT64_IEEE Accel_Data_CM_double 0 0 -1.7e+308 1.7e+308 ECU_ADDRESS 0x0 DISPLAY_IDENTIFIER Accel_Data.Acc_Data_Conversion_R_Y.Gain.Gain /end MEASUREMENT
/begin MEASUREMENT Accel_Data.Accel_Data_B.AccDataConversionRZ.Gain "" FLOAT64_IEEE Accel_Data_CM_double 0 0 -1.7e+308 1.7e+308 ECU_ADDRESS 0x0 DISPLAY_IDENTIFIER Accel_Data.Acc_Data_Conversion_R_Z.Gain.Gain /end MEASUREMENT
/begin MEASUREMENT Accel_Data.Accel_Data_B.LowPass.Gain "" FLOAT64_IEEE Accel_Data_CM_double 0 0 -1.7e+308 1.7e+308 ECU_ADDRESS 0x0 DISPLAY_IDENTIFIER Accel_Data.Low_Pass.Gain.Gain /end MEASUREMENT
/begin MEASUREMENT Accel_Data.Accel_Data_B.LowPass1.Gain "" FLOAT64_IEEE Accel_Data_CM_double 0 0 -1.7e+308 1.7e+308 ECU_ADDRESS 0x0 DISPLAY_IDENTIFIER Accel_Data.Low_Pass1.Gain.Gain /end MEASUREMENT
/begin MEASUREMENT Accel_Data.Accel_Data_B.LowPass2.Gain "" FLOAT64_IEEE Accel_Data_CM_double 0 0 -1.7e+308 1.7e+308 ECU_ADDRESS 0x0 DISPLAY_IDENTIFIER Accel_Data.Low_Pass2.Gain.Gain /end MEASUREMENT
/begin MEASUREMENT Accel_Data.Accel_Data_DW.A "" FLOAT64_IEEE Accel_Data_CM_double 0 0 -1.7e+308 1.7e+308 ECU_ADDRESS 0x0 DISPLAY_IDENTIFIER Accel_Data.Gyro_Data_Conversion_R_Z.Data_Store_Memory.A /end MEASUREMENT
/begin MEASUREMENT Accel_Data.Accel_Data_DW.A_f "" FLOAT64_IEEE Accel_Data_CM_double 0 0 -1.7e+308 1.7e+308 ECU_ADDRESS 0x0 DISPLAY_IDENTIFIER Accel_Data.Gyro_Data_Conversion_F_Z.Data_Store_Memory.A_f /end MEASUREMENT
/begin MEASUREMENT Accel_Data.Accel_Data_U.ACCEL_F_X "" FLOAT64_IEEE Accel_Data_CM_double 0 0 -1.7e+308 1.7e+308 ECU_ADDRESS 0x0 DISPLAY_IDENTIFIER Accel_Data.ACCEL_F_X /end MEASUREMENT
/begin MEASUREMENT Accel_Data.Accel_Data_U.ACCEL_F_Y "" FLOAT64_IEEE Accel_Data_CM_double 0 0 -1.7e+308 1.7e+308 ECU_ADDRESS 0x0 DISPLAY_IDENTIFIER Accel_Data.ACCEL_F_Y /end MEASUREMENT
/begin MEASUREMENT Accel_Data.Accel_Data_U.ACCEL_F_Z "" FLOAT64_IEEE Accel_Data_CM_double 0 0 -1.7e+308 1.7e+308 ECU_ADDRESS 0x0 DISPLAY_IDENTIFIER Accel_Data.ACCEL_F_Z /end MEASUREMENT
/begin MEASUREMENT Accel_Data.Accel_Data_U.ACCEL_R_X "" FLOAT64_IEEE Accel_Data_CM_double 0 0 -1.7e+308 1.7e+308 ECU_ADDRESS 0x0 DISPLAY_IDENTIFIER Accel_Data.ACCEL_R_X /end MEASUREMENT
/begin MEASUREMENT Accel_Data.Accel_Data_U.ACCEL_R_Y "" FLOAT64_IEEE Accel_Data_CM_double 0 0 -1.7e+308 1.7e+308 ECU_ADDRESS 0x0 DISPLAY_IDENTIFIER Accel_Data.ACCEL_R_Y /end MEASUREMENT
/begin MEASUREMENT Accel_Data.Accel_Data_U.ACCEL_R_Z "" FLOAT64_IEEE Accel_Data_CM_double 0 0 -1.7e+308 1.7e+308 ECU_ADDRESS 0x0 DISPLAY_IDENTIFIER Accel_Data.ACCEL_R_Z /end MEASUREMENT
/begin MEASUREMENT Accel_Data.Accel_Data_U.Gyroscope_F "" FLOAT64_IEEE Accel_Data_CM_double 0 0 -1.7e+308 1.7e+308 ECU_ADDRESS 0x0 DISPLAY_IDENTIFIER Accel_Data.Gyroscope_F /end MEASUREMENT
/begin MEASUREMENT Accel_Data.Accel_Data_U.Gyroscope_R "" FLOAT64_IEEE Accel_Data_CM_double 0 0 -1.7e+308 1.7e+308 ECU_ADDRESS 0x0 DISPLAY_IDENTIFIER Accel_Data.Gyroscope_R /end MEASUREMENT
/begin MEASUREMENT Accel_Data.Accel_Data_Y.Accel_F_X_SI "" FLOAT64_IEEE Accel_Data_CM_double 0 0 -1.7e+308 1.7e+308 ECU_ADDRESS 0x0 DISPLAY_IDENTIFIER Accel_Data.Accel_F_X_SI /end MEASUREMENT
/begin MEASUREMENT Accel_Data.Accel_Data_Y.Accel_F_Y_SI "" FLOAT64_IEEE Accel_Data_CM_double 0 0 -1.7e+308 1.7e+308 ECU_ADDRESS 0x0 DISPLAY_IDENTIFIER Accel_Data.Accel_F_Y_SI /end MEASUREMENT
/begin MEASUREMENT Accel_Data.Accel_Data_Y.Accel_F_Z_SI "" FLOAT64_IEEE Accel_Data_CM_double 0 0 -1.7e+308 1.7e+308 ECU_ADDRESS 0x0 DISPLAY_IDENTIFIER Accel_Data.Accel_F_Z_SI /end MEASUREMENT
/begin MEASUREMENT Accel_Data.Accel_Data_Y.Accel_R_X_SI "" FLOAT64_IEEE Accel_Data_CM_double 0 0 -1.7e+308 1.7e+308 ECU_ADDRESS 0x0 DISPLAY_IDENTIFIER Accel_Data.Accel_R_X_SI /end MEASUREMENT
/begin MEASUREMENT Accel_Data.Accel_Data_Y.Accel_R_Y_SI "" FLOAT64_IEEE Accel_Data_CM_double 0 0 -1.7e+308 1.7e+308 ECU_ADDRESS 0x0 DISPLAY_IDENTIFIER Accel_Data.Accel_R_Y_SI /end MEASUREMENT
/begin MEASUREMENT Accel_Data.Accel_Data_Y.Accel_R_Z_SI "" FLOAT64_IEEE Accel_Data_CM_double 0 0 -1.7e+308 1.7e+308 ECU_ADDRESS 0x0 DISPLAY_IDENTIFIER Accel_Data.Accel_R_Z_SI /end MEASUREMENT
/begin MEASUREMENT Accel_Data.Accel_Data_Y.Gyro_F_Z_Deg "" FLOAT64_IEEE Accel_Data_CM_double 0 0 -1.7e+308 1.7e+308 ECU_ADDRESS 0x0 DISPLAY_IDENTIFIER Accel_Data.Gyro_F_Z_Deg /end MEASUREMENT
/begin MEASUREMENT Accel_Data.Accel_Data_Y.Gyro_R_Z_Deg "" FLOAT64_IEEE Accel_Data_CM_double 0 0 -1.7e+308 1.7e+308 ECU_ADDRESS 0x0 DISPLAY_IDENTIFIER Accel_Data.Gyro_R_Z_Deg /end MEASUREMENT
/begin MEASUREMENT Accel_Data.Accel_Data_Y.Rate_F_Z_Degs2 "" FLOAT64_IEEE Accel_Data_CM_double 0 0 -1.7e+308 1.7e+308 ECU_ADDRESS 0x0 DISPLAY_IDENTIFIER Accel_Data.Rate_F_Z_Deg_s2 /end MEASUREMENT
/begin MEASUREMENT Accel_Data.Accel_Data_Y.Rate_R_Z_Degs "" FLOAT64_IEEE Accel_Data_CM_double 0 0 -1.7e+308 1.7e+308 ECU_ADDRESS 0x0 DISPLAY_IDENTIFIER Accel_Data.Rate_R_Z_Deg_s /end MEASUREMENT
/begin CHARACTERISTIC Car_State.Car_State_P.CompareToConstant_const "" VALUE 0x0 SCALAR_FLOAT64_IEEE 3.5e+305 Car_State_CM_double -1.7e+308 1.7e+308 DISPLAY_IDENTIFIER Car_State.CarOK_Checks.Compare_To_Constant.Constant.Value /end CHARACTERISTIC
/begin CHARACTERISTIC Car_State.Car_State_P.Constant_Value "" VALUE 0x0 SCALAR_FLOAT64_IEEE 3.5e+305 Car_State_CM_double -1.7e+308 1.7e+308 DISPLAY_IDENTIFIER Car_State.AIRS_Request.Precharge.Constant.Value /end CHARACTERISTIC
/begin CHARACTERISTIC Car_State.Car_State_P.Constant_Value_f "" VALUE 0x0 SCALAR_FLOAT64_IEEE 3.5e+305 Car_State_CM_double -1.7e+308 1.7e+308 DISPLAY_IDENTIFIER Car_State.CurrentPathDisconnection_Detection.OK_or_latch.OK.Constant.Value /end CHARACTERISTIC
/begin CHARACTERISTIC Car_State.Car_State_P.Constant_Value_fl "" VALUE 0x0 SCALAR_FLOAT64_IEEE 3.5e+305 Car_State_CM_double -1.7e+308 1.7e+308 DISPLAY_IDENTIFIER Car_State.CarOK_Checks.Compare_To_Zero2.Constant.Value /end CHARACTERISTIC
/begin CHARACTERISTIC Car_State.Car_State_P.Constant_Value_k "" VALUE 0x0 SCALAR_FLOAT64_IEEE 3.5e+305 Car_State_CM_double -1.7e+308 1.7e+308 DISPLAY_IDENTIFIER Car_State.AIRS_Request.Tancar_Airs.Constant.Value /end CHARACTERISTIC
/begin CHARACTERISTIC Car_State.Car_State_P.Constant_Value_kb "" VALUE 0x0 SCALAR_FLOAT64_IEEE 3.5e+305 Car_State_CM_double -1.7e+308 1.7e+308 DISPLAY_IDENTIFIER Car_State.CarOK_Checks.Compare_To_Zero1.Constant.Value /end CHARACTERISTIC
/begin CHARACTERISTIC Car_State.Car_State_P.DataStoreMemory_InitialValue "" VALUE 0x0 SCALAR_FLOAT64_IEEE 3.5e+305 Car_State_CM_double -1.7e+308 1.7e+308 DISPLAY_IDENTIFIER Car_State.CurrentPathDisconnection_Detection.Data_Store_Memory.InitialValue /end CHARACTERISTIC
/begin CHARACTERISTIC Car_State.Car_State_P.Gain_Gain "" VALUE 0x0 SCALAR_FLOAT64_IEEE 3.5e+305 Car_State_CM_double -1.7e+308 1.7e+308 DISPLAY_IDENTIFIER Car_State.PrechargeAssert_Conditions.Gain.Gain /end CHARACTERISTIC
/begin CHARACTERISTIC Car_State.Car_State_P.IfDCBUSnotbits_Gain "" VALUE 0x0 SCALAR_FLOAT64_IEEE 3.5e+305 Car_State_CM_double -1.7e+308 1.7e+308 DISPLAY_IDENTIFIER Car_State.Precharge_Info.If_DC_BUS_not_bits.Gain /end CHARACTERISTIC
/begin CHARACTERISTIC Car_State.Car_State_P.Merge_InitialOutput "" VALUE 0x0 SCALAR_FLOAT64_IEEE 3.5e+305 Car_State_CM_double -1.7e+308 1.7e+308 DISPLAY_IDENTIFIER Car_State.AIRS_Request.Merge.InitialOutput /end CHARACTERISTIC
/begin CHARACTERISTIC Car_State.Car_State_P.Saturation_LowerSat "" VALUE 0x0 SCALAR_FLOAT64_IEEE 3.5e+305 Car_State_CM_double -1.7e+308 1.7e+308 DISPLAY_IDENTIFIER Car_State.Precharge_Info.Saturation.LowerLimit /end CHARACTERISTIC
/begin CHARACTERISTIC Car_State.Car_State_P.Saturation_UpperSat "" VALUE 0x0 SCALAR_FLOAT64_IEEE 3.5e+305 Car_State_CM_double -1.7e+308 1.7e+308 DISPLAY_IDENTIFIER Car_State.Precharge_Info.Saturation.UpperLimit /end CHARACTERISTIC
/begin CHARACTERISTIC Disconnections.Disconnections_P.Constant_Value "" VALUE 0x0 SCALAR_FLOAT64_IEEE 3.5e+305 Disconnections_CM_double -1.7e+308 1.7e+308 DISPLAY_IDENTIFIER Disconnections.Subsystem.VDC_2018_Complete.Constant.Value /end CHARACTERISTIC
/begin CHARACTERISTIC Disconnections.Disconnections_P.Constant_Value_c "" VALUE 0x0 SCALAR_FLOAT64_IEEE 3.5e+305 Disconnections_CM_double -1.7e+308 1.7e+308 DISPLAY_IDENTIFIER Disconnections.Counter.Constant.Value /end CHARACTERISTIC
/begin CHARACTERISTIC Disconnections.Disconnections_P.Constant_Value_d "" VALUE 0x0 SCALAR_FLOAT64_IEEE 3.5e+305 Disconnections_CM_double -1.7e+308 1.7e+308 DISPLAY_IDENTIFIER Disconnections.Signal_Disconnections.Compare_To_Zero2.Constant.Value /end CHARACTERISTIC
/begin CHARACTERISTIC Disconnections.Disconnections_P.Constant_Value_e "" VALUE 0x0 SCALAR_FLOAT64_IEEE 3.5e+305 Disconnections_CM_double -1.7e+308 1.7e+308 DISPLAY_IDENTIFIER Disconnections.Subsystem.Rigid_Axle.Constant.Value /end CHARACTERISTIC
/begin CHARACTERISTIC Disconnections.Disconnections_P.Constant_Value_h "" VALUE 0x0 SCALAR_FLOAT64_IEEE 3.5e+305 Disconnections_CM_double -1.7e+308 1.7e+308 DISPLAY_IDENTIFIER Disconnections.Subsystem.VDC_without_Longitudinal.Constant.Value /end CHARACTERISTIC
/begin CHARACTERISTIC Disconnections.Disconnections_P.Constant_Value_i "" VALUE 0x0 SCALAR_FLOAT64_IEEE 3.5e+305 Disconnections_CM_double -1.7e+308 1.7e+308 DISPLAY_IDENTIFIER Disconnections.Constant.Value /end CHARACTERISTIC
/begin CHARACTERISTIC Disconnections.Disconnections_P.Constant_Value_ic "" VALUE 0x0 SCALAR_FLOAT64_IEEE 3.5e+305 Disconnections_CM_double -1.7e+308 1.7e+308 DISPLAY_IDENTIFIER Disconnections.Signal_Disconnections.Compare_To_Zero.Constant.Value /end CHARACTERISTIC
/begin CHARACTERISTIC Disconnections.Disconnections_P.Constant_Value_j "" VALUE 0x0 SCALAR_FLOAT64_IEEE 3.5e+305 Disconnections_CM_double -1.7e+308 1.7e+308 DISPLAY_IDENTIFIER Disconnections.Signal_Disconnections.Compare_To_Zero3.Constant.Value /end CHARACTERISTIC
/begin CHARACTERISTIC Disconnections.Disconnections_P.Constant_Value_l "" VALUE 0x0 SCALAR_FLOAT64_IEEE 3.5e+305 Disconnections_CM_double -1.7e+308 1.7e+308 DISPLAY_IDENTIFIER Disconnections.Signal_Disconnections.Compare_To_Zero1.Constant.Value /end CHARACTERISTIC
/begin CHARACTERISTIC Disconnections.Disconnections_P.Constant_Value_m "" VALUE 0x0 SCALAR_FLOAT64_IEEE 3.5e+305 Disconnections_CM_double -1.7e+308 1.7e+308 DISPLAY_IDENTIFIER Disconnections.Subsystem.Steering_TV_2017_without_TC.Constant.Value /end CHARACTERISTIC
/begin CHARACTERISTIC Disconnections.Disconnections_P.Constant_Value_o "" VALUE 0x0 SCALAR_FLOAT64_IEEE 3.5e+305 Disconnections_CM_double -1.7e+308 1.7e+308 DISPLAY_IDENTIFIER Disconnections.Signal_Disconnections.Compare_To_Zero4.Constant.Value /end CHARACTERISTIC
/begin CHARACTERISTIC Disconnections.Disconnections_P.DataStoreMemory1_InitialValue "" VALUE 0x0 SCALAR_FLOAT64_IEEE 3.5e+305 Disconnections_CM_double -1.7e+308 1.7e+308 DISPLAY_IDENTIFIER Disconnections.Pedal_Box_Disconnections__Noise_.Life_check3.Data_Store_Memory1.InitialValue /end CHARACTERISTIC
/begin CHARACTERISTIC Disconnections.Disconnections_P.DataStoreMemory1_InitialValue_b "" VALUE 0x0 SCALAR_FLOAT64_IEEE 3.5e+305 Disconnections_CM_double -1.7e+308 1.7e+308 DISPLAY_IDENTIFIER Disconnections.Pedal_Box_Disconnections__Noise_.Life_check1.Data_Store_Memory1.InitialValue /end CHARACTERISTIC
/begin CHARACTERISTIC Disconnections.Disconnections_P.DataStoreMemory1_InitialValue_c "" VALUE 0x0 SCALAR_FLOAT64_IEEE 3.5e+305 Disconnections_CM_double -1.7e+308 1.7e+308 DISPLAY_IDENTIFIER Disconnections.Gyro_Disconnections__Noise_.Life_check8.Data_Store_Memory1.InitialValue /end CHARACTERISTIC
/begin CHARACTERISTIC Disconnections.Disconnections_P.DataStoreMemory1_InitialValue_d "" VALUE 0x0 SCALAR_FLOAT64_IEEE 3.5e+305 Disconnections_CM_double -1.7e+308 1.7e+308 DISPLAY_IDENTIFIER Disconnections.Pedal_Box_Disconnections__Noise_.Life_check2.Data_Store_Memory1.InitialValue /end CHARACTERISTIC
/begin CHARACTERISTIC Disconnections.Disconnections_P.DataStoreMemory1_InitialValue_m "" VALUE 0x0 SCALAR_FLOAT64_IEEE 3.5e+305 Disconnections_CM_double -1.7e+308 1.7e+308 DISPLAY_IDENTIFIER Disconnections.Gyro_Disconnections__Noise_.Life_check6.Data_Store_Memory1.InitialValue /end CHARACTERISTIC
/begin CHARACTERISTIC Disconnections.Disconnections_P.DataStoreMemory_InitialValue "" VALUE 0x0 SCALAR_FLOAT64_IEEE 3.5e+305 Disconnections_CM_double -1.7e+308 1.7e+308 DISPLAY_IDENTIFIER Disconnections.ECU_Disconections.LifeCheck_BMS.Data_Store_Memory.InitialValue /end CHARACTERISTIC
/begin CHARACTERISTIC Disconnections.Disconnections_P.DataStoreMemory_InitialValue_b "" VALUE 0x0 SCALAR_FLOAT64_IEEE 3.5e+305 Disconnections_CM_double -1.7e+308 1.7e+308 DISPLAY_IDENTIFIER Disconnections.ECU_Disconections.LifeCheck_ADCAN.Data_Store_Memory.InitialValue /end CHARACTERISTIC
/begin CHARACTERISTIC Disconnections.Disconnections_P.DataStoreMemory_InitialValue_ba "" VALUE 0x0 SCALAR_FLOAT64_IEEE 3.5e+305 Disconnections_CM_double -1.7e+308 1.7e+308 DISPLAY_IDENTIFIER Disconnections.Gyro_Disconnections__Noise_.Life_check8.Data_Store_Memory.InitialValue /end CHARACTERISTIC
/begin CHARACTERISTIC Disconnections.Disconnections_P.DataStoreMemory_InitialValue_c "" VALUE 0x0 SCALAR_FLOAT64_IEEE 3.5e+305 Disconnections_CM_double -1.7e+308 1.7e+308 DISPLAY_IDENTIFIER Disconnections.Pedal_Box_Disconnections__Noise_.Life_check3.Data_Store_Memory.InitialValue /end CHARACTERISTIC
/begin CHARACTERISTIC Disconnections.Disconnections_P.DataStoreMemory_InitialValue_d "" VALUE 0x0 SCALAR_FLOAT64_IEEE 3.5e+305 Disconnections_CM_double -1.7e+308 1.7e+308 DISPLAY_IDENTIFIER Disconnections.ECU_Disconections.LifeCheck_AccFront.Data_Store_Memory.InitialValue /end CHARACTERISTIC
/begin CHARACTERISTIC Disconnections.Disconnections_P.DataStoreMemory_InitialValue_f "" VALUE 0x0 SCALAR_FLOAT64_IEEE 3.5e+305 Disconnections_CM_double -1.7e+308 1.7e+308 DISPLAY_IDENTIFIER Disconnections.ECU_Disconections.LifeCheck_AccRear.Data_Store_Memory.InitialValue /end CHARACTERISTIC
/begin CHARACTERISTIC Disconnections.Disconnections_P.DataStoreMemory_InitialValue_j "" VALUE 0x0 SCALAR_FLOAT64_IEEE 3.5e+305 Disconnections_CM_double -1.7e+308 1.7e+308 DISPLAY_IDENTIFIER Disconnections.Counter.Data_Store_Memory.InitialValue /end CHARACTERISTIC
/begin CHARACTERISTIC Disconnections.Disconnections_P.DataStoreMemory_InitialValue_jc "" VALUE 0x0 SCALAR_FLOAT64_IEEE 3.5e+305 Disconnections_CM_double -1.7e+308 1.7e+308 DISPLAY_IDENTIFIER Disconnections.Pedal_Box_Disconnections__Noise_.Life_check1.Data_Store_Memory.InitialValue /end CHARACTERISTIC
/begin CHARACTERISTIC Disconnections.Disconnections_P.DataStoreMemory_InitialValue_k "" VALUE 0x0 SCALAR_FLOAT64_IEEE 3.5e+305 Disconnections_CM_double -1.7e+308 1.7e+308 DISPLAY_IDENTIFIER Disconnections.ECU_Disconections.LifeCheck_Dash.Data_Store_Memory.InitialValue /end CHARACTERISTIC
/begin CHARACTERISTIC Disconnections.Disconnections_P.DataStoreMemory_InitialValue_kg "" VALUE 0x0 SCALAR_FLOAT64_IEEE 3.5e+305 Disconnections_CM_double -1.7e+308 1.7e+308 DISPLAY_IDENTIFIER Disconnections.Pedal_Box_Disconnections__Noise_.Life_check2.Data_Store_Memory.InitialValue /end CHARACTERISTIC
/begin CHARACTERISTIC Disconnections.Disconnections_P.DataStoreMemory_InitialValue_ks "" VALUE 0x0 SCALAR_FLOAT64_IEEE 3.5e+305 Disconnections_CM_double -1.7e+308 1.7e+308 DISPLAY_IDENTIFIER Disconnections.ECU_Disconections.Life_check4.Data_Store_Memory.InitialValue /end CHARACTERISTIC
/begin CHARACTERISTIC Disconnections.Disconnections_P.DataStoreMemory_InitialValue_m "" VALUE 0x0 SCALAR_FLOAT64_IEEE 3.5e+305 Disconnections_CM_double -1.7e+308 1.7e+308 DISPLAY_IDENTIFIER Disconnections.Gyro_Disconnections__Noise_.Life_check6.Data_Store_Memory.InitialValue /end CHARACTERISTIC
/begin CHARACTERISTIC Disconnections.Disconnections_P.DataStoreMemory_InitialValue_o "" VALUE 0x0 SCALAR_FLOAT64_IEEE 3.5e+305 Disconnections_CM_double -1.7e+308 1.7e+308 DISPLAY_IDENTIFIER Disconnections.ECU_Disconections.LifeCheck_Shutdown.Data_Store_Memory.InitialValue /end CHARACTERISTIC
/begin CHARACTERISTIC Disconnections.Disconnections_P.Merge_InitialOutput "" VALUE 0x0 SCALAR_FLOAT64_IEEE 3.5e+305 Disconnections_CM_double -1.7e+308 1.7e+308 DISPLAY_IDENTIFIER Disconnections.ECU_Disconections.LifeCheck_BMS.Merge.InitialOutput /end CHARACTERISTIC
/begin CHARACTERISTIC Disconnections.Disconnections_P.Merge_InitialOutput_a "" VALUE 0x0 SCALAR_FLOAT64_IEEE 3.5e+305 Disconnections_CM_double -1.7e+308 1.7e+308 DISPLAY_IDENTIFIER Disconnections.ECU_Disconections.LifeCheck_ADCAN.Merge.InitialOutput /end CHARACTERISTIC
/begin CHARACTERISTIC Disconnections.Disconnections_P.Merge_InitialOutput_b "" VALUE 0x0 SCALAR_FLOAT64_IEEE 3.5e+305 Disconnections_CM_double -1.7e+308 1.7e+308 DISPLAY_IDENTIFIER Disconnections.ECU_Disconections.LifeCheck_Dash.Merge.InitialOutput /end CHARACTERISTIC
/begin CHARACTERISTIC Disconnections.Disconnections_P.Merge_InitialOutput_l "" VALUE 0x0 SCALAR_FLOAT64_IEEE 3.5e+305 Disconnections_CM_double -1.7e+308 1.7e+308 DISPLAY_IDENTIFIER Disconnections.ECU_Disconections.LifeCheck_Shutdown.Merge.InitialOutput /end CHARACTERISTIC
/begin CHARACTERISTIC Disconnections.Disconnections_P.Merge_InitialOutput_m "" VALUE 0x0 SCALAR_FLOAT64_IEEE 3.5e+305 Disconnections_CM_double -1.7e+308 1.7e+308 DISPLAY_IDENTIFIER Disconnections.ECU_Disconections.LifeCheck_AccFront.Merge.InitialOutput /end CHARACTERISTIC
/begin CHARACTERISTIC Disconnections.Disconnections_P.Merge_InitialOutput_o "" VALUE 0x0 SCALAR_FLOAT64_IEEE 3.5e+305 Disconnections_CM_double -1.7e+308 1.7e+308 DISPLAY_IDENTIFIER Disconnections.ECU_Disconections.Life_check4.Merge.InitialOutput /end CHARACTERISTIC
/begin CHARACTERISTIC Disconnections.Disconnections_P.Merge_InitialOutput_p "" VALUE 0x0 SCALAR_FLOAT64_IEEE 3.5e+305 Disconnections_CM_double -1.7e+308 1.7e+308 DISPLAY_IDENTIFIER Disconnections.ECU_Disconections.LifeCheck_AccRear.Merge.InitialOutput /end CHARACTERISTIC
/begin CHARACTERISTIC Pedals_Susp_Sensors.Pedals_Susp_Sensors_P.Brake_Light_Threshold_Value "" VALUE 0x0 SCALAR_FLOAT64_IEEE 3.5e+305 Pedals_Susp_Sensors_CM_double -1.7e+308 1.7e+308 DISPLAY_IDENTIFIER Pedals_Susp_Sensors.Brake_Light.Brake_Light_Threshold.Value /end CHARACTERISTIC
/begin CHARACTERISTIC Pedals_Susp_Sensors.Pedals_Susp_Sensors_P.Ctemuelles_Gain "" VALUE 0x0 SCALAR_FLOAT64_IEEE 3.5e+305 Pedals_Susp_Sensors_CM_double -1.7e+308 1.7e+308 DISPLAY_IDENTIFIER Pedals_Susp_Sensors.Suspension_FL_Data_Conv.Cte_muelles.Gain /end CHARACTERISTIC
/begin CHARACTERISTIC Pedals_Susp_Sensors.Pedals_Susp_Sensors_P.Ctemuelles_Gain_a "" VALUE 0x0 SCALAR_FLOAT64_IEEE 3.5e+305 Pedals_Susp_Sensors_CM_double -1.7e+308 1.7e+308 DISPLAY_IDENTIFIER Pedals_Susp_Sensors.Suspension_RL_Data_Conv.Cte_muelles.Gain /end CHARACTERISTIC
/begin CHARACTERISTIC Pedals_Susp_Sensors.Pedals_Susp_Sensors_P.Ctemuelles_Gain_e "" VALUE 0x0 SCALAR_FLOAT64_IEEE 3.5e+305 Pedals_Susp_Sensors_CM_double -1.7e+308 1.7e+308 DISPLAY_IDENTIFIER Pedals_Susp_Sensors.Suspension_FR_Data_Conv.Cte_muelles.Gain /end CHARACTERISTIC
/begin CHARACTERISTIC Pedals_Susp_Sensors.Pedals_Susp_Sensors_P.Ctemuelles_Gain_g "" VALUE 0x0 SCALAR_FLOAT64_IEEE 3.5e+305 Pedals_Susp_Sensors_CM_double -1.7e+308 1.7e+308 DISPLAY_IDENTIFIER Pedals_Susp_Sensors.Suspension_RR_Data_Conv.Cte_muelles.Gain /end CHARACTERISTIC
/begin CHARACTERISTIC Pedals_Susp_Sensors.Pedals_Susp_Sensors_P.Ltotal_Gain "" VALUE 0x0 SCALAR_FLOAT64_IEEE 3.5e+305 Pedals_Susp_Sensors_CM_double -1.7e+308 1.7e+308 DISPLAY_IDENTIFIER Pedals_Susp_Sensors.Suspension_FL_Data_Conv.Ltotal.Gain /end CHARACTERISTIC
/begin CHARACTERISTIC Pedals_Susp_Sensors.Pedals_Susp_Sensors_P.Ltotal_Gain_c "" VALUE 0x0 SCALAR_FLOAT64_IEEE 3.5e+305 Pedals_Susp_Sensors_CM_double -1.7e+308 1.7e+308 DISPLAY_IDENTIFIER Pedals_Susp_Sensors.Suspension_FR_Data_Conv.Ltotal.Gain /end CHARACTERISTIC
/begin CHARACTERISTIC Pedals_Susp_Sensors.Pedals_Susp_Sensors_P.Ltotal_Gain_h "" VALUE 0x0 SCALAR_FLOAT64_IEEE 3.5e+305 Pedals_Susp_Sensors_CM_double -1.7e+308 1.7e+308 DISPLAY_IDENTIFIER Pedals_Susp_Sensors.Suspension_RL_Data_Conv.Ltotal.Gain /end CHARACTERISTIC
/begin CHARACTERISTIC Pedals_Susp_Sensors.Pedals_Susp_Sensors_P.Ltotal_Gain_j "" VALUE 0x0 SCALAR_FLOAT64_IEEE 3.5e+305 Pedals_Susp_Sensors_CM_double -1.7e+308 1.7e+308 DISPLAY_IDENTIFIER Pedals_Susp_Sensors.Suspension_RR_Data_Conv.Ltotal.Gain /end CHARACTERISTIC
/begin CHARACTERISTIC Pedals_Susp_Sensors.Pedals_Susp_Sensors_P.ON_Value "" VALUE 0x0 SCALAR_FLOAT64_IEEE 3.5e+305 Pedals_Susp_Sensors_CM_double -1.7e+308 1.7e+308 DISPLAY_IDENTIFIER Pedals_Susp_Sensors.Brake_Light.Brake_Light_ON.ON.Value /end CHARACTERISTIC
/begin CHARACTERISTIC Pedals_Susp_Sensors.Pedals_Susp_Sensors_P.Off_Value "" VALUE 0x0 SCALAR_FLOAT64_IEEE 3.5e+305 Pedals_Susp_Sensors_CM_double -1.7e+308 1.7e+308 DISPLAY_IDENTIFIER Pedals_Susp_Sensors.Brake_Light.Brake_Light_OFF.Off.Value /end CHARACTERISTIC
/begin CHARACTERISTIC Pedals_Susp_Sensors.Pedals_Susp_Sensors_P.Zero_Bits_Experimental_Value "" VALUE 0x0 SCALAR_FLOAT64_IEEE 3.5e+305 Pedals_Susp_Sensors_CM_double -1.7e+308 1.7e+308 DISPLAY_IDENTIFIER Pedals_Susp_Sensors.Zero_Bits_Experimental.Value /end CHARACTERISTIC
/begin CHARACTERISTIC Pedals_Susp_Sensors.Pedals_Susp_Sensors_P.bitsmax_Value "" VALUE 0x0 SCALAR_FLOAT64_IEEE 3.5e+305 Pedals_Susp_Sensors_CM_double -1.7e+308 1.7e+308 DISPLAY_IDENTIFIER Pedals_Susp_Sensors.Suspension_FL_Data_Conv.bitsmax.Value /end CHARACTERISTIC
/begin CHARACTERISTIC Pedals_Susp_Sensors.Pedals_Susp_Sensors_P.bitsmax_Value_a "" VALUE 0x0 SCALAR_FLOAT64_IEEE 3.5e+305 Pedals_Susp_Sensors_CM_double -1.7e+308 1.7e+308 DISPLAY_IDENTIFIER Pedals_Susp_Sensors.Suspension_RL_Data_Conv.bitsmax.Value /end CHARACTERISTIC
/begin CHARACTERISTIC Pedals_Susp_Sensors.Pedals_Susp_Sensors_P.bitsmax_Value_f "" VALUE 0x0 SCALAR_FLOAT64_IEEE 3.5e+305 Pedals_Susp_Sensors_CM_double -1.7e+308 1.7e+308 DISPLAY_IDENTIFIER Pedals_Susp_Sensors.Suspension_RR_Data_Conv.bitsmax.Value /end CHARACTERISTIC
/begin CHARACTERISTIC Pedals_Susp_Sensors.Pedals_Susp_Sensors_P.bitsmax_Value_m "" VALUE 0x0 SCALAR_FLOAT64_IEEE 3.5e+305 Pedals_Susp_Sensors_CM_double -1.7e+308 1.7e+308 DISPLAY_IDENTIFIER Pedals_Susp_Sensors.Suspension_FR_Data_Conv.bitsmax.Value /end CHARACTERISTIC
/begin CHARACTERISTIC Pedals_Susp_Sensors.Pedals_Susp_Sensors_P.max_Value "" VALUE 0x0 SCALAR_FLOAT64_IEEE 3.5e+305 Pedals_Susp_Sensors_CM_double -1.7e+308 1.7e+308 DISPLAY_IDENTIFIER Pedals_Susp_Sensors.BRS_Data_Conv.max.Value /end CHARACTERISTIC
/begin CHARACTERISTIC Pedals_Susp_Sensors.Pedals_Susp_Sensors_P.max_Value_a "" VALUE 0x0 SCALAR_FLOAT64_IEEE 3.5e+305 Pedals_Susp_Sensors_CM_double -1.7e+308 1.7e+308 DISPLAY_IDENTIFIER Pedals_Susp_Sensors.APPS2_Data_Conv.max.Value /end CHARACTERISTIC
/begin CHARACTERISTIC Pedals_Susp_Sensors.Pedals_Susp_Sensors_P.max_Value_f "" VALUE 0x0 SCALAR_FLOAT64_IEEE 3.5e+305 Pedals_Susp_Sensors_CM_double -1.7e+308 1.7e+308 DISPLAY_IDENTIFIER Pedals_Susp_Sensors.APPS1_Data_Conv.max.Value /end CHARACTERISTIC
/begin CHARACTERISTIC Pedals_Susp_Sensors.Pedals_Susp_Sensors_P.min_Value "" VALUE 0x0 SCALAR_FLOAT64_IEEE 3.5e+305 Pedals_Susp_Sensors_CM_double -1.7e+308 1.7e+308 DISPLAY_IDENTIFIER Pedals_Susp_Sensors.BRS_Data_Conv.min.Value /end CHARACTERISTIC
/begin CHARACTERISTIC Pedals_Susp_Sensors.Pedals_Susp_Sensors_P.min_Value_a "" VALUE 0x0 SCALAR_FLOAT64_IEEE 3.5e+305 Pedals_Susp_Sensors_CM_double -1.7e+308 1.7e+308 DISPLAY_IDENTIFIER Pedals_Susp_Sensors.APPS1_Data_Conv.min.Value /end CHARACTERISTIC
/begin CHARACTERISTIC Pedals_Susp_Sensors.Pedals_Susp_Sensors_P.min_Value_g "" VALUE 0x0 SCALAR_FLOAT64_IEEE 3.5e+305 Pedals_Susp_Sensors_CM_double -1.7e+308 1.7e+308 DISPLAY_IDENTIFIER Pedals_Susp_Sensors.APPS2_Data_Conv.min.Value /end CHARACTERISTIC
/begin CHARACTERISTIC Accel_Data.Accel_Data_P.CycleTime_Gain "" VALUE 0x0 SCALAR_FLOAT64_IEEE 3.5e+305 Accel_Data_CM_double -1.7e+308 1.7e+308 DISPLAY_IDENTIFIER Accel_Data.Gyro_Data_Conversion_F_Z.Cycle_Time.Gain /end CHARACTERISTIC
/begin CHARACTERISTIC Accel_Data.Accel_Data_P.CycleTime_Gain_h "" VALUE 0x0 SCALAR_FLOAT64_IEEE 3.5e+305 Accel_Data_CM_double -1.7e+308 1.7e+308 DISPLAY_IDENTIFIER Accel_Data.Gyro_Data_Conversion_R_Z.Cycle_Time.Gain /end CHARACTERISTIC
/begin CHARACTERISTIC Accel_Data.Accel_Data_P.DataStoreMemory_InitialValue "" VALUE 0x0 SCALAR_FLOAT64_IEEE 3.5e+305 Accel_Data_CM_double -1.7e+308 1.7e+308 DISPLAY_IDENTIFIER Accel_Data.Gyro_Data_Conversion_F_Z.Data_Store_Memory.InitialValue /end CHARACTERISTIC
/begin CHARACTERISTIC Accel_Data.Accel_Data_P.DataStoreMemory_InitialValue_m "" VALUE 0x0 SCALAR_FLOAT64_IEEE 3.5e+305 Accel_Data_CM_double -1.7e+308 1.7e+308 DISPLAY_IDENTIFIER Accel_Data.Gyro_Data_Conversion_R_Z.Data_Store_Memory.InitialValue /end CHARACTERISTIC
/begin CHARACTERISTIC Accel_Data.Accel_Data_P.ExperimentalOffset_Value "" VALUE 0x0 SCALAR_FLOAT64_IEEE 3.5e+305 Accel_Data_CM_double -1.7e+308 1.7e+308 DISPLAY_IDENTIFIER Accel_Data.Gyro_Data_Conversion_F_Z.Experimental_Offset.Value /end CHARACTERISTIC
/begin CHARACTERISTIC Accel_Data.Accel_Data_P.ExperimentalOffset_Value_e "" VALUE 0x0 SCALAR_FLOAT64_IEEE 3.5e+305 Accel_Data_CM_double -1.7e+308 1.7e+308 DISPLAY_IDENTIFIER Accel_Data.Gyro_Data_Conversion_R_Z.Experimental_Offset.Value /end CHARACTERISTIC
/begin CHARACTERISTIC Accel_Data.Accel_Data_P.Gain2_Gain "" VALUE 0x0 SCALAR_FLOAT64_IEEE 3.5e+305 Accel_Data_CM_double -1.7e+308 1.7e+308 DISPLAY_IDENTIFIER Accel_Data.Gain2.Gain /end CHARACTERISTIC
/begin CHARACTERISTIC Accel_Data.Accel_Data_P.Gain4_Gain "" VALUE 0x0 SCALAR_FLOAT64_IEEE 3.5e+305 Accel_Data_CM_double -1.7e+308 1.7e+308 DISPLAY_IDENTIFIER Accel_Data.Gain4.Gain /end CHARACTERISTIC
/begin CHARACTERISTIC Accel_Data.Accel_Data_P.RpsLSB_Value "" VALUE 0x0 SCALAR_FLOAT64_IEEE 3.5e+305 Accel_Data_CM_double -1.7e+308 1.7e+308 DISPLAY_IDENTIFIER Accel_Data.Gyro_Data_Conversion_R_Z.Rps__LSB.Value /end CHARACTERISTIC
/begin CHARACTERISTIC Accel_Data.Accel_Data_P.sbit_Value "" VALUE 0x0 SCALAR_FLOAT64_IEEE 3.5e+305 Accel_Data_CM_double -1.7e+308 1.7e+308 DISPLAY_IDENTIFIER Accel_Data.Gyro_Data_Conversion_F_Z.___s___bit.Value /end CHARACTERISTIC
/begin CHARACTERISTIC ETCSignals.ES900.ES910.CAN1.CAN1.AP_ETAS_DashData1.Speed_calibrate "" VALUE 0x0 STANDARD_VALUE_R64 0.0 LINEAR_FUNCTION_M1_T0_U1 -128 127 MAX_REFRESH 6 1 /end CHARACTERISTIC
/begin CHARACTERISTIC ETCSignals.ES900.ES910.CAN1.CAN1.AP_ETAS_DashData1.Precharge_Voltage_calibrate "" VALUE 0x0 STANDARD_VALUE_R64 0.0 LINEAR_FUNCTION_M1_T0_U1 0 655.35 MAX_REFRESH 6 1 /end CHARACTERISTIC
/begin CHARACTERISTIC ETCSignals.ES900.ES910.CAN1.CAN1.AP_ETAS_DashData1.Precharge_Percentage_calibrate "" VALUE 0x0 STANDARD_VALUE_R64 0.0 LINEAR_FUNCTION_M1_T0_U1 0 100 MAX_REFRESH 6 1 /end CHARACTERISTIC
/begin CHARACTERISTIC ETCSignals.ES900.ES910.CAN1.CAN1.AP_ETAS_DashData1.LVbattery_Voltage_calibrate "" VALUE 0x0 STANDARD_VALUE_R64 0.0 LINEAR_FUNCTION_M1_T0_U1 0 32.7675 MAX_REFRESH 6 1 /end CHARACTERISTIC
/begin CHARACTERISTIC ETCSignals.ES900.ES910.CAN1.CAN1.AP_ETAS_DashData1.LVbattery_SOC_calibrate "" VALUE 0x0 STANDARD_VALUE_R64 0.0 LINEAR_FUNCTION_M1_T0_U1 0 100 MAX_REFRESH 6 1 /end CHARACTERISTIC
/begin CHARACTERISTIC ETCSignals.ES900.ES910.CAN1.CAN1.AP_ETAS_VDCParams2.VDC_Cte_SKF_calibrate "" VALUE 0x0 STANDARD_VALUE_R64 0.0 LINEAR_FUNCTION_M1_T0_U1 0 1 MAX_REFRESH 6 1 /end CHARACTERISTIC
/begin CHARACTERISTIC ETCSignals.ES900.ES910.CAN1.CAN1.AP_ETAS_VDCParams2.VDC_Cte_CKF_calibrate "" VALUE 0x0 STANDARD_VALUE_R64 0.0 LINEAR_FUNCTION_M1_T0_U1 0 1 MAX_REFRESH 6 1 /end CHARACTERISTIC
/begin CHARACTERISTIC ETCSignals.ES900.ES910.CAN1.CAN1.AP_ETAS_VDCParams.VDC_CKF_Initial_calibrate "" VALUE 0x0 STANDARD_VALUE_R64 0.0 LINEAR_FUNCTION_M1_T0_U1 0 1 MAX_REFRESH 6 1 /end CHARACTERISTIC
/begin CHARACTERISTIC ETCSignals.ES900.ES910.CAN1.CAN1.AP_ETAS_VDCParams.VDC_SKF_Initial_calibrate "" VALUE 0x0 STANDARD_VALUE_R64 0.0 LINEAR_FUNCTION_M1_T0_U1 0 1 MAX_REFRESH 6 1 /end CHARACTERISTIC
/begin CHARACTERISTIC ETCSignals.ES900.ES910.CAN1.CAN1.AP_ETAS_VDCParams.VDC_Power_Limit_calibrate "" VALUE 0x0 STANDARD_VALUE_R64 0.0 LINEAR_FUNCTION_M1_T0_U1 0 85 MAX_REFRESH 6 1 /end CHARACTERISTIC
/begin CHARACTERISTIC ETCSignals.ES900.ES910.CAN1.CAN1.AP_ETAS_VDCParams.VDC_Max_Regenerative_Torque_calibrate "" VALUE 0x0 STANDARD_VALUE_R64 0.0 LINEAR_FUNCTION_M1_T0_U1 0 10.2 MAX_REFRESH 6 1 /end CHARACTERISTIC
/begin CHARACTERISTIC ETCSignals.ES900.ES910.CAN1.CAN1.AP_ETAS_VDCParams.VDC_K_Reduction_Temperature_calibrate "" VALUE 0x0 STANDARD_VALUE_R64 0.0 LINEAR_FUNCTION_M1_T0_U1 0 1 MAX_REFRESH 6 1 /end CHARACTERISTIC
/begin CHARACTERISTIC ETCSignals.ES900.ES910.CAN1.CAN1.AP_ETAS_VDCParams.VDC_K_Reduction_P_calibrate "" VALUE 0x0 STANDARD_VALUE_R64 0.0 LINEAR_FUNCTION_M1_T0_U1 0 1 MAX_REFRESH 6 1 /end CHARACTERISTIC
/begin CHARACTERISTIC ETCSignals.ES900.ES910.CAN1.CAN1.AP_ETAS_VDCParams.VDC_APPS_Sat_Up_calibrate "" VALUE 0x0 STANDARD_VALUE_R64 0.0 LINEAR_FUNCTION_M1_T0_U1 0 1 MAX_REFRESH 6 1 /end CHARACTERISTIC
/begin CHARACTERISTIC ETCSignals.ES900.ES910.CAN1.CAN1.AP_ETAS_VDCParams.VDC_APPS_Sat_Down_calibrate "" VALUE 0x0 STANDARD_VALUE_R64 0.0 LINEAR_FUNCTION_M1_T0_U1 0 1 MAX_REFRESH 6 1 /end CHARACTERISTIC
/begin CHARACTERISTIC ETCSignals.ES900.ES910.CAN1.CAN1.AP_ETAS_Inverter_R_Rx.Inverter_R_RegID_calibrate "" VALUE 0x0 STANDARD_VALUE_R64 0.0 LINEAR_FUNCTION_M1_T0_U1 0 255 MAX_REFRESH 6 1 /end CHARACTERISTIC
/begin CHARACTERISTIC ETCSignals.ES900.ES910.CAN1.CAN1.AP_ETAS_Inverter_R_Rx.Inverter_R_b7tob0_calibrate "" VALUE 0x0 STANDARD_VALUE_R64 0.0 LINEAR_FUNCTION_M1_T0_U1 0 255 MAX_REFRESH 6 1 /end CHARACTERISTIC
/begin CHARACTERISTIC ETCSignals.ES900.ES910.CAN1.CAN1.AP_ETAS_Inverter_R_Rx.Inverter_R_b15tob8_calibrate "" VALUE 0x0 STANDARD_VALUE_R64 0.0 LINEAR_FUNCTION_M1_T0_U1 0 255 MAX_REFRESH 6 1 /end CHARACTERISTIC
/begin CHARACTERISTIC ETCSignals.ES900.ES910.CAN1.CAN1.AP_ETAS_Inverter_L_Rx.Inverter_L_RegID_calibrate "" VALUE 0x0 STANDARD_VALUE_R64 0.0 LINEAR_FUNCTION_M1_T0_U1 0 255 MAX_REFRESH 6 1 /end CHARACTERISTIC
/begin CHARACTERISTIC ETCSignals.ES900.ES910.CAN1.CAN1.AP_ETAS_Inverter_L_Rx.Inverter_L_b7tob0_calibrate "" VALUE 0x0 STANDARD_VALUE_R64 0.0 LINEAR_FUNCTION_M1_T0_U1 0 255 MAX_REFRESH 6 1 /end CHARACTERISTIC
/begin CHARACTERISTIC ETCSignals.ES900.ES910.CAN1.CAN1.AP_ETAS_Inverter_L_Rx.Inverter_L_b15tob8_calibrate "" VALUE 0x0 STANDARD_VALUE_R64 0.0 LINEAR_FUNCTION_M1_T0_U1 0 255 MAX_REFRESH 6 1 /end CHARACTERISTIC
/begin CHARACTERISTIC ETCSignals.ES900.ES910.CAN1.CAN1.AP_ETAS_CarState.Car_State_calibrate "" VALUE 0x0 STANDARD_VALUE_R64 0.0 LINEAR_FUNCTION_M1_T0_U1 0 255 MAX_REFRESH 6 1 /end CHARACTERISTIC
/begin CHARACTERISTIC ETCSignals.ES900.ES910.CAN1.CAN1.AP_ETAS_AIRsRequest.AIRs_Request_calibrate "" VALUE 0x0 STANDARD_VALUE_R64 0.0 LINEAR_FUNCTION_M1_T0_U1 0 255 MAX_REFRESH 6 1 /end CHARACTERISTIC
/begin CHARACTERISTIC ETCSignals.ES900.ES910.CAN1.CAN1.AP_ETAS_AnalogicControl.BrakeLight_Control_calibrate "" VALUE 0x0 STANDARD_VALUE_R64 0.0 LINEAR_FUNCTION_M1_T0_U1 0 1 MAX_REFRESH 6 1 /end CHARACTERISTIC
/begin CHARACTERISTIC ETCSignals.ES900.ES910.CAN1.CAN1.AP_ETAS_AnalogicControl.Pumps_Control_calibrate "" VALUE 0x0 STANDARD_VALUE_R64 0.0 LINEAR_FUNCTION_M1_T0_U1 0 1 MAX_REFRESH 6 1 /end CHARACTERISTIC
/begin CHARACTERISTIC ETCSignals.ES900.ES910.CAN1.CAN1.MEAS_ETAS_InternalVars.CriticalDisconnection_calibrate "" VALUE 0x0 STANDARD_VALUE_R64 0.0 LINEAR_FUNCTION_M1_T0_U1 0 1 MAX_REFRESH 6 1 /end CHARACTERISTIC
/begin CHARACTERISTIC ETCSignals.ES900.ES910.CAN1.CAN1.MEAS_ETAS_InternalVars.CurrentPathDisconnectionFlag_calibrate "" VALUE 0x0 STANDARD_VALUE_R64 0.0 LINEAR_FUNCTION_M1_T0_U1 0 1 MAX_REFRESH 6 1 /end CHARACTERISTIC
/begin CHARACTERISTIC ETCSignals.ES900.ES910.CAN1.CAN1.MEAS_ETAS_InternalVars.Car_OK_calibrate "" VALUE 0x0 STANDARD_VALUE_R64 0.0 LINEAR_FUNCTION_M1_T0_U1 0 1 MAX_REFRESH 6 1 /end CHARACTERISTIC
/begin CHARACTERISTIC ETCSignals.ES900.ES910.CAN1.CAN1.MEAS_ETAS_InternalVars.Power_calibrate "" VALUE 0x0 STANDARD_VALUE_R64 0.0 LINEAR_FUNCTION_M1_T0_U1 0 255 MAX_REFRESH 6 1 /end CHARACTERISTIC
/begin CHARACTERISTIC ETCSignals.ES900.ES910.CAN1.CAN1.MEAS_ETAS_InternalVars.Torque_OK_calibrate "" VALUE 0x0 STANDARD_VALUE_R64 0.0 LINEAR_FUNCTION_M1_T0_U1 0 1 MAX_REFRESH 6 1 /end CHARACTERISTIC
/begin CHARACTERISTIC ETCSignals.ES900.ES910.CAN1.CAN1.MEAS_ETAS_InternalVars.TV_Mode_calibrate "" VALUE 0x0 STANDARD_VALUE_R64 0.0 LINEAR_FUNCTION_M1_T0_U1 0 7 MAX_REFRESH 6 1 /end CHARACTERISTIC
/begin CHARACTERISTIC ETCSignals.ES900.ES910.CAN1.CAN1.MEAS_ETAS_InternalVars.Critical_Signal_Disconnection_calibrate "" VALUE 0x0 STANDARD_VALUE_R64 0.0 LINEAR_FUNCTION_M1_T0_U1 0 1 MAX_REFRESH 6 1 /end CHARACTERISTIC
/begin CHARACTERISTIC ETCSignals.ES900.ES910.CAN1.CAN1.MEAS_ETAS_InternalVars.Critical_CAN_Disconnection_calibrate "" VALUE 0x0 STANDARD_VALUE_R64 0.0 LINEAR_FUNCTION_M1_T0_U1 0 1 MAX_REFRESH 6 1 /end CHARACTERISTIC
/begin CHARACTERISTIC ETCSignals.ES900.ES910.CAN1.CAN1.MEAS_ETAS_InternalVars.Brake_Implausibility_calibrate "" VALUE 0x0 STANDARD_VALUE_R64 0.0 LINEAR_FUNCTION_M1_T0_U1 0 1 MAX_REFRESH 6 1 /end CHARACTERISTIC
/begin CHARACTERISTIC ETCSignals.ES900.ES910.CAN1.CAN1.MEAS_ETAS_InternalVars.APPS_Implausibility_calibrate "" VALUE 0x0 STANDARD_VALUE_R64 0.0 LINEAR_FUNCTION_M1_T0_U1 0 1 MAX_REFRESH 6 1 /end CHARACTERISTIC
/begin CHARACTERISTIC ETCSignals.ES900.ES910.CAN1.CAN1.NM_ETAS_Disconnections.Disconnection_LV_Derivation_calibrate "" VALUE 0x0 STANDARD_VALUE_R64 0.0 LINEAR_FUNCTION_M1_T0_U1 0 1 MAX_REFRESH 6 1 /end CHARACTERISTIC
/begin CHARACTERISTIC ETCSignals.ES900.ES910.CAN1.CAN1.NM_ETAS_Disconnections.Disconnection_DashBoard_calibrate "" VALUE 0x0 STANDARD_VALUE_R64 0.0 LINEAR_FUNCTION_M1_T0_U1 0 1 MAX_REFRESH 6 1 /end CHARACTERISTIC
/begin CHARACTERISTIC ETCSignals.ES900.ES910.CAN1.CAN1.NM_ETAS_Disconnections.Disconnection_BMS_calibrate "" VALUE 0x0 STANDARD_VALUE_R64 0.0 LINEAR_FUNCTION_M1_T0_U1 0 1 MAX_REFRESH 6 1 /end CHARACTERISTIC
/begin CHARACTERISTIC ETCSignals.ES900.ES910.CAN1.CAN1.NM_ETAS_Disconnections.Disconnection_Gyroscope_F_calibrate "" VALUE 0x0 STANDARD_VALUE_R64 0.0 LINEAR_FUNCTION_M1_T0_U1 0 1 MAX_REFRESH 6 1 /end CHARACTERISTIC
/begin CHARACTERISTIC ETCSignals.ES900.ES910.CAN1.CAN1.NM_ETAS_Disconnections.Disconnection_Gyroscope_R_calibrate "" VALUE 0x0 STANDARD_VALUE_R64 0.0 LINEAR_FUNCTION_M1_T0_U1 0 1 MAX_REFRESH 6 1 /end CHARACTERISTIC
/begin CHARACTERISTIC ETCSignals.ES900.ES910.CAN1.CAN1.NM_ETAS_Disconnections.Disconnection_Accel_F_calibrate "" VALUE 0x0 STANDARD_VALUE_R64 0.0 LINEAR_FUNCTION_M1_T0_U1 0 1 MAX_REFRESH 6 1 /end CHARACTERISTIC
/begin CHARACTERISTIC ETCSignals.ES900.ES910.CAN1.CAN1.NM_ETAS_Disconnections.Disconnection_Accel_R_calibrate "" VALUE 0x0 STANDARD_VALUE_R64 0.0 LINEAR_FUNCTION_M1_T0_U1 0 1 MAX_REFRESH 6 1 /end CHARACTERISTIC
/begin CHARACTERISTIC ETCSignals.ES900.ES910.CAN1.CAN1.NM_ETAS_Disconnections.Disconnection_SteeringSensor_calibrate "" VALUE 0x0 STANDARD_VALUE_R64 0.0 LINEAR_FUNCTION_M1_T0_U1 0 1 MAX_REFRESH 6 1 /end CHARACTERISTIC
/begin CHARACTERISTIC ETCSignals.ES900.ES910.CAN1.CAN1.NM_ETAS_Disconnections.Disconnection_Susp_R_R_calibrate "" VALUE 0x0 STANDARD_VALUE_R64 0.0 LINEAR_FUNCTION_M1_T0_U1 0 1 MAX_REFRESH 6 1 /end CHARACTERISTIC
/begin CHARACTERISTIC ETCSignals.ES900.ES910.CAN1.CAN1.NM_ETAS_Disconnections.Disconnection_Susp_R_L_calibrate "" VALUE 0x0 STANDARD_VALUE_R64 0.0 LINEAR_FUNCTION_M1_T0_U1 0 1 MAX_REFRESH 6 1 /end CHARACTERISTIC
/begin CHARACTERISTIC ETCSignals.ES900.ES910.CAN1.CAN1.NM_ETAS_Disconnections.Disconnection_Susp_F_R_calibrate "" VALUE 0x0 STANDARD_VALUE_R64 0.0 LINEAR_FUNCTION_M1_T0_U1 0 1 MAX_REFRESH 6 1 /end CHARACTERISTIC
/begin CHARACTERISTIC ETCSignals.ES900.ES910.CAN1.CAN1.NM_ETAS_Disconnections.Disconnection_Susp_F_L_calibrate "" VALUE 0x0 STANDARD_VALUE_R64 0.0 LINEAR_FUNCTION_M1_T0_U1 0 1 MAX_REFRESH 6 1 /end CHARACTERISTIC
/begin CHARACTERISTIC ETCSignals.ES900.ES910.CAN1.CAN1.NM_ETAS_Disconnections.Disconnection_Brake_Sensor_calibrate "" VALUE 0x0 STANDARD_VALUE_R64 0.0 LINEAR_FUNCTION_M1_T0_U1 0 1 MAX_REFRESH 6 1 /end CHARACTERISTIC
/begin CHARACTERISTIC ETCSignals.ES900.ES910.CAN1.CAN1.NM_ETAS_Disconnections.Disconnection_APPS2_calibrate "" VALUE 0x0 STANDARD_VALUE_R64 0.0 LINEAR_FUNCTION_M1_T0_U1 0 1 MAX_REFRESH 6 1 /end CHARACTERISTIC
/begin CHARACTERISTIC ETCSignals.ES900.ES910.CAN1.CAN1.NM_ETAS_Disconnections.Disconnection_APPS1_calibrate "" VALUE 0x0 STANDARD_VALUE_R64 0.0 LINEAR_FUNCTION_M1_T0_U1 0 1 MAX_REFRESH 6 1 /end CHARACTERISTIC
/begin CHARACTERISTIC ETCSignals.ES900.ES910.CAN1.CAN1.NM_ETAS_Disconnections.Disconnection_ADCAN_calibrate "" VALUE 0x0 STANDARD_VALUE_R64 0.0 LINEAR_FUNCTION_M1_T0_U1 0 1 MAX_REFRESH 6 1 /end CHARACTERISTIC
/begin CHARACTERISTIC ETCSignals.ES900.ES910.CAN1.CAN1.NM_ETAS_Disconnections.Disconnection_Shutdown_calibrate "" VALUE 0x0 STANDARD_VALUE_R64 0.0 LINEAR_FUNCTION_M1_T0_U1 0 1 MAX_REFRESH 6 1 /end CHARACTERISTIC
/begin CHARACTERISTIC ETCSignals.ES900.ES910.CAN1.CAN1.AP_ETAS_DashData2.SteeringSensor_Value_calibrate "" VALUE 0x0 STANDARD_VALUE_R64 0.0 LINEAR_FUNCTION_M1_T0_U1 -128 127 MAX_REFRESH 6 1 /end CHARACTERISTIC
/begin CHARACTERISTIC ETCSignals.ES900.ES910.CAN1.CAN1.AP_ETAS_DashData2.SKF_actual_calibrate "" VALUE 0x0 STANDARD_VALUE_R64 0.0 LINEAR_FUNCTION_M1_T0_U1 0 25.5 MAX_REFRESH 6 1 /end CHARACTERISTIC
/begin CHARACTERISTIC ETCSignals.ES900.ES910.CAN1.CAN1.AP_ETAS_DashData2.CKF_actual_calibrate "" VALUE 0x0 STANDARD_VALUE_R64 0.0 LINEAR_FUNCTION_M1_T0_U1 0 25.5 MAX_REFRESH 6 1 /end CHARACTERISTIC
/begin CHARACTERISTIC ETCSignals.ES900.ES910.CAN1.CAN1.AP_ETAS_DashData2.BrakeSensor_Value_calibrate "" VALUE 0x0 STANDARD_VALUE_R64 0.0 LINEAR_FUNCTION_M1_T0_U1 0 1 MAX_REFRESH 6 1 /end CHARACTERISTIC
/begin CHARACTERISTIC ETCSignals.ES900.ES910.CAN1.CAN1.AP_ETAS_DashData2.APPS2_Value_calibrate "" VALUE 0x0 STANDARD_VALUE_R64 0.0 LINEAR_FUNCTION_M1_T0_U1 0 1 MAX_REFRESH 6 1 /end CHARACTERISTIC
/begin CHARACTERISTIC ETCSignals.ES900.ES910.CAN1.CAN1.AP_ETAS_DashData2.APPS1_Value_calibrate "" VALUE 0x0 STANDARD_VALUE_R64 0.0 LINEAR_FUNCTION_M1_T0_U1 0 1 MAX_REFRESH 6 1 /end CHARACTERISTIC
/begin CHARACTERISTIC ETCSignals.ES900.ES910.CAN1.CAN1.AP_ETAS_Synchronism.Sync_CAN1_calibrate "" VALUE 0x0 STANDARD_VALUE_R64 0.0 LINEAR_FUNCTION_M1_T0_U1 0 255 MAX_REFRESH 6 1 /end CHARACTERISTIC
/begin CHARACTERISTIC ETCSignals.ES900.ES910.CAN2.CAN2.MEAS_ETAS_Inverter_R_Data.Inv_R_TempMotor_calibrate "" VALUE 0x0 STANDARD_VALUE_R64 0.0 LINEAR_FUNCTION_M1_T0_U1 -28 227 MAX_REFRESH 6 1 /end CHARACTERISTIC
/begin CHARACTERISTIC ETCSignals.ES900.ES910.CAN2.CAN2.MEAS_ETAS_Inverter_R_Data.Inv_R_TempIGBT_calibrate "" VALUE 0x0 STANDARD_VALUE_R64 0.0 LINEAR_FUNCTION_M1_T0_U1 -28 227 MAX_REFRESH 6 1 /end CHARACTERISTIC
/begin CHARACTERISTIC ETCSignals.ES900.ES910.CAN2.CAN2.MEAS_ETAS_Inverter_R_Data.Inv_R_Speed_calibrate "" VALUE 0x0 STANDARD_VALUE_R64 0.0 LINEAR_FUNCTION_M1_T0_U1 -5120 5080 MAX_REFRESH 6 1 /end CHARACTERISTIC
/begin CHARACTERISTIC ETCSignals.ES900.ES910.CAN2.CAN2.MEAS_ETAS_Inverter_R_Data.Inv_R_Iq_calibrate "" VALUE 0x0 STANDARD_VALUE_R64 0.0 LINEAR_FUNCTION_M1_T0_U1 -320 317.5 MAX_REFRESH 6 1 /end CHARACTERISTIC
/begin CHARACTERISTIC ETCSignals.ES900.ES910.CAN2.CAN2.MEAS_ETAS_Inverter_R_Data.Inv_R_Icommand_calibrate "" VALUE 0x0 STANDARD_VALUE_R64 0.0 LINEAR_FUNCTION_M1_T0_U1 -320 317.5 MAX_REFRESH 6 1 /end CHARACTERISTIC
/begin CHARACTERISTIC ETCSignals.ES900.ES910.CAN2.CAN2.MEAS_ETAS_Inverter_R_Data.Inv_R_Iactual_calibrate "" VALUE 0x0 STANDARD_VALUE_R64 0.0 LINEAR_FUNCTION_M1_T0_U1 -320 317.5 MAX_REFRESH 6 1 /end CHARACTERISTIC
/begin CHARACTERISTIC ETCSignals.ES900.ES910.CAN2.CAN2.MEAS_ETAS_Inverter_L_Data.Inv_L_TempMotor_calibrate "" VALUE 0x0 STANDARD_VALUE_R64 0.0 LINEAR_FUNCTION_M1_T0_U1 -28 227 MAX_REFRESH 6 1 /end CHARACTERISTIC
/begin CHARACTERISTIC ETCSignals.ES900.ES910.CAN2.CAN2.MEAS_ETAS_Inverter_L_Data.Inv_L_TempIGBT_calibrate "" VALUE 0x0 STANDARD_VALUE_R64 0.0 LINEAR_FUNCTION_M1_T0_U1 -28 227 MAX_REFRESH 6 1 /end CHARACTERISTIC
/begin CHARACTERISTIC ETCSignals.ES900.ES910.CAN2.CAN2.MEAS_ETAS_Inverter_L_Data.Inv_L_Speed_calibrate "" VALUE 0x0 STANDARD_VALUE_R64 0.0 LINEAR_FUNCTION_M1_T0_U1 -5120 5080 MAX_REFRESH 6 1 /end CHARACTERISTIC
/begin CHARACTERISTIC ETCSignals.ES900.ES910.CAN2.CAN2.MEAS_ETAS_Inverter_L_Data.Inv_L_Iq_calibrate "" VALUE 0x0 STANDARD_VALUE_R64 0.0 LINEAR_FUNCTION_M1_T0_U1 -320 317.5 MAX_REFRESH 6 1 /end CHARACTERISTIC
/begin CHARACTERISTIC ETCSignals.ES900.ES910.CAN2.CAN2.MEAS_ETAS_Inverter_L_Data.Inv_L_Icommand_calibrate "" VALUE 0x0 STANDARD_VALUE_R64 0.0 LINEAR_FUNCTION_M1_T0_U1 -320 317.5 MAX_REFRESH 6 1 /end CHARACTERISTIC
/begin CHARACTERISTIC ETCSignals.ES900.ES910.CAN2.CAN2.MEAS_ETAS_Inverter_L_Data.Inv_L_Iactual_calibrate "" VALUE 0x0 STANDARD_VALUE_R64 0.0 LINEAR_FUNCTION_M1_T0_U1 -320 317.5 MAX_REFRESH 6 1 /end CHARACTERISTIC
/begin CHARACTERISTIC ETCSignals.ES900.ES910.CAN2.CAN2.MEAS_ETAS_VDCdata6.SUSP_F_R_calibrate "" VALUE 0x0 STANDARD_VALUE_R64 0.0 LINEAR_FUNCTION_M1_T0_U1 -327.68 327.67 MAX_REFRESH 6 1 /end CHARACTERISTIC
/begin CHARACTERISTIC ETCSignals.ES900.ES910.CAN2.CAN2.MEAS_ETAS_VDCdata6.SUSP_F_L_calibrate "" VALUE 0x0 STANDARD_VALUE_R64 0.0 LINEAR_FUNCTION_M1_T0_U1 -327.68 327.67 MAX_REFRESH 6 1 /end CHARACTERISTIC
/begin CHARACTERISTIC ETCSignals.ES900.ES910.CAN2.CAN2.MEAS_ETAS_VDCdata5.Gyro_F_Z_Deg_calibrate "" VALUE 0x0 STANDARD_VALUE_R64 0.0 LINEAR_FUNCTION_M1_T0_U1 0 393.21 MAX_REFRESH 6 1 /end CHARACTERISTIC
/begin CHARACTERISTIC ETCSignals.ES900.ES910.CAN2.CAN2.MEAS_ETAS_VDCdata5.Accel_F_Z_SI_calibrate "" VALUE 0x0 STANDARD_VALUE_R64 0.0 LINEAR_FUNCTION_M1_T0_U1 -327.68 327.67 MAX_REFRESH 6 1 /end CHARACTERISTIC
/begin CHARACTERISTIC ETCSignals.ES900.ES910.CAN2.CAN2.MEAS_ETAS_VDCdata5.Accel_F_Y_SI_calibrate "" VALUE 0x0 STANDARD_VALUE_R64 0.0 LINEAR_FUNCTION_M1_T0_U1 -327.68 327.67 MAX_REFRESH 6 1 /end CHARACTERISTIC
/begin CHARACTERISTIC ETCSignals.ES900.ES910.CAN2.CAN2.MEAS_ETAS_VDCdata5.Accel_F_X_SI_calibrate "" VALUE 0x0 STANDARD_VALUE_R64 0.0 LINEAR_FUNCTION_M1_T0_U1 -327.68 327.67 MAX_REFRESH 6 1 /end CHARACTERISTIC
/begin CHARACTERISTIC ETCSignals.ES900.ES910.CAN2.CAN2.MEAS_ETAS_VDCdata4.Gyro_R_Z_Deg_calibrate "" VALUE 0x0 STANDARD_VALUE_R64 0.0 LINEAR_FUNCTION_M1_T0_U1 0 393.21 MAX_REFRESH 6 1 /end CHARACTERISTIC
/begin CHARACTERISTIC ETCSignals.ES900.ES910.CAN2.CAN2.MEAS_ETAS_VDCdata4.Accel_R_Z_SI_calibrate "" VALUE 0x0 STANDARD_VALUE_R64 0.0 LINEAR_FUNCTION_M1_T0_U1 -327.68 327.67 MAX_REFRESH 6 1 /end CHARACTERISTIC
/begin CHARACTERISTIC ETCSignals.ES900.ES910.CAN2.CAN2.MEAS_ETAS_VDCdata4.Accel_R_Y_SI_calibrate "" VALUE 0x0 STANDARD_VALUE_R64 0.0 LINEAR_FUNCTION_M1_T0_U1 -327.68 327.67 MAX_REFRESH 6 1 /end CHARACTERISTIC
/begin CHARACTERISTIC ETCSignals.ES900.ES910.CAN2.CAN2.MEAS_ETAS_VDCdata4.Accel_R_X_SI_calibrate "" VALUE 0x0 STANDARD_VALUE_R64 0.0 LINEAR_FUNCTION_M1_T0_U1 -327.68 327.67 MAX_REFRESH 6 1 /end CHARACTERISTIC
/begin CHARACTERISTIC ETCSignals.ES900.ES910.CAN2.CAN2.MEAS_ETAS_VDCdata7.Torque_R_calibrate "" VALUE 0x0 STANDARD_VALUE_R64 0.0 LINEAR_FUNCTION_M1_T0_U1 -254 254 MAX_REFRESH 6 1 /end CHARACTERISTIC
/begin CHARACTERISTIC ETCSignals.ES900.ES910.CAN2.CAN2.MEAS_ETAS_VDCdata7.Torque_L_calibrate "" VALUE 0x0 STANDARD_VALUE_R64 0.0 LINEAR_FUNCTION_M1_T0_U1 -256 254 MAX_REFRESH 6 1 /end CHARACTERISTIC
/begin CHARACTERISTIC ETCSignals.ES900.ES910.CAN2.CAN2.MEAS_ETAS_VDCdata3.Handling_calibrate "" VALUE 0x0 STANDARD_VALUE_R64 0.0 LINEAR_FUNCTION_M1_T0_U1 0 65535 MAX_REFRESH 6 1 /end CHARACTERISTIC
/begin CHARACTERISTIC ETCSignals.ES900.ES910.CAN2.CAN2.MEAS_ETAS_VDCdata3.Dash_Speed_calibrate "" VALUE 0x0 STANDARD_VALUE_R64 0.0 LINEAR_FUNCTION_M1_T0_U1 -32768 32767 MAX_REFRESH 6 1 /end CHARACTERISTIC
/begin CHARACTERISTIC ETCSignals.ES900.ES910.CAN2.CAN2.MEAS_ETAS_VDCdata3.Mass_calibrate "" VALUE 0x0 STANDARD_VALUE_R64 0.0 LINEAR_FUNCTION_M1_T0_U1 0 65535 MAX_REFRESH 6 1 /end CHARACTERISTIC
/begin CHARACTERISTIC ETCSignals.ES900.ES910.CAN2.CAN2.MEAS_ETAS_VDCdata2.Throttle_calibrate "" VALUE 0x0 STANDARD_VALUE_R64 0.0 LINEAR_FUNCTION_M1_T0_U1 0 65535 MAX_REFRESH 6 1 /end CHARACTERISTIC
/begin CHARACTERISTIC ETCSignals.ES900.ES910.CAN2.CAN2.MEAS_ETAS_VDCdata2.Max_Fx_RR_calibrate "" VALUE 0x0 STANDARD_VALUE_R64 0.0 LINEAR_FUNCTION_M1_T0_U1 0 65535 MAX_REFRESH 6 1 /end CHARACTERISTIC
/begin CHARACTERISTIC ETCSignals.ES900.ES910.CAN2.CAN2.MEAS_ETAS_VDCdata2.Max_Fx_RL_calibrate "" VALUE 0x0 STANDARD_VALUE_R64 0.0 LINEAR_FUNCTION_M1_T0_U1 0 65535 MAX_REFRESH 6 1 /end CHARACTERISTIC
/begin COMPU_METHOD Car_State_CM_double "Q = V" RAT_FUNC "%9.6" "NO_PHYSICAL_QTY" COEFFS 0.0 1.0 0.0 0.0 0.0 1.0 /end COMPU_METHOD
/begin COMPU_METHOD Car_State_CM_boolean "Q = V" RAT_FUNC "%9.6" "NO_PHYSICAL_QTY" COEFFS 0.0 1.0 0.0 0.0 0.0 1.0 /end COMPU_METHOD
/begin COMPU_METHOD Disconnections_CM_double "Q = V" RAT_FUNC "%9.6" "NO_PHYSICAL_QTY" COEFFS 0.0 1.0 0.0 0.0 0.0 1.0 /end COMPU_METHOD
/begin COMPU_METHOD Disconnections_CM_uint8 "Q = V" RAT_FUNC "%9.6" "NO_PHYSICAL_QTY" COEFFS 0.0 1.0 0.0 0.0 0.0 1.0 /end COMPU_METHOD
/begin COMPU_METHOD Disconnections_CM_boolean "Q = V" RAT_FUNC "%9.6" "NO_PHYSICAL_QTY" COEFFS 0.0 1.0 0.0 0.0 0.0 1.0 /end COMPU_METHOD
/begin COMPU_METHOD Pedals_Susp_Sensors_CM_double "Q = V" RAT_FUNC "%9.6" "NO_PHYSICAL_QTY" COEFFS 0.0 1.0 0.0 0.0 0.0 1.0 /end COMPU_METHOD
/begin COMPU_METHOD Accel_Data_CM_double "Q = V" RAT_FUNC "%9.6" "NO_PHYSICAL_QTY" COEFFS 0.0 1.0 0.0 0.0 0.0 1.0 /end COMPU_METHOD
/begin COMPU_METHOD LINEAR_FUNCTION_M1_T0_U1 "" RAT_FUNC "%8.4" "" COEFFS 0 1 0 0 0 1 /end COMPU_METHOD
/begin RECORD_LAYOUT SCALAR_FLOAT64_IEEE FNC_VALUES 1 FLOAT64_IEEE COLUMN_DIR DIRECT /end RECORD_LAYOUT
/begin RECORD_LAYOUT STANDARD_VALUE_R64 FNC_VALUES 1 FLOAT64_IEEE COLUMN_DIR DIRECT /end RECORD_LAYOUT
/begin GROUP Car_State "" ROOT
 /begin REF_MEASUREMENT Car_State.Car_State_B.Merge Car_State.Car_State_DW.A Car_State.Car_State_U.AIRs_State Car_State.Car_State_U.Accumulator_Voltage Car_State.Car_State_U.BMSerror_CANDisconnection Car_State.Car_State_U.BMSerror_CurrentSensDisc Car_State.Car_State_U.BMSerror_NTCDisconnection Car_State.Car_State_U.BMSerror_OverTemperature Car_State.Car_State_U.BMSerror_OverVoltage Car_State.Car_State_U.BMSerror_UnderTemperature Car_State.Car_State_U.BMSerror_UnderVoltage Car_State.Car_State_U.Critical_CAN_Disconnection Car_State.Car_State_U.DashPrechargeRequest Car_State.Car_State_U.EnableDrive Car_State.Car_State_U.InvertersMinDCBus Car_State.Car_State_U.InvertersSubscribed Car_State.Car_State_U.Lock Car_State.Car_State_U.Shutdown_BMS Car_State.Car_State_U.Shutdown_BOTS Car_State.Car_State_U.Shutdown_BSPD Car_State.Car_State_U.Shutdown_HVBOX Car_State.Car_State_U.Shutdown_HVD Car_State.Car_State_U.Shutdown_Inertia Car_State.Car_State_U.Shutdown_InverterLIntck Car_State.Car_State_U.Shutdown_InverterRIntck Car_State.Car_State_U.Shutdown_PackageIntck Car_State.Car_State_U.Shutdown_SetaCockpit Car_State.Car_State_U.Shutdown_SetaLeft Car_State.Car_State_U.Shutdown_SetaRight Car_State.Car_State_U.Shutdown_TSMPIntck Car_State.Car_State_U.Shutdown_TSMS Car_State.Car_State_Y.AIRs_Request Car_State.Car_State_Y.Car_OK Car_State.Car_State_Y.Car_State_f Car_State.Car_State_Y.CurrentPathDisconnectionFlag Car_State.Car_State_Y.InvertersAction Car_State.Car_State_Y.PrechargeAssert Car_State.Car_State_Y.Precharge_Percentage Car_State.Car_State_Y.Precharge_Voltage Car_State.Car_State_Y.ShutdownClosed Car_State.Car_State_Y.TorqueEnable Car_State.Car_State_Y.errors /end REF_MEASUREMENT
 /begin REF_CHARACTERISTIC Car_State.Car_State_P.CompareToConstant_const Car_State.Car_State_P.Constant_Value Car_State.Car_State_P.Constant_Value_f Car_State.Car_State_P.Constant_Value_fl Car_State.Car_State_P.Constant_Value_k Car_State.Car_State_P.Constant_Value_kb Car_State.Car_State_P.DataStoreMemory_InitialValue Car_State.Car_State_P.Gain_Gain Car_State.Car_State_P.IfDCBUSnotbits_Gain Car_State.Car_State_P.Merge_InitialOutput Car_State.Car_State_P.Saturation_LowerSat Car_State.Car_State_P.Saturation_UpperSat /end REF_CHARACTERISTIC
 /begin SUB_GROUP Car_State.Car_State_B Car_State.Car_State_DW Car_State.Car_State_U Car_State.Car_State_Y Car_State.Car_State_P /end SUB_GROUP
/end GROUP
/begin GROUP Car_State.Car_State_B "" /begin REF_MEASUREMENT Car_State.Car_State_B.Merge /end REF_MEASUREMENT /end GROUP
/begin GROUP Car_State.Car_State_DW "" /begin REF_MEASUREMENT Car_State.Car_State_DW.A /end REF_MEASUREMENT /end GROUP
/begin GROUP Car_State.Car_State_U ""
 /begin REF_MEASUREMENT Car_State.Car_State_U.AIRs_State Car_State.Car_State_U.Accumulator_Voltage Car_State.Car_State_U.BMSerror_CANDisconnection Car_State.Car_State_U.BMSerror_CurrentSensDisc Car_State.Car_State_U.BMSerror_NTCDisconnection Car_State.Car_State_U.BMSerror_OverTemperature Car_State.Car_State_U.BMSerror_OverVoltage Car_State.Car_State_U.BMSerror_UnderTemperature Car_State.Car_State_U.BMSerror_UnderVoltage Car_State.Car_State_U.Critical_CAN_Disconnection Car_State.Car_State_U.DashPrechargeRequest Car_State.Car_State_U.EnableDrive Car_State.Car_State_U.InvertersMinDCBus Car_State.Car_State_U.InvertersSubscribed Car_State.Car_State_U.Lock Car_State.Car_State_U.Shutdown_BMS Car_State.Car_State_U.Shutdown_BOTS Car_State.Car_State_U.Shutdown_BSPD Car_State.Car_State_U.Shutdown_HVBOX Car_State.Car_State_U.Shutdown_HVD Car_State.Car_State_U.Shutdown_Inertia Car_State.Car_State_U.Shutdown_InverterLIntck Car_State.Car_State_U.Shutdown_InverterRIntck Car_State.Car_State_U.Shutdown_PackageIntck Car_State.Car_State_U.Shutdown_SetaCockpit Car_State.Car_State_U.Shutdown_SetaLeft Car_State.Car_State_U.Shutdown_SetaRight Car_State.Car_State_U.Shutdown_TSMPIntck Car_State.Car_State_U.Shutdown_TSMS /end REF_MEASUREMENT
/end GROUP
/begin GROUP Car_State.Car_State_Y ""
 /begin REF_MEASUREMENT Car_State.Car_State_Y.AIRs_Request Car_State.Car_State_Y.Car_OK Car_State.Car_State_Y.Car_State_f Car_State.Car_State_Y.CurrentPathDisconnectionFlag Car_State.Car_State_Y.InvertersAction Car_State.Car_State_Y.PrechargeAssert Car_State.Car_State_Y.Precharge_Percentage Car_State.Car_State_Y.Precharge_Voltage Car_State.Car_State_Y.ShutdownClosed Car_State.Car_State_Y.TorqueEnable Car_State.Car_State_Y.errors /end REF_MEASUREMENT
/end GROUP
/begin GROUP Car_State.Car_State_P ""
 /begin REF_CHARACTERISTIC Car_State.Car_State_P.CompareToConstant_const Car_State.Car_State_P.Constant_Value Car_State.Car_State_P.Constant_Value_f Car_State.Car_State_P.Constant_Value_fl Car_State.Car_State_P.Constant_Value_k Car_State.Car_State_P.Constant_Value_kb Car_State.Car_State_P.DataStoreMemory_InitialValue Car_State.Car_State_P.Gain_Gain Car_State.Car_State_P.IfDCBUSnotbits_Gain Car_State.Car_State_P.Merge_InitialOutput Car_State.Car_State_P.Saturation_LowerSat Car_State.Car_State_P.Saturation_UpperSat /end REF_CHARACTERISTIC
/end GROUP
/begin GROUP Disconnections "" ROOT
 /begin REF_MEASUREMENT Disconnections.Disconnections_B.Merge Disconnections.Disconnections_B.Merge_b Disconnections.Disconnections_B.Merge_d Disconnections.Disconnections_B.Merge_f Disconnections.Disconnections_B.Merge_h Disconnections.Disconnections_B.Merge_he Disconnections.Disconnections_B.Merge_j Disconnections.Disconnections_DW.A Disconnections.Disconnections_DW.Last_alive Disconnections.Disconnections_DW.Last_alive_a Disconnections.Disconnections_DW.Last_alive_ar Disconnections.Disconnections_DW.Last_alive_c Disconnections.Disconnections_DW.Last_alive_c0 Disconnections.Disconnections_DW.Last_alive_g Disconnections.Disconnections_DW.Last_alive_gx Disconnections.Disconnections_DW.Last_alive_j Disconnections.Disconnections_DW.Last_alive_je Disconnections.Disconnections_DW.Last_alive_l Disconnections.Disconnections_DW.Last_alive_m Disconnections.Disconnections_DW.Last_alive_o Disconnections.Disconnections_DW.Tot_Errors Disconnections.Disconnections_DW.Tot_Errors_h Disconnections.Disconnections_DW.Tot_Errors_j Disconnections.Disconnections_DW.Tot_Errors_k Disconnections.Disconnections_DW.Tot_Errors_m Disconnections.Disconnections_U.ADCAN_Alive Disconnections.Disconnections_U.APPS1_Bits Disconnections.Disconnections_U.APPS2_Bits Disconnections.Disconnections_U.Accel_F_Alive Disconnections.Disconnections_U.Accel_R_Alive Disconnections.Disconnections_U.BMS_Alive Disconnections.Disconnections_U.BrakeSensor_Bits Disconnections.Disconnections_U.Dash_Alive Disconnections.Disconnections_U.Gyroscope_F Disconnections.Disconnections_U.Gyroscope_R Disconnections.Disconnections_U.LV_Derivation_Alive Disconnections.Disconnections_U.Shutdown_Alive Disconnections.Disconnections_U.SteeringSensor_Bits Disconnections.Disconnections_U.Susp_F_L_Bits Disconnections.Disconnections_U.Susp_F_R_Bits Disconnections.Disconnections_U.Susp_R_L_Bits Disconnections.Disconnections_U.Susp_R_R_Bits Disconnections.Disconnections_Y.CounterOut Disconnections.Disconnections_Y.CriticalDisconnection Disconnections.Disconnections_Y.Critical_CAN_Disconnection Disconnections.Disconnections_Y.Critical_Signal_Disconnection Disconnections.Disconnections_Y.Disconnection_ADCAN Disconnections.Disconnections_Y.Disconnection_APPS1 Disconnections.Disconnections_Y.Disconnection_APPS2 Disconnections.Disconnections_Y.Disconnection_Accel_F Disconnections.Disconnections_Y.Disconnection_Accel_R Disconnections.Disconnections_Y.Disconnection_BMS Disconnections.Disconnections_Y.Disconnection_Brake_Sensor Disconnections.Disconnections_Y.Disconnection_DashBoard Disconnections.Disconnections_Y.Disconnection_Gyroscope_F Disconnections.Disconnections_Y.Disconnection_Gyroscope_R Disconnections.Disconnections_Y.Disconnection_LV_Derivation Disconnections.Disconnections_Y.Disconnection_Shutdown Disconnections.Disconnections_Y.Disconnection_SteeringSensor Disconnections.Disconnections_Y.Disconnection_Susp_F_L Disconnections.Disconnections_Y.Disconnection_Susp_F_R Disconnections.Disconnections_Y.Disconnection_Susp_R_L Disconnections.Disconnections_Y.Disconnection_Susp_R_R Disconnections.Disconnections_Y.TV_mode /end REF_MEASUREMENT
 /begin REF_CHARACTERISTIC Disconnections.Disconnections_P.Constant_Value Disconnections.Disconnections_P.Constant_Value_c Disconnections.Disconnections_P.Constant_Value_d Disconnections.Disconnections_P.Constant_Value_e Disconnections.Disconnections_P.Constant_Value_h Disconnections.Disconnections_P.Constant_Value_i Disconnections.Disconnections_P.Constant_Value_ic Disconnections.Disconnections_P.Constant_Value_j Disconnections.Disconnections_P.Constant_Value_l Disconnections.Disconnections_P.Constant_Value_m Disconnections.Disconnections_P.Constant_Value_o Disconnections.Disconnections_P.DataStoreMemory1_InitialValue Disconnections.Disconnections_P.DataStoreMemory1_InitialValue_b Disconnections.Disconnections_P.DataStoreMemory1_InitialValue_c Disconnections.Disconnections_P.DataStoreMemory1_InitialValue_d Disconnections.Disconnections_P.DataStoreMemory1_InitialValue_m Disconnections.Disconnections_P.DataStoreMemory_InitialValue Disconnections.Disconnections_P.DataStoreMemory_InitialValue_b Disconnections.Disconnections_P.DataStoreMemory_InitialValue_ba Disconnections.Disconnections_P.DataStoreMemory_InitialValue_c Disconnections.Disconnections_P.DataStoreMemory_InitialValue_d Disconnections.Disconnections_P.DataStoreMemory_InitialValue_f Disconnections.Disconnections_P.DataStoreMemory_InitialValue_j Disconnections.Disconnections_P.DataStoreMemory_InitialValue_jc Disconnections.Disconnections_P.DataStoreMemory_InitialValue_k Disconnections.Disconnections_P.DataStoreMemory_InitialValue_kg Disconnections.Disconnections_P.DataStoreMemory_InitialValue_ks Disconnections.Disconnections_P.DataStoreMemory_InitialValue_m Disconnections.Disconnections_P.DataStoreMemory_InitialValue_o Disconnections.Disconnections_P.Merge_InitialOutput Disconnections.Disconnections_P.Merge_InitialOutput_a Disconnections.Disconnections_P.Merge_InitialOutput_b Disconnections.Disconnections_P.Merge_InitialOutput_l Disconnections.Disconnections_P.Merge_InitialOutput_m Disconnections.Disconnections_P.Merge_InitialOutput_o Disconnections.Disconnections_P.Merge_InitialOutput_p /end REF_CHARACTERISTIC
 /begin SUB_GROUP Disconnections.Disconnections_B Disconnections.Disconnections_DW Disconnections.Disconnections_U Disconnections.Disconnections_Y Disconnections.Disconnections_P /end SUB_GROUP
/end GROUP
/begin GROUP Disconnections.Disconnections_B ""
 /begin REF_MEASUREMENT Disconnections.Disconnections_B.Merge Disconnections.Disconnections_B.Merge_b Disconnections.Disconnections_B.Merge_d Disconnections.Disconnections_B.Merge_f Disconnections.Disconnections_B.Merge_h Disconnections.Disconnections_B.Merge_he Disconnections.Disconnections_B.Merge_j /end REF_MEASUREMENT
/end GROUP
/begin GROUP Disconnections.Disconnections_DW ""
 /begin REF_MEASUREMENT Disconnections.Disconnections_DW.A Disconnections.Disconnections_DW.Last_alive Disconnections.Disconnections_DW.Last_alive_a Disconnections.Disconnections_DW.Last_alive_ar Disconnections.Disconnections_DW.Last_alive_c Disconnections.Disconnections_DW.Last_alive_c0 Disconnections.Disconnections_DW.Last_alive_g Disconnections.Disconnections_DW.Last_alive_gx Disconnections.Disconnections_DW.Last_alive_j Disconnections.Disconnections_DW.Last_alive_je Disconnections.Disconnections_DW.Last_alive_l Disconnections.Disconnections_DW.Last_alive_m Disconnections.Disconnections_DW.Last_alive_o Disconnections.Disconnections_DW.Tot_Errors Disconnections.Disconnections_DW.Tot_Errors_h Disconnections.Disconnections_DW.Tot_Errors_j Disconnections.Disconnections_DW.Tot_Errors_k Disconnections.Disconnections_DW.Tot_Errors_m /end REF_MEASUREMENT
/end GROUP
/begin GROUP Disconnections.Disconnections_U ""
 /begin REF_MEASUREMENT Disconnections.Disconnections_U.ADCAN_Alive Disconnections.Disconnections_U.APPS1_Bits Disconnections.Disconnections_U.APPS2_Bits Disconnections.Disconnections_U.Accel_F_Alive Disconnections.Disconnections_U.Accel_R_Alive Disconnections.Disconnections_U.BMS_Alive Disconnections.Disconnections_U.BrakeSensor_Bits Disconnections.Disconnections_U.Dash_Alive Disconnections.Disconnections_U.Gyroscope_F Disconnections.Disconnections_U.Gyroscope_R Disconnections.Disconnections_U.LV_Derivation_Alive Disconnections.Disconnections_U.Shutdown_Alive Disconnections.Disconnections_U.SteeringSensor_Bits Disconnections.Disconnections_U.Susp_F_L_Bits Disconnections.Disconnections_U.Susp_F_R_Bits Disconnections.Disconnections_U.Susp_R_L_Bits Disconnections.Disconnections_U.Susp_R_R_Bits /end REF_MEASUREMENT
/end GROUP
/begin GROUP Disconnections.Disconnections_Y ""
 /begin REF_MEASUREMENT Disconnections.Disconnections_Y.CounterOut Disconnections.Disconnections_Y.CriticalDisconnection Disconnections.Disconnections_Y.Critical_CAN_Disconnection Disconnections.Disconnections_Y.Critical_Signal_Disconnection Disconnections.Disconnections_Y.Disconnection_ADCAN Disconnections.Disconnections_Y.Disconnection_APPS1 Disconnections.Disconnections_Y.Disconnection_APPS2 Disconnections.Disconnections_Y.Disconnection_Accel_F Disconnections.Disconnections_Y.Disconnection_Accel_R Disconnections.Disconnections_Y.Disconnection_BMS Disconnections.Disconnections_Y.Disconnection_Brake_Sensor Disconnections.Disconnections_Y.Disconnection_DashBoard Disconnections.Disconnections_Y.Disconnection_Gyroscope_F Disconnections.Disconnections_Y.Disconnection_Gyroscope_R Disconnections.Disconnections_Y.Disconnection_LV_Derivation Disconnections.Disconnections_Y.Disconnection_Shutdown Disconnections.Disconnections_Y.Disconnection_SteeringSensor Disconnections.Disconnections_Y.Disconnection_Susp_F_L Disconnections.Disconnections_Y.Disconnection_Susp_F_R Disconnections.Disconnections_Y.Disconnection_Susp_R_L Disconnections.Disconnections_Y.Disconnection_Susp_R_R Disconnections.Disconnections_Y.TV_mode /end REF_MEASUREMENT
/end GROUP
/begin GROUP Disconnections.Disconnections_P ""
 /begin REF_CHARACTERISTIC Disconnections.Disconnections_P.Constant_Value Disconnections.Disconnections_P.Constant_Value_c Disconnections.Disconnections_P.Constant_Value_d Disconnections.Disconnections_P.Constant_Value_e Disconnections.Disconnections_P.Constant_Value_h Disconnections.Disconnections_P.Constant_Value_i Disconnections.Disconnections_P.Constant_Value_ic Disconnections.Disconnections_P.Constant_Value_j Disconnections.Disconnections_P.Constant_Value_l Disconnections.Disconnections_P.Constant_Value_m Disconnections.Disconnections_P.Constant_Value_o Disconnections.Disconnections_P.DataStoreMemory1_InitialValue Disconnections.Disconnections_P.DataStoreMemory1_InitialValue_b Disconnections.Disconnections_P.DataStoreMemory1_InitialValue_c Disconnections.Disconnections_P.DataStoreMemory1_InitialValue_d Disconnections.Disconnections_P.DataStoreMemory1_InitialValue_m Disconnections.Disconnections_P.DataStoreMemory_InitialValue Disconnections.Disconnections_P.DataStoreMemory_InitialValue_b Disconnections.Disconnections_P.DataStoreMemory_InitialValue_ba Disconnections.Disconnections_P.DataStoreMemory_InitialValue_c Disconnections.Disconnections_P.DataStoreMemory_InitialValue_d Disconnections.Disconnections_P.DataStoreMemory_InitialValue_f Disconnections.Disconnections_P.DataStoreMemory_InitialValue_j Disconnections.Disconnections_P.DataStoreMemory_InitialValue_jc Disconnections.Disconnections_P.DataStoreMemory_InitialValue_k Disconnections.Disconnections_P.DataStoreMemory_InitialValue_kg Disconnections.Disconnections_P.DataStoreMemory_InitialValue_ks Disconnections.Disconnections_P.DataStoreMemory_InitialValue_m Disconnections.Disconnections_P.DataStoreMemory_InitialValue_o Disconnections.Disconnections_P.Merge_InitialOutput Disconnections.Disconnections_P.Merge_InitialOutput_a Disconnections.Disconnections_P.Merge_InitialOutput_b Disconnections.Disconnections_P.Merge_InitialOutput_l Disconnections.Disconnections_P.Merge_InitialOutput_m Disconnections.Disconnections_P.Merge_InitialOutput_o Disconnections.Disconnections_P.Merge_InitialOutput_p /end REF_CHARACTERISTIC
/end GROUP
/begin GROUP Pedals_Susp_Sensors "" ROOT
 /begin REF_MEASUREMENT Pedals_Susp_Sensors.Pedals_Susp_Sensors_U.APPS1_Bits Pedals_Susp_Sensors.Pedals_Susp_Sensors_U.APPS2_Bits Pedals_Susp_Sensors.Pedals_Susp_Sensors_U.BrakeSensor_Bits Pedals_Susp_Sensors.Pedals_Susp_Sensors_U.Susp_F_L_Bits Pedals_Susp_Sensors.Pedals_Susp_Sensors_U.Susp_F_R_Bits Pedals_Susp_Sensors.Pedals_Susp_Sensors_U.Susp_R_L_Bits Pedals_Susp_Sensors.Pedals_Susp_Sensors_U.Susp_R_R_Bits Pedals_Susp_Sensors.Pedals_Susp_Sensors_Y.APPS1_Value Pedals_Susp_Sensors.Pedals_Susp_Sensors_Y.APPS2_Value Pedals_Susp_Sensors.Pedals_Susp_Sensors_Y.BrakeLight_Control Pedals_Susp_Sensors.Pedals_Susp_Sensors_Y.BrakeSensor_Value Pedals_Susp_Sensors.Pedals_Susp_Sensors_Y.SUSP_F_L Pedals_Susp_Sensors.Pedals_Susp_Sensors_Y.SUSP_F_R Pedals_Susp_Sensors.Pedals_Susp_Sensors_Y.SUSP_R_L Pedals_Susp_Sensors.Pedals_Susp_Sensors_Y.SUSP_R_R /end REF_MEASUREMENT
 /begin REF_CHARACTERISTIC Pedals_Susp_Sensors.Pedals_Susp_Sensors_P.Brake_Light_Threshold_Value Pedals_Susp_Sensors.Pedals_Susp_Sensors_P.Ctemuelles_Gain Pedals_Susp_Sensors.Pedals_Susp_Sensors_P.Ctemuelles_Gain_a Pedals_Susp_Sensors.Pedals_Susp_Sensors_P.Ctemuelles_Gain_e Pedals_Susp_Sensors.Pedals_Susp_Sensors_P.Ctemuelles_Gain_g Pedals_Susp_Sensors.Pedals_Susp_Sensors_P.Ltotal_Gain Pedals_Susp_Sensors.Pedals_Susp_Sensors_P.Ltotal_Gain_c Pedals_Susp_Sensors.Pedals_Susp_Sensors_P.Ltotal_Gain_h Pedals_Susp_Sensors.Pedals_Susp_Sensors_P.Ltotal_Gain_j Pedals_Susp_Sensors.Pedals_Susp_Sensors_P.ON_Value Pedals_Susp_Sensors.Pedals_Susp_Sensors_P.Off_Value Pedals_Susp_Sensors.Pedals_Susp_Sensors_P.Zero_Bits_Experimental_Value Pedals_Susp_Sensors.Pedals_Susp_Sensors_P.bitsmax_Value Pedals_Susp_Sensors.Pedals_Susp_Sensors_P.bitsmax_Value_a Pedals_Susp_Sensors.Pedals_Susp_Sensors_P.bitsmax_Value_f Pedals_Susp_Sensors.Pedals_Susp_Sensors_P.bitsmax_Value_m Pedals_Susp_Sensors.Pedals_Susp_Sensors_P.max_Value Pedals_Susp_Sensors.Pedals_Susp_Sensors_P.max_Value_a Pedals_Susp_Sensors.Pedals_Susp_Sensors_P.max_Value_f Pedals_Susp_Sensors.Pedals_Susp_Sensors_P.min_Value Pedals_Susp_Sensors.Pedals_Susp_Sensors_P.min_Value_a Pedals_Susp_Sensors.Pedals_Susp_Sensors_P.min_Value_g /end REF_CHARACTERISTIC
 /begin SUB_GROUP Pedals_Susp_Sensors.Pedals_Susp_Sensors_U Pedals_Susp_Sensors.Pedals_Susp_Sensors_Y Pedals_Susp_Sensors.Pedals_Susp_Sensors_P /end SUB_GROUP
/end GROUP
/begin GROUP Pedals_Susp_Sensors.Pedals_Susp_Sensors_U ""
 /begin REF_MEASUREMENT Pedals_Susp_Sensors.Pedals_Susp_Sensors_U.APPS1_Bits Pedals_Susp_Sensors.Pedals_Susp_Sensors_U.APPS2_Bits Pedals_Susp_Sensors.Pedals_Susp_Sensors_U.BrakeSensor_Bits Pedals_Susp_Sensors.Pedals_Susp_Sensors_U.Susp_F_L_Bits Pedals_Susp_Sensors.Pedals_Susp_Sensors_U.Susp_F_R_Bits Pedals_Susp_Sensors.Pedals_Susp_Sensors_U.Susp_R_L_Bits Pedals_Susp_Sensors.Pedals_Susp_Sensors_U.Susp_R_R_Bits /end REF_MEASUREMENT
/end GROUP
/begin GROUP Pedals_Susp_Sensors.Pedals_Susp_Sensors_Y ""
 /begin REF_MEASUREMENT Pedals_Susp_Sensors.Pedals_Susp_Sensors_Y.APPS1_Value Pedals_Susp_Sensors.Pedals_Susp_Sensors_Y.APPS2_Value Pedals_Susp_Sensors.Pedals_Susp_Sensors_Y.BrakeLight_Control Pedals_Susp_Sensors.Pedals_Susp_Sensors_Y.BrakeSensor_Value Pedals_Susp_Sensors.Pedals_Susp_Sensors_Y.SUSP_F_L Pedals_Susp_Sensors.Pedals_Susp_Sensors_Y.SUSP_F_R Pedals_Susp_Sensors.Pedals_Susp_Sensors_Y.SUSP_R_L Pedals_Susp_Sensors.Pedals_Susp_Sensors_Y.SUSP_R_R /end REF_MEASUREMENT
/end GROUP
/begin GROUP Pedals_Susp_Sensors.Pedals_Susp_Sensors_P ""
 /begin REF_CHARACTERISTIC Pedals_Susp_Sensors.Pedals_Susp_Sensors_P.Brake_Light_Threshold_Value Pedals_Susp_Sensors.Pedals_Susp_Sensors_P.Ctemuelles_Gain Pedals_Susp_Sensors.Pedals_Susp_Sensors_P.Ctemuelles_Gain_a Pedals_Susp_Sensors.Pedals_Susp_Sensors_P.Ctemuelles_Gain_e Pedals_Susp_Sensors.Pedals_Susp_Sensors_P.Ctemuelles_Gain_g Pedals_Susp_Sensors.Pedals_Susp_Sensors_P.Ltotal_Gain Pedals_Susp_Sensors.Pedals_Susp_Sensors_P.Ltotal_Gain_c Pedals_Susp_Sensors.Pedals_Susp_Sensors_P.Ltotal_Gain_h Pedals_Susp_Sensors.Pedals_Susp_Sensors_P.Ltotal_Gain_j Pedals_Susp_Sensors.Pedals_Susp_Sensors_P.ON_Value Pedals_Susp_Sensors.Pedals_Susp_Sensors_P.Off_Value Pedals_Susp_Sensors.Pedals_Susp_Sensors_P.Zero_Bits_Experimental_Value Pedals_Susp_Sensors.Pedals_Susp_Sensors_P.bitsmax_Value Pedals_Susp_Sensors.Pedals_Susp_Sensors_P.bitsmax_Value_a Pedals_Susp_Sensors.Pedals_Susp_Sensors_P.bitsmax_Value_f Pedals_Susp_Sensors.Pedals_Susp_Sensors_P.bitsmax_Value_m Pedals_Susp_Sensors.Pedals_Susp_Sensors_P.max_Value Pedals_Susp_Sensors.Pedals_Susp_Sensors_P.max_Value_a Pedals_Susp_Sensors.Pedals_Susp_Sensors_P.max_Value_f Pedals_Susp_Sensors.Pedals_Susp_Sensors_P.min_Value Pedals_Susp_Sensors.Pedals_Susp_Sensors_P.min_Value_a Pedals_Susp_Sensors.Pedals_Susp_Sensors_P.min_Value_g /end REF_CHARACTERISTIC
/end GROUP
/begin GROUP Accel_Data "" ROOT
 /begin REF_MEASUREMENT Accel_Data.Accel_Data_B.AccDataConversionFX.Gain Accel_Data.Accel_Data_B.AccDataConversionFY.Gain Accel_Data.Accel_Data_B.AccDataConversionFZ.Gain Accel_Data.Accel_Data_B.AccDataConversionRX.Gain Accel_Data.Accel_Data_B.AccDataConversionRY.Gain Accel_Data.Accel_Data_B.AccDataConversionRZ.Gain Accel_Data.Accel_Data_B.LowPass.Gain Accel_Data.Accel_Data_B.LowPass1.Gain Accel_Data.Accel_Data_B.LowPass2.Gain Accel_Data.Accel_Data_DW.A Accel_Data.Accel_Data_DW.A_f Accel_Data.Accel_Data_U.ACCEL_F_X Accel_Data.Accel_Data_U.ACCEL_F_Y Accel_Data.Accel_Data_U.ACCEL_F_Z Accel_Data.Accel_Data_U.ACCEL_R_X Accel_Data.Accel_Data_U.ACCEL_R_Y Accel_Data.Accel_Data_U.ACCEL_R_Z Accel_Data.Accel_Data_U.Gyroscope_F Accel_Data.Accel_Data_U.Gyroscope_R Accel_Data.Accel_Data_Y.Accel_F_X_SI Accel_Data.Accel_Data_Y.Accel_F_Y_SI Accel_Data.Accel_Data_Y.Accel_F_Z_SI Accel_Data.Accel_Data_Y.Accel_R_X_SI Accel_Data.Accel_Data_Y.Accel_R_Y_SI Accel_Data.Accel_Data_Y.Accel_R_Z_SI Accel_Data.Accel_Data_Y.Gyro_F_Z_Deg Accel_Data.Accel_Data_Y.Gyro_R_Z_Deg Accel_Data.Accel_Data_Y.Rate_F_Z_Degs2 Accel_Data.Accel_Data_Y.Rate_R_Z_Degs /end REF_MEASUREMENT
 /begin REF_CHARACTERISTIC Accel_Data.Accel_Data_P.CycleTime_Gain Accel_Data.Accel_Data_P.CycleTime_Gain_h Accel_Data.Accel_Data_P.DataStoreMemory_InitialValue Accel_Data.Accel_Data_P.DataStoreMemory_InitialValue_m Accel_Data.Accel_Data_P.ExperimentalOffset_Value Accel_Data.Accel_Data_P.ExperimentalOffset_Value_e Accel_Data.Accel_Data_P.Gain2_Gain Accel_Data.Accel_Data_P.Gain4_Gain Accel_Data.Accel_Data_P.RpsLSB_Value Accel_Data.Accel_Data_P.sbit_Value /end REF_CHARACTERISTIC
 /begin SUB_GROUP Accel_Data.Accel_Data_B Accel_Data.Accel_Data_B.AccDataConversionFX Accel_Data.Accel_Data_B.AccDataConversionFY Accel_Data.Accel_Data_B.AccDataConversionFZ Accel_Data.Accel_Data_B.AccDataConversionRX Accel_Data.Accel_Data_B.AccDataConversionRY Accel_Data.Accel_Data_B.AccDataConversionRZ Accel_Data.Accel_Data_B.LowPass Accel_Data.Accel_Data_B.LowPass1 Accel_Data.Accel_Data_B.LowPass2 Accel_Data.Accel_Data_DW Accel_Data.Accel_Data_U Accel_Data.Accel_Data_Y Accel_Data.Accel_Data_P /end SUB_GROUP
/end GROUP
/begin GROUP Accel_Data.Accel_Data_B ""
 /begin REF_MEASUREMENT Accel_Data.Accel_Data_B.AccDataConversionFX.Gain Accel_Data.Accel_Data_B.AccDataConversionFY.Gain Accel_Data.Accel_Data_B.AccDataConversionFZ.Gain Accel_Data.Accel_Data_B.AccDataConversionRX.Gain Accel_Data.Accel_Data_B.AccDataConversionRY.Gain Accel_Data.Accel_Data_B.AccDataConversionRZ.Gain Accel_Data.Accel_Data_B.LowPass.Gain Accel_Data.Accel_Data_B.LowPass1.Gain Accel_Data.Accel_Data_B.LowPass2.Gain /end REF_MEASUREMENT
/end GROUP
/begin GROUP Accel_Data.Accel_Data_B.AccDataConversionFX "" /begin REF_MEASUREMENT Accel_Data.Accel_Data_B.AccDataConversionFX.Gain /end REF_MEASUREMENT /end GROUP
/begin GROUP Accel_Data.Accel_Data_B.AccDataConversionFY "" /begin REF_MEASUREMENT Accel_Data.Accel_Data_B.AccDataConversionFY.Gain /end REF_MEASUREMENT /end GROUP
/begin GROUP Accel_Data.Accel_Data_B.AccDataConversionFZ "" /begin REF_MEASUREMENT Accel_Data.Accel_Data_B.AccDataConversionFZ.Gain /end REF_MEASUREMENT /end GROUP
/begin GROUP Accel_Data.Accel_Data_B.AccDataConversionRX "" /begin REF_MEASUREMENT Accel_Data.Accel_Data_B.AccDataConversionRX.Gain /end REF_MEASUREMENT /end GROUP
/begin GROUP Accel_Data.Accel_Data_B.AccDataConversionRY "" /begin REF_MEASUREMENT Accel_Data.Accel_Data_B.AccDataConversionRY.Gain /end REF_MEASUREMENT /end GROUP
/begin GROUP Accel_Data.Accel_Data_B.AccDataConversionRZ "" /begin REF_MEASUREMENT Accel_Data.Accel_Data_B.AccDataConversionRZ.Gain /end REF_MEASUREMENT /end GROUP
/begin GROUP Accel_Data.Accel_Data_B.LowPass "" /begin REF_MEASUREMENT Accel_Data.Accel_Data_B.LowPass.Gain /end REF_MEASUREMENT /end GROUP
/begin GROUP Accel_Data.Accel_Data_B.LowPass1 "" /begin REF_MEASUREMENT Accel_Data.Accel_Data_B.LowPass1.Gain /end REF_MEASUREMENT /end GROUP
/begin GROUP Accel_Data.Accel_Data_B.LowPass2 "" /begin REF_MEASUREMENT Accel_Data.Accel_Data_B.LowPass2.Gain /end REF_MEASUREMENT /end GROUP
/begin GROUP Accel_Data.Accel_Data_DW "" /begin REF_MEASUREMENT Accel_Data.Accel_Data_DW.A Accel_Data.Accel_Data_DW.A_f /end REF_MEASUREMENT /end GROUP
/begin GROUP Accel_Data.Accel_Data_U ""
 /begin REF_MEASUREMENT Accel_Data.Accel_Data_U.ACCEL_F_X Accel_Data.Accel_Data_U.ACCEL_F_Y Accel_Data.Accel_Data_U.ACCEL_F_Z Accel_Data.Accel_Data_U.ACCEL_R_X Accel_Data.Accel_Data_U.ACCEL_R_Y Accel_Data.Accel_Data_U.ACCEL_R_Z Accel_Data.Accel_Data_U.Gyroscope_F Accel_Data.Accel_Data_U.Gyroscope_R /end REF_MEASUREMENT
/end GROUP
/begin GROUP Accel_Data.Accel_Data_Y ""
 /begin REF_MEASUREMENT Accel_Data.Accel_Data_Y.Accel_F_X_SI Accel_Data.Accel_Data_Y.Accel_F_Y_SI Accel_Data.Accel_Data_Y.Accel_F_Z_SI Accel_Data.Accel_Data_Y.Accel_R_X_SI Accel_Data.Accel_Data_Y.Accel_R_Y_SI Accel_Data.Accel_Data_Y.Accel_R_Z_SI Accel_Data.Accel_Data_Y.Gyro_F_Z_Deg Accel_Data.Accel_Data_Y.Gyro_R_Z_Deg Accel_Data.Accel_Data_Y.Rate_F_Z_Degs2 Accel_Data.Accel_Data_Y.Rate_R_Z_Degs /end REF_MEASUREMENT
/end GROUP
/begin GROUP Accel_Data.Accel_Data_P ""
 /begin REF_CHARACTERISTIC Accel_Data.Accel_Data_P.CycleTime_Gain Accel_Data.Accel_Data_P.CycleTime_Gain_h Accel_Data.Accel_Data_P.DataStoreMemory_InitialValue Accel_Data.Accel_Data_P.DataStoreMemory_InitialValue_m Accel_Data.Accel_Data_P.ExperimentalOffset_Value Accel_Data.Accel_Data_P.ExperimentalOffset_Value_e Accel_Data.Accel_Data_P.Gain2_Gain Accel_Data.Accel_Data_P.Gain4_Gain Accel_Data.Accel_Data_P.RpsLSB_Value Accel_Data.Accel_Data_P.sbit_Value /end REF_CHARACTERISTIC
/end GROUP
/begin GROUP ETCSignals "" ROOT
 /begin REF_CHARACTERISTIC ETCSignals.ES900.ES910.CAN1.CAN1.AP_ETAS_DashData1.Speed_calibrate ETCSignals.ES900.ES910.CAN1.CAN1.AP_ETAS_DashData1.Precharge_Voltage_calibrate ETCSignals.ES900.ES910.CAN1.CAN1.AP_ETAS_DashData1.Precharge_Percentage_calibrate ETCSignals.ES900.ES910.CAN1.CAN1.AP_ETAS_DashData1.LVbattery_Voltage_calibrate ETCSignals.ES900.ES910.CAN1.CAN1.AP_ETAS_DashData1.LVbattery_SOC_calibrate ETCSignals.ES900.ES910.CAN1.CAN1.AP_ETAS_VDCParams2.VDC_Cte_SKF_calibrate ETCSignals.ES900.ES910.CAN1.CAN1.AP_ETAS_VDCParams2.VDC_Cte_CKF_calibrate ETCSignals.ES900.ES910.CAN1.CAN1.AP_ETAS_VDCParams.VDC_CKF_Initial_calibrate ETCSignals.ES900.ES910.CAN1.CAN1.AP_ETAS_VDCParams.VDC_SKF_Initial_calibrate ETCSignals.ES900.ES910.CAN1.CAN1.AP_ETAS_VDCParams.VDC_Power_Limit_calibrate ETCSignals.ES900.ES910.CAN1.CAN1.AP_ETAS_VDCParams.VDC_Max_Regenerative_Torque_calibrate ETCSignals.ES900.ES910.CAN1.CAN1.AP_ETAS_VDCParams.VDC_K_Reduction_Temperature_calibrate ETCSignals.ES900.ES910.CAN1.CAN1.AP_ETAS_VDCParams.VDC_K_Reduction_P_calibrate ETCSignals.ES900.ES910.CAN1.CAN1.AP_ETAS_VDCParams.VDC_APPS_Sat_Up_calibrate ETCSignals.ES900.ES910.CAN1.CAN1.AP_ETAS_VDCParams.VDC_APPS_Sat_Down_calibrate ETCSignals.ES900.ES910.CAN1.CAN1.AP_ETAS_Inverter_R_Rx.Inverter_R_RegID_calibrate ETCSignals.ES900.ES910.CAN1.CAN1.AP_ETAS_Inverter_R_Rx.Inverter_R_b7tob0_calibrate ETCSignals.ES900.ES910.CAN1.CAN1.AP_ETAS_Inverter_R_Rx.Inverter_R_b15tob8_calibrate ETCSignals.ES900.ES910.CAN1.CAN1.AP_ETAS_Inverter_L_Rx.Inverter_L_RegID_calibrate ETCSignals.ES900.ES910.CAN1.CAN1.AP_ETAS_Inverter_L_Rx.Inverter_L_b7tob0_calibrate ETCSignals.ES900.ES910.CAN1.CAN1.AP_ETAS_Inverter_L_Rx.Inverter_L_b15tob8_calibrate ETCSignals.ES900.ES910.CAN1.CAN1.AP_ETAS_CarState.Car_State_calibrate ETCSignals.ES900.ES910.CAN1.CAN1.AP_ETAS_AIRsRequest.AIRs_Request_calibrate ETCSignals.ES900.ES910.CAN1.CAN1.AP_ETAS_AnalogicControl.BrakeLight_Control_calibrate ETCSignals.ES900.ES910.CAN1.CAN1.AP_ETAS_AnalogicControl.Pumps_Control_calibrate ETCSignals.ES900.ES910.CAN1.CAN1.MEAS_ETAS_InternalVars.CriticalDisconnection_calibrate ETCSignals.ES900.ES910.CAN1.CAN1.MEAS_ETAS_InternalVars.CurrentPathDisconnectionFlag_calibrate ETCSignals.ES900.ES910.CAN1.CAN1.MEAS_ETAS_InternalVars.Car_OK_calibrate ETCSignals.ES900.ES910.CAN1.CAN1.MEAS_ETAS_InternalVars.Power_calibrate ETCSignals.ES900.ES910.CAN1.CAN1.MEAS_ETAS_InternalVars.Torque_OK_calibrate ETCSignals.ES900.ES910.CAN1.CAN1.MEAS_ETAS_InternalVars.TV_Mode_calibrate ETCSignals.ES900.ES910.CAN1.CAN1.MEAS_ETAS_InternalVars.Critical_Signal_Disconnection_calibrate ETCSignals.ES900.ES910.CAN1.CAN1.MEAS_ETAS_InternalVars.Critical_CAN_Disconnection_calibrate ETCSignals.ES900.ES910.CAN1.CAN1.MEAS_ETAS_InternalVars.Brake_Implausibility_calibrate ETCSignals.ES900.ES910.CAN1.CAN1.MEAS_ETAS_InternalVars.APPS_Implausibility_calibrate ETCSignals.ES900.ES910.CAN1.CAN1.NM_ETAS_Disconnections.Disconnection_LV_Derivation_calibrate ETCSignals.ES900.ES910.CAN1.CAN1.NM_ETAS_Disconnections.Disconnection_DashBoard_calibrate ETCSignals.ES900.ES910.CAN1.CAN1.NM_ETAS_Disconnections.Disconnection_BMS_calibrate ETCSignals.ES900.ES910.CAN1.CAN1.NM_ETAS_Disconnections.Disconnection_Gyroscope_F_calibrate ETCSignals.ES900.ES910.CAN1.CAN1.NM_ETAS_Disconnections.Disconnection_Gyroscope_R_calibrate ETCSignals.ES900.ES910.CAN1.CAN1.NM_ETAS_Disconnections.Disconnection_Accel_F_calibrate ETCSignals.ES900.ES910.CAN1.CAN1.NM_ETAS_Disconnections.Disconnection_Accel_R_calibrate ETCSignals.ES900.ES910.CAN1.CAN1.NM_ETAS_Disconnections.Disconnection_SteeringSensor_calibrate ETCSignals.ES900.ES910.CAN1.CAN1.NM_ETAS_Disconnections.Disconnection_Susp_R_R_calibrate ETCSignals.ES900.ES910.CAN1.CAN1.NM_ETAS_Disconnections.Disconnection_Susp_R_L_calibrate ETCSignals.ES900.ES910.CAN1.CAN1.NM_ETAS_Disconnections.Disconnection_Susp_F_R_calibrate ETCSignals.ES900.ES910.CAN1.CAN1.NM_ETAS_Disconnections.Disconnection_Susp_F_L_calibrate ETCSignals.ES900.ES910.CAN1.CAN1.NM_ETAS_Disconnections.Disconnection_Brake_Sensor_calibrate ETCSignals.ES900.ES910.CAN1.CAN1.NM_ETAS_Disconnections.Disconnection_APPS2_calibrate ETCSignals.ES900.ES910.CAN1.CAN1.NM_ETAS_Disconnections.Disconnection_APPS1_calibrate ETCSignals.ES900.ES910.CAN1.CAN1.NM_ETAS_Disconnections.Disconnection_ADCAN_calibrate ETCSignals.ES900.ES910.CAN1.CAN1.NM_ETAS_Disconnections.Disconnection_Shutdown_calibrate ETCSignals.ES900.ES910.CAN1.CAN1.AP_ETAS_DashData2.SteeringSensor_Value_calibrate ETCSignals.ES900.ES910.CAN1.CAN1.AP_ETAS_DashData2.SKF_actual_calibrate ETCSignals.ES900.ES910.CAN1.CAN1.AP_ETAS_DashData2.CKF_actual_calibrate ETCSignals.ES900.ES910.CAN1.CAN1.AP_ETAS_DashData2.BrakeSensor_Value_calibrate ETCSignals.ES900.ES910.CAN1.CAN1.AP_ETAS_DashData2.APPS2_Value_calibrate ETCSignals.ES900.ES910.CAN1.CAN1.AP_ETAS_DashData2.APPS1_Value_calibrate ETCSignals.ES900.ES910.CAN1.CAN1.AP_ETAS_Synchronism.Sync_CAN1_calibrate ETCSignals.ES900.ES910.CAN2.CAN2.MEAS_ETAS_Inverter_R_Data.Inv_R_TempMotor_calibrate ETCSignals.ES900.ES910.CAN2.CAN2.MEAS_ETAS_Inverter_R_Data.Inv_R_TempIGBT_calibrate ETCSignals.ES900.ES910.CAN2.CAN2.MEAS_ETAS_Inverter_R_Data.Inv_R_Speed_calibrate ETCSignals.ES900.ES910.CAN2.CAN2.MEAS_ETAS_Inverter_R_Data.Inv_R_Iq_calibrate ETCSignals.ES900.ES910.CAN2.CAN2.MEAS_ETAS_Inverter_R_Data.Inv_R_Icommand_calibrate ETCSignals.ES900.ES910.CAN2.CAN2.MEAS_ETAS_Inverter_R_Data.Inv_R_Iactual_calibrate ETCSignals.ES900.ES910.CAN2.CAN2.MEAS_ETAS_Inverter_L_Data.Inv_L_TempMotor_calibrate ETCSignals.ES900.ES910.CAN2.CAN2.MEAS_ETAS_Inverter_L_Data.Inv_L_TempIGBT_calibrate ETCSignals.ES900.ES910.CAN2.CAN2.MEAS_ETAS_Inverter_L_Data.Inv_L_Speed_calibrate ETCSignals.ES900.ES910.CAN2.CAN2.MEAS_ETAS_Inverter_L_Data.Inv_L_Iq_calibrate ETCSignals.ES900.ES910.CAN2.CAN2.MEAS_ETAS_Inverter_L_Data.Inv_L_Icommand_calibrate ETCSignals.ES900.ES910.CAN2.CAN2.MEAS_ETAS_Inverter_L_Data.Inv_L_Iactual_calibrate ETCSignals.ES900.ES910.CAN2.CAN2.MEAS_ETAS_VDCdata6.SUSP_F_R_calibrate ETCSignals.ES900.ES910.CAN2.CAN2.MEAS_ETAS_VDCdata6.SUSP_F_L_calibrate ETCSignals.ES900.ES910.CAN2.CAN2.MEAS_ETAS_VDCdata5.Gyro_F_Z_Deg_calibrate ETCSignals.ES900.ES910.CAN2.CAN2.MEAS_ETAS_VDCdata5.Accel_F_Z_SI_calibrate ETCSignals.ES900.ES910.CAN2.CAN2.MEAS_ETAS_VDCdata5.Accel_F_Y_SI_calibrate ETCSignals.ES900.ES910.CAN2.CAN2.MEAS_ETAS_VDCdata5.Accel_F_X_SI_calibrate ETCSignals.ES900.ES910.CAN2.CAN2.MEAS_ETAS_VDCdata4.Gyro_R_Z_Deg_calibrate ETCSignals.ES900.ES910.CAN2.CAN2.MEAS_ETAS_VDCdata4.Accel_R_Z_SI_calibrate ETCSignals.ES900.ES910.CAN2.CAN2.MEAS_ETAS_VDCdata4.Accel_R_Y_SI_calibrate ETCSignals.ES900.ES910.CAN2.CAN2.MEAS_ETAS_VDCdata4.Accel_R_X_SI_calibrate ETCSignals.ES900.ES910.CAN2.CAN2.MEAS_ETAS_VDCdata7.Torque_R_calibrate ETCSignals.ES900.ES910.CAN2.CAN2.MEAS_ETAS_VDCdata7.Torque_L_calibrate ETCSignals.ES900.ES910.CAN2.CAN2.MEAS_ETAS_VDCdata3.Handling_calibrate ETCSignals.ES900.ES910.CAN2.CAN2.MEAS_ETAS_VDCdata3.Dash_Speed_calibrate ETCSignals.ES900.ES910.CAN2.CAN2.MEAS_ETAS_VDCdata3.Mass_calibrate ETCSignals.ES900.ES910.CAN2.CAN2.MEAS_ETAS_VDCdata2.Throttle_calibrate ETCSignals.ES900.ES910.CAN2.CAN2.MEAS_ETAS_VDCdata2.Max_Fx_RR_calibrate ETCSignals.ES900.ES910.CAN2.CAN2.MEAS_ETAS_VDCdata2.Max_Fx_RL_calibrate /end REF_CHARACTERISTIC
 /begin SUB_GROUP ETCSignals.ES900 ETCSignals.ES900.ES910 ETCSignals.ES900.ES910.CAN1 ETCSignals.ES900.ES910.CAN1.Presence ETCSignals.ES900.ES910.CAN1.Presence.PresenceGroup ETCSignals.ES900.ES910.CAN1.CAN1 ETCSignals.ES900.ES910.CAN1.CAN1.AP_BMS_Current_SOC_SOH ETCSignals.ES900.ES910.CAN1.CAN1.AP_BMS_StateAndFailReport ETCSignals.ES900.ES910.CAN1.CAN1.AP_BMS_Voltages ETCSignals.ES900.ES910.CAN1.CAN1.AP_BMS_OnBoardTemperatures ETCSignals.ES900.ES910.CAN1.CAN1.AP_BMS_ChargerParameters ETCSignals.ES900.ES910.CAN1.CAN1.AP_BMS_BatteryTemperatures ETCSignals.ES900.ES910.CAN1.CAN1.AP_Inverter_R_Tx ETCSignals.ES900.ES910.CAN1.CAN1.AP_Inverter_L_Tx ETCSignals.ES900.ES910.CAN1.CAN1.AP_DASH_CustomMode ETCSignals.ES900.ES910.CAN1.CAN1.AP_DASH_Mode ETCSignals.ES900.ES910.CAN1.CAN1.NM_BMS_Keep_Alive ETCSignals.ES900.ES910.CAN1.CAN1.AP_BMS_AIRs_State ETCSignals.ES900.ES910.CAN1.CAN1.NM_DASH_Keep_Alive ETCSignals.ES900.ES910.CAN1.CAN1.AP_DASH_TorqueLockOn ETCSignals.ES900.ES910.CAN1.CAN1.AP_DASH_PrechargeRequest ETCSignals.ES900.ES910.CAN1.CAN1.AP_DASH_EnableDrive ETCSignals.ES900.ES910.CAN1.CAN1.AP_ETAS_DashData1 ETCSignals.ES900.ES910.CAN1.CAN1.AP_ETAS_VDCParams2 ETCSignals.ES900.ES910.CAN1.CAN1.AP_ETAS_VDCParams ETCSignals.ES900.ES910.CAN1.CAN1.AP_ETAS_Inverter_R_Rx ETCSignals.ES900.ES910.CAN1.CAN1.AP_ETAS_Inverter_L_Rx ETCSignals.ES900.ES910.CAN1.CAN1.AP_ETAS_CarState ETCSignals.ES900.ES910.CAN1.CAN1.AP_ETAS_AIRsRequest ETCSignals.ES900.ES910.CAN1.CAN1.AP_ETAS_AnalogicControl ETCSignals.ES900.ES910.CAN1.CAN1.MEAS_ETAS_InternalVars ETCSignals.ES900.ES910.CAN1.CAN1.AP_SHUTDOWN_State ETCSignals.ES900.ES910.CAN1.CAN1.NM_ETAS_Disconnections ETCSignals.ES900.ES910.CAN1.CAN1.NM_SHUTDOWN_Keep_Alive ETCSignals.ES900.ES910.CAN1.CAN1.AP_ETAS_DashData2 ETCSignals.ES900.ES910.CAN1.CAN1.AP_ETAS_Synchronism ETCSignals.ES900.ES910.CAN2 ETCSignals.ES900.ES910.CAN2.Presence ETCSignals.ES900.ES910.CAN2.Presence.PresenceGroup ETCSignals.ES900.ES910.CAN2.CAN2 ETCSignals.ES900.ES910.CAN2.CAN2.AP_ELLIPSE_EKF_POS ETCSignals.ES900.ES910.CAN2.CAN2.AP_ELLIPSE_IMU_ACCEL ETCSignals.ES900.ES910.CAN2.CAN2.AP_ELLIPSE_MAG ETCSignals.ES900.ES910.CAN2.CAN2.AP_ELLIPSE_EKF_EULER ETCSignals.ES900.ES910.CAN2.CAN2.AP_ELLIPSE_EKF_VEL_BODY ETCSignals.ES900.ES910.CAN2.CAN2.NM_ELLIPSE_Status ETCSignals.ES900.ES910.CAN2.CAN2.AP_ELLIPSE_IMU_GYRO ETCSignals.ES900.ES910.CAN2.CAN2.AP_ELLIPSE_SLIP_CURV ETCSignals.ES900.ES910.CAN2.CAN2.MEAS_ETAS_Inverter_R_Data ETCSignals.ES900.ES910.CAN2.CAN2.MEAS_ETAS_Inverter_L_Data ETCSignals.ES900.ES910.CAN2.CAN2.MEAS_ETAS_VDCdata6 ETCSignals.ES900.ES910.CAN2.CAN2.MEAS_ETAS_VDCdata5 ETCSignals.ES900.ES910.CAN2.CAN2.MEAS_ETAS_VDCdata4 ETCSignals.ES900.ES910.CAN2.CAN2.AP_LV_Derivation_LVData ETCSignals.ES900.ES910.CAN2.CAN2.MEAS_ETAS_VDCdata7 ETCSignals.ES900.ES910.CAN2.CAN2.MEAS_ETAS_VDCdata3 ETCSignals.ES900.ES910.CAN2.CAN2.MEAS_ETAS_VDCdata2 ETCSignals.ES900.ES910.CAN2.CAN2.MEAS_ETAS_VDCdata1 ETCSignals.ES900.ES910.CAN2.CAN2.AP_ACCEL_R_Data2 ETCSignals.ES900.ES910.CAN2.CAN2.NM_LV_Derivation_Keep_Alive ETCSignals.ES900.ES910.CAN2.CAN2.AP_ACCEL_F_Data ETCSignals.ES900.ES910.CAN2.CAN2.NM_ACCEL_F_Keep_Alive ETCSignals.ES900.ES910.CAN2.CAN2.NM_ACCEL_R_Keep_Alive ETCSignals.ES900.ES910.CAN2.CAN2.AP_ACCEL_R_Data ETCSignals.ES900.ES910.CAN2.CAN2.AP_ADCAN_Data2 ETCSignals.ES900.ES910.CAN2.CAN2.AP_ADCAN_Data1 ETCSignals.ES900.ES910.CAN2.CAN2.AP_ETAS_Synchronism ETCSignals.ES900.ES910.CAN2.CAN2.NM_ADCAN_Keep_Alive /end SUB_GROUP
/end GROUP
/begin GROUP ETCSignals.ES900 ""
 /begin REF_CHARACTERISTIC ETCSignals.ES900.ES910.CAN1.CAN1.AP_ETAS_DashData1.Speed_calibrate ETCSignals.ES900.ES910.CAN1.CAN1.AP_ETAS_DashData1.Precharge_Voltage_calibrate ETCSignals.ES900.ES910.CAN1.CAN1.AP_ETAS_DashData1.Precharge_Percentage_calibrate ETCSignals.ES900.ES910.CAN1.CAN1.AP_ETAS_DashData1.LVbattery_Voltage_calibrate ETCSignals.ES900.ES910.CAN1.CAN1.AP_ETAS_DashData1.LVbattery_SOC_calibrate ETCSignals.ES900.ES910.CAN1.CAN1.AP_ETAS_VDCParams2.VDC_Cte_SKF_calibrate ETCSignals.ES900.ES910.CAN1.CAN1.AP_ETAS_VDCParams2.VDC_Cte_CKF_calibrate ETCSignals.ES900.ES910.CAN1.CAN1.AP_ETAS_VDCParams.VDC_CKF_Initial_calibrate ETCSignals.ES900.ES910.CAN1.CAN1.AP_ETAS_VDCParams.VDC_SKF_Initial_calibrate ETCSignals.ES900.ES910.CAN1.CAN1.AP_ETAS_VDCParams.VDC_Power_Limit_calibrate ETCSignals.ES900.ES910.CAN1.CAN1.AP_ETAS_VDCParams.VDC_Max_Regenerative_Torque_calibrate ETCSignals.ES900.ES910.CAN1.CAN1.AP_ETAS_VDCParams.VDC_K_Reduction_Temperature_calibrate ETCSignals.ES900.ES910.CAN1.CAN1.AP_ETAS_VDCParams.VDC_K_Reduction_P_calibrate ETCSignals.ES900.ES910.CAN1.CAN1.AP_ETAS_VDCParams.VDC_APPS_Sat_Up_calibrate ETCSignals.ES900.ES910.CAN1.CAN1.AP_ETAS_VDCParams.VDC_APPS_Sat_Down_calibrate ETCSignals.ES900.ES910.CAN1.CAN1.AP_ETAS_Inverter_R_Rx.Inverter_R_RegID_calibrate ETCSignals.ES900.ES910.CAN1.CAN1.AP_ETAS_Inverter_R_Rx.Inverter_R_b7tob0_calibrate ETCSignals.ES900.ES910.CAN1.CAN1.AP_ETAS_Inverter_R_Rx.Inverter_R_b15tob8_calibrate ETCSignals.ES900.ES910.CAN1.CAN1.AP_ETAS_Inverter_L_Rx.Inverter_L_RegID_calibrate ETCSignals.ES900.ES910.CAN1.CAN1.AP_ETAS_Inverter_L_Rx.Inverter_L_b7tob0_calibrate ETCSignals.ES900.ES910.CAN1.CAN1.AP_ETAS_Inverter_L_Rx.Inverter_L_b15tob8_calibrate ETCSignals.ES900.ES910.CAN1.CAN1.AP_ETAS_CarState.Car_State_calibrate ETCSignals.ES900.ES910.CAN1.CAN1.AP_ETAS_AIRsRequest.AIRs_Request_calibrate ETCSignals.ES900.ES910.CAN1.CAN1.AP_ETAS_AnalogicControl.BrakeLight_Control_calibrate ETCSignals.ES900.ES910.CAN1.CAN1.AP_ETAS_AnalogicControl.Pumps_Control_calibrate ETCSignals.ES900.ES910.CAN1.CAN1.MEAS_ETAS_InternalVars.CriticalDisconnection_calibrate ETCSignals.ES900.ES910.CAN1.CAN1.MEAS_ETAS_InternalVars.CurrentPathDisconnectionFlag_calibrate ETCSignals.ES900.ES910.CAN1.CAN1.MEAS_ETAS_InternalVars.Car_OK_calibrate ETCSignals.ES900.ES910.CAN1.CAN1.MEAS_ETAS_InternalVars.Power_calibrate ETCSignals.ES900.ES910.CAN1.CAN1.MEAS_ETAS_InternalVars.Torque_OK_calibrate ETCSignals.ES900.ES910.CAN1.CAN1.MEAS_ETAS_InternalVars.TV_Mode_calibrate ETCSignals.ES900.ES910.CAN1.CAN1.MEAS_ETAS_InternalVars.Critical_Signal_Disconnection_calibrate ETCSignals.ES900.ES910.CAN1.CAN1.MEAS_ETAS_InternalVars.Critical_CAN_Disconnection_calibrate ETCSignals.ES900.ES910.CAN1.CAN1.MEAS_ETAS_InternalVars.Brake_Implausibility_calibrate ETCSignals.ES900.ES910.CAN1.CAN1.MEAS_ETAS_InternalVars.APPS_Implausibility_calibrate ETCSignals.ES900.ES910.CAN1.CAN1.NM_ETAS_Disconnections.Disconnection_LV_Derivation_calibrate ETCSignals.ES900.ES910.CAN1.CAN1.NM_ETAS_Disconnections.Disconnection_DashBoard_calibrate ETCSignals.ES900.ES910.CAN1.CAN1.NM_ETAS_Disconnections.Disconnection_BMS_calibrate ETCSignals.ES900.ES910.CAN1.CAN1.NM_ETAS_Disconnections.Disconnection_Gyroscope_F_calibrate ETCSignals.ES900.ES910.CAN1.CAN1.NM_ETAS_Disconnections.Disconnection_Gyroscope_R_calibrate ETCSignals.ES900.ES910.CAN1.CAN1.NM_ETAS_Disconnections.Disconnection_Accel_F_calibrate ETCSignals.ES900.ES910.CAN1.CAN1.NM_ETAS_Disconnections.Disconnection_Accel_R_calibrate ETCSignals.ES900.ES910.CAN1.CAN1.NM_ETAS_Disconnections.Disconnection_SteeringSensor_calibrate ETCSignals.ES900.ES910.CAN1.CAN1.NM_ETAS_Disconnections.Disconnection_Susp_R_R_calibrate ETCSignals.ES900.ES910.CAN1.CAN1.NM_ETAS_Disconnections.Disconnection_Susp_R_L_calibrate ETCSignals.ES900.ES910.CAN1.CAN1.NM_ETAS_Disconnections.Disconnection_Susp_F_R_calibrate ETCSignals.ES900.ES910.CAN1.CAN1.NM_ETAS_Disconnections.Disconnection_Susp_F_L_calibrate ETCSignals.ES900.ES910.CAN1.CAN1.NM_ETAS_Disconnections.Disconnection_Brake_Sensor_calibrate ETCSignals.ES900.ES910.CAN1.CAN1.NM_ETAS_Disconnections.Disconnection_APPS2_calibrate ETCSignals.ES900.ES910.CAN1.CAN1.NM_ETAS_Disconnections.Disconnection_APPS1_calibrate ETCSignals.ES900.ES910.CAN1.CAN1.NM_ETAS_Disconnections.Disconnection_ADCAN_calibrate ETCSignals.ES900.ES910.CAN1.CAN1.NM_ETAS_Disconnections.Disconnection_Shutdown_calibrate ETCSignals.ES900.ES910.CAN1.CAN1.AP_ETAS_DashData2.SteeringSensor_Value_calibrate ETCSignals.ES900.ES910.CAN1.CAN1.AP_ETAS_DashData2.SKF_actual_calibrate ETCSignals.ES900.ES910.CAN1.CAN1.AP_ETAS_DashData2.CKF_actual_calibrate ETCSignals.ES900.ES910.CAN1.CAN1.AP_ETAS_DashData2.BrakeSensor_Value_calibrate ETCSignals.ES900.ES910.CAN1.CAN1.AP_ETAS_DashData2.APPS2_Value_calibrate ETCSignals.ES900.ES910.CAN1.CAN1.AP_ETAS_DashData2.APPS1_Value_calibrate ETCSignals.ES900.ES910.CAN1.CAN1.AP_ETAS_Synchronism.Sync_CAN1_calibrate ETCSignals.ES900.ES910.CAN2.CAN2.MEAS_ETAS_Inverter_R_Data.Inv_R_TempMotor_calibrate ETCSignals.ES900.ES910.CAN2.CAN2.MEAS_ETAS_Inverter_R_Data.Inv_R_TempIGBT_calibrate ETCSignals.ES900.ES910.CAN2.CAN2.MEAS_ETAS_Inverter_R_Data.Inv_R_Speed_calibrate ETCSignals.ES900.ES910.CAN2.CAN2.MEAS_ETAS_Inverter_R_Data.Inv_R_Iq_calibrate ETCSignals.ES900.ES910.CAN2.CAN2.MEAS_ETAS_Inverter_R_Data.Inv_R_Icommand_calibrate ETCSignals.ES900.ES910.CAN2.CAN2.MEAS_ETAS_Inverter_R_Data.Inv_R_Iactual_calibrate ETCSignals.ES900.ES910.CAN2.CAN2.MEAS_ETAS_Inverter_L_Data.Inv_L_TempMotor_calibrate ETCSignals.ES900.ES910.CAN2.CAN2.MEAS_ETAS_Inverter_L_Data.Inv_L_TempIGBT_calibrate ETCSignals.ES900.ES910.CAN2.CAN2.MEAS_ETAS_Inverter_L_Data.Inv_L_Speed_calibrate ETCSignals.ES900.ES910.CAN2.CAN2.MEAS_ETAS_Inverter_L_Data.Inv_L_Iq_calibrate ETCSignals.ES900.ES910.CAN2.CAN2.MEAS_ETAS_Inverter_L_Data.Inv_L_Icommand_calibrate ETCSignals.ES900.ES910.CAN2.CAN2.MEAS_ETAS_Inverter_L_Data.Inv_L_Iactual_calibrate ETCSignals.ES900.ES910.CAN2.CAN2.MEAS_ETAS_VDCdata6.SUSP_F_R_calibrate ETCSignals.ES900.ES910.CAN2.CAN2.MEAS_ETAS_VDCdata6.SUSP_F_L_calibrate ETCSignals.ES900.ES910.CAN2.CAN2.MEAS_ETAS_VDCdata5.Gyro_F_Z_Deg_calibrate ETCSignals.ES900.ES910.CAN2.CAN2.MEAS_ETAS_VDCdata5.Accel_F_Z_SI_calibrate ETCSignals.ES900.ES910.CAN2.CAN2.MEAS_ETAS_VDCdata5.Accel_F_Y_SI_calibrate ETCSignals.ES900.ES910.CAN2.CAN2.MEAS_ETAS_VDCdata5.Accel_F_X_SI_calibrate ETCSignals.ES900.ES910.CAN2.CAN2.MEAS_ETAS_VDCdata4.Gyro_R_Z_Deg_calibrate ETCSignals.ES900.ES910.CAN2.CAN2.MEAS_ETAS_VDCdata4.Accel_R_Z_SI_calibrate ETCSignals.ES900.ES910.CAN2.CAN2.MEAS_ETAS_VDCdata4.Accel_R_Y_SI_calibrate ETCSignals.ES900.ES910.CAN2.CAN2.MEAS_ETAS_VDCdata4.Accel_R_X_SI_calibrate ETCSignals.ES900.ES910.CAN2.CAN2.MEAS_ETAS_VDCdata7.Torque_R_calibrate ETCSignals.ES900.ES910.CAN2.CAN2.MEAS_ETAS_VDCdata7.Torque_L_calibrate ETCSignals.ES900.ES910.CAN2.CAN2.MEAS_ETAS_VDCdata3.Handling_calibrate ETCSignals.ES900.ES910.CAN2.CAN2.MEAS_ETAS_VDCdata3.Dash_Speed_calibrate ETCSignals.ES900.ES910.CAN2.CAN2.MEAS_ETAS_VDCdata3.Mass_calibrate ETCSignals.ES900.ES910.CAN2.CAN2.MEAS_ETAS_VDCdata2.Throttle_calibrate ETCSignals.ES900.ES910.CAN2.CAN2.MEAS_ETAS_VDCdata2.Max_Fx_RR_calibrate ETCSignals.ES900.ES910.CAN2.CAN2.MEAS_ETAS_VDCdata2.Max_Fx_RL_calibrate /end REF_CHARACTERISTIC
/end GROUP
/begin GROUP ETCSignals.ES900.ES910 ""
 /begin REF_CHARACTERISTIC ETCSignals.ES900.ES910.CAN1.CAN1.AP_ETAS_DashData1.Speed_calibrate ETCSignals.ES900.ES910.CAN1.CAN1.AP_ETAS_DashData1.Precharge_Voltage_calibrate ETCSignals.ES900.ES910.CAN1.CAN1.AP_ETAS_DashData1.Precharge_Percentage_calibrate ETCSignals.ES900.ES910.CAN1.CAN1.AP_ETAS_DashData1.LVbattery_Voltage_calibrate ETCSignals.ES900.ES910.CAN1.CAN1.AP_ETAS_DashData1.LVbattery_SOC_calibrate ETCSignals.ES900.ES910.CAN1.CAN1.AP_ETAS_VDCParams2.VDC_Cte_SKF_calibrate ETCSignals.ES900.ES910.CAN1.CAN1.AP_ETAS_VDCParams2.VDC_Cte_CKF_calibrate ETCSignals.ES900.ES910.CAN1.CAN1.AP_ETAS_VDCParams.VDC_CKF_Initial_calibrate ETCSignals.ES900.ES910.CAN1.CAN1.AP_ETAS_VDCParams.VDC_SKF_Initial_calibrate ETCSignals.ES900.ES910.CAN1.CAN1.AP_ETAS_VDCParams.VDC_Power_Limit_calibrate ETCSignals.ES900.ES910.CAN1.CAN1.AP_ETAS_VDCParams.VDC_Max_Regenerative_Torque_calibrate ETCSignals.ES900.ES910.CAN1.CAN1.AP_ETAS_VDCParams.VDC_K_Reduction_Temperature_calibrate ETCSignals.ES900.ES910.CAN1.CAN1.AP_ETAS_VDCParams.VDC_K_Reduction_P_calibrate ETCSignals.ES900.ES910.CAN1.CAN1.AP_ETAS_VDCParams.VDC_APPS_Sat_Up_calibrate ETCSignals.ES900.ES910.CAN1.CAN1.AP_ETAS_VDCParams.VDC_APPS_Sat_Down_calibrate ETCSignals.ES900.ES910.CAN1.CAN1.AP_ETAS_Inverter_R_Rx.Inverter_R_RegID_calibrate ETCSignals.ES900.ES910.CAN1.CAN1.AP_ETAS_Inverter_R_Rx.Inverter_R_b7tob0_calibrate ETCSignals.ES900.ES910.CAN1.CAN1.AP_ETAS_Inverter_R_Rx.Inverter_R_b15tob8_calibrate ETCSignals.ES900.ES910.CAN1.CAN1.AP_ETAS_Inverter_L_Rx.Inverter_L_RegID_calibrate ETCSignals.ES900.ES910.CAN1.CAN1.AP_ETAS_Inverter_L_Rx.Inverter_L_b7tob0_calibrate ETCSignals.ES900.ES910.CAN1.CAN1.AP_ETAS_Inverter_L_Rx.Inverter_L_b15tob8_calibrate ETCSignals.ES900.ES910.CAN1.CAN1.AP_ETAS_CarState.Car_State_calibrate ETCSignals.ES900.ES910.CAN1.CAN1.AP_ETAS_AIRsRequest.AIRs_Request_calibrate ETCSignals.ES900.ES910.CAN1.CAN1.AP_ETAS_AnalogicControl.BrakeLight_Control_calibrate ETCSignals.ES900.ES910.CAN1.CAN1.AP_ETAS_AnalogicControl.Pumps_Control_calibrate ETCSignals.ES900.ES910.CAN1.CAN1.MEAS_ETAS_InternalVars.CriticalDisconnection_calibrate ETCSignals.ES900.ES910.CAN1.CAN1.MEAS_ETAS_InternalVars.CurrentPathDisconnectionFlag_calibrate ETCSignals.ES900.ES910.CAN1.CAN1.MEAS_ETAS_InternalVars.Car_OK_calibrate ETCSignals.ES900.ES910.CAN1.CAN1.MEAS_ETAS_InternalVars.Power_calibrate ETCSignals.ES900.ES910.CAN1.CAN1.MEAS_ETAS_InternalVars.Torque_OK_calibrate ETCSignals.ES900.ES910.CAN1.CAN1.MEAS_ETAS_InternalVars.TV_Mode_calibrate ETCSignals.ES900.ES910.CAN1.CAN1.MEAS_ETAS_InternalVars.Critical_Signal_Disconnection_calibrate ETCSignals.ES900.ES910.CAN1.CAN1.MEAS_ETAS_InternalVars.Critical_CAN_Disconnection_calibrate ETCSignals.ES900.ES910.CAN1.CAN1.MEAS_ETAS_InternalVars.Brake_Implausibility_calibrate ETCSignals.ES900.ES910.CAN1.CAN1.MEAS_ETAS_InternalVars.APPS_Implausibility_calibrate ETCSignals.ES900.ES910.CAN1.CAN1.NM_ETAS_Disconnections.Disconnection_LV_Derivation_calibrate ETCSignals.ES900.ES910.CAN1.CAN1.NM_ETAS_Disconnections.Disconnection_DashBoard_calibrate ETCSignals.ES900.ES910.CAN1.CAN1.NM_ETAS_Disconnections.Disconnection_BMS_calibrate ETCSignals.ES900.ES910.CAN1.CAN1.NM_ETAS_Disconnections.Disconnection_Gyroscope_F_calibrate ETCSignals.ES900.ES910.CAN1.CAN1.NM_ETAS_Disconnections.Disconnection_Gyroscope_R_calibrate ETCSignals.ES900.ES910.CAN1.CAN1.NM_ETAS_Disconnections.Disconnection_Accel_F_calibrate ETCSignals.ES900.ES910.CAN1.CAN1.NM_ETAS_Disconnections.Disconnection_Accel_R_calibrate ETCSignals.ES900.ES910.CAN1.CAN1.NM_ETAS_Disconnections.Disconnection_SteeringSensor_calibrate ETCSignals.ES900.ES910.CAN1.CAN1.NM_ETAS_Disconnections.Disconnection_Susp_R_R_calibrate ETCSignals.ES900.ES910.CAN1.CAN1.NM_ETAS_Disconnections.Disconnection_Susp_R_L_calibrate ETCSignals.ES900.ES910.CAN1.CAN1.NM_ETAS_Disconnections.Disconnection_Susp_F_R_calibrate ETCSignals.ES900.ES910.CAN1.CAN1.NM_ETAS_Disconnections.Disconnection_Susp_F_L_calibrate ETCSignals.ES900.ES910.CAN1.CAN1.NM_ETAS_Disconnections.Disconnection_Brake_Sensor_calibrate ETCSignals.ES900.ES910.CAN1.CAN1.NM_ETAS_Disconnections.Disconnection_APPS2_calibrate ETCSignals.ES900.ES910.CAN1.CAN1.NM_ETAS_Disconnections.Disconnection_APPS1_calibrate ETCSignals.ES900.ES910.CAN1.CAN1.NM_ETAS_Disconnections.Disconnection_ADCAN_calibrate ETCSignals.ES900.ES910.CAN1.CAN1.NM_ETAS_Disconnections.Disconnection_Shutdown_calibrate ETCSignals.ES900.ES910.CAN1.CAN1.AP_ETAS_DashData2.SteeringSensor_Value_calibrate ETCSignals.ES900.ES910.CAN1.CAN1.AP_ETAS_DashData2.SKF_actual_calibrate ETCSignals.ES900.ES910.CAN1.CAN1.AP_ETAS_DashData2.CKF_actual_calibrate ETCSignals.ES900.ES910.CAN1.CAN1.AP_ETAS_DashData2.BrakeSensor_Value_calibrate ETCSignals.ES900.ES910.CAN1.CAN1.AP_ETAS_DashData2.APPS2_Value_calibrate ETCSignals.ES900.ES910.CAN1.CAN1.AP_ETAS_DashData2.APPS1_Value_calibrate ETCSignals.ES900.ES910.CAN1.CAN1.AP_ETAS_Synchronism.Sync_CAN1_calibrate ETCSignals.ES900.ES910.CAN2.CAN2.MEAS_ETAS_Inverter_R_Data.Inv_R_TempMotor_calibrate ETCSignals.ES900.ES910.CAN2.CAN2.MEAS_ETAS_Inverter_R_Data.Inv_R_TempIGBT_calibrate ETCSignals.ES900.ES910.CAN2.CAN2.MEAS_ETAS_Inverter_R_Data.Inv_R_Speed_calibrate ETCSignals.ES900.ES910.CAN2.CAN2.MEAS_ETAS_Inverter_R_Data.Inv_R_Iq_calibrate ETCSignals.ES900.ES910.CAN2.CAN2.MEAS_ETAS_Inverter_R_Data.Inv_R_Icommand_calibrate ETCSignals.ES900.ES910.CAN2.CAN2.MEAS_ETAS_Inverter_R_Data.Inv_R_Iactual_calibrate ETCSignals.ES900.ES910.CAN2.CAN2.MEAS_ETAS_Inverter_L_Data.Inv_L_TempMotor_calibrate ETCSignals.ES900.ES910.CAN2.CAN2.MEAS_ETAS_Inverter_L_Data.Inv_L_TempIGBT_calibrate ETCSignals.ES900.ES910.CAN2.CAN2.MEAS_ETAS_Inverter_L_Data.Inv_L_Speed_calibrate ETCSignals.ES900.ES910.CAN2.CAN2.MEAS_ETAS_Inverter_L_Data.Inv_L_Iq_calibrate ETCSignals.ES900.ES910.CAN2.CAN2.MEAS_ETAS_Inverter_L_Data.Inv_L_Icommand_calibrate ETCSignals.ES900.ES910.CAN2.CAN2.MEAS_ETAS_Inverter_L_Data.Inv_L_Iactual_calibrate ETCSignals.ES900.ES910.CAN2.CAN2.MEAS_ETAS_VDCdata6.SUSP_F_R_calibrate ETCSignals.ES900.ES910.CAN2.CAN2.MEAS_ETAS_VDCdata6.SUSP_F_L_calibrate ETCSignals.ES900.ES910.CAN2.CAN2.MEAS_ETAS_VDCdata5.Gyro_F_Z_Deg_calibrate ETCSignals.ES900.ES910.CAN2.CAN2.MEAS_ETAS_VDCdata5.Accel_F_Z_SI_calibrate ETCSignals.ES900.ES910.CAN2.CAN2.MEAS_ETAS_VDCdata5.Accel_F_Y_SI_calibrate ETCSignals.ES900.ES910.CAN2.CAN2.MEAS_ETAS_VDCdata5.Accel_F_X_SI_calibrate ETCSignals.ES900.ES910.CAN2.CAN2.MEAS_ETAS_VDCdata4.Gyro_R_Z_Deg_calibrate ETCSignals.ES900.ES910.CAN2.CAN2.MEAS_ETAS_VDCdata4.Accel_R_Z_SI_calibrate ETCSignals.ES900.ES910.CAN2.CAN2.MEAS_ETAS_VDCdata4.Accel_R_Y_SI_calibrate ETCSignals.ES900.ES910.CAN2.CAN2.MEAS_ETAS_VDCdata4.Accel_R_X_SI_calibrate ETCSignals.ES900.ES910.CAN2.CAN2.MEAS_ETAS_VDCdata7.Torque_R_calibrate ETCSignals.ES900.ES910.CAN2.CAN2.MEAS_ETAS_VDCdata7.Torque_L_calibrate ETCSignals.ES900.ES910.CAN2.CAN2.MEAS_ETAS_VDCdata3.Handling_calibrate ETCSignals.ES900.ES910.CAN2.CAN2.MEAS_ETAS_VDCdata3.Dash_Speed_calibrate ETCSignals.ES900.ES910.CAN2.CAN2.MEAS_ETAS_VDCdata3.Mass_calibrate ETCSignals.ES900.ES910.CAN2.CAN2.MEAS_ETAS_VDCdata2.Throttle_calibrate ETCSignals.ES900.ES910.CAN2.CAN2.MEAS_ETAS_VDCdata2.Max_Fx_RR_calibrate ETCSignals.ES900.ES910.CAN2.CAN2.MEAS_ETAS_VDCdata2.Max_Fx_RL_calibrate /end REF_CHARACTERISTIC
/end GROUP
/begin GROUP ETCSignals.ES900.ES910.CAN1 ""
 /begin REF_CHARACTERISTIC ETCSignals.ES900.ES910.CAN1.CAN1.AP_ETAS_DashData1.Speed_calibrate ETCSignals.ES900.ES910.CAN1.CAN1.AP_ETAS_DashData1.Precharge_Voltage_calibrate ETCSignals.ES900.ES910.CAN1.CAN1.AP_ETAS_DashData1.Precharge_Percentage_calibrate ETCSignals.ES900.ES910.CAN1.CAN1.AP_ETAS_DashData1.LVbattery_Voltage_calibrate ETCSignals.ES900.ES910.CAN1.CAN1.AP_ETAS_DashData1.LVbattery_SOC_calibrate ETCSignals.ES900.ES910.CAN1.CAN1.AP_ETAS_VDCParams2.VDC_Cte_SKF_calibrate ETCSignals.ES900.ES910.CAN1.CAN1.AP_ETAS_VDCParams2.VDC_Cte_CKF_calibrate ETCSignals.ES900.ES910.CAN1.CAN1.AP_ETAS_VDCParams.VDC_CKF_Initial_calibrate ETCSignals.ES900.ES910.CAN1.CAN1.AP_ETAS_VDCParams.VDC_SKF_Initial_calibrate ETCSignals.ES900.ES910.CAN1.CAN1.AP_ETAS_VDCParams.VDC_Power_Limit_calibrate ETCSignals.ES900.ES910.CAN1.CAN1.AP_ETAS_VDCParams.VDC_Max_Regenerative_Torque_calibrate ETCSignals.ES900.ES910.CAN1.CAN1.AP_ETAS_VDCParams.VDC_K_Reduction_Temperature_calibrate ETCSignals.ES900.ES910.CAN1.CAN1.AP_ETAS_VDCParams.VDC_K_Reduction_P_calibrate ETCSignals.ES900.ES910.CAN1.CAN1.AP_ETAS_VDCParams.VDC_APPS_Sat_Up_calibrate ETCSignals.ES900.ES910.CAN1.CAN1.AP_ETAS_VDCParams.VDC_APPS_Sat_Down_calibrate ETCSignals.ES900.ES910.CAN1.CAN1.AP_ETAS_Inverter_R_Rx.Inverter_R_RegID_calibrate ETCSignals.ES900.ES910.CAN1.CAN1.AP_ETAS_Inverter_R_Rx.Inverter_R_b7tob0_calibrate ETCSignals.ES900.ES910.CAN1.CAN1.AP_ETAS_Inverter_R_Rx.Inverter_R_b15tob8_calibrate ETCSignals.ES900.ES910.CAN1.CAN1.AP_ETAS_Inverter_L_Rx.Inverter_L_RegID_calibrate ETCSignals.ES900.ES910.CAN1.CAN1.AP_ETAS_Inverter_L_Rx.Inverter_L_b7tob0_calibrate ETCSignals.ES900.ES910.CAN1.CAN1.AP_ETAS_Inverter_L_Rx.Inverter_L_b15tob8_calibrate ETCSignals.ES900.ES910.CAN1.CAN1.AP_ETAS_CarState.Car_State_calibrate ETCSignals.ES900.ES910.CAN1.CAN1.AP_ETAS_AIRsRequest.AIRs_Request_calibrate ETCSignals.ES900.ES910.CAN1.CAN1.AP_ETAS_AnalogicControl.BrakeLight_Control_calibrate ETCSignals.ES900.ES910.CAN1.CAN1.AP_ETAS_AnalogicControl.Pumps_Control_calibrate ETCSignals.ES900.ES910.CAN1.CAN1.MEAS_ETAS_InternalVars.CriticalDisconnection_calibrate ETCSignals.ES900.ES910.CAN1.CAN1.MEAS_ETAS_InternalVars.CurrentPathDisconnectionFlag_calibrate ETCSignals.ES900.ES910.CAN1.CAN1.MEAS_ETAS_InternalVars.Car_OK_calibrate ETCSignals.ES900.ES910.CAN1.CAN1.MEAS_ETAS_InternalVars.Power_calibrate ETCSignals.ES900.ES910.CAN1.CAN1.MEAS_ETAS_InternalVars.Torque_OK_calibrate ETCSignals.ES900.ES910.CAN1.CAN1.MEAS_ETAS_InternalVars.TV_Mode_calibrate ETCSignals.ES900.ES910.CAN1.CAN1.MEAS_ETAS_InternalVars.Critical_Signal_Disconnection_calibrate ETCSignals.ES900.ES910.CAN1.CAN1.MEAS_ETAS_InternalVars.Critical_CAN_Disconnection_calibrate ETCSignals.ES900.ES910.CAN1.CAN1.MEAS_ETAS_InternalVars.Brake_Implausibility_calibrate ETCSignals.ES900.ES910.CAN1.CAN1.MEAS_ETAS_InternalVars.APPS_Implausibility_calibrate ETCSignals.ES900.ES910.CAN1.CAN1.NM_ETAS_Disconnections.Disconnection_LV_Derivation_calibrate ETCSignals.ES900.ES910.CAN1.CAN1.NM_ETAS_Disconnections.Disconnection_DashBoard_calibrate ETCSignals.ES900.ES910.CAN1.CAN1.NM_ETAS_Disconnections.Disconnection_BMS_calibrate ETCSignals.ES900.ES910.CAN1.CAN1.NM_ETAS_Disconnections.Disconnection_Gyroscope_F_calibrate ETCSignals.ES900.ES910.CAN1.CAN1.NM_ETAS_Disconnections.Disconnection_Gyroscope_R_calibrate ETCSignals.ES900.ES910.CAN1.CAN1.NM_ETAS_Disconnections.Disconnection_Accel_F_calibrate ETCSignals.ES900.ES910.CAN1.CAN1.NM_ETAS_Disconnections.Disconnection_Accel_R_calibrate ETCSignals.ES900.ES910.CAN1.CAN1.NM_ETAS_Disconnections.Disconnection_SteeringSensor_calibrate ETCSignals.ES900.ES910.CAN1.CAN1.NM_ETAS_Disconnections.Disconnection_Susp_R_R_calibrate ETCSignals.ES900.ES910.CAN1.CAN1.NM_ETAS_Disconnections.Disconnection_Susp_R_L_calibrate ETCSignals.ES900.ES910.CAN1.CAN1.NM_ETAS_Disconnections.Disconnection_Susp_F_R_calibrate ETCSignals.ES900.ES910.CAN1.CAN1.NM_ETAS_Disconnections.Disconnection_Susp_F_L_calibrate ETCSignals.ES900.ES910.CAN1.CAN1.NM_ETAS_Disconnections.Disconnection_Brake_Sensor_calibrate ETCSignals.ES900.ES910.CAN1.CAN1.NM_ETAS_Disconnections.Disconnection_APPS2_calibrate ETCSignals.ES900.ES910.CAN1.CAN1.NM_ETAS_Disconnections.Disconnection_APPS1_calibrate ETCSignals.ES900.ES910.CAN1.CAN1.NM_ETAS_Disconnections.Disconnection_ADCAN_calibrate ETCSignals.ES900.ES910.CAN1.CAN1.NM_ETAS_Disconnections.Disconnection_Shutdown_calibrate ETCSignals.ES900.ES910.CAN1.CAN1.AP_ETAS_DashData2.SteeringSensor_Value_calibrate ETCSignals.ES900.ES910.CAN1.CAN1.AP_ETAS_DashData2.SKF_actual_calibrate ETCSignals.ES900.ES910.CAN1.CAN1.AP_ETAS_DashData2.CKF_actual_calibrate ETCSignals.ES900.ES910.CAN1.CAN1.AP_ETAS_DashData2.BrakeSensor_Value_calibrate ETCSignals.ES900.ES910.CAN1.CAN1.AP_ETAS_DashData2.APPS2_Value_calibrate ETCSignals.ES900.ES910.CAN1.CAN1.AP_ETAS_DashData2.APPS1_Value_calibrate ETCSignals.ES900.ES910.CAN1.CAN1.AP_ETAS_Synchronism.Sync_CAN1_calibrate /end REF_CHARACTERISTIC
/end GROUP
/begin GROUP ETCSignals.ES900.ES910.CAN1.CAN1 ""
 /begin REF_CHARACTERISTIC ETCSignals.ES900.ES910.CAN1.CAN1.AP_ETAS_DashData1.Speed_calibrate ETCSignals.ES900.ES910.CAN1.CAN1.AP_ETAS_DashData1.Precharge_Voltage_calibrate ETCSignals.ES900.ES910.CAN1.CAN1.AP_ETAS_DashData1.Precharge_Percentage_calibrate ETCSignals.ES900.ES910.CAN1.CAN1.AP_ETAS_DashData1.LVbattery_Voltage_calibrate ETCSignals.ES900.ES910.CAN1.CAN1.AP_ETAS_DashData1.LVbattery_SOC_calibrate ETCSignals.ES900.ES910.CAN1.CAN1.AP_ETAS_VDCParams2.VDC_Cte_SKF_calibrate ETCSignals.ES900.ES910.CAN1.CAN1.AP_ETAS_VDCParams2.VDC_Cte_CKF_calibrate ETCSignals.ES900.ES910.CAN1.CAN1.AP_ETAS_VDCParams.VDC_CKF_Initial_calibrate ETCSignals.ES900.ES910.CAN1.CAN1.AP_ETAS_VDCParams.VDC_SKF_Initial_calibrate ETCSignals.ES900.ES910.CAN1.CAN1.AP_ETAS_VDCParams.VDC_Power_Limit_calibrate ETCSignals.ES900.ES910.CAN1.CAN1.AP_ETAS_VDCParams.VDC_Max_Regenerative_Torque_calibrate ETCSignals.ES900.ES910.CAN1.CAN1.AP_ETAS_VDCParams.VDC_K_Reduction_Temperature_calibrate ETCSignals.ES900.ES910.CAN1.CAN1.AP_ETAS_VDCParams.VDC_K_Reduction_P_calibrate ETCSignals.ES900.ES910.CAN1.CAN1.AP_ETAS_VDCParams.VDC_APPS_Sat_Up_calibrate ETCSignals.ES900.ES910.CAN1.CAN1.AP_ETAS_VDCParams.VDC_APPS_Sat_Down_calibrate ETCSignals.ES900.ES910.CAN1.CAN1.AP_ETAS_Inverter_R_Rx.Inverter_R_RegID_calibrate ETCSignals.ES900.ES910.CAN1.CAN1.AP_ETAS_Inverter_R_Rx.Inverter_R_b7tob0_calibrate ETCSignals.ES900.ES910.CAN1.CAN1.AP_ETAS_Inverter_R_Rx.Inverter_R_b15tob8_calibrate ETCSignals.ES900.ES910.CAN1.CAN1.AP_ETAS_Inverter_L_Rx.Inverter_L_RegID_calibrate ETCSignals.ES900.ES910.CAN1.CAN1.AP_ETAS_Inverter_L_Rx.Inverter_L_b7tob0_calibrate ETCSignals.ES900.ES910.CAN1.CAN1.AP_ETAS_Inverter_L_Rx.Inverter_L_b15tob8_calibrate ETCSignals.ES900.ES910.CAN1.CAN1.AP_ETAS_CarState.Car_State_calibrate ETCSignals.ES900.ES910.CAN1.CAN1.AP_ETAS_AIRsRequest.AIRs_Request_calibrate ETCSignals.ES900.ES910.CAN1.CAN1.AP_ETAS_AnalogicControl.BrakeLight_Control_calibrate ETCSignals.ES900.ES910.CAN1.CAN1.AP_ETAS_AnalogicControl.Pumps_Control_calibrate ETCSignals.ES900.ES910.CAN1.CAN1.MEAS_ETAS_InternalVars.CriticalDisconnection_calibrate ETCSignals.ES900.ES910.CAN1.CAN1.MEAS_ETAS_InternalVars.CurrentPathDisconnectionFlag_calibrate ETCSignals.ES900.ES910.CAN1.CAN1.MEAS_ETAS_InternalVars.Car_OK_calibrate ETCSignals.ES900.ES910.CAN1.CAN1.MEAS_ETAS_InternalVars.Power_calibrate ETCSignals.ES900.ES910.CAN1.CAN1.MEAS_ETAS_InternalVars.Torque_OK_calibrate ETCSignals.ES900.ES910.CAN1.CAN1.MEAS_ETAS_InternalVars.TV_Mode_calibrate ETCSignals.ES900.ES910.CAN1.CAN1.MEAS_ETAS_InternalVars.Critical_Signal_Disconnection_calibrate ETCSignals.ES900.ES910.CAN1.CAN1.MEAS_ETAS_InternalVars.Critical_CAN_Disconnection_calibrate ETCSignals.ES900.ES910.CAN1.CAN1.MEAS_ETAS_InternalVars.Brake_Implausibility_calibrate ETCSignals.ES900.ES910.CAN1.CAN1.MEAS_ETAS_InternalVars.APPS_Implausibility_calibrate ETCSignals.ES900.ES910.CAN1.CAN1.NM_ETAS_Disconnections.Disconnection_LV_Derivation_calibrate ETCSignals.ES900.ES910.CAN1.CAN1.NM_ETAS_Disconnections.Disconnection_DashBoard_calibrate ETCSignals.ES900.ES910.CAN1.CAN1.NM_ETAS_Disconnections.Disconnection_BMS_calibrate ETCSignals.ES900.ES910.CAN1.CAN1.NM_ETAS_Disconnections.Disconnection_Gyroscope_F_calibrate ETCSignals.ES900.ES910.CAN1.CAN1.NM_ETAS_Disconnections.Disconnection_Gyroscope_R_calibrate ETCSignals.ES900.ES910.CAN1.CAN1.NM_ETAS_Disconnections.Disconnection_Accel_F_calibrate ETCSignals.ES900.ES910.CAN1.CAN1.NM_ETAS_Disconnections.Disconnection_Accel_R_calibrate ETCSignals.ES900.ES910.CAN1.CAN1.NM_ETAS_Disconnections.Disconnection_SteeringSensor_calibrate ETCSignals.ES900.ES910.CAN1.CAN1.NM_ETAS_Disconnections.Disconnection_Susp_R_R_calibrate ETCSignals.ES900.ES910.CAN1.CAN1.NM_ETAS_Disconnections.Disconnection_Susp_R_L_calibrate ETCSignals.ES900.ES910.CAN1.CAN1.NM_ETAS_Disconnections.Disconnection_Susp_F_R_calibrate ETCSignals.ES900.ES910.CAN1.CAN1.NM_ETAS_Disconnections.Disconnection_Susp_F_L_calibrate ETCSignals.ES900.ES910.CAN1.CAN1.NM_ETAS_Disconnections.Disconnection_Brake_Sensor_calibrate ETCSignals.ES900.ES910.CAN1.CAN1.NM_ETAS_Disconnections.Disconnection_APPS2_calibrate ETCSignals.ES900.ES910.CAN1.CAN1.NM_ETAS_Disconnections.Disconnection_APPS1_calibrate ETCSignals.ES900.ES910.CAN1.CAN1.NM_ETAS_Disconnections.Disconnection_ADCAN_calibrate ETCSignals.ES900.ES910.CAN1.CAN1.NM_ETAS_Disconnections.Disconnection_Shutdown_calibrate ETCSignals.ES900.ES910.CAN1.CAN1.AP_ETAS_DashData2.SteeringSensor_Value_calibrate ETCSignals.ES900.ES910.CAN1.CAN1.AP_ETAS_DashData2.SKF_actual_calibrate ETCSignals.ES900.ES910.CAN1.CAN1.AP_ETAS_DashData2.CKF_actual_calibrate ETCSignals.ES900.ES910.CAN1.CAN1.AP_ETAS_DashData2.BrakeSensor_Value_calibrate ETCSignals.ES900.ES910.CAN1.CAN1.AP_ETAS_DashData2.APPS2_Value_calibrate ETCSignals.ES900.ES910.CAN1.CAN1.AP_ETAS_DashData2.APPS1_Value_calibrate ETCSignals.ES900.ES910.CAN1.CAN1.AP_ETAS_Synchronism.Sync_CAN1_calibrate /end REF_CHARACTERISTIC
/end GROUP
/begin GROUP ETCSignals.ES900.ES910.CAN1.CAN1.AP_ETAS_DashData1 ""
 /begin REF_CHARACTERISTIC ETCSignals.ES900.ES910.CAN1.CAN1.AP_ETAS_DashData1.Speed_calibrate ETCSignals.ES900.ES910.CAN1.CAN1.AP_ETAS_DashData1.Precharge_Voltage_calibrate ETCSignals.ES900.ES910.CAN1.CAN1.AP_ETAS_DashData1.Precharge_Percentage_calibrate ETCSignals.ES900.ES910.CAN1.CAN1.AP_ETAS_DashData1.LVbattery_Voltage_calibrate ETCSignals.ES900.ES910.CAN1.CAN1.AP_ETAS_DashData1.LVbattery_SOC_calibrate /end REF_CHARACTERISTIC
/end GROUP
/begin GROUP ETCSignals.ES900.ES910.CAN1.CAN1.AP_ETAS_VDCParams2 ""
 /begin REF_CHARACTERISTIC ETCSignals.ES900.ES910.CAN1.CAN1.AP_ETAS_VDCParams2.VDC_Cte_SKF_calibrate ETCSignals.ES900.ES910.CAN1.CAN1.AP_ETAS_VDCParams2.VDC_Cte_CKF_calibrate /end REF_CHARACTERISTIC
/end GROUP
/begin GROUP ETCSignals.ES900.ES910.CAN1.CAN1.AP_ETAS_VDCParams ""
 /begin REF_CHARACTERISTIC ETCSignals.ES900.ES910.CAN1.CAN1.AP_ETAS_VDCParams.VDC_CKF_Initial_calibrate ETCSignals.ES900.ES910.CAN1.CAN1.AP_ETAS_VDCParams.VDC_SKF_Initial_calibrate ETCSignals.ES900.ES910.CAN1.CAN1.AP_ETAS_VDCParams.VDC_Power_Limit_calibrate ETCSignals.ES900.ES910.CAN1.CAN1.AP_ETAS_VDCParams.VDC_Max_Regenerative_Torque_calibrate ETCSignals.ES900.ES910.CAN1.CAN1.AP_ETAS_VDCParams.VDC_K_Reduction_Temperature_calibrate ETCSignals.ES900.ES910.CAN1.CAN1.AP_ETAS_VDCParams.VDC_K_Reduction_P_calibrate ETCSignals.ES900.ES910.CAN1.CAN1.AP_ETAS_VDCParams.VDC_APPS_Sat_Up_calibrate ETCSignals.ES900.ES910.CAN1.CAN1.AP_ETAS_VDCParams.VDC_APPS_Sat_Down_calibrate /end REF_CHARACTERISTIC
/end GROUP
/begin GROUP ETCSignals.ES900.ES910.CAN1.CAN1.AP_ETAS_Inverter_R_Rx ""
 /begin REF_CHARACTERISTIC ETCSignals.ES900.ES910.CAN1.CAN1.AP_ETAS_Inverter_R_Rx.Inverter_R_RegID_calibrate ETCSignals.ES900.ES910.CAN1.CAN1.AP_ETAS_Inverter_R_Rx.Inverter_R_b7tob0_calibrate ETCSignals.ES900.ES910.CAN1.CAN1.AP_ETAS_Inverter_R_Rx.Inverter_R_b15tob8_calibrate /end REF_CHARACTERISTIC
/end GROUP
/begin GROUP ETCSignals.ES900.ES910.CAN1.CAN1.AP_ETAS_Inverter_L_Rx ""
 /begin REF_CHARACTERISTIC ETCSignals.ES900.ES910.CAN1.CAN1.AP_ETAS_Inverter_L_Rx.Inverter_L_RegID_calibrate ETCSignals.ES900.ES910.CAN1.CAN1.AP_ETAS_Inverter_L_Rx.Inverter_L_b7tob0_calibrate ETCSignals.ES900.ES910.CAN1.CAN1.AP_ETAS_Inverter_L_Rx.Inverter_L_b15tob8_calibrate /end REF_CHARACTERISTIC
/end GROUP
/begin GROUP ETCSignals.ES900.ES910.CAN1.CAN1.AP_ETAS_CarState ""
 /begin REF_CHARACTERISTIC ETCSignals.ES900.ES910.CAN1.CAN1.AP_ETAS_CarState.Car_State_calibrate /end REF_CHARACTERISTIC
/end GROUP
/begin GROUP ETCSignals.ES900.ES910.CAN1.CAN1.AP_ETAS_AIRsRequest ""
 /begin REF_CHARACTERISTIC ETCSignals.ES900.ES910.CAN1.CAN1.AP_ETAS_AIRsRequest.AIRs_Request_calibrate /end REF_CHARACTERISTIC
/end GROUP
/begin GROUP ETCSignals.ES900.ES910.CAN1.CAN1.AP_ETAS_AnalogicControl ""
 /begin REF_CHARACTERISTIC ETCSignals.ES900.ES910.CAN1.CAN1.AP_ETAS_AnalogicControl.BrakeLight_Control_calibrate ETCSignals.ES900.ES910.CAN1.CAN1.AP_ETAS_AnalogicControl.Pumps_Control_calibrate /end REF_CHARACTERISTIC
/end GROUP
/begin GROUP ETCSignals.ES900.ES910.CAN1.CAN1.MEAS_ETAS_InternalVars ""
 /begin REF_CHARACTERISTIC ETCSignals.ES900.ES910.CAN1.CAN1.MEAS_ETAS_InternalVars.CriticalDisconnection_calibrate ETCSignals.ES900.ES910.CAN1.CAN1.MEAS_ETAS_InternalVars.CurrentPathDisconnectionFlag_calibrate ETCSignals.ES900.ES910.CAN1.CAN1.MEAS_ETAS_InternalVars.Car_OK_calibrate ETCSignals.ES900.ES910.CAN1.CAN1.MEAS_ETAS_InternalVars.Power_calibrate ETCSignals.ES900.ES910.CAN1.CAN1.MEAS_ETAS_InternalVars.Torque_OK_calibrate ETCSignals.ES900.ES910.CAN1.CAN1.MEAS_ETAS_InternalVars.TV_Mode_calibrate ETCSignals.ES900.ES910.CAN1.CAN1.MEAS_ETAS_InternalVars.Critical_Signal_Disconnection_calibrate ETCSignals.ES900.ES910.CAN1.CAN1.MEAS_ETAS_InternalVars.Critical_CAN_Disconnection_calibrate ETCSignals.ES900.ES910.CAN1.CAN1.MEAS_ETAS_InternalVars.Brake_Implausibility_calibrate ETCSignals.ES900.ES910.CAN1.CAN1.MEAS_ETAS_InternalVars.APPS_Implausibility_calibrate /end REF_CHARACTERISTIC
/end GROUP
/begin GROUP ETCSignals.ES900.ES910.CAN1.CAN1.NM_ETAS_Disconnections ""
 /begin REF_CHARACTERISTIC ETCSignals.ES900.ES910.CAN1.CAN1.NM_ETAS_Disconnections.Disconnection_LV_Derivation_calibrate ETCSignals.ES900.ES910.CAN1.CAN1.NM_ETAS_Disconnections.Disconnection_DashBoard_calibrate ETCSignals.ES900.ES910.CAN1.CAN1.NM_ETAS_Disconnections.Disconnection_BMS_calibrate ETCSignals.ES900.ES910.CAN1.CAN1.NM_ETAS_Disconnections.Disconnection_Gyroscope_F_calibrate ETCSignals.ES900.ES910.CAN1.CAN1.NM_ETAS_Disconnections.Disconnection_Gyroscope_R_calibrate ETCSignals.ES900.ES910.CAN1.CAN1.NM_ETAS_Disconnections.Disconnection_Accel_F_calibrate ETCSignals.ES900.ES910.CAN1.CAN1.NM_ETAS_Disconnections.Disconnection_Accel_R_calibrate ETCSignals.ES900.ES910.CAN1.CAN1.NM_ETAS_Disconnections.Disconnection_SteeringSensor_calibrate ETCSignals.ES900.ES910.CAN1.CAN1.NM_ETAS_Disconnections.Disconnection_Susp_R_R_calibrate ETCSignals.ES900.ES910.CAN1.CAN1.NM_ETAS_Disconnections.Disconnection_Susp_R_L_calibrate ETCSignals.ES900.ES910.CAN1.CAN1.NM_ETAS_Disconnections.Disconnection_Susp_F_R_calibrate ETCSignals.ES900.ES910.CAN1.CAN1.NM_ETAS_Disconnections.Disconnection_Susp_F_L_calibrate ETCSignals.ES900.ES910.CAN1.CAN1.NM_ETAS_Disconnections.Disconnection_Brake_Sensor_calibrate ETCSignals.ES900.ES910.CAN1.CAN1.NM_ETAS_Disconnections.Disconnection_APPS2_calibrate ETCSignals.ES900.ES910.CAN1.CAN1.NM_ETAS_Disconnections.Disconnection_APPS1_calibrate ETCSignals.ES900.ES910.CAN1.CAN1.NM_ETAS_Disconnections.Disconnection_ADCAN_calibrate ETCSignals.ES900.ES910.CAN1.CAN1.NM_ETAS_Disconnections.Disconnection_Shutdown_calibrate /end REF_CHARACTERISTIC
/end GROUP
/begin GROUP ETCSignals.ES900.ES910.CAN1.CAN1.AP_ETAS_DashData2 ""
 /begin REF_CHARACTERISTIC ETCSignals.ES900.ES910.CAN1.CAN1.AP_ETAS_DashData2.SteeringSensor_Value_calibrate ETCSignals.ES900.ES910.CAN1.CAN1.AP_ETAS_DashData2.SKF_actual_calibrate ETCSignals.ES900.ES910.CAN1.CAN1.AP_ETAS_DashData2.CKF_actual_calibrate ETCSignals.ES900.ES910.CAN1.CAN1.AP_ETAS_DashData2.BrakeSensor_Value_calibrate ETCSignals.ES900.ES910.CAN1.CAN1.AP_ETAS_DashData2.APPS2_Value_calibrate ETCSignals.ES900.ES910.CAN1.CAN1.AP_ETAS_DashData2.APPS1_Value_calibrate /end REF_CHARACTERISTIC
/end GROUP
/begin GROUP ETCSignals.ES900.ES910.CAN1.CAN1.AP_ETAS_Synchronism ""
 /begin REF_CHARACTERISTIC ETCSignals.ES900.ES910.CAN1.CAN1.AP_ETAS_Synchronism.Sync_CAN1_calibrate /end REF_CHARACTERISTIC
/end GROUP
/begin GROUP ETCSignals.ES900.ES910.CAN2 ""
 /begin REF_CHARACTERISTIC ETCSignals.ES900.ES910.CAN2.CAN2.MEAS_ETAS_Inverter_R_Data.Inv_R_TempMotor_calibrate ETCSignals.ES900.ES910.CAN2.CAN2.MEAS_ETAS_Inverter_R_Data.Inv_R_TempIGBT_calibrate ETCSignals.ES900.ES910.CAN2.CAN2.MEAS_ETAS_Inverter_R_Data.Inv_R_Speed_calibrate ETCSignals.ES900.ES910.CAN2.CAN2.MEAS_ETAS_Inverter_R_Data.Inv_R_Iq_calibrate ETCSignals.ES900.ES910.CAN2.CAN2.MEAS_ETAS_Inverter_R_Data.Inv_R_Icommand_calibrate ETCSignals.ES900.ES910.CAN2.CAN2.MEAS_ETAS_Inverter_R_Data.Inv_R_Iactual_calibrate ETCSignals.ES900.ES910.CAN2.CAN2.MEAS_ETAS_Inverter_L_Data.Inv_L_TempMotor_calibrate ETCSignals.ES900.ES910.CAN2.CAN2.MEAS_ETAS_Inverter_L_Data.Inv_L_TempIGBT_calibrate ETCSignals.ES900.ES910.CAN2.CAN2.MEAS_ETAS_Inverter_L_Data.Inv_L_Speed_calibrate ETCSignals.ES900.ES910.CAN2.CAN2.MEAS_ETAS_Inverter_L_Data.Inv_L_Iq_calibrate ETCSignals.ES900.ES910.CAN2.CAN2.MEAS_ETAS_Inverter_L_Data.Inv_L_Icommand_calibrate ETCSignals.ES900.ES910.CAN2.CAN2.MEAS_ETAS_Inverter_L_Data.Inv_L_Iactual_calibrate ETCSignals.ES900.ES910.CAN2.CAN2.MEAS_ETAS_VDCdata6.SUSP_F_R_calibrate ETCSignals.ES900.ES910.CAN2.CAN2.MEAS_ETAS_VDCdata6.SUSP_F_L_calibrate ETCSignals.ES900.ES910.CAN2.CAN2.MEAS_ETAS_VDCdata5.Gyro_F_Z_Deg_calibrate ETCSignals.ES900.ES910.CAN2.CAN2.MEAS_ETAS_VDCdata5.Accel_F_Z_SI_calibrate ETCSignals.ES900.ES910.CAN2.CAN2.MEAS_ETAS_VDCdata5.Accel_F_Y_SI_calibrate ETCSignals.ES900.ES910.CAN2.CAN2.MEAS_ETAS_VDCdata5.Accel_F_X_SI_calibrate ETCSignals.ES900.ES910.CAN2.CAN2.MEAS_ETAS_VDCdata4.Gyro_R_Z_Deg_calibrate ETCSignals.ES900.ES910.CAN2.CAN2.MEAS_ETAS_VDCdata4.Accel_R_Z_SI_calibrate ETCSignals.ES900.ES910.CAN2.CAN2.MEAS_ETAS_VDCdata4.Accel_R_Y_SI_calibrate ETCSignals.ES900.ES910.CAN2.CAN2.MEAS_ETAS_VDCdata4.Accel_R_X_SI_calibrate ETCSignals.ES900.ES910.CAN2.CAN2.MEAS_ETAS_VDCdata7.Torque_R_calibrate ETCSignals.ES900.ES910.CAN2.CAN2.MEAS_ETAS_VDCdata7.Torque_L_calibrate ETCSignals.ES900.ES910.CAN2.CAN2.MEAS_ETAS_VDCdata3.Handling_calibrate ETCSignals.ES900.ES910.CAN2.CAN2.MEAS_ETAS_VDCdata3.Dash_Speed_calibrate ETCSignals.ES900.ES910.CAN2.CAN2.MEAS_ETAS_VDCdata3.Mass_calibrate ETCSignals.ES900.ES910.CAN2.CAN2.MEAS_ETAS_VDCdata2.Throttle_calibrate ETCSignals.ES900.ES910.CAN2.CAN2.MEAS_ETAS_VDCdata2.Max_Fx_RR_calibrate ETCSignals.ES900.ES910.CAN2.CAN2.MEAS_ETAS_VDCdata2.Max_Fx_RL_calibrate /end REF_CHARACTERISTIC
/end GROUP
/begin GROUP ETCSignals.ES900.ES910.CAN2.CAN2 ""
 /begin REF_CHARACTERISTIC ETCSignals.ES900.ES910.CAN2.CAN2.MEAS_ETAS_Inverter_R_Data.Inv_R_TempMotor_calibrate ETCSignals.ES900.ES910.CAN2.CAN2.MEAS_ETAS_Inverter_R_Data.Inv_R_TempIGBT_calibrate ETCSignals.ES900.ES910.CAN2.CAN2.MEAS_ETAS_Inverter_R_Data.Inv_R_Speed_calibrate ETCSignals.ES900.ES910.CAN2.CAN2.MEAS_ETAS_Inverter_R_Data.Inv_R_Iq_calibrate ETCSignals.ES900.ES910.CAN2.CAN2.MEAS_ETAS_Inverter_R_Data.Inv_R_Icommand_calibrate ETCSignals.ES900.ES910.CAN2.CAN2.MEAS_ETAS_Inverter_R_Data.Inv_R_Iactual_calibrate ETCSignals.ES900.ES910.CAN2.CAN2.MEAS_ETAS_Inverter_L_Data.Inv_L_TempMotor_calibrate ETCSignals.ES900.ES910.CAN2.CAN2.MEAS_ETAS_Inverter_L_Data.Inv_L_TempIGBT_calibrate ETCSignals.ES900.ES910.CAN2.CAN2.MEAS_ETAS_Inverter_L_Data.Inv_L_Speed_calibrate ETCSignals.ES900.ES910.CAN2.CAN2.MEAS_ETAS_Inverter_L_Data.Inv_L_Iq_calibrate ETCSignals.ES900.ES910.CAN2.CAN2.MEAS_ETAS_Inverter_L_Data.Inv_L_Icommand_calibrate ETCSignals.ES900.ES910.CAN2.CAN2.MEAS_ETAS_Inverter_L_Data.Inv_L_Iactual_calibrate ETCSignals.ES900.ES910.CAN2.CAN2.MEAS_ETAS_VDCdata6.SUSP_F_R_calibrate ETCSignals.ES900.ES910.CAN2.CAN2.MEAS_ETAS_VDCdata6.SUSP_F_L_calibrate ETCSignals.ES900.ES910.CAN2.CAN2.MEAS_ETAS_VDCdata5.Gyro_F_Z_Deg_calibrate ETCSignals.ES900.ES910.CAN2.CAN2.MEAS_ETAS_VDCdata5.Accel_F_Z_SI_calibrate ETCSignals.ES900.ES910.CAN2.CAN2.MEAS_ETAS_VDCdata5.Accel_F_Y_SI_calibrate ETCSignals.ES900.ES910.CAN2.CAN2.MEAS_ETAS_VDCdata5.Accel_F_X_SI_calibrate ETCSignals.ES900.ES910.CAN2.CAN2.MEAS_ETAS_VDCdata4.Gyro_R_Z_Deg_calibrate ETCSignals.ES900.ES910.CAN2.CAN2.MEAS_ETAS_VDCdata4.Accel_R_Z_SI_calibrate ETCSignals.ES900.ES910.CAN2.CAN2.MEAS_ETAS_VDCdata4.Accel_R_Y_SI_calibrate ETCSignals.ES900.ES910.CAN2.CAN2.MEAS_ETAS_VDCdata4.Accel_R_X_SI_calibrate ETCSignals.ES900.ES910.CAN2.CAN2.MEAS_ETAS_VDCdata7.Torque_R_calibrate ETCSignals.ES900.ES910.CAN2.CAN2.MEAS_ETAS_VDCdata7.Torque_L_calibrate ETCSignals.ES900.ES910.CAN2.CAN2.MEAS_ETAS_VDCdata3.Handling_calibrate ETCSignals.ES900.ES910.CAN2.CAN2.MEAS_ETAS_VDCdata3.Dash_Speed_calibrate ETCSignals.ES900.ES910.CAN2.CAN2.MEAS_ETAS_VDCdata3.Mass_calibrate ETCSignals.ES900.ES910.CAN2.CAN2.MEAS_ETAS_VDCdata2.Throttle_calibrate ETCSignals.ES900.ES910.CAN2.CAN2.MEAS_ETAS_VDCdata2.Max_Fx_RR_calibrate ETCSignals.ES900.ES910.CAN2.CAN2.MEAS_ETAS_VDCdata2.Max_Fx_RL_calibrate /end REF_CHARACTERISTIC
/end GROUP
/begin GROUP ETCSignals.ES900.ES910.CAN2.CAN2.MEAS_ETAS_Inverter_R_Data ""
 /begin REF_CHARACTERISTIC ETCSignals.ES900.ES910.CAN2.CAN2.MEAS_ETAS_Inverter_R_Data.Inv_R_TempMotor_calibrate ETCSignals.ES900.ES910.CAN2.CAN2.MEAS_ETAS_Inverter_R_Data.Inv_R_TempIGBT_calibrate ETCSignals.ES900.ES910.CAN2.CAN2.MEAS_ETAS_Inverter_R_Data.Inv_R_Speed_calibrate ETCSignals.ES900.ES910.CAN2.CAN2.MEAS_ETAS_Inverter_R_Data.Inv_R_Iq_calibrate ETCSignals.ES900.ES910.CAN2.CAN2.MEAS_ETAS_Inverter_R_Data.Inv_R_Icommand_calibrate ETCSignals.ES900.ES910.CAN2.CAN2.MEAS_ETAS_Inverter_R_Data.Inv_R_Iactual_calibrate /end REF_CHARACTERISTIC
/end GROUP
/begin GROUP ETCSignals.ES900.ES910.CAN2.CAN2.MEAS_ETAS_Inverter_L_Data ""
 /begin REF_CHARACTERISTIC ETCSignals.ES900.ES910.CAN2.CAN2.MEAS_ETAS_Inverter_L_Data.Inv_L_TempMotor_calibrate ETCSignals.ES900.ES910.CAN2.CAN2.MEAS_ETAS_Inverter_L_Data.Inv_L_TempIGBT_calibrate ETCSignals.ES900.ES910.CAN2.CAN2.MEAS_ETAS_Inverter_L_Data.Inv_L_Speed_calibrate ETCSignals.ES900.ES910.CAN2.CAN2.MEAS_ETAS_Inverter_L_Data.Inv_L_Iq_calibrate ETCSignals.ES900.ES910.CAN2.CAN2.MEAS_ETAS_Inverter_L_Data.Inv_L_Icommand_calibrate ETCSignals.ES900.ES910.CAN2.CAN2.MEAS_ETAS_Inverter_L_Data.Inv_L_Iactual_calibrate /end REF_CHARACTERISTIC
/end GROUP
/begin GROUP ETCSignals.ES900.ES910.CAN2.CAN2.MEAS_ETAS_VDCdata6 ""
 /begin REF_CHARACTERISTIC ETCSignals.ES900.ES910.CAN2.CAN2.MEAS_ETAS_VDCdata6.SUSP_F_R_calibrate ETCSignals.ES900.ES910.CAN2.CAN2.MEAS_ETAS_VDCdata6.SUSP_F_L_calibrate /end REF_CHARACTERISTIC
/end GROUP
/begin GROUP ETCSignals.ES900.ES910.CAN2.CAN2.MEAS_ETAS_VDCdata5 ""
 /begin REF_CHARACTERISTIC ETCSignals.ES900.ES910.CAN2.CAN2.MEAS_ETAS_VDCdata5.Gyro_F_Z_Deg_calibrate ETCSignals.ES900.ES910.CAN2.CAN2.MEAS_ETAS_VDCdata5.Accel_F_Z_SI_calibrate ETCSignals.ES900.ES910.CAN2.CAN2.MEAS_ETAS_VDCdata5.Accel_F_Y_SI_calibrate ETCSignals.ES900.ES910.CAN2.CAN2.MEAS_ETAS_VDCdata5.Accel_F_X_SI_calibrate /end REF_CHARACTERISTIC
/end GROUP
/begin GROUP ETCSignals.ES900.ES910.CAN2.CAN2.MEAS_ETAS_VDCdata4 ""
 /begin REF_CHARACTERISTIC ETCSignals.ES900.ES910.CAN2.CAN2.MEAS_ETAS_VDCdata4.Gyro_R_Z_Deg_calibrate ETCSignals.ES900.ES910.CAN2.CAN2.MEAS_ETAS_VDCdata4.Accel_R_Z_SI_calibrate ETCSignals.ES900.ES910.CAN2.CAN2.MEAS_ETAS_VDCdata4.Accel_R_Y_SI_calibrate ETCSignals.ES900.ES910.CAN2.CAN2.MEAS_ETAS_VDCdata4.Accel_R_X_SI_calibrate /end REF_CHARACTERISTIC
/end GROUP
/begin GROUP ETCSignals.ES900.ES910.CAN2.CAN2.MEAS_ETAS_VDCdata7 ""
 /begin REF_CHARACTERISTIC ETCSignals.ES900.ES910.CAN2.CAN2.MEAS_ETAS_VDCdata7.Torque_R_calibrate ETCSignals.ES900.ES910.CAN2.CAN2.MEAS_ETAS_VDCdata7.Torque_L_calibrate /end REF_CHARACTERISTIC
/end GROUP
/begin GROUP ETCSignals.ES900.ES910.CAN2.CAN2.MEAS_ETAS_VDCdata3 ""
 /begin REF_CHARACTERISTIC ETCSignals.ES900.ES910.CAN2.CAN2.MEAS_ETAS_VDCdata3.Handling_calibrate ETCSignals.ES900.ES910.CAN2.CAN2.MEAS_ETAS_VDCdata3.Dash_Speed_calibrate ETCSignals.ES900.ES910.CAN2.CAN2.MEAS_ETAS_VDCdata3.Mass_calibrate /end REF_CHARACTERISTIC
/end GROUP
/begin GROUP ETCSignals.ES900.ES910.CAN2.CAN2.MEAS_ETAS_VDCdata2 ""
 /begin REF_CHARACTERISTIC ETCSignals.ES900.ES910.CAN2.CAN2.MEAS_ETAS_VDCdata2.Throttle_calibrate ETCSignals.ES900.ES910.CAN2.CAN2.MEAS_ETAS_VDCdata2.Max_Fx_RR_calibrate ETCSignals.ES900.ES910.CAN2.CAN2.MEAS_ETAS_VDCdata2.Max_Fx_RL_calibrate /end REF_CHARACTERISTIC
/end GROUP
/end MODULE
/end PROJECT
