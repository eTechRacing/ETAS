ASAP2_VERSION 1 41
/begin PROJECT ETAS "Generated by ETAS from INTECRIO V4.7.0.1005 integration project"
/begin HEADER "" VERSION "" PROJECT_NO Y /end HEADER
/begin MODULE INTECRIO_MERGED "Generated by ETAS INTECRIO V4.7.0.1005 for M/C interface ETARGET"
/begin MOD_COMMON "Common definitions" BYTE_ORDER MSB_FIRST ALIGNMENT_BYTE 1 ALIGNMENT_WORD 2 ALIGNMENT_LONG 4 ALIGNMENT_FLOAT32_IEEE 4 ALIGNMENT_FLOAT64_IEEE 8 /end MOD_COMMON
/begin MEASUREMENT ETCSignals.ES900.ES910.CAN1.Presence.PresenceGroup.PresenceFlag "" FLOAT64_IEEE LINEAR_FUNCTION_M1_T0_U1 1 100 0 1 ECU_ADDRESS 0x0 /end MEASUREMENT
/begin MEASUREMENT ETCSignals.ES900.ES910.CAN1.CAN1.AP_BMS_Current_SOC_SOH.Accumulator_SOH "" FLOAT64_IEEE LINEAR_FUNCTION_M1_T0_U1 1 100 0 0 ECU_ADDRESS 0x0 /end MEASUREMENT
/begin MEASUREMENT ETCSignals.ES900.ES910.CAN1.CAN1.AP_BMS_Current_SOC_SOH.Accumulator_SOC "" FLOAT64_IEEE LINEAR_FUNCTION_M1_T0_U1 1 100 0 0 ECU_ADDRESS 0x0 /end MEASUREMENT
/begin MEASUREMENT ETCSignals.ES900.ES910.CAN1.CAN1.AP_BMS_Current_SOC_SOH.Accumulator_Current "" FLOAT64_IEEE LINEAR_FUNCTION_M1_T0_U1 1 100 0 0 ECU_ADDRESS 0x0 /end MEASUREMENT
/begin MEASUREMENT ETCSignals.ES900.ES910.CAN1.CAN1.AP_BMS_StateAndFailReport.BMS_AccumulatorIntck "" FLOAT64_IEEE LINEAR_FUNCTION_M1_T0_U1 1 100 0 0 ECU_ADDRESS 0x0 /end MEASUREMENT
/begin MEASUREMENT ETCSignals.ES900.ES910.CAN1.CAN1.AP_BMS_StateAndFailReport.State_PrechargeRelay "" FLOAT64_IEEE LINEAR_FUNCTION_M1_T0_U1 1 100 0 0 ECU_ADDRESS 0x0 /end MEASUREMENT
/begin MEASUREMENT ETCSignals.ES900.ES910.CAN1.CAN1.AP_BMS_StateAndFailReport.State_DivideCurrent "" FLOAT64_IEEE LINEAR_FUNCTION_M1_T0_U1 1 100 0 0 ECU_ADDRESS 0x0 /end MEASUREMENT
/begin MEASUREMENT ETCSignals.ES900.ES910.CAN1.CAN1.AP_BMS_StateAndFailReport.State_BMS_Ok "" FLOAT64_IEEE LINEAR_FUNCTION_M1_T0_U1 1 100 0 0 ECU_ADDRESS 0x0 /end MEASUREMENT
/begin MEASUREMENT ETCSignals.ES900.ES910.CAN1.CAN1.AP_BMS_StateAndFailReport.State_Balancing "" FLOAT64_IEEE LINEAR_FUNCTION_M1_T0_U1 1 100 0 0 ECU_ADDRESS 0x0 /end MEASUREMENT
/begin MEASUREMENT ETCSignals.ES900.ES910.CAN1.CAN1.AP_BMS_StateAndFailReport.State_Air_Plus "" FLOAT64_IEEE LINEAR_FUNCTION_M1_T0_U1 1 100 0 0 ECU_ADDRESS 0x0 /end MEASUREMENT
/begin MEASUREMENT ETCSignals.ES900.ES910.CAN1.CAN1.AP_BMS_StateAndFailReport.State_Air_Minus "" FLOAT64_IEEE LINEAR_FUNCTION_M1_T0_U1 1 100 0 0 ECU_ADDRESS 0x0 /end MEASUREMENT
/begin MEASUREMENT ETCSignals.ES900.ES910.CAN1.CAN1.AP_BMS_StateAndFailReport.State_AccumulatorFans "" FLOAT64_IEEE LINEAR_FUNCTION_M1_T0_U1 1 100 0 0 ECU_ADDRESS 0x0 /end MEASUREMENT
/begin MEASUREMENT ETCSignals.ES900.ES910.CAN1.CAN1.AP_BMS_StateAndFailReport.BMSerror_VoltageDisconnection "" FLOAT64_IEEE LINEAR_FUNCTION_M1_T0_U1 1 100 0 0 ECU_ADDRESS 0x0 /end MEASUREMENT
/begin MEASUREMENT ETCSignals.ES900.ES910.CAN1.CAN1.AP_BMS_StateAndFailReport.BMSerror_UnderVoltage "" FLOAT64_IEEE LINEAR_FUNCTION_M1_T0_U1 1 100 0 0 ECU_ADDRESS 0x0 /end MEASUREMENT
/begin MEASUREMENT ETCSignals.ES900.ES910.CAN1.CAN1.AP_BMS_StateAndFailReport.BMSerror_UnderTemperature "" FLOAT64_IEEE LINEAR_FUNCTION_M1_T0_U1 1 100 0 0 ECU_ADDRESS 0x0 /end MEASUREMENT
/begin MEASUREMENT ETCSignals.ES900.ES910.CAN1.CAN1.AP_BMS_StateAndFailReport.BMSerror_OverVoltage "" FLOAT64_IEEE LINEAR_FUNCTION_M1_T0_U1 1 100 0 0 ECU_ADDRESS 0x0 /end MEASUREMENT
/begin MEASUREMENT ETCSignals.ES900.ES910.CAN1.CAN1.AP_BMS_StateAndFailReport.BMSerror_OverTemperature "" FLOAT64_IEEE LINEAR_FUNCTION_M1_T0_U1 1 100 0 0 ECU_ADDRESS 0x0 /end MEASUREMENT
/begin MEASUREMENT ETCSignals.ES900.ES910.CAN1.CAN1.AP_BMS_StateAndFailReport.BMSerror_NTCDisconnection "" FLOAT64_IEEE LINEAR_FUNCTION_M1_T0_U1 1 100 0 0 ECU_ADDRESS 0x0 /end MEASUREMENT
/begin MEASUREMENT ETCSignals.ES900.ES910.CAN1.CAN1.AP_BMS_StateAndFailReport.BMSerror_CurrentSensDisc "" FLOAT64_IEEE LINEAR_FUNCTION_M1_T0_U1 1 100 0 0 ECU_ADDRESS 0x0 /end MEASUREMENT
/begin MEASUREMENT ETCSignals.ES900.ES910.CAN1.CAN1.AP_BMS_StateAndFailReport.BMSerror_CANDisconnection "" FLOAT64_IEEE LINEAR_FUNCTION_M1_T0_U1 1 100 0 0 ECU_ADDRESS 0x0 /end MEASUREMENT
/begin MEASUREMENT ETCSignals.ES900.ES910.CAN1.CAN1.AP_BMS_Voltages.Lowest_CellVoltage "" FLOAT64_IEEE LINEAR_FUNCTION_M1_T0_U1 1 100 0 0 ECU_ADDRESS 0x0 /end MEASUREMENT
/begin MEASUREMENT ETCSignals.ES900.ES910.CAN1.CAN1.AP_BMS_Voltages.Highest_CellVoltage "" FLOAT64_IEEE LINEAR_FUNCTION_M1_T0_U1 1 100 0 0 ECU_ADDRESS 0x0 /end MEASUREMENT
/begin MEASUREMENT ETCSignals.ES900.ES910.CAN1.CAN1.AP_BMS_Voltages.Accumulator_Voltage "" FLOAT64_IEEE LINEAR_FUNCTION_M1_T0_U1 1 100 0 0 ECU_ADDRESS 0x0 /end MEASUREMENT
/begin MEASUREMENT ETCSignals.ES900.ES910.CAN1.CAN1.AP_BMS_OnBoardTemperatures.Lowest_OnBoardTemp "" FLOAT64_IEEE LINEAR_FUNCTION_M1_T0_U1 1 100 0 0 ECU_ADDRESS 0x0 /end MEASUREMENT
/begin MEASUREMENT ETCSignals.ES900.ES910.CAN1.CAN1.AP_BMS_OnBoardTemperatures.Highest_OnBoardTemp "" FLOAT64_IEEE LINEAR_FUNCTION_M1_T0_U1 1 100 0 0 ECU_ADDRESS 0x0 /end MEASUREMENT
/begin MEASUREMENT ETCSignals.ES900.ES910.CAN1.CAN1.AP_BMS_OnBoardTemperatures.Average_OnBoardTemp "" FLOAT64_IEEE LINEAR_FUNCTION_M1_T0_U1 1 100 0 0 ECU_ADDRESS 0x0 /end MEASUREMENT
/begin MEASUREMENT ETCSignals.ES900.ES910.CAN1.CAN1.AP_BMS_ChargerParameters.Charger_MaxVoltage "" FLOAT64_IEEE LINEAR_FUNCTION_M1_T0_U1 1 100 0 0 ECU_ADDRESS 0x0 /end MEASUREMENT
/begin MEASUREMENT ETCSignals.ES900.ES910.CAN1.CAN1.AP_BMS_ChargerParameters.Charger_MaxCurrent "" FLOAT64_IEEE LINEAR_FUNCTION_M1_T0_U1 1 100 0 0 ECU_ADDRESS 0x0 /end MEASUREMENT
/begin MEASUREMENT ETCSignals.ES900.ES910.CAN1.CAN1.AP_BMS_BatteryTemperatures.Lowest_CellTemp "" FLOAT64_IEEE LINEAR_FUNCTION_M1_T0_U1 1 100 0 0 ECU_ADDRESS 0x0 /end MEASUREMENT
/begin MEASUREMENT ETCSignals.ES900.ES910.CAN1.CAN1.AP_BMS_BatteryTemperatures.Highest_CellTemp "" FLOAT64_IEEE LINEAR_FUNCTION_M1_T0_U1 1 100 0 0 ECU_ADDRESS 0x0 /end MEASUREMENT
/begin MEASUREMENT ETCSignals.ES900.ES910.CAN1.CAN1.AP_BMS_BatteryTemperatures.Average_CellTemp "" FLOAT64_IEEE LINEAR_FUNCTION_M1_T0_U1 1 100 0 0 ECU_ADDRESS 0x0 /end MEASUREMENT
/begin MEASUREMENT ETCSignals.ES900.ES910.CAN1.CAN1.AP_Inverter_R_Tx.Inv_R_RegID "" FLOAT64_IEEE LINEAR_FUNCTION_M1_T0_U1 1 100 0 0 ECU_ADDRESS 0x0 /end MEASUREMENT
/begin MEASUREMENT ETCSignals.ES900.ES910.CAN1.CAN1.AP_Inverter_R_Tx.Inv_R_RegID_M73_Inv_R_TempMotor "" FLOAT64_IEEE LINEAR_FUNCTION_M1_T0_U1 1 100 0 0 ECU_ADDRESS 0x0 /end MEASUREMENT
/begin MEASUREMENT ETCSignals.ES900.ES910.CAN1.CAN1.AP_Inverter_R_Tx.Inv_R_RegID_M74_Inv_R_TempIGBT "" FLOAT64_IEEE LINEAR_FUNCTION_M1_T0_U1 1 100 0 0 ECU_ADDRESS 0x0 /end MEASUREMENT
/begin MEASUREMENT ETCSignals.ES900.ES910.CAN1.CAN1.AP_Inverter_R_Tx.Inv_R_RegID_M48_Inv_R_Speed "" FLOAT64_IEEE LINEAR_FUNCTION_M1_T0_U1 1 100 0 0 ECU_ADDRESS 0x0 /end MEASUREMENT
/begin MEASUREMENT ETCSignals.ES900.ES910.CAN1.CAN1.AP_Inverter_R_Tx.Inv_R_RegID_M39_Inv_R_Iq "" FLOAT64_IEEE LINEAR_FUNCTION_M1_T0_U1 1 100 0 0 ECU_ADDRESS 0x0 /end MEASUREMENT
/begin MEASUREMENT ETCSignals.ES900.ES910.CAN1.CAN1.AP_Inverter_R_Tx.Inv_R_RegID_M38_Inv_R_Icommand "" FLOAT64_IEEE LINEAR_FUNCTION_M1_T0_U1 1 100 0 0 ECU_ADDRESS 0x0 /end MEASUREMENT
/begin MEASUREMENT ETCSignals.ES900.ES910.CAN1.CAN1.AP_Inverter_R_Tx.Inv_R_RegID_M32_Inv_R_Iactual "" FLOAT64_IEEE LINEAR_FUNCTION_M1_T0_U1 1 100 0 0 ECU_ADDRESS 0x0 /end MEASUREMENT
/begin MEASUREMENT ETCSignals.ES900.ES910.CAN1.CAN1.AP_Inverter_R_Tx.Inv_R_RegID_M232_Inv_R_Enable "" FLOAT64_IEEE LINEAR_FUNCTION_M1_T0_U1 1 100 0 0 ECU_ADDRESS 0x0 /end MEASUREMENT
/begin MEASUREMENT ETCSignals.ES900.ES910.CAN1.CAN1.AP_Inverter_R_Tx.Inv_R_RegID_M235_Inv_R_DCBus "" FLOAT64_IEEE LINEAR_FUNCTION_M1_T0_U1 1 100 0 0 ECU_ADDRESS 0x0 /end MEASUREMENT
/begin MEASUREMENT ETCSignals.ES900.ES910.CAN1.CAN1.AP_Inverter_L_Tx.Inv_L_RegID "" FLOAT64_IEEE LINEAR_FUNCTION_M1_T0_U1 1 100 0 0 ECU_ADDRESS 0x0 /end MEASUREMENT
/begin MEASUREMENT ETCSignals.ES900.ES910.CAN1.CAN1.AP_Inverter_L_Tx.Inv_L_RegID_M73_Inv_L_TempMotor "" FLOAT64_IEEE LINEAR_FUNCTION_M1_T0_U1 1 100 0 0 ECU_ADDRESS 0x0 /end MEASUREMENT
/begin MEASUREMENT ETCSignals.ES900.ES910.CAN1.CAN1.AP_Inverter_L_Tx.Inv_L_RegID_M74_Inv_L_TempIGBT "" FLOAT64_IEEE LINEAR_FUNCTION_M1_T0_U1 1 100 0 0 ECU_ADDRESS 0x0 /end MEASUREMENT
/begin MEASUREMENT ETCSignals.ES900.ES910.CAN1.CAN1.AP_Inverter_L_Tx.Inv_L_RegID_M48_Inv_L_Speed "" FLOAT64_IEEE LINEAR_FUNCTION_M1_T0_U1 1 100 0 0 ECU_ADDRESS 0x0 /end MEASUREMENT
/begin MEASUREMENT ETCSignals.ES900.ES910.CAN1.CAN1.AP_Inverter_L_Tx.Inv_L_RegID_M39_Inv_L_Iq "" FLOAT64_IEEE LINEAR_FUNCTION_M1_T0_U1 1 100 0 0 ECU_ADDRESS 0x0 /end MEASUREMENT
/begin MEASUREMENT ETCSignals.ES900.ES910.CAN1.CAN1.AP_Inverter_L_Tx.Inv_L_RegID_M38_Inv_L_Icommand "" FLOAT64_IEEE LINEAR_FUNCTION_M1_T0_U1 1 100 0 0 ECU_ADDRESS 0x0 /end MEASUREMENT
/begin MEASUREMENT ETCSignals.ES900.ES910.CAN1.CAN1.AP_Inverter_L_Tx.Inv_L_RegID_M32_Inv_L_Iactual "" FLOAT64_IEEE LINEAR_FUNCTION_M1_T0_U1 1 100 0 0 ECU_ADDRESS 0x0 /end MEASUREMENT
/begin MEASUREMENT ETCSignals.ES900.ES910.CAN1.CAN1.AP_Inverter_L_Tx.Inv_L_RegID_M232_Inv_L_Enable "" FLOAT64_IEEE LINEAR_FUNCTION_M1_T0_U1 1 100 0 0 ECU_ADDRESS 0x0 /end MEASUREMENT
/begin MEASUREMENT ETCSignals.ES900.ES910.CAN1.CAN1.AP_Inverter_L_Tx.Inv_L_RegID_M235_Inv_L_DCBus "" FLOAT64_IEEE LINEAR_FUNCTION_M1_T0_U1 1 100 0 0 ECU_ADDRESS 0x0 /end MEASUREMENT
/begin MEASUREMENT ETCSignals.ES900.ES910.CAN1.CAN1.AP_DASH_CustomMode.CustomMode_Identifier "" FLOAT64_IEEE LINEAR_FUNCTION_M1_T0_U1 1 100 0 0 ECU_ADDRESS 0x0 /end MEASUREMENT
/begin MEASUREMENT ETCSignals.ES900.ES910.CAN1.CAN1.AP_DASH_CustomMode.CustomMode_Data "" FLOAT64_IEEE LINEAR_FUNCTION_M1_T0_U1 1 100 0 0 ECU_ADDRESS 0x0 /end MEASUREMENT
/begin MEASUREMENT ETCSignals.ES900.ES910.CAN1.CAN1.AP_DASH_Mode.RacingMode "" FLOAT64_IEEE LINEAR_FUNCTION_M1_T0_U1 1 100 0 0 ECU_ADDRESS 0x0 /end MEASUREMENT
/begin MEASUREMENT ETCSignals.ES900.ES910.CAN1.CAN1.NM_BMS_Keep_Alive.BMS_Alive "" FLOAT64_IEEE LINEAR_FUNCTION_M1_T0_U1 1 100 0 0 ECU_ADDRESS 0x0 /end MEASUREMENT
/begin MEASUREMENT ETCSignals.ES900.ES910.CAN1.CAN1.AP_BMS_AIRs_State.AIRs_State "" FLOAT64_IEEE LINEAR_FUNCTION_M1_T0_U1 1 100 0 0 ECU_ADDRESS 0x0 /end MEASUREMENT
/begin MEASUREMENT ETCSignals.ES900.ES910.CAN1.CAN1.NM_DASH_Keep_Alive.Dash_Alive "" FLOAT64_IEEE LINEAR_FUNCTION_M1_T0_U1 1 100 0 0 ECU_ADDRESS 0x0 /end MEASUREMENT
/begin MEASUREMENT ETCSignals.ES900.ES910.CAN1.CAN1.AP_DASH_TorqueLockOn.Torque_LockOn "" FLOAT64_IEEE LINEAR_FUNCTION_M1_T0_U1 1 100 0 0 ECU_ADDRESS 0x0 /end MEASUREMENT
/begin MEASUREMENT ETCSignals.ES900.ES910.CAN1.CAN1.AP_DASH_PrechargeRequest.PrechargeRequest "" FLOAT64_IEEE LINEAR_FUNCTION_M1_T0_U1 1 100 0 0 ECU_ADDRESS 0x0 /end MEASUREMENT
/begin MEASUREMENT ETCSignals.ES900.ES910.CAN1.CAN1.AP_DASH_EnableDrive.EnableDrive_Order "" FLOAT64_IEEE LINEAR_FUNCTION_M1_T0_U1 1 100 0 0 ECU_ADDRESS 0x0 /end MEASUREMENT
/begin MEASUREMENT ETCSignals.ES900.ES910.CAN1.CAN1.AP_ETAS_DashData1.Speed "" FLOAT64_IEEE LINEAR_FUNCTION_M1_T0_U1 1 100 -128 127 ECU_ADDRESS 0x0 /end MEASUREMENT
/begin MEASUREMENT ETCSignals.ES900.ES910.CAN1.CAN1.AP_ETAS_DashData1.Precharge_Voltage "" FLOAT64_IEEE LINEAR_FUNCTION_M1_T0_U1 1 100 0 655.35 ECU_ADDRESS 0x0 /end MEASUREMENT
/begin MEASUREMENT ETCSignals.ES900.ES910.CAN1.CAN1.AP_ETAS_DashData1.Precharge_Percentage "" FLOAT64_IEEE LINEAR_FUNCTION_M1_T0_U1 1 100 0 100 ECU_ADDRESS 0x0 /end MEASUREMENT
/begin MEASUREMENT ETCSignals.ES900.ES910.CAN1.CAN1.AP_ETAS_DashData1.LVbattery_Voltage "" FLOAT64_IEEE LINEAR_FUNCTION_M1_T0_U1 1 100 0 32.7675 ECU_ADDRESS 0x0 /end MEASUREMENT
/begin MEASUREMENT ETCSignals.ES900.ES910.CAN1.CAN1.AP_ETAS_DashData1.LVbattery_SOC "" FLOAT64_IEEE LINEAR_FUNCTION_M1_T0_U1 1 100 0 100 ECU_ADDRESS 0x0 /end MEASUREMENT
/begin MEASUREMENT ETCSignals.ES900.ES910.CAN1.CAN1.AP_ETAS_VDCParams2.VDC_Cte_SKF "" FLOAT64_IEEE LINEAR_FUNCTION_M1_T0_U1 1 100 0 1 ECU_ADDRESS 0x0 /end MEASUREMENT
/begin MEASUREMENT ETCSignals.ES900.ES910.CAN1.CAN1.AP_ETAS_VDCParams2.VDC_Cte_CKF "" FLOAT64_IEEE LINEAR_FUNCTION_M1_T0_U1 1 100 0 1 ECU_ADDRESS 0x0 /end MEASUREMENT
/begin MEASUREMENT ETCSignals.ES900.ES910.CAN1.CAN1.AP_ETAS_VDCParams.VDC_CKF_Initial "" FLOAT64_IEEE LINEAR_FUNCTION_M1_T0_U1 1 100 0 1 ECU_ADDRESS 0x0 /end MEASUREMENT
/begin MEASUREMENT ETCSignals.ES900.ES910.CAN1.CAN1.AP_ETAS_VDCParams.VDC_SKF_Initial "" FLOAT64_IEEE LINEAR_FUNCTION_M1_T0_U1 1 100 0 1 ECU_ADDRESS 0x0 /end MEASUREMENT
/begin MEASUREMENT ETCSignals.ES900.ES910.CAN1.CAN1.AP_ETAS_VDCParams.VDC_Power_Limit "" FLOAT64_IEEE LINEAR_FUNCTION_M1_T0_U1 1 100 0 85 ECU_ADDRESS 0x0 /end MEASUREMENT
/begin MEASUREMENT ETCSignals.ES900.ES910.CAN1.CAN1.AP_ETAS_VDCParams.VDC_Max_Regenerative_Torque "" FLOAT64_IEEE LINEAR_FUNCTION_M1_T0_U1 1 100 0 10.2 ECU_ADDRESS 0x0 /end MEASUREMENT
/begin MEASUREMENT ETCSignals.ES900.ES910.CAN1.CAN1.AP_ETAS_VDCParams.VDC_K_Reduction_Temperature "" FLOAT64_IEEE LINEAR_FUNCTION_M1_T0_U1 1 100 0 1 ECU_ADDRESS 0x0 /end MEASUREMENT
/begin MEASUREMENT ETCSignals.ES900.ES910.CAN1.CAN1.AP_ETAS_VDCParams.VDC_K_Reduction_P "" FLOAT64_IEEE LINEAR_FUNCTION_M1_T0_U1 1 100 0 1 ECU_ADDRESS 0x0 /end MEASUREMENT
/begin MEASUREMENT ETCSignals.ES900.ES910.CAN1.CAN1.AP_ETAS_VDCParams.VDC_APPS_Sat_Up "" FLOAT64_IEEE LINEAR_FUNCTION_M1_T0_U1 1 100 0 1 ECU_ADDRESS 0x0 /end MEASUREMENT
/begin MEASUREMENT ETCSignals.ES900.ES910.CAN1.CAN1.AP_ETAS_VDCParams.VDC_APPS_Sat_Down "" FLOAT64_IEEE LINEAR_FUNCTION_M1_T0_U1 1 100 0 1 ECU_ADDRESS 0x0 /end MEASUREMENT
/begin MEASUREMENT ETCSignals.ES900.ES910.CAN1.CAN1.AP_ETAS_Inverter_R_Rx.Inverter_R_RegID "" FLOAT64_IEEE LINEAR_FUNCTION_M1_T0_U1 1 100 0 255 ECU_ADDRESS 0x0 /end MEASUREMENT
/begin MEASUREMENT ETCSignals.ES900.ES910.CAN1.CAN1.AP_ETAS_Inverter_R_Rx.Inverter_R_b7tob0 "" FLOAT64_IEEE LINEAR_FUNCTION_M1_T0_U1 1 100 0 255 ECU_ADDRESS 0x0 /end MEASUREMENT
/begin MEASUREMENT ETCSignals.ES900.ES910.CAN1.CAN1.AP_ETAS_Inverter_R_Rx.Inverter_R_b15tob8 "" FLOAT64_IEEE LINEAR_FUNCTION_M1_T0_U1 1 100 0 255 ECU_ADDRESS 0x0 /end MEASUREMENT
/begin MEASUREMENT ETCSignals.ES900.ES910.CAN1.CAN1.AP_ETAS_Inverter_L_Rx.Inverter_L_RegID "" FLOAT64_IEEE LINEAR_FUNCTION_M1_T0_U1 1 100 0 255 ECU_ADDRESS 0x0 /end MEASUREMENT
/begin MEASUREMENT ETCSignals.ES900.ES910.CAN1.CAN1.AP_ETAS_Inverter_L_Rx.Inverter_L_b7tob0 "" FLOAT64_IEEE LINEAR_FUNCTION_M1_T0_U1 1 100 0 255 ECU_ADDRESS 0x0 /end MEASUREMENT
/begin MEASUREMENT ETCSignals.ES900.ES910.CAN1.CAN1.AP_ETAS_Inverter_L_Rx.Inverter_L_b15tob8 "" FLOAT64_IEEE LINEAR_FUNCTION_M1_T0_U1 1 100 0 255 ECU_ADDRESS 0x0 /end MEASUREMENT
/begin MEASUREMENT ETCSignals.ES900.ES910.CAN1.CAN1.AP_ETAS_CarState.Car_State "" FLOAT64_IEEE LINEAR_FUNCTION_M1_T0_U1 1 100 0 255 ECU_ADDRESS 0x0 /end MEASUREMENT
/begin MEASUREMENT ETCSignals.ES900.ES910.CAN1.CAN1.AP_ETAS_AIRsRequest.AIRs_Request "" FLOAT64_IEEE LINEAR_FUNCTION_M1_T0_U1 1 100 0 255 ECU_ADDRESS 0x0 /end MEASUREMENT
/begin MEASUREMENT ETCSignals.ES900.ES910.CAN1.CAN1.AP_ETAS_AnalogicControl.BrakeLight_Control "" FLOAT64_IEEE LINEAR_FUNCTION_M1_T0_U1 1 100 0 1 ECU_ADDRESS 0x0 /end MEASUREMENT
/begin MEASUREMENT ETCSignals.ES900.ES910.CAN1.CAN1.AP_ETAS_AnalogicControl.Pumps_Control "" FLOAT64_IEEE LINEAR_FUNCTION_M1_T0_U1 1 100 0 1 ECU_ADDRESS 0x0 /end MEASUREMENT
/begin MEASUREMENT ETCSignals.ES900.ES910.CAN1.CAN1.MEAS_ETAS_InternalVars.CriticalDisconnection "" FLOAT64_IEEE LINEAR_FUNCTION_M1_T0_U1 1 100 0 1 ECU_ADDRESS 0x0 /end MEASUREMENT
/begin MEASUREMENT ETCSignals.ES900.ES910.CAN1.CAN1.MEAS_ETAS_InternalVars.CurrentPathDisconnectionFlag "" FLOAT64_IEEE LINEAR_FUNCTION_M1_T0_U1 1 100 0 1 ECU_ADDRESS 0x0 /end MEASUREMENT
/begin MEASUREMENT ETCSignals.ES900.ES910.CAN1.CAN1.MEAS_ETAS_InternalVars.Car_OK "" FLOAT64_IEEE LINEAR_FUNCTION_M1_T0_U1 1 100 0 1 ECU_ADDRESS 0x0 /end MEASUREMENT
/begin MEASUREMENT ETCSignals.ES900.ES910.CAN1.CAN1.MEAS_ETAS_InternalVars.Power "" FLOAT64_IEEE LINEAR_FUNCTION_M1_T0_U1 1 100 0 255 ECU_ADDRESS 0x0 /end MEASUREMENT
/begin MEASUREMENT ETCSignals.ES900.ES910.CAN1.CAN1.MEAS_ETAS_InternalVars.Torque_OK "" FLOAT64_IEEE LINEAR_FUNCTION_M1_T0_U1 1 100 0 1 ECU_ADDRESS 0x0 /end MEASUREMENT
/begin MEASUREMENT ETCSignals.ES900.ES910.CAN1.CAN1.MEAS_ETAS_InternalVars.TV_Mode "" FLOAT64_IEEE LINEAR_FUNCTION_M1_T0_U1 1 100 0 7 ECU_ADDRESS 0x0 /end MEASUREMENT
/begin MEASUREMENT ETCSignals.ES900.ES910.CAN1.CAN1.MEAS_ETAS_InternalVars.Critical_Signal_Disconnection "" FLOAT64_IEEE LINEAR_FUNCTION_M1_T0_U1 1 100 0 1 ECU_ADDRESS 0x0 /end MEASUREMENT
/begin MEASUREMENT ETCSignals.ES900.ES910.CAN1.CAN1.MEAS_ETAS_InternalVars.Critical_CAN_Disconnection "" FLOAT64_IEEE LINEAR_FUNCTION_M1_T0_U1 1 100 0 1 ECU_ADDRESS 0x0 /end MEASUREMENT
/begin MEASUREMENT ETCSignals.ES900.ES910.CAN1.CAN1.MEAS_ETAS_InternalVars.Brake_Implausibility "" FLOAT64_IEEE LINEAR_FUNCTION_M1_T0_U1 1 100 0 1 ECU_ADDRESS 0x0 /end MEASUREMENT
/begin MEASUREMENT ETCSignals.ES900.ES910.CAN1.CAN1.MEAS_ETAS_InternalVars.APPS_Implausibility "" FLOAT64_IEEE LINEAR_FUNCTION_M1_T0_U1 1 100 0 1 ECU_ADDRESS 0x0 /end MEASUREMENT
/begin MEASUREMENT ETCSignals.ES900.ES910.CAN1.CAN1.AP_SHUTDOWN_State.Shutdown_IMD_OKreading "" FLOAT64_IEEE LINEAR_FUNCTION_M1_T0_U1 1 100 0 0 ECU_ADDRESS 0x0 /end MEASUREMENT
/begin MEASUREMENT ETCSignals.ES900.ES910.CAN1.CAN1.AP_SHUTDOWN_State.Shutdown_IMD "" FLOAT64_IEEE LINEAR_FUNCTION_M1_T0_U1 1 100 0 0 ECU_ADDRESS 0x0 /end MEASUREMENT
/begin MEASUREMENT ETCSignals.ES900.ES910.CAN1.CAN1.AP_SHUTDOWN_State.Shutdown_HVBox "" FLOAT64_IEEE LINEAR_FUNCTION_M1_T0_U1 1 100 0 0 ECU_ADDRESS 0x0 /end MEASUREMENT
/begin MEASUREMENT ETCSignals.ES900.ES910.CAN1.CAN1.AP_SHUTDOWN_State.Shutdown_TSMS "" FLOAT64_IEEE LINEAR_FUNCTION_M1_T0_U1 1 100 0 0 ECU_ADDRESS 0x0 /end MEASUREMENT
/begin MEASUREMENT ETCSignals.ES900.ES910.CAN1.CAN1.AP_SHUTDOWN_State.Shutdown_TSMPintck "" FLOAT64_IEEE LINEAR_FUNCTION_M1_T0_U1 1 100 0 0 ECU_ADDRESS 0x0 /end MEASUREMENT
/begin MEASUREMENT ETCSignals.ES900.ES910.CAN1.CAN1.AP_SHUTDOWN_State.Shutdown_SetaRight "" FLOAT64_IEEE LINEAR_FUNCTION_M1_T0_U1 1 100 0 0 ECU_ADDRESS 0x0 /end MEASUREMENT
/begin MEASUREMENT ETCSignals.ES900.ES910.CAN1.CAN1.AP_SHUTDOWN_State.Shutdown_SetaLeft "" FLOAT64_IEEE LINEAR_FUNCTION_M1_T0_U1 1 100 0 0 ECU_ADDRESS 0x0 /end MEASUREMENT
/begin MEASUREMENT ETCSignals.ES900.ES910.CAN1.CAN1.AP_SHUTDOWN_State.Shutdown_SetaCockPit "" FLOAT64_IEEE LINEAR_FUNCTION_M1_T0_U1 1 100 0 0 ECU_ADDRESS 0x0 /end MEASUREMENT
/begin MEASUREMENT ETCSignals.ES900.ES910.CAN1.CAN1.AP_SHUTDOWN_State.Shutdown_PackageIntck "" FLOAT64_IEEE LINEAR_FUNCTION_M1_T0_U1 1 100 0 0 ECU_ADDRESS 0x0 /end MEASUREMENT
/begin MEASUREMENT ETCSignals.ES900.ES910.CAN1.CAN1.AP_SHUTDOWN_State.Shutdown_InverterRIntck "" FLOAT64_IEEE LINEAR_FUNCTION_M1_T0_U1 1 100 0 0 ECU_ADDRESS 0x0 /end MEASUREMENT
/begin MEASUREMENT ETCSignals.ES900.ES910.CAN1.CAN1.AP_SHUTDOWN_State.Shutdown_InverterLIntck "" FLOAT64_IEEE LINEAR_FUNCTION_M1_T0_U1 1 100 0 0 ECU_ADDRESS 0x0 /end MEASUREMENT
/begin MEASUREMENT ETCSignals.ES900.ES910.CAN1.CAN1.AP_SHUTDOWN_State.Shutdown_Inertia "" FLOAT64_IEEE LINEAR_FUNCTION_M1_T0_U1 1 100 0 0 ECU_ADDRESS 0x0 /end MEASUREMENT
/begin MEASUREMENT ETCSignals.ES900.ES910.CAN1.CAN1.AP_SHUTDOWN_State.Shutdown_HVD "" FLOAT64_IEEE LINEAR_FUNCTION_M1_T0_U1 1 100 0 0 ECU_ADDRESS 0x0 /end MEASUREMENT
/begin MEASUREMENT ETCSignals.ES900.ES910.CAN1.CAN1.AP_SHUTDOWN_State.Shutdown_BSPD_RelayReading "" FLOAT64_IEEE LINEAR_FUNCTION_M1_T0_U1 1 100 0 0 ECU_ADDRESS 0x0 /end MEASUREMENT
/begin MEASUREMENT ETCSignals.ES900.ES910.CAN1.CAN1.AP_SHUTDOWN_State.Shutdown_BSPD "" FLOAT64_IEEE LINEAR_FUNCTION_M1_T0_U1 1 100 0 0 ECU_ADDRESS 0x0 /end MEASUREMENT
/begin MEASUREMENT ETCSignals.ES900.ES910.CAN1.CAN1.AP_SHUTDOWN_State.Shutdown_BOTS "" FLOAT64_IEEE LINEAR_FUNCTION_M1_T0_U1 1 100 0 0 ECU_ADDRESS 0x0 /end MEASUREMENT
/begin MEASUREMENT ETCSignals.ES900.ES910.CAN1.CAN1.AP_SHUTDOWN_State.Shutdown_BMS_OKreading "" FLOAT64_IEEE LINEAR_FUNCTION_M1_T0_U1 1 100 0 0 ECU_ADDRESS 0x0 /end MEASUREMENT
/begin MEASUREMENT ETCSignals.ES900.ES910.CAN1.CAN1.AP_SHUTDOWN_State.Shutdown_BMS "" FLOAT64_IEEE LINEAR_FUNCTION_M1_T0_U1 1 100 0 0 ECU_ADDRESS 0x0 /end MEASUREMENT
/begin MEASUREMENT ETCSignals.ES900.ES910.CAN1.CAN1.AP_SHUTDOWN_State.Pumps_State "" FLOAT64_IEEE LINEAR_FUNCTION_M1_T0_U1 1 100 0 0 ECU_ADDRESS 0x0 /end MEASUREMENT
/begin MEASUREMENT ETCSignals.ES900.ES910.CAN1.CAN1.AP_SHUTDOWN_State.BrakeLight_State "" FLOAT64_IEEE LINEAR_FUNCTION_M1_T0_U1 1 100 0 0 ECU_ADDRESS 0x0 /end MEASUREMENT
/begin MEASUREMENT ETCSignals.ES900.ES910.CAN1.CAN1.NM_ETAS_Disconnections.Disconnection_LV_Derivation "" FLOAT64_IEEE LINEAR_FUNCTION_M1_T0_U1 1 100 0 1 ECU_ADDRESS 0x0 /end MEASUREMENT
/begin MEASUREMENT ETCSignals.ES900.ES910.CAN1.CAN1.NM_ETAS_Disconnections.Disconnection_DashBoard "" FLOAT64_IEEE LINEAR_FUNCTION_M1_T0_U1 1 100 0 1 ECU_ADDRESS 0x0 /end MEASUREMENT
/begin MEASUREMENT ETCSignals.ES900.ES910.CAN1.CAN1.NM_ETAS_Disconnections.Disconnection_BMS "" FLOAT64_IEEE LINEAR_FUNCTION_M1_T0_U1 1 100 0 1 ECU_ADDRESS 0x0 /end MEASUREMENT
/begin MEASUREMENT ETCSignals.ES900.ES910.CAN1.CAN1.NM_ETAS_Disconnections.Disconnection_Gyroscope_F "" FLOAT64_IEEE LINEAR_FUNCTION_M1_T0_U1 1 100 0 1 ECU_ADDRESS 0x0 /end MEASUREMENT
/begin MEASUREMENT ETCSignals.ES900.ES910.CAN1.CAN1.NM_ETAS_Disconnections.Disconnection_Gyroscope_R "" FLOAT64_IEEE LINEAR_FUNCTION_M1_T0_U1 1 100 0 1 ECU_ADDRESS 0x0 /end MEASUREMENT
/begin MEASUREMENT ETCSignals.ES900.ES910.CAN1.CAN1.NM_ETAS_Disconnections.Disconnection_Accel_F "" FLOAT64_IEEE LINEAR_FUNCTION_M1_T0_U1 1 100 0 1 ECU_ADDRESS 0x0 /end MEASUREMENT
/begin MEASUREMENT ETCSignals.ES900.ES910.CAN1.CAN1.NM_ETAS_Disconnections.Disconnection_Accel_R "" FLOAT64_IEEE LINEAR_FUNCTION_M1_T0_U1 1 100 0 1 ECU_ADDRESS 0x0 /end MEASUREMENT
/begin MEASUREMENT ETCSignals.ES900.ES910.CAN1.CAN1.NM_ETAS_Disconnections.Disconnection_SteeringSensor "" FLOAT64_IEEE LINEAR_FUNCTION_M1_T0_U1 1 100 0 1 ECU_ADDRESS 0x0 /end MEASUREMENT
/begin MEASUREMENT ETCSignals.ES900.ES910.CAN1.CAN1.NM_ETAS_Disconnections.Disconnection_Susp_R_R "" FLOAT64_IEEE LINEAR_FUNCTION_M1_T0_U1 1 100 0 1 ECU_ADDRESS 0x0 /end MEASUREMENT
/begin MEASUREMENT ETCSignals.ES900.ES910.CAN1.CAN1.NM_ETAS_Disconnections.Disconnection_Susp_R_L "" FLOAT64_IEEE LINEAR_FUNCTION_M1_T0_U1 1 100 0 1 ECU_ADDRESS 0x0 /end MEASUREMENT
/begin MEASUREMENT ETCSignals.ES900.ES910.CAN1.CAN1.NM_ETAS_Disconnections.Disconnection_Susp_F_R "" FLOAT64_IEEE LINEAR_FUNCTION_M1_T0_U1 1 100 0 1 ECU_ADDRESS 0x0 /end MEASUREMENT
/begin MEASUREMENT ETCSignals.ES900.ES910.CAN1.CAN1.NM_ETAS_Disconnections.Disconnection_Susp_F_L "" FLOAT64_IEEE LINEAR_FUNCTION_M1_T0_U1 1 100 0 1 ECU_ADDRESS 0x0 /end MEASUREMENT
/begin MEASUREMENT ETCSignals.ES900.ES910.CAN1.CAN1.NM_ETAS_Disconnections.Disconnection_Brake_Sensor "" FLOAT64_IEEE LINEAR_FUNCTION_M1_T0_U1 1 100 0 1 ECU_ADDRESS 0x0 /end MEASUREMENT
/begin MEASUREMENT ETCSignals.ES900.ES910.CAN1.CAN1.NM_ETAS_Disconnections.Disconnection_APPS2 "" FLOAT64_IEEE LINEAR_FUNCTION_M1_T0_U1 1 100 0 1 ECU_ADDRESS 0x0 /end MEASUREMENT
/begin MEASUREMENT ETCSignals.ES900.ES910.CAN1.CAN1.NM_ETAS_Disconnections.Disconnection_APPS1 "" FLOAT64_IEEE LINEAR_FUNCTION_M1_T0_U1 1 100 0 1 ECU_ADDRESS 0x0 /end MEASUREMENT
/begin MEASUREMENT ETCSignals.ES900.ES910.CAN1.CAN1.NM_ETAS_Disconnections.Disconnection_ADCAN "" FLOAT64_IEEE LINEAR_FUNCTION_M1_T0_U1 1 100 0 1 ECU_ADDRESS 0x0 /end MEASUREMENT
/begin MEASUREMENT ETCSignals.ES900.ES910.CAN1.CAN1.NM_ETAS_Disconnections.Disconnection_Shutdown "" FLOAT64_IEEE LINEAR_FUNCTION_M1_T0_U1 1 100 0 1 ECU_ADDRESS 0x0 /end MEASUREMENT
/begin MEASUREMENT ETCSignals.ES900.ES910.CAN1.CAN1.NM_SHUTDOWN_Keep_Alive.Shutdown_Alive "" FLOAT64_IEEE LINEAR_FUNCTION_M1_T0_U1 1 100 0 0 ECU_ADDRESS 0x0 /end MEASUREMENT
/begin MEASUREMENT ETCSignals.ES900.ES910.CAN1.CAN1.AP_ETAS_DashData2.SteeringSensor_Value "" FLOAT64_IEEE LINEAR_FUNCTION_M1_T0_U1 1 100 -128 127 ECU_ADDRESS 0x0 /end MEASUREMENT
/begin MEASUREMENT ETCSignals.ES900.ES910.CAN1.CAN1.AP_ETAS_DashData2.SKF_actual "" FLOAT64_IEEE LINEAR_FUNCTION_M1_T0_U1 1 100 0 25.5 ECU_ADDRESS 0x0 /end MEASUREMENT
/begin MEASUREMENT ETCSignals.ES900.ES910.CAN1.CAN1.AP_ETAS_DashData2.CKF_actual "" FLOAT64_IEEE LINEAR_FUNCTION_M1_T0_U1 1 100 0 25.5 ECU_ADDRESS 0x0 /end MEASUREMENT
/begin MEASUREMENT ETCSignals.ES900.ES910.CAN1.CAN1.AP_ETAS_DashData2.BrakeSensor_Value "" FLOAT64_IEEE LINEAR_FUNCTION_M1_T0_U1 1 100 0 1 ECU_ADDRESS 0x0 /end MEASUREMENT
/begin MEASUREMENT ETCSignals.ES900.ES910.CAN1.CAN1.AP_ETAS_DashData2.APPS2_Value "" FLOAT64_IEEE LINEAR_FUNCTION_M1_T0_U1 1 100 0 1 ECU_ADDRESS 0x0 /end MEASUREMENT
/begin MEASUREMENT ETCSignals.ES900.ES910.CAN1.CAN1.AP_ETAS_DashData2.APPS1_Value "" FLOAT64_IEEE LINEAR_FUNCTION_M1_T0_U1 1 100 0 1 ECU_ADDRESS 0x0 /end MEASUREMENT
/begin MEASUREMENT ETCSignals.ES900.ES910.CAN1.CAN1.AP_ETAS_Synchronism.Sync_CAN1 "" FLOAT64_IEEE LINEAR_FUNCTION_M1_T0_U1 1 100 0 255 ECU_ADDRESS 0x0 /end MEASUREMENT
/begin MEASUREMENT ETCSignals.ES900.ES910.CAN2.Presence.PresenceGroup.PresenceFlag "" FLOAT64_IEEE LINEAR_FUNCTION_M1_T0_U1 1 100 0 1 ECU_ADDRESS 0x0 /end MEASUREMENT
/begin MEASUREMENT ETCSignals.ES900.ES910.CAN2.CAN2.AP_ELLIPSE_EKF_POS.LONGITUDE_EKF "" FLOAT64_IEEE LINEAR_FUNCTION_M1_T0_U2 1 100 0 0 ECU_ADDRESS 0x0 /end MEASUREMENT
/begin MEASUREMENT ETCSignals.ES900.ES910.CAN2.CAN2.AP_ELLIPSE_EKF_POS.LATITUDE_EKF "" FLOAT64_IEEE LINEAR_FUNCTION_M1_T0_U2 1 100 0 0 ECU_ADDRESS 0x0 /end MEASUREMENT
/begin MEASUREMENT ETCSignals.ES900.ES910.CAN2.CAN2.AP_ELLIPSE_IMU_ACCEL.ACCEL_Z_IMU "" FLOAT64_IEEE LINEAR_FUNCTION_M1_T0_U3 1 100 0 0 ECU_ADDRESS 0x0 /end MEASUREMENT
/begin MEASUREMENT ETCSignals.ES900.ES910.CAN2.CAN2.AP_ELLIPSE_IMU_ACCEL.ACCEL_Y_IMU "" FLOAT64_IEEE LINEAR_FUNCTION_M1_T0_U3 1 100 0 0 ECU_ADDRESS 0x0 /end MEASUREMENT
/begin MEASUREMENT ETCSignals.ES900.ES910.CAN2.CAN2.AP_ELLIPSE_IMU_ACCEL.ACCEL_X_IMU "" FLOAT64_IEEE LINEAR_FUNCTION_M1_T0_U3 1 100 0 0 ECU_ADDRESS 0x0 /end MEASUREMENT
/begin MEASUREMENT ETCSignals.ES900.ES910.CAN2.CAN2.AP_ELLIPSE_MAG.ACCEL_Z_MAG "" FLOAT64_IEEE LINEAR_FUNCTION_M1_T0_U3 1 100 0 0 ECU_ADDRESS 0x0 /end MEASUREMENT
/begin MEASUREMENT ETCSignals.ES900.ES910.CAN2.CAN2.AP_ELLIPSE_MAG.ACCEL_Y_MAG "" FLOAT64_IEEE LINEAR_FUNCTION_M1_T0_U3 1 100 0 0 ECU_ADDRESS 0x0 /end MEASUREMENT
/begin MEASUREMENT ETCSignals.ES900.ES910.CAN2.CAN2.AP_ELLIPSE_MAG.ACCEL_X_MAG "" FLOAT64_IEEE LINEAR_FUNCTION_M1_T0_U3 1 100 0 0 ECU_ADDRESS 0x0 /end MEASUREMENT
/begin MEASUREMENT ETCSignals.ES900.ES910.CAN2.CAN2.AP_ELLIPSE_EKF_EULER.YAW "" FLOAT64_IEEE LINEAR_FUNCTION_M1_T0_U4 1 100 0 0 ECU_ADDRESS 0x0 /end MEASUREMENT
/begin MEASUREMENT ETCSignals.ES900.ES910.CAN2.CAN2.AP_ELLIPSE_EKF_EULER.PITCH "" FLOAT64_IEEE LINEAR_FUNCTION_M1_T0_U4 1 100 0 0 ECU_ADDRESS 0x0 /end MEASUREMENT
/begin MEASUREMENT ETCSignals.ES900.ES910.CAN2.CAN2.AP_ELLIPSE_EKF_EULER.ROLL "" FLOAT64_IEEE LINEAR_FUNCTION_M1_T0_U4 1 100 0 0 ECU_ADDRESS 0x0 /end MEASUREMENT
/begin MEASUREMENT ETCSignals.ES900.ES910.CAN2.CAN2.AP_ELLIPSE_EKF_VEL_BODY.el_Vel_Z "" FLOAT64_IEEE LINEAR_FUNCTION_M1_T0_U5 1 100 0 0 ECU_ADDRESS 0x0 /end MEASUREMENT
/begin MEASUREMENT ETCSignals.ES900.ES910.CAN2.CAN2.AP_ELLIPSE_EKF_VEL_BODY.el_Vel_Y "" FLOAT64_IEEE LINEAR_FUNCTION_M1_T0_U5 1 100 0 0 ECU_ADDRESS 0x0 /end MEASUREMENT
/begin MEASUREMENT ETCSignals.ES900.ES910.CAN2.CAN2.AP_ELLIPSE_EKF_VEL_BODY.el_Vel_X "" FLOAT64_IEEE LINEAR_FUNCTION_M1_T0_U5 1 100 0 0 ECU_ADDRESS 0x0 /end MEASUREMENT
/begin MEASUREMENT ETCSignals.ES900.ES910.CAN2.CAN2.NM_ELLIPSE_Status.CLOCK "" FLOAT64_IEEE LINEAR_FUNCTION_M1_T0_U1 1 100 0 0 ECU_ADDRESS 0x0 /end MEASUREMENT
/begin MEASUREMENT ETCSignals.ES900.ES910.CAN2.CAN2.NM_ELLIPSE_Status.GENERAL "" FLOAT64_IEEE LINEAR_FUNCTION_M1_T0_U1 1 100 0 0 ECU_ADDRESS 0x0 /end MEASUREMENT
/begin MEASUREMENT ETCSignals.ES900.ES910.CAN2.CAN2.NM_ELLIPSE_Status.TIME_STAMP "" FLOAT64_IEEE LINEAR_FUNCTION_M1_T0_U6 1 100 0 0 ECU_ADDRESS 0x0 /end MEASUREMENT
/begin MEASUREMENT ETCSignals.ES900.ES910.CAN2.CAN2.AP_ELLIPSE_IMU_GYRO.GYRO_Z "" FLOAT64_IEEE LINEAR_FUNCTION_M1_T0_U7 1 100 0 0 ECU_ADDRESS 0x0 /end MEASUREMENT
/begin MEASUREMENT ETCSignals.ES900.ES910.CAN2.CAN2.AP_ELLIPSE_IMU_GYRO.GYRO_Y "" FLOAT64_IEEE LINEAR_FUNCTION_M1_T0_U7 1 100 0 0 ECU_ADDRESS 0x0 /end MEASUREMENT
/begin MEASUREMENT ETCSignals.ES900.ES910.CAN2.CAN2.AP_ELLIPSE_IMU_GYRO.GYRO_X "" FLOAT64_IEEE LINEAR_FUNCTION_M1_T0_U7 1 100 0 0 ECU_ADDRESS 0x0 /end MEASUREMENT
/begin MEASUREMENT ETCSignals.ES900.ES910.CAN2.CAN2.AP_ELLIPSE_SLIP_CURV.AUTO_STATUS "" FLOAT64_IEEE LINEAR_FUNCTION_M1_T0_U1 1 100 0 0 ECU_ADDRESS 0x0 /end MEASUREMENT
/begin MEASUREMENT ETCSignals.ES900.ES910.CAN2.CAN2.AP_ELLIPSE_SLIP_CURV.CURVATURE_RADIUS "" FLOAT64_IEEE LINEAR_FUNCTION_M1_T0_U8 1 100 0 0 ECU_ADDRESS 0x0 /end MEASUREMENT
/begin MEASUREMENT ETCSignals.ES900.ES910.CAN2.CAN2.AP_ELLIPSE_SLIP_CURV.ANGLE_SLIP "" FLOAT64_IEEE LINEAR_FUNCTION_M1_T0_U4 1 100 0 0 ECU_ADDRESS 0x0 /end MEASUREMENT
/begin MEASUREMENT ETCSignals.ES900.ES910.CAN2.CAN2.AP_ELLIPSE_SLIP_CURV.ANGLE_TRACK "" FLOAT64_IEEE LINEAR_FUNCTION_M1_T0_U4 1 100 0 0 ECU_ADDRESS 0x0 /end MEASUREMENT
/begin MEASUREMENT ETCSignals.ES900.ES910.CAN2.CAN2.MEAS_ETAS_Inverter_R_Data.Inv_R_TempMotor "" FLOAT64_IEEE LINEAR_FUNCTION_M1_T0_U1 1 100 -28 227 ECU_ADDRESS 0x0 /end MEASUREMENT
/begin MEASUREMENT ETCSignals.ES900.ES910.CAN2.CAN2.MEAS_ETAS_Inverter_R_Data.Inv_R_TempIGBT "" FLOAT64_IEEE LINEAR_FUNCTION_M1_T0_U1 1 100 -28 227 ECU_ADDRESS 0x0 /end MEASUREMENT
/begin MEASUREMENT ETCSignals.ES900.ES910.CAN2.CAN2.MEAS_ETAS_Inverter_R_Data.Inv_R_Speed "" FLOAT64_IEEE LINEAR_FUNCTION_M1_T0_U1 1 100 -5120 5080 ECU_ADDRESS 0x0 /end MEASUREMENT
/begin MEASUREMENT ETCSignals.ES900.ES910.CAN2.CAN2.MEAS_ETAS_Inverter_R_Data.Inv_R_Iq "" FLOAT64_IEEE LINEAR_FUNCTION_M1_T0_U1 1 100 -320 317.5 ECU_ADDRESS 0x0 /end MEASUREMENT
/begin MEASUREMENT ETCSignals.ES900.ES910.CAN2.CAN2.MEAS_ETAS_Inverter_R_Data.Inv_R_Icommand "" FLOAT64_IEEE LINEAR_FUNCTION_M1_T0_U1 1 100 -320 317.5 ECU_ADDRESS 0x0 /end MEASUREMENT
/begin MEASUREMENT ETCSignals.ES900.ES910.CAN2.CAN2.MEAS_ETAS_Inverter_R_Data.Inv_R_Iactual "" FLOAT64_IEEE LINEAR_FUNCTION_M1_T0_U1 1 100 -320 317.5 ECU_ADDRESS 0x0 /end MEASUREMENT
/begin MEASUREMENT ETCSignals.ES900.ES910.CAN2.CAN2.MEAS_ETAS_Inverter_L_Data.Inv_L_TempMotor "" FLOAT64_IEEE LINEAR_FUNCTION_M1_T0_U1 1 100 -28 227 ECU_ADDRESS 0x0 /end MEASUREMENT
/begin MEASUREMENT ETCSignals.ES900.ES910.CAN2.CAN2.MEAS_ETAS_Inverter_L_Data.Inv_L_TempIGBT "" FLOAT64_IEEE LINEAR_FUNCTION_M1_T0_U1 1 100 -28 227 ECU_ADDRESS 0x0 /end MEASUREMENT
/begin MEASUREMENT ETCSignals.ES900.ES910.CAN2.CAN2.MEAS_ETAS_Inverter_L_Data.Inv_L_Speed "" FLOAT64_IEEE LINEAR_FUNCTION_M1_T0_U1 1 100 -5120 5080 ECU_ADDRESS 0x0 /end MEASUREMENT
/begin MEASUREMENT ETCSignals.ES900.ES910.CAN2.CAN2.MEAS_ETAS_Inverter_L_Data.Inv_L_Iq "" FLOAT64_IEEE LINEAR_FUNCTION_M1_T0_U1 1 100 -320 317.5 ECU_ADDRESS 0x0 /end MEASUREMENT
/begin MEASUREMENT ETCSignals.ES900.ES910.CAN2.CAN2.MEAS_ETAS_Inverter_L_Data.Inv_L_Icommand "" FLOAT64_IEEE LINEAR_FUNCTION_M1_T0_U1 1 100 -320 317.5 ECU_ADDRESS 0x0 /end MEASUREMENT
/begin MEASUREMENT ETCSignals.ES900.ES910.CAN2.CAN2.MEAS_ETAS_Inverter_L_Data.Inv_L_Iactual "" FLOAT64_IEEE LINEAR_FUNCTION_M1_T0_U1 1 100 -320 317.5 ECU_ADDRESS 0x0 /end MEASUREMENT
/begin MEASUREMENT ETCSignals.ES900.ES910.CAN2.CAN2.MEAS_ETAS_VDCdata6.SUSP_F_R "" FLOAT64_IEEE LINEAR_FUNCTION_M1_T0_U1 1 100 -327.68 327.67 ECU_ADDRESS 0x0 /end MEASUREMENT
/begin MEASUREMENT ETCSignals.ES900.ES910.CAN2.CAN2.MEAS_ETAS_VDCdata6.SUSP_F_L "" FLOAT64_IEEE LINEAR_FUNCTION_M1_T0_U1 1 100 -327.68 327.67 ECU_ADDRESS 0x0 /end MEASUREMENT
/begin MEASUREMENT ETCSignals.ES900.ES910.CAN2.CAN2.MEAS_ETAS_VDCdata5.Gyro_F_Z_Deg "" FLOAT64_IEEE LINEAR_FUNCTION_M1_T0_U1 1 100 0 393.21 ECU_ADDRESS 0x0 /end MEASUREMENT
/begin MEASUREMENT ETCSignals.ES900.ES910.CAN2.CAN2.MEAS_ETAS_VDCdata5.Accel_F_Z_SI "" FLOAT64_IEEE LINEAR_FUNCTION_M1_T0_U1 1 100 -327.68 327.67 ECU_ADDRESS 0x0 /end MEASUREMENT
/begin MEASUREMENT ETCSignals.ES900.ES910.CAN2.CAN2.MEAS_ETAS_VDCdata5.Accel_F_Y_SI "" FLOAT64_IEEE LINEAR_FUNCTION_M1_T0_U1 1 100 -327.68 327.67 ECU_ADDRESS 0x0 /end MEASUREMENT
/begin MEASUREMENT ETCSignals.ES900.ES910.CAN2.CAN2.MEAS_ETAS_VDCdata5.Accel_F_X_SI "" FLOAT64_IEEE LINEAR_FUNCTION_M1_T0_U1 1 100 -327.68 327.67 ECU_ADDRESS 0x0 /end MEASUREMENT
/begin MEASUREMENT ETCSignals.ES900.ES910.CAN2.CAN2.MEAS_ETAS_VDCdata4.Gyro_R_Z_Deg "" FLOAT64_IEEE LINEAR_FUNCTION_M1_T0_U1 1 100 0 393.21 ECU_ADDRESS 0x0 /end MEASUREMENT
/begin MEASUREMENT ETCSignals.ES900.ES910.CAN2.CAN2.MEAS_ETAS_VDCdata4.Accel_R_Z_SI "" FLOAT64_IEEE LINEAR_FUNCTION_M1_T0_U1 1 100 -327.68 327.67 ECU_ADDRESS 0x0 /end MEASUREMENT
/begin MEASUREMENT ETCSignals.ES900.ES910.CAN2.CAN2.MEAS_ETAS_VDCdata4.Accel_R_Y_SI "" FLOAT64_IEEE LINEAR_FUNCTION_M1_T0_U1 1 100 -327.68 327.67 ECU_ADDRESS 0x0 /end MEASUREMENT
/begin MEASUREMENT ETCSignals.ES900.ES910.CAN2.CAN2.MEAS_ETAS_VDCdata4.Accel_R_X_SI "" FLOAT64_IEEE LINEAR_FUNCTION_M1_T0_U1 1 100 -327.68 327.67 ECU_ADDRESS 0x0 /end MEASUREMENT
/begin MEASUREMENT ETCSignals.ES900.ES910.CAN2.CAN2.AP_LV_Derivation_LVData.LVBattery_Voltage_Bits "" FLOAT64_IEEE LINEAR_FUNCTION_M1_T0_U1 1 100 0 0 ECU_ADDRESS 0x0 /end MEASUREMENT
/begin MEASUREMENT ETCSignals.ES900.ES910.CAN2.CAN2.MEAS_ETAS_VDCdata7.Torque_R "" FLOAT64_IEEE LINEAR_FUNCTION_M1_T0_U1 1 100 -254 254 ECU_ADDRESS 0x0 /end MEASUREMENT
/begin MEASUREMENT ETCSignals.ES900.ES910.CAN2.CAN2.MEAS_ETAS_VDCdata7.Torque_L "" FLOAT64_IEEE LINEAR_FUNCTION_M1_T0_U1 1 100 -256 254 ECU_ADDRESS 0x0 /end MEASUREMENT
/begin MEASUREMENT ETCSignals.ES900.ES910.CAN2.CAN2.MEAS_ETAS_VDCdata3.Handling "" FLOAT64_IEEE LINEAR_FUNCTION_M1_T0_U1 1 100 0 65535 ECU_ADDRESS 0x0 /end MEASUREMENT
/begin MEASUREMENT ETCSignals.ES900.ES910.CAN2.CAN2.MEAS_ETAS_VDCdata3.Dash_Speed "" FLOAT64_IEEE LINEAR_FUNCTION_M1_T0_U1 1 100 -32768 32767 ECU_ADDRESS 0x0 /end MEASUREMENT
/begin MEASUREMENT ETCSignals.ES900.ES910.CAN2.CAN2.MEAS_ETAS_VDCdata3.Mass "" FLOAT64_IEEE LINEAR_FUNCTION_M1_T0_U1 1 100 0 65535 ECU_ADDRESS 0x0 /end MEASUREMENT
/begin MEASUREMENT ETCSignals.ES900.ES910.CAN2.CAN2.MEAS_ETAS_VDCdata2.Throttle "" FLOAT64_IEEE LINEAR_FUNCTION_M1_T0_U1 1 100 0 65535 ECU_ADDRESS 0x0 /end MEASUREMENT
/begin MEASUREMENT ETCSignals.ES900.ES910.CAN2.CAN2.MEAS_ETAS_VDCdata2.Max_Fx_RR "" FLOAT64_IEEE LINEAR_FUNCTION_M1_T0_U1 1 100 0 65535 ECU_ADDRESS 0x0 /end MEASUREMENT
/begin MEASUREMENT ETCSignals.ES900.ES910.CAN2.CAN2.MEAS_ETAS_VDCdata2.Max_Fx_RL "" FLOAT64_IEEE LINEAR_FUNCTION_M1_T0_U1 1 100 0 65535 ECU_ADDRESS 0x0 /end MEASUREMENT
/begin MEASUREMENT ETCSignals.ES900.ES910.CAN2.CAN2.MEAS_ETAS_VDCdata2.Fy_R "" FLOAT64_IEEE LINEAR_FUNCTION_M1_T0_U1 1 100 0 65535 ECU_ADDRESS 0x0 /end MEASUREMENT
/begin MEASUREMENT ETCSignals.ES900.ES910.CAN2.CAN2.MEAS_ETAS_VDCdata1.Max_Torque_RR "" FLOAT64_IEEE LINEAR_FUNCTION_M1_T0_U1 1 100 0 65535 ECU_ADDRESS 0x0 /end MEASUREMENT
/begin MEASUREMENT ETCSignals.ES900.ES910.CAN2.CAN2.MEAS_ETAS_VDCdata1.Max_Torque_RL "" FLOAT64_IEEE LINEAR_FUNCTION_M1_T0_U1 1 100 0 65535 ECU_ADDRESS 0x0 /end MEASUREMENT
/begin MEASUREMENT ETCSignals.ES900.ES910.CAN2.CAN2.MEAS_ETAS_VDCdata1.Torque_RRwc "" FLOAT64_IEEE LINEAR_FUNCTION_M1_T0_U1 1 100 0 65535 ECU_ADDRESS 0x0 /end MEASUREMENT
/begin MEASUREMENT ETCSignals.ES900.ES910.CAN2.CAN2.MEAS_ETAS_VDCdata1.Torque_RLwc "" FLOAT64_IEEE LINEAR_FUNCTION_M1_T0_U1 1 100 0 65535 ECU_ADDRESS 0x0 /end MEASUREMENT
/begin MEASUREMENT ETCSignals.ES900.ES910.CAN2.CAN2.AP_ACCEL_R_Data2.Susp_R_R_Bits "" FLOAT64_IEEE LINEAR_FUNCTION_M1_T0_U1 1 100 0 0 ECU_ADDRESS 0x0 /end MEASUREMENT
/begin MEASUREMENT ETCSignals.ES900.ES910.CAN2.CAN2.AP_ACCEL_R_Data2.Susp_R_L_Bits "" FLOAT64_IEEE LINEAR_FUNCTION_M1_T0_U1 1 100 0 0 ECU_ADDRESS 0x0 /end MEASUREMENT
/begin MEASUREMENT ETCSignals.ES900.ES910.CAN2.CAN2.NM_LV_Derivation_Keep_Alive.LV_Derivation_Alive "" FLOAT64_IEEE LINEAR_FUNCTION_M1_T0_U1 1 100 0 0 ECU_ADDRESS 0x0 /end MEASUREMENT
/begin MEASUREMENT ETCSignals.ES900.ES910.CAN2.CAN2.AP_ACCEL_F_Data.Gyroscope_F "" FLOAT64_IEEE LINEAR_FUNCTION_M1_T0_U1 1 100 0 0 ECU_ADDRESS 0x0 /end MEASUREMENT
/begin MEASUREMENT ETCSignals.ES900.ES910.CAN2.CAN2.AP_ACCEL_F_Data.ACCEL_F_Z "" FLOAT64_IEEE LINEAR_FUNCTION_M1_T0_U1 1 100 0 0 ECU_ADDRESS 0x0 /end MEASUREMENT
/begin MEASUREMENT ETCSignals.ES900.ES910.CAN2.CAN2.AP_ACCEL_F_Data.ACCEL_F_Y "" FLOAT64_IEEE LINEAR_FUNCTION_M1_T0_U1 1 100 0 0 ECU_ADDRESS 0x0 /end MEASUREMENT
/begin MEASUREMENT ETCSignals.ES900.ES910.CAN2.CAN2.AP_ACCEL_F_Data.ACCEL_F_X "" FLOAT64_IEEE LINEAR_FUNCTION_M1_T0_U1 1 100 0 0 ECU_ADDRESS 0x0 /end MEASUREMENT
/begin MEASUREMENT ETCSignals.ES900.ES910.CAN2.CAN2.NM_ACCEL_F_Keep_Alive.ACCEL_F_Alive "" FLOAT64_IEEE LINEAR_FUNCTION_M1_T0_U1 1 100 0 0 ECU_ADDRESS 0x0 /end MEASUREMENT
/begin MEASUREMENT ETCSignals.ES900.ES910.CAN2.CAN2.NM_ACCEL_R_Keep_Alive.ACCEL_R_Alive "" FLOAT64_IEEE LINEAR_FUNCTION_M1_T0_U1 1 100 0 0 ECU_ADDRESS 0x0 /end MEASUREMENT
/begin MEASUREMENT ETCSignals.ES900.ES910.CAN2.CAN2.AP_ACCEL_R_Data.Gyroscope_R "" FLOAT64_IEEE LINEAR_FUNCTION_M1_T0_U1 1 100 0 0 ECU_ADDRESS 0x0 /end MEASUREMENT
/begin MEASUREMENT ETCSignals.ES900.ES910.CAN2.CAN2.AP_ACCEL_R_Data.ACCEL_R_Z "" FLOAT64_IEEE LINEAR_FUNCTION_M1_T0_U1 1 100 0 0 ECU_ADDRESS 0x0 /end MEASUREMENT
/begin MEASUREMENT ETCSignals.ES900.ES910.CAN2.CAN2.AP_ACCEL_R_Data.ACCEL_R_Y "" FLOAT64_IEEE LINEAR_FUNCTION_M1_T0_U1 1 100 0 0 ECU_ADDRESS 0x0 /end MEASUREMENT
/begin MEASUREMENT ETCSignals.ES900.ES910.CAN2.CAN2.AP_ACCEL_R_Data.ACCEL_R_X "" FLOAT64_IEEE LINEAR_FUNCTION_M1_T0_U1 1 100 0 0 ECU_ADDRESS 0x0 /end MEASUREMENT
/begin MEASUREMENT ETCSignals.ES900.ES910.CAN2.CAN2.AP_ADCAN_Data2.Susp_F_R_Bits "" FLOAT64_IEEE LINEAR_FUNCTION_M1_T0_U1 1 100 0 0 ECU_ADDRESS 0x0 /end MEASUREMENT
/begin MEASUREMENT ETCSignals.ES900.ES910.CAN2.CAN2.AP_ADCAN_Data2.Susp_F_L_Bits "" FLOAT64_IEEE LINEAR_FUNCTION_M1_T0_U1 1 100 0 0 ECU_ADDRESS 0x0 /end MEASUREMENT
/begin MEASUREMENT ETCSignals.ES900.ES910.CAN2.CAN2.AP_ADCAN_Data1.SteeringSensor_Bits "" FLOAT64_IEEE LINEAR_FUNCTION_M1_T0_U1 1 100 0 0 ECU_ADDRESS 0x0 /end MEASUREMENT
/begin MEASUREMENT ETCSignals.ES900.ES910.CAN2.CAN2.AP_ADCAN_Data1.BrakeSensor_Bits "" FLOAT64_IEEE LINEAR_FUNCTION_M1_T0_U1 1 100 0 0 ECU_ADDRESS 0x0 /end MEASUREMENT
/begin MEASUREMENT ETCSignals.ES900.ES910.CAN2.CAN2.AP_ADCAN_Data1.APPS2_Bits "" FLOAT64_IEEE LINEAR_FUNCTION_M1_T0_U1 1 100 0 0 ECU_ADDRESS 0x0 /end MEASUREMENT
/begin MEASUREMENT ETCSignals.ES900.ES910.CAN2.CAN2.AP_ADCAN_Data1.APPS1_Bits "" FLOAT64_IEEE LINEAR_FUNCTION_M1_T0_U1 1 100 0 0 ECU_ADDRESS 0x0 /end MEASUREMENT
/begin MEASUREMENT ETCSignals.ES900.ES910.CAN2.CAN2.AP_ETAS_Synchronism.Sync_CAN2 "" FLOAT64_IEEE LINEAR_FUNCTION_M1_T0_U1 1 100 0 255 ECU_ADDRESS 0x0 /end MEASUREMENT
/begin MEASUREMENT ETCSignals.ES900.ES910.CAN2.CAN2.NM_ADCAN_Keep_Alive.ADCAN_Alive "" FLOAT64_IEEE LINEAR_FUNCTION_M1_T0_U1 1 100 0 0 ECU_ADDRESS 0x0 /end MEASUREMENT
/begin CHARACTERISTIC ETCSignals.ES900.ES910.CAN2.CAN2.MEAS_ETAS_VDCdata2.Fy_R_calibrate "" VALUE 0x0 STANDARD_VALUE_R64 0.0 LINEAR_FUNCTION_M1_T0_U1 0 65535 MAX_REFRESH 6 1 /end CHARACTERISTIC
/begin CHARACTERISTIC ETCSignals.ES900.ES910.CAN2.CAN2.MEAS_ETAS_VDCdata1.Max_Torque_RR_calibrate "" VALUE 0x0 STANDARD_VALUE_R64 0.0 LINEAR_FUNCTION_M1_T0_U1 0 65535 MAX_REFRESH 6 1 /end CHARACTERISTIC
/begin CHARACTERISTIC ETCSignals.ES900.ES910.CAN2.CAN2.MEAS_ETAS_VDCdata1.Max_Torque_RL_calibrate "" VALUE 0x0 STANDARD_VALUE_R64 0.0 LINEAR_FUNCTION_M1_T0_U1 0 65535 MAX_REFRESH 6 1 /end CHARACTERISTIC
/begin CHARACTERISTIC ETCSignals.ES900.ES910.CAN2.CAN2.MEAS_ETAS_VDCdata1.Torque_RRwc_calibrate "" VALUE 0x0 STANDARD_VALUE_R64 0.0 LINEAR_FUNCTION_M1_T0_U1 0 65535 MAX_REFRESH 6 1 /end CHARACTERISTIC
/begin CHARACTERISTIC ETCSignals.ES900.ES910.CAN2.CAN2.MEAS_ETAS_VDCdata1.Torque_RLwc_calibrate "" VALUE 0x0 STANDARD_VALUE_R64 0.0 LINEAR_FUNCTION_M1_T0_U1 0 65535 MAX_REFRESH 6 1 /end CHARACTERISTIC
/begin CHARACTERISTIC ETCSignals.ES900.ES910.CAN2.CAN2.AP_ETAS_Synchronism.Sync_CAN2_calibrate "" VALUE 0x0 STANDARD_VALUE_R64 0.0 LINEAR_FUNCTION_M1_T0_U1 0 255 MAX_REFRESH 6 1 /end CHARACTERISTIC
/begin COMPU_METHOD LINEAR_FUNCTION_M1_T0_U1 "" RAT_FUNC "%8.4" "" COEFFS 0 1 0 0 0 1 /end COMPU_METHOD
/begin COMPU_METHOD LINEAR_FUNCTION_M1_T0_U2 "" RAT_FUNC "%8.4" "°" COEFFS 0 1 0 0 0 1 /end COMPU_METHOD
/begin COMPU_METHOD LINEAR_FUNCTION_M1_T0_U3 "" RAT_FUNC "%8.4" "m.s-2" COEFFS 0 1 0 0 0 1 /end COMPU_METHOD
/begin COMPU_METHOD LINEAR_FUNCTION_M1_T0_U4 "" RAT_FUNC "%8.4" "rad" COEFFS 0 1 0 0 0 1 /end COMPU_METHOD
/begin COMPU_METHOD LINEAR_FUNCTION_M1_T0_U5 "" RAT_FUNC "%8.4" "m.s-1" COEFFS 0 1 0 0 0 1 /end COMPU_METHOD
/begin COMPU_METHOD LINEAR_FUNCTION_M1_T0_U6 "" RAT_FUNC "%8.4" "µs" COEFFS 0 1 0 0 0 1 /end COMPU_METHOD
/begin COMPU_METHOD LINEAR_FUNCTION_M1_T0_U7 "" RAT_FUNC "%8.4" "rad.s-1" COEFFS 0 1 0 0 0 1 /end COMPU_METHOD
/begin COMPU_METHOD LINEAR_FUNCTION_M1_T0_U8 "" RAT_FUNC "%8.4" "m" COEFFS 0 1 0 0 0 1 /end COMPU_METHOD
/begin RECORD_LAYOUT STANDARD_VALUE_R64 FNC_VALUES 1 FLOAT64_IEEE COLUMN_DIR DIRECT /end RECORD_LAYOUT
/begin GROUP ETCSignals "" ROOT
 /begin REF_MEASUREMENT ETCSignals.ES900.ES910.CAN1.Presence.PresenceGroup.PresenceFlag ETCSignals.ES900.ES910.CAN1.CAN1.AP_BMS_Current_SOC_SOH.Accumulator_SOH ETCSignals.ES900.ES910.CAN1.CAN1.AP_BMS_Current_SOC_SOH.Accumulator_SOC ETCSignals.ES900.ES910.CAN1.CAN1.AP_BMS_Current_SOC_SOH.Accumulator_Current ETCSignals.ES900.ES910.CAN1.CAN1.AP_BMS_StateAndFailReport.BMS_AccumulatorIntck ETCSignals.ES900.ES910.CAN1.CAN1.AP_BMS_StateAndFailReport.State_PrechargeRelay ETCSignals.ES900.ES910.CAN1.CAN1.AP_BMS_StateAndFailReport.State_DivideCurrent ETCSignals.ES900.ES910.CAN1.CAN1.AP_BMS_StateAndFailReport.State_BMS_Ok ETCSignals.ES900.ES910.CAN1.CAN1.AP_BMS_StateAndFailReport.State_Balancing ETCSignals.ES900.ES910.CAN1.CAN1.AP_BMS_StateAndFailReport.State_Air_Plus ETCSignals.ES900.ES910.CAN1.CAN1.AP_BMS_StateAndFailReport.State_Air_Minus ETCSignals.ES900.ES910.CAN1.CAN1.AP_BMS_StateAndFailReport.State_AccumulatorFans ETCSignals.ES900.ES910.CAN1.CAN1.AP_BMS_StateAndFailReport.BMSerror_VoltageDisconnection ETCSignals.ES900.ES910.CAN1.CAN1.AP_BMS_StateAndFailReport.BMSerror_UnderVoltage ETCSignals.ES900.ES910.CAN1.CAN1.AP_BMS_StateAndFailReport.BMSerror_UnderTemperature ETCSignals.ES900.ES910.CAN1.CAN1.AP_BMS_StateAndFailReport.BMSerror_OverVoltage ETCSignals.ES900.ES910.CAN1.CAN1.AP_BMS_StateAndFailReport.BMSerror_OverTemperature ETCSignals.ES900.ES910.CAN1.CAN1.AP_BMS_StateAndFailReport.BMSerror_NTCDisconnection ETCSignals.ES900.ES910.CAN1.CAN1.AP_BMS_StateAndFailReport.BMSerror_CurrentSensDisc ETCSignals.ES900.ES910.CAN1.CAN1.AP_BMS_StateAndFailReport.BMSerror_CANDisconnection ETCSignals.ES900.ES910.CAN1.CAN1.AP_BMS_Voltages.Lowest_CellVoltage ETCSignals.ES900.ES910.CAN1.CAN1.AP_BMS_Voltages.Highest_CellVoltage ETCSignals.ES900.ES910.CAN1.CAN1.AP_BMS_Voltages.Accumulator_Voltage ETCSignals.ES900.ES910.CAN1.CAN1.AP_BMS_OnBoardTemperatures.Lowest_OnBoardTemp ETCSignals.ES900.ES910.CAN1.CAN1.AP_BMS_OnBoardTemperatures.Highest_OnBoardTemp ETCSignals.ES900.ES910.CAN1.CAN1.AP_BMS_OnBoardTemperatures.Average_OnBoardTemp ETCSignals.ES900.ES910.CAN1.CAN1.AP_BMS_ChargerParameters.Charger_MaxVoltage ETCSignals.ES900.ES910.CAN1.CAN1.AP_BMS_ChargerParameters.Charger_MaxCurrent ETCSignals.ES900.ES910.CAN1.CAN1.AP_BMS_BatteryTemperatures.Lowest_CellTemp ETCSignals.ES900.ES910.CAN1.CAN1.AP_BMS_BatteryTemperatures.Highest_CellTemp ETCSignals.ES900.ES910.CAN1.CAN1.AP_BMS_BatteryTemperatures.Average_CellTemp ETCSignals.ES900.ES910.CAN1.CAN1.AP_Inverter_R_Tx.Inv_R_RegID ETCSignals.ES900.ES910.CAN1.CAN1.AP_Inverter_R_Tx.Inv_R_RegID_M73_Inv_R_TempMotor ETCSignals.ES900.ES910.CAN1.CAN1.AP_Inverter_R_Tx.Inv_R_RegID_M74_Inv_R_TempIGBT ETCSignals.ES900.ES910.CAN1.CAN1.AP_Inverter_R_Tx.Inv_R_RegID_M48_Inv_R_Speed ETCSignals.ES900.ES910.CAN1.CAN1.AP_Inverter_R_Tx.Inv_R_RegID_M39_Inv_R_Iq ETCSignals.ES900.ES910.CAN1.CAN1.AP_Inverter_R_Tx.Inv_R_RegID_M38_Inv_R_Icommand ETCSignals.ES900.ES910.CAN1.CAN1.AP_Inverter_R_Tx.Inv_R_RegID_M32_Inv_R_Iactual ETCSignals.ES900.ES910.CAN1.CAN1.AP_Inverter_R_Tx.Inv_R_RegID_M232_Inv_R_Enable ETCSignals.ES900.ES910.CAN1.CAN1.AP_Inverter_R_Tx.Inv_R_RegID_M235_Inv_R_DCBus ETCSignals.ES900.ES910.CAN1.CAN1.AP_Inverter_L_Tx.Inv_L_RegID ETCSignals.ES900.ES910.CAN1.CAN1.AP_Inverter_L_Tx.Inv_L_RegID_M73_Inv_L_TempMotor ETCSignals.ES900.ES910.CAN1.CAN1.AP_Inverter_L_Tx.Inv_L_RegID_M74_Inv_L_TempIGBT ETCSignals.ES900.ES910.CAN1.CAN1.AP_Inverter_L_Tx.Inv_L_RegID_M48_Inv_L_Speed ETCSignals.ES900.ES910.CAN1.CAN1.AP_Inverter_L_Tx.Inv_L_RegID_M39_Inv_L_Iq ETCSignals.ES900.ES910.CAN1.CAN1.AP_Inverter_L_Tx.Inv_L_RegID_M38_Inv_L_Icommand ETCSignals.ES900.ES910.CAN1.CAN1.AP_Inverter_L_Tx.Inv_L_RegID_M32_Inv_L_Iactual ETCSignals.ES900.ES910.CAN1.CAN1.AP_Inverter_L_Tx.Inv_L_RegID_M232_Inv_L_Enable ETCSignals.ES900.ES910.CAN1.CAN1.AP_Inverter_L_Tx.Inv_L_RegID_M235_Inv_L_DCBus ETCSignals.ES900.ES910.CAN1.CAN1.AP_DASH_CustomMode.CustomMode_Identifier ETCSignals.ES900.ES910.CAN1.CAN1.AP_DASH_CustomMode.CustomMode_Data ETCSignals.ES900.ES910.CAN1.CAN1.AP_DASH_Mode.RacingMode ETCSignals.ES900.ES910.CAN1.CAN1.NM_BMS_Keep_Alive.BMS_Alive ETCSignals.ES900.ES910.CAN1.CAN1.AP_BMS_AIRs_State.AIRs_State ETCSignals.ES900.ES910.CAN1.CAN1.NM_DASH_Keep_Alive.Dash_Alive ETCSignals.ES900.ES910.CAN1.CAN1.AP_DASH_TorqueLockOn.Torque_LockOn ETCSignals.ES900.ES910.CAN1.CAN1.AP_DASH_PrechargeRequest.PrechargeRequest ETCSignals.ES900.ES910.CAN1.CAN1.AP_DASH_EnableDrive.EnableDrive_Order ETCSignals.ES900.ES910.CAN1.CAN1.AP_ETAS_DashData1.Speed ETCSignals.ES900.ES910.CAN1.CAN1.AP_ETAS_DashData1.Precharge_Voltage ETCSignals.ES900.ES910.CAN1.CAN1.AP_ETAS_DashData1.Precharge_Percentage ETCSignals.ES900.ES910.CAN1.CAN1.AP_ETAS_DashData1.LVbattery_Voltage ETCSignals.ES900.ES910.CAN1.CAN1.AP_ETAS_DashData1.LVbattery_SOC ETCSignals.ES900.ES910.CAN1.CAN1.AP_ETAS_VDCParams2.VDC_Cte_SKF ETCSignals.ES900.ES910.CAN1.CAN1.AP_ETAS_VDCParams2.VDC_Cte_CKF ETCSignals.ES900.ES910.CAN1.CAN1.AP_ETAS_VDCParams.VDC_CKF_Initial ETCSignals.ES900.ES910.CAN1.CAN1.AP_ETAS_VDCParams.VDC_SKF_Initial ETCSignals.ES900.ES910.CAN1.CAN1.AP_ETAS_VDCParams.VDC_Power_Limit ETCSignals.ES900.ES910.CAN1.CAN1.AP_ETAS_VDCParams.VDC_Max_Regenerative_Torque ETCSignals.ES900.ES910.CAN1.CAN1.AP_ETAS_VDCParams.VDC_K_Reduction_Temperature ETCSignals.ES900.ES910.CAN1.CAN1.AP_ETAS_VDCParams.VDC_K_Reduction_P ETCSignals.ES900.ES910.CAN1.CAN1.AP_ETAS_VDCParams.VDC_APPS_Sat_Up ETCSignals.ES900.ES910.CAN1.CAN1.AP_ETAS_VDCParams.VDC_APPS_Sat_Down ETCSignals.ES900.ES910.CAN1.CAN1.AP_ETAS_Inverter_R_Rx.Inverter_R_RegID ETCSignals.ES900.ES910.CAN1.CAN1.AP_ETAS_Inverter_R_Rx.Inverter_R_b7tob0 ETCSignals.ES900.ES910.CAN1.CAN1.AP_ETAS_Inverter_R_Rx.Inverter_R_b15tob8 ETCSignals.ES900.ES910.CAN1.CAN1.AP_ETAS_Inverter_L_Rx.Inverter_L_RegID ETCSignals.ES900.ES910.CAN1.CAN1.AP_ETAS_Inverter_L_Rx.Inverter_L_b7tob0 ETCSignals.ES900.ES910.CAN1.CAN1.AP_ETAS_Inverter_L_Rx.Inverter_L_b15tob8 ETCSignals.ES900.ES910.CAN1.CAN1.AP_ETAS_CarState.Car_State ETCSignals.ES900.ES910.CAN1.CAN1.AP_ETAS_AIRsRequest.AIRs_Request ETCSignals.ES900.ES910.CAN1.CAN1.AP_ETAS_AnalogicControl.BrakeLight_Control ETCSignals.ES900.ES910.CAN1.CAN1.AP_ETAS_AnalogicControl.Pumps_Control ETCSignals.ES900.ES910.CAN1.CAN1.MEAS_ETAS_InternalVars.CriticalDisconnection ETCSignals.ES900.ES910.CAN1.CAN1.MEAS_ETAS_InternalVars.CurrentPathDisconnectionFlag ETCSignals.ES900.ES910.CAN1.CAN1.MEAS_ETAS_InternalVars.Car_OK ETCSignals.ES900.ES910.CAN1.CAN1.MEAS_ETAS_InternalVars.Power ETCSignals.ES900.ES910.CAN1.CAN1.MEAS_ETAS_InternalVars.Torque_OK ETCSignals.ES900.ES910.CAN1.CAN1.MEAS_ETAS_InternalVars.TV_Mode ETCSignals.ES900.ES910.CAN1.CAN1.MEAS_ETAS_InternalVars.Critical_Signal_Disconnection ETCSignals.ES900.ES910.CAN1.CAN1.MEAS_ETAS_InternalVars.Critical_CAN_Disconnection ETCSignals.ES900.ES910.CAN1.CAN1.MEAS_ETAS_InternalVars.Brake_Implausibility ETCSignals.ES900.ES910.CAN1.CAN1.MEAS_ETAS_InternalVars.APPS_Implausibility ETCSignals.ES900.ES910.CAN1.CAN1.AP_SHUTDOWN_State.Shutdown_IMD_OKreading ETCSignals.ES900.ES910.CAN1.CAN1.AP_SHUTDOWN_State.Shutdown_IMD ETCSignals.ES900.ES910.CAN1.CAN1.AP_SHUTDOWN_State.Shutdown_HVBox ETCSignals.ES900.ES910.CAN1.CAN1.AP_SHUTDOWN_State.Shutdown_TSMS ETCSignals.ES900.ES910.CAN1.CAN1.AP_SHUTDOWN_State.Shutdown_TSMPintck ETCSignals.ES900.ES910.CAN1.CAN1.AP_SHUTDOWN_State.Shutdown_SetaRight ETCSignals.ES900.ES910.CAN1.CAN1.AP_SHUTDOWN_State.Shutdown_SetaLeft ETCSignals.ES900.ES910.CAN1.CAN1.AP_SHUTDOWN_State.Shutdown_SetaCockPit ETCSignals.ES900.ES910.CAN1.CAN1.AP_SHUTDOWN_State.Shutdown_PackageIntck ETCSignals.ES900.ES910.CAN1.CAN1.AP_SHUTDOWN_State.Shutdown_InverterRIntck ETCSignals.ES900.ES910.CAN1.CAN1.AP_SHUTDOWN_State.Shutdown_InverterLIntck ETCSignals.ES900.ES910.CAN1.CAN1.AP_SHUTDOWN_State.Shutdown_Inertia ETCSignals.ES900.ES910.CAN1.CAN1.AP_SHUTDOWN_State.Shutdown_HVD ETCSignals.ES900.ES910.CAN1.CAN1.AP_SHUTDOWN_State.Shutdown_BSPD_RelayReading ETCSignals.ES900.ES910.CAN1.CAN1.AP_SHUTDOWN_State.Shutdown_BSPD ETCSignals.ES900.ES910.CAN1.CAN1.AP_SHUTDOWN_State.Shutdown_BOTS ETCSignals.ES900.ES910.CAN1.CAN1.AP_SHUTDOWN_State.Shutdown_BMS_OKreading ETCSignals.ES900.ES910.CAN1.CAN1.AP_SHUTDOWN_State.Shutdown_BMS ETCSignals.ES900.ES910.CAN1.CAN1.AP_SHUTDOWN_State.Pumps_State ETCSignals.ES900.ES910.CAN1.CAN1.AP_SHUTDOWN_State.BrakeLight_State ETCSignals.ES900.ES910.CAN1.CAN1.NM_ETAS_Disconnections.Disconnection_LV_Derivation ETCSignals.ES900.ES910.CAN1.CAN1.NM_ETAS_Disconnections.Disconnection_DashBoard ETCSignals.ES900.ES910.CAN1.CAN1.NM_ETAS_Disconnections.Disconnection_BMS ETCSignals.ES900.ES910.CAN1.CAN1.NM_ETAS_Disconnections.Disconnection_Gyroscope_F ETCSignals.ES900.ES910.CAN1.CAN1.NM_ETAS_Disconnections.Disconnection_Gyroscope_R ETCSignals.ES900.ES910.CAN1.CAN1.NM_ETAS_Disconnections.Disconnection_Accel_F ETCSignals.ES900.ES910.CAN1.CAN1.NM_ETAS_Disconnections.Disconnection_Accel_R ETCSignals.ES900.ES910.CAN1.CAN1.NM_ETAS_Disconnections.Disconnection_SteeringSensor ETCSignals.ES900.ES910.CAN1.CAN1.NM_ETAS_Disconnections.Disconnection_Susp_R_R ETCSignals.ES900.ES910.CAN1.CAN1.NM_ETAS_Disconnections.Disconnection_Susp_R_L ETCSignals.ES900.ES910.CAN1.CAN1.NM_ETAS_Disconnections.Disconnection_Susp_F_R ETCSignals.ES900.ES910.CAN1.CAN1.NM_ETAS_Disconnections.Disconnection_Susp_F_L ETCSignals.ES900.ES910.CAN1.CAN1.NM_ETAS_Disconnections.Disconnection_Brake_Sensor ETCSignals.ES900.ES910.CAN1.CAN1.NM_ETAS_Disconnections.Disconnection_APPS2 ETCSignals.ES900.ES910.CAN1.CAN1.NM_ETAS_Disconnections.Disconnection_APPS1 ETCSignals.ES900.ES910.CAN1.CAN1.NM_ETAS_Disconnections.Disconnection_ADCAN ETCSignals.ES900.ES910.CAN1.CAN1.NM_ETAS_Disconnections.Disconnection_Shutdown ETCSignals.ES900.ES910.CAN1.CAN1.NM_SHUTDOWN_Keep_Alive.Shutdown_Alive ETCSignals.ES900.ES910.CAN1.CAN1.AP_ETAS_DashData2.SteeringSensor_Value ETCSignals.ES900.ES910.CAN1.CAN1.AP_ETAS_DashData2.SKF_actual ETCSignals.ES900.ES910.CAN1.CAN1.AP_ETAS_DashData2.CKF_actual ETCSignals.ES900.ES910.CAN1.CAN1.AP_ETAS_DashData2.BrakeSensor_Value ETCSignals.ES900.ES910.CAN1.CAN1.AP_ETAS_DashData2.APPS2_Value ETCSignals.ES900.ES910.CAN1.CAN1.AP_ETAS_DashData2.APPS1_Value ETCSignals.ES900.ES910.CAN1.CAN1.AP_ETAS_Synchronism.Sync_CAN1 ETCSignals.ES900.ES910.CAN2.Presence.PresenceGroup.PresenceFlag ETCSignals.ES900.ES910.CAN2.CAN2.AP_ELLIPSE_EKF_POS.LONGITUDE_EKF ETCSignals.ES900.ES910.CAN2.CAN2.AP_ELLIPSE_EKF_POS.LATITUDE_EKF ETCSignals.ES900.ES910.CAN2.CAN2.AP_ELLIPSE_IMU_ACCEL.ACCEL_Z_IMU ETCSignals.ES900.ES910.CAN2.CAN2.AP_ELLIPSE_IMU_ACCEL.ACCEL_Y_IMU ETCSignals.ES900.ES910.CAN2.CAN2.AP_ELLIPSE_IMU_ACCEL.ACCEL_X_IMU ETCSignals.ES900.ES910.CAN2.CAN2.AP_ELLIPSE_MAG.ACCEL_Z_MAG ETCSignals.ES900.ES910.CAN2.CAN2.AP_ELLIPSE_MAG.ACCEL_Y_MAG ETCSignals.ES900.ES910.CAN2.CAN2.AP_ELLIPSE_MAG.ACCEL_X_MAG ETCSignals.ES900.ES910.CAN2.CAN2.AP_ELLIPSE_EKF_EULER.YAW ETCSignals.ES900.ES910.CAN2.CAN2.AP_ELLIPSE_EKF_EULER.PITCH ETCSignals.ES900.ES910.CAN2.CAN2.AP_ELLIPSE_EKF_EULER.ROLL ETCSignals.ES900.ES910.CAN2.CAN2.AP_ELLIPSE_EKF_VEL_BODY.el_Vel_Z ETCSignals.ES900.ES910.CAN2.CAN2.AP_ELLIPSE_EKF_VEL_BODY.el_Vel_Y ETCSignals.ES900.ES910.CAN2.CAN2.AP_ELLIPSE_EKF_VEL_BODY.el_Vel_X ETCSignals.ES900.ES910.CAN2.CAN2.NM_ELLIPSE_Status.CLOCK ETCSignals.ES900.ES910.CAN2.CAN2.NM_ELLIPSE_Status.GENERAL ETCSignals.ES900.ES910.CAN2.CAN2.NM_ELLIPSE_Status.TIME_STAMP ETCSignals.ES900.ES910.CAN2.CAN2.AP_ELLIPSE_IMU_GYRO.GYRO_Z ETCSignals.ES900.ES910.CAN2.CAN2.AP_ELLIPSE_IMU_GYRO.GYRO_Y ETCSignals.ES900.ES910.CAN2.CAN2.AP_ELLIPSE_IMU_GYRO.GYRO_X ETCSignals.ES900.ES910.CAN2.CAN2.AP_ELLIPSE_SLIP_CURV.AUTO_STATUS ETCSignals.ES900.ES910.CAN2.CAN2.AP_ELLIPSE_SLIP_CURV.CURVATURE_RADIUS ETCSignals.ES900.ES910.CAN2.CAN2.AP_ELLIPSE_SLIP_CURV.ANGLE_SLIP ETCSignals.ES900.ES910.CAN2.CAN2.AP_ELLIPSE_SLIP_CURV.ANGLE_TRACK ETCSignals.ES900.ES910.CAN2.CAN2.MEAS_ETAS_Inverter_R_Data.Inv_R_TempMotor ETCSignals.ES900.ES910.CAN2.CAN2.MEAS_ETAS_Inverter_R_Data.Inv_R_TempIGBT ETCSignals.ES900.ES910.CAN2.CAN2.MEAS_ETAS_Inverter_R_Data.Inv_R_Speed ETCSignals.ES900.ES910.CAN2.CAN2.MEAS_ETAS_Inverter_R_Data.Inv_R_Iq ETCSignals.ES900.ES910.CAN2.CAN2.MEAS_ETAS_Inverter_R_Data.Inv_R_Icommand ETCSignals.ES900.ES910.CAN2.CAN2.MEAS_ETAS_Inverter_R_Data.Inv_R_Iactual ETCSignals.ES900.ES910.CAN2.CAN2.MEAS_ETAS_Inverter_L_Data.Inv_L_TempMotor ETCSignals.ES900.ES910.CAN2.CAN2.MEAS_ETAS_Inverter_L_Data.Inv_L_TempIGBT ETCSignals.ES900.ES910.CAN2.CAN2.MEAS_ETAS_Inverter_L_Data.Inv_L_Speed ETCSignals.ES900.ES910.CAN2.CAN2.MEAS_ETAS_Inverter_L_Data.Inv_L_Iq ETCSignals.ES900.ES910.CAN2.CAN2.MEAS_ETAS_Inverter_L_Data.Inv_L_Icommand ETCSignals.ES900.ES910.CAN2.CAN2.MEAS_ETAS_Inverter_L_Data.Inv_L_Iactual ETCSignals.ES900.ES910.CAN2.CAN2.MEAS_ETAS_VDCdata6.SUSP_F_R ETCSignals.ES900.ES910.CAN2.CAN2.MEAS_ETAS_VDCdata6.SUSP_F_L ETCSignals.ES900.ES910.CAN2.CAN2.MEAS_ETAS_VDCdata5.Gyro_F_Z_Deg ETCSignals.ES900.ES910.CAN2.CAN2.MEAS_ETAS_VDCdata5.Accel_F_Z_SI ETCSignals.ES900.ES910.CAN2.CAN2.MEAS_ETAS_VDCdata5.Accel_F_Y_SI ETCSignals.ES900.ES910.CAN2.CAN2.MEAS_ETAS_VDCdata5.Accel_F_X_SI ETCSignals.ES900.ES910.CAN2.CAN2.MEAS_ETAS_VDCdata4.Gyro_R_Z_Deg ETCSignals.ES900.ES910.CAN2.CAN2.MEAS_ETAS_VDCdata4.Accel_R_Z_SI ETCSignals.ES900.ES910.CAN2.CAN2.MEAS_ETAS_VDCdata4.Accel_R_Y_SI ETCSignals.ES900.ES910.CAN2.CAN2.MEAS_ETAS_VDCdata4.Accel_R_X_SI ETCSignals.ES900.ES910.CAN2.CAN2.AP_LV_Derivation_LVData.LVBattery_Voltage_Bits ETCSignals.ES900.ES910.CAN2.CAN2.MEAS_ETAS_VDCdata7.Torque_R ETCSignals.ES900.ES910.CAN2.CAN2.MEAS_ETAS_VDCdata7.Torque_L ETCSignals.ES900.ES910.CAN2.CAN2.MEAS_ETAS_VDCdata3.Handling ETCSignals.ES900.ES910.CAN2.CAN2.MEAS_ETAS_VDCdata3.Dash_Speed ETCSignals.ES900.ES910.CAN2.CAN2.MEAS_ETAS_VDCdata3.Mass ETCSignals.ES900.ES910.CAN2.CAN2.MEAS_ETAS_VDCdata2.Throttle ETCSignals.ES900.ES910.CAN2.CAN2.MEAS_ETAS_VDCdata2.Max_Fx_RR ETCSignals.ES900.ES910.CAN2.CAN2.MEAS_ETAS_VDCdata2.Max_Fx_RL ETCSignals.ES900.ES910.CAN2.CAN2.MEAS_ETAS_VDCdata2.Fy_R ETCSignals.ES900.ES910.CAN2.CAN2.MEAS_ETAS_VDCdata1.Max_Torque_RR ETCSignals.ES900.ES910.CAN2.CAN2.MEAS_ETAS_VDCdata1.Max_Torque_RL ETCSignals.ES900.ES910.CAN2.CAN2.MEAS_ETAS_VDCdata1.Torque_RRwc ETCSignals.ES900.ES910.CAN2.CAN2.MEAS_ETAS_VDCdata1.Torque_RLwc ETCSignals.ES900.ES910.CAN2.CAN2.AP_ACCEL_R_Data2.Susp_R_R_Bits ETCSignals.ES900.ES910.CAN2.CAN2.AP_ACCEL_R_Data2.Susp_R_L_Bits ETCSignals.ES900.ES910.CAN2.CAN2.NM_LV_Derivation_Keep_Alive.LV_Derivation_Alive ETCSignals.ES900.ES910.CAN2.CAN2.AP_ACCEL_F_Data.Gyroscope_F ETCSignals.ES900.ES910.CAN2.CAN2.AP_ACCEL_F_Data.ACCEL_F_Z ETCSignals.ES900.ES910.CAN2.CAN2.AP_ACCEL_F_Data.ACCEL_F_Y ETCSignals.ES900.ES910.CAN2.CAN2.AP_ACCEL_F_Data.ACCEL_F_X ETCSignals.ES900.ES910.CAN2.CAN2.NM_ACCEL_F_Keep_Alive.ACCEL_F_Alive ETCSignals.ES900.ES910.CAN2.CAN2.NM_ACCEL_R_Keep_Alive.ACCEL_R_Alive ETCSignals.ES900.ES910.CAN2.CAN2.AP_ACCEL_R_Data.Gyroscope_R ETCSignals.ES900.ES910.CAN2.CAN2.AP_ACCEL_R_Data.ACCEL_R_Z ETCSignals.ES900.ES910.CAN2.CAN2.AP_ACCEL_R_Data.ACCEL_R_Y ETCSignals.ES900.ES910.CAN2.CAN2.AP_ACCEL_R_Data.ACCEL_R_X ETCSignals.ES900.ES910.CAN2.CAN2.AP_ADCAN_Data2.Susp_F_R_Bits ETCSignals.ES900.ES910.CAN2.CAN2.AP_ADCAN_Data2.Susp_F_L_Bits ETCSignals.ES900.ES910.CAN2.CAN2.AP_ADCAN_Data1.SteeringSensor_Bits ETCSignals.ES900.ES910.CAN2.CAN2.AP_ADCAN_Data1.BrakeSensor_Bits ETCSignals.ES900.ES910.CAN2.CAN2.AP_ADCAN_Data1.APPS2_Bits ETCSignals.ES900.ES910.CAN2.CAN2.AP_ADCAN_Data1.APPS1_Bits ETCSignals.ES900.ES910.CAN2.CAN2.AP_ETAS_Synchronism.Sync_CAN2 ETCSignals.ES900.ES910.CAN2.CAN2.NM_ADCAN_Keep_Alive.ADCAN_Alive /end REF_MEASUREMENT
 /begin REF_CHARACTERISTIC ETCSignals.ES900.ES910.CAN2.CAN2.MEAS_ETAS_VDCdata2.Fy_R_calibrate ETCSignals.ES900.ES910.CAN2.CAN2.MEAS_ETAS_VDCdata1.Max_Torque_RR_calibrate ETCSignals.ES900.ES910.CAN2.CAN2.MEAS_ETAS_VDCdata1.Max_Torque_RL_calibrate ETCSignals.ES900.ES910.CAN2.CAN2.MEAS_ETAS_VDCdata1.Torque_RRwc_calibrate ETCSignals.ES900.ES910.CAN2.CAN2.MEAS_ETAS_VDCdata1.Torque_RLwc_calibrate ETCSignals.ES900.ES910.CAN2.CAN2.AP_ETAS_Synchronism.Sync_CAN2_calibrate /end REF_CHARACTERISTIC
/end GROUP
/begin GROUP ETCSignals.ES900 ""
 /begin REF_MEASUREMENT ETCSignals.ES900.ES910.CAN1.Presence.PresenceGroup.PresenceFlag ETCSignals.ES900.ES910.CAN1.CAN1.AP_BMS_Current_SOC_SOH.Accumulator_SOH ETCSignals.ES900.ES910.CAN1.CAN1.AP_BMS_Current_SOC_SOH.Accumulator_SOC ETCSignals.ES900.ES910.CAN1.CAN1.AP_BMS_Current_SOC_SOH.Accumulator_Current ETCSignals.ES900.ES910.CAN1.CAN1.AP_BMS_StateAndFailReport.BMS_AccumulatorIntck ETCSignals.ES900.ES910.CAN1.CAN1.AP_BMS_StateAndFailReport.State_PrechargeRelay ETCSignals.ES900.ES910.CAN1.CAN1.AP_BMS_StateAndFailReport.State_DivideCurrent ETCSignals.ES900.ES910.CAN1.CAN1.AP_BMS_StateAndFailReport.State_BMS_Ok ETCSignals.ES900.ES910.CAN1.CAN1.AP_BMS_StateAndFailReport.State_Balancing ETCSignals.ES900.ES910.CAN1.CAN1.AP_BMS_StateAndFailReport.State_Air_Plus ETCSignals.ES900.ES910.CAN1.CAN1.AP_BMS_StateAndFailReport.State_Air_Minus ETCSignals.ES900.ES910.CAN1.CAN1.AP_BMS_StateAndFailReport.State_AccumulatorFans ETCSignals.ES900.ES910.CAN1.CAN1.AP_BMS_StateAndFailReport.BMSerror_VoltageDisconnection ETCSignals.ES900.ES910.CAN1.CAN1.AP_BMS_StateAndFailReport.BMSerror_UnderVoltage ETCSignals.ES900.ES910.CAN1.CAN1.AP_BMS_StateAndFailReport.BMSerror_UnderTemperature ETCSignals.ES900.ES910.CAN1.CAN1.AP_BMS_StateAndFailReport.BMSerror_OverVoltage ETCSignals.ES900.ES910.CAN1.CAN1.AP_BMS_StateAndFailReport.BMSerror_OverTemperature ETCSignals.ES900.ES910.CAN1.CAN1.AP_BMS_StateAndFailReport.BMSerror_NTCDisconnection ETCSignals.ES900.ES910.CAN1.CAN1.AP_BMS_StateAndFailReport.BMSerror_CurrentSensDisc ETCSignals.ES900.ES910.CAN1.CAN1.AP_BMS_StateAndFailReport.BMSerror_CANDisconnection ETCSignals.ES900.ES910.CAN1.CAN1.AP_BMS_Voltages.Lowest_CellVoltage ETCSignals.ES900.ES910.CAN1.CAN1.AP_BMS_Voltages.Highest_CellVoltage ETCSignals.ES900.ES910.CAN1.CAN1.AP_BMS_Voltages.Accumulator_Voltage ETCSignals.ES900.ES910.CAN1.CAN1.AP_BMS_OnBoardTemperatures.Lowest_OnBoardTemp ETCSignals.ES900.ES910.CAN1.CAN1.AP_BMS_OnBoardTemperatures.Highest_OnBoardTemp ETCSignals.ES900.ES910.CAN1.CAN1.AP_BMS_OnBoardTemperatures.Average_OnBoardTemp ETCSignals.ES900.ES910.CAN1.CAN1.AP_BMS_ChargerParameters.Charger_MaxVoltage ETCSignals.ES900.ES910.CAN1.CAN1.AP_BMS_ChargerParameters.Charger_MaxCurrent ETCSignals.ES900.ES910.CAN1.CAN1.AP_BMS_BatteryTemperatures.Lowest_CellTemp ETCSignals.ES900.ES910.CAN1.CAN1.AP_BMS_BatteryTemperatures.Highest_CellTemp ETCSignals.ES900.ES910.CAN1.CAN1.AP_BMS_BatteryTemperatures.Average_CellTemp ETCSignals.ES900.ES910.CAN1.CAN1.AP_Inverter_R_Tx.Inv_R_RegID ETCSignals.ES900.ES910.CAN1.CAN1.AP_Inverter_R_Tx.Inv_R_RegID_M73_Inv_R_TempMotor ETCSignals.ES900.ES910.CAN1.CAN1.AP_Inverter_R_Tx.Inv_R_RegID_M74_Inv_R_TempIGBT ETCSignals.ES900.ES910.CAN1.CAN1.AP_Inverter_R_Tx.Inv_R_RegID_M48_Inv_R_Speed ETCSignals.ES900.ES910.CAN1.CAN1.AP_Inverter_R_Tx.Inv_R_RegID_M39_Inv_R_Iq ETCSignals.ES900.ES910.CAN1.CAN1.AP_Inverter_R_Tx.Inv_R_RegID_M38_Inv_R_Icommand ETCSignals.ES900.ES910.CAN1.CAN1.AP_Inverter_R_Tx.Inv_R_RegID_M32_Inv_R_Iactual ETCSignals.ES900.ES910.CAN1.CAN1.AP_Inverter_R_Tx.Inv_R_RegID_M232_Inv_R_Enable ETCSignals.ES900.ES910.CAN1.CAN1.AP_Inverter_R_Tx.Inv_R_RegID_M235_Inv_R_DCBus ETCSignals.ES900.ES910.CAN1.CAN1.AP_Inverter_L_Tx.Inv_L_RegID ETCSignals.ES900.ES910.CAN1.CAN1.AP_Inverter_L_Tx.Inv_L_RegID_M73_Inv_L_TempMotor ETCSignals.ES900.ES910.CAN1.CAN1.AP_Inverter_L_Tx.Inv_L_RegID_M74_Inv_L_TempIGBT ETCSignals.ES900.ES910.CAN1.CAN1.AP_Inverter_L_Tx.Inv_L_RegID_M48_Inv_L_Speed ETCSignals.ES900.ES910.CAN1.CAN1.AP_Inverter_L_Tx.Inv_L_RegID_M39_Inv_L_Iq ETCSignals.ES900.ES910.CAN1.CAN1.AP_Inverter_L_Tx.Inv_L_RegID_M38_Inv_L_Icommand ETCSignals.ES900.ES910.CAN1.CAN1.AP_Inverter_L_Tx.Inv_L_RegID_M32_Inv_L_Iactual ETCSignals.ES900.ES910.CAN1.CAN1.AP_Inverter_L_Tx.Inv_L_RegID_M232_Inv_L_Enable ETCSignals.ES900.ES910.CAN1.CAN1.AP_Inverter_L_Tx.Inv_L_RegID_M235_Inv_L_DCBus ETCSignals.ES900.ES910.CAN1.CAN1.AP_DASH_CustomMode.CustomMode_Identifier ETCSignals.ES900.ES910.CAN1.CAN1.AP_DASH_CustomMode.CustomMode_Data ETCSignals.ES900.ES910.CAN1.CAN1.AP_DASH_Mode.RacingMode ETCSignals.ES900.ES910.CAN1.CAN1.NM_BMS_Keep_Alive.BMS_Alive ETCSignals.ES900.ES910.CAN1.CAN1.AP_BMS_AIRs_State.AIRs_State ETCSignals.ES900.ES910.CAN1.CAN1.NM_DASH_Keep_Alive.Dash_Alive ETCSignals.ES900.ES910.CAN1.CAN1.AP_DASH_TorqueLockOn.Torque_LockOn ETCSignals.ES900.ES910.CAN1.CAN1.AP_DASH_PrechargeRequest.PrechargeRequest ETCSignals.ES900.ES910.CAN1.CAN1.AP_DASH_EnableDrive.EnableDrive_Order ETCSignals.ES900.ES910.CAN1.CAN1.AP_ETAS_DashData1.Speed ETCSignals.ES900.ES910.CAN1.CAN1.AP_ETAS_DashData1.Precharge_Voltage ETCSignals.ES900.ES910.CAN1.CAN1.AP_ETAS_DashData1.Precharge_Percentage ETCSignals.ES900.ES910.CAN1.CAN1.AP_ETAS_DashData1.LVbattery_Voltage ETCSignals.ES900.ES910.CAN1.CAN1.AP_ETAS_DashData1.LVbattery_SOC ETCSignals.ES900.ES910.CAN1.CAN1.AP_ETAS_VDCParams2.VDC_Cte_SKF ETCSignals.ES900.ES910.CAN1.CAN1.AP_ETAS_VDCParams2.VDC_Cte_CKF ETCSignals.ES900.ES910.CAN1.CAN1.AP_ETAS_VDCParams.VDC_CKF_Initial ETCSignals.ES900.ES910.CAN1.CAN1.AP_ETAS_VDCParams.VDC_SKF_Initial ETCSignals.ES900.ES910.CAN1.CAN1.AP_ETAS_VDCParams.VDC_Power_Limit ETCSignals.ES900.ES910.CAN1.CAN1.AP_ETAS_VDCParams.VDC_Max_Regenerative_Torque ETCSignals.ES900.ES910.CAN1.CAN1.AP_ETAS_VDCParams.VDC_K_Reduction_Temperature ETCSignals.ES900.ES910.CAN1.CAN1.AP_ETAS_VDCParams.VDC_K_Reduction_P ETCSignals.ES900.ES910.CAN1.CAN1.AP_ETAS_VDCParams.VDC_APPS_Sat_Up ETCSignals.ES900.ES910.CAN1.CAN1.AP_ETAS_VDCParams.VDC_APPS_Sat_Down ETCSignals.ES900.ES910.CAN1.CAN1.AP_ETAS_Inverter_R_Rx.Inverter_R_RegID ETCSignals.ES900.ES910.CAN1.CAN1.AP_ETAS_Inverter_R_Rx.Inverter_R_b7tob0 ETCSignals.ES900.ES910.CAN1.CAN1.AP_ETAS_Inverter_R_Rx.Inverter_R_b15tob8 ETCSignals.ES900.ES910.CAN1.CAN1.AP_ETAS_Inverter_L_Rx.Inverter_L_RegID ETCSignals.ES900.ES910.CAN1.CAN1.AP_ETAS_Inverter_L_Rx.Inverter_L_b7tob0 ETCSignals.ES900.ES910.CAN1.CAN1.AP_ETAS_Inverter_L_Rx.Inverter_L_b15tob8 ETCSignals.ES900.ES910.CAN1.CAN1.AP_ETAS_CarState.Car_State ETCSignals.ES900.ES910.CAN1.CAN1.AP_ETAS_AIRsRequest.AIRs_Request ETCSignals.ES900.ES910.CAN1.CAN1.AP_ETAS_AnalogicControl.BrakeLight_Control ETCSignals.ES900.ES910.CAN1.CAN1.AP_ETAS_AnalogicControl.Pumps_Control ETCSignals.ES900.ES910.CAN1.CAN1.MEAS_ETAS_InternalVars.CriticalDisconnection ETCSignals.ES900.ES910.CAN1.CAN1.MEAS_ETAS_InternalVars.CurrentPathDisconnectionFlag ETCSignals.ES900.ES910.CAN1.CAN1.MEAS_ETAS_InternalVars.Car_OK ETCSignals.ES900.ES910.CAN1.CAN1.MEAS_ETAS_InternalVars.Power ETCSignals.ES900.ES910.CAN1.CAN1.MEAS_ETAS_InternalVars.Torque_OK ETCSignals.ES900.ES910.CAN1.CAN1.MEAS_ETAS_InternalVars.TV_Mode ETCSignals.ES900.ES910.CAN1.CAN1.MEAS_ETAS_InternalVars.Critical_Signal_Disconnection ETCSignals.ES900.ES910.CAN1.CAN1.MEAS_ETAS_InternalVars.Critical_CAN_Disconnection ETCSignals.ES900.ES910.CAN1.CAN1.MEAS_ETAS_InternalVars.Brake_Implausibility ETCSignals.ES900.ES910.CAN1.CAN1.MEAS_ETAS_InternalVars.APPS_Implausibility ETCSignals.ES900.ES910.CAN1.CAN1.AP_SHUTDOWN_State.Shutdown_IMD_OKreading ETCSignals.ES900.ES910.CAN1.CAN1.AP_SHUTDOWN_State.Shutdown_IMD ETCSignals.ES900.ES910.CAN1.CAN1.AP_SHUTDOWN_State.Shutdown_HVBox ETCSignals.ES900.ES910.CAN1.CAN1.AP_SHUTDOWN_State.Shutdown_TSMS ETCSignals.ES900.ES910.CAN1.CAN1.AP_SHUTDOWN_State.Shutdown_TSMPintck ETCSignals.ES900.ES910.CAN1.CAN1.AP_SHUTDOWN_State.Shutdown_SetaRight ETCSignals.ES900.ES910.CAN1.CAN1.AP_SHUTDOWN_State.Shutdown_SetaLeft ETCSignals.ES900.ES910.CAN1.CAN1.AP_SHUTDOWN_State.Shutdown_SetaCockPit ETCSignals.ES900.ES910.CAN1.CAN1.AP_SHUTDOWN_State.Shutdown_PackageIntck ETCSignals.ES900.ES910.CAN1.CAN1.AP_SHUTDOWN_State.Shutdown_InverterRIntck ETCSignals.ES900.ES910.CAN1.CAN1.AP_SHUTDOWN_State.Shutdown_InverterLIntck ETCSignals.ES900.ES910.CAN1.CAN1.AP_SHUTDOWN_State.Shutdown_Inertia ETCSignals.ES900.ES910.CAN1.CAN1.AP_SHUTDOWN_State.Shutdown_HVD ETCSignals.ES900.ES910.CAN1.CAN1.AP_SHUTDOWN_State.Shutdown_BSPD_RelayReading ETCSignals.ES900.ES910.CAN1.CAN1.AP_SHUTDOWN_State.Shutdown_BSPD ETCSignals.ES900.ES910.CAN1.CAN1.AP_SHUTDOWN_State.Shutdown_BOTS ETCSignals.ES900.ES910.CAN1.CAN1.AP_SHUTDOWN_State.Shutdown_BMS_OKreading ETCSignals.ES900.ES910.CAN1.CAN1.AP_SHUTDOWN_State.Shutdown_BMS ETCSignals.ES900.ES910.CAN1.CAN1.AP_SHUTDOWN_State.Pumps_State ETCSignals.ES900.ES910.CAN1.CAN1.AP_SHUTDOWN_State.BrakeLight_State ETCSignals.ES900.ES910.CAN1.CAN1.NM_ETAS_Disconnections.Disconnection_LV_Derivation ETCSignals.ES900.ES910.CAN1.CAN1.NM_ETAS_Disconnections.Disconnection_DashBoard ETCSignals.ES900.ES910.CAN1.CAN1.NM_ETAS_Disconnections.Disconnection_BMS ETCSignals.ES900.ES910.CAN1.CAN1.NM_ETAS_Disconnections.Disconnection_Gyroscope_F ETCSignals.ES900.ES910.CAN1.CAN1.NM_ETAS_Disconnections.Disconnection_Gyroscope_R ETCSignals.ES900.ES910.CAN1.CAN1.NM_ETAS_Disconnections.Disconnection_Accel_F ETCSignals.ES900.ES910.CAN1.CAN1.NM_ETAS_Disconnections.Disconnection_Accel_R ETCSignals.ES900.ES910.CAN1.CAN1.NM_ETAS_Disconnections.Disconnection_SteeringSensor ETCSignals.ES900.ES910.CAN1.CAN1.NM_ETAS_Disconnections.Disconnection_Susp_R_R ETCSignals.ES900.ES910.CAN1.CAN1.NM_ETAS_Disconnections.Disconnection_Susp_R_L ETCSignals.ES900.ES910.CAN1.CAN1.NM_ETAS_Disconnections.Disconnection_Susp_F_R ETCSignals.ES900.ES910.CAN1.CAN1.NM_ETAS_Disconnections.Disconnection_Susp_F_L ETCSignals.ES900.ES910.CAN1.CAN1.NM_ETAS_Disconnections.Disconnection_Brake_Sensor ETCSignals.ES900.ES910.CAN1.CAN1.NM_ETAS_Disconnections.Disconnection_APPS2 ETCSignals.ES900.ES910.CAN1.CAN1.NM_ETAS_Disconnections.Disconnection_APPS1 ETCSignals.ES900.ES910.CAN1.CAN1.NM_ETAS_Disconnections.Disconnection_ADCAN ETCSignals.ES900.ES910.CAN1.CAN1.NM_ETAS_Disconnections.Disconnection_Shutdown ETCSignals.ES900.ES910.CAN1.CAN1.NM_SHUTDOWN_Keep_Alive.Shutdown_Alive ETCSignals.ES900.ES910.CAN1.CAN1.AP_ETAS_DashData2.SteeringSensor_Value ETCSignals.ES900.ES910.CAN1.CAN1.AP_ETAS_DashData2.SKF_actual ETCSignals.ES900.ES910.CAN1.CAN1.AP_ETAS_DashData2.CKF_actual ETCSignals.ES900.ES910.CAN1.CAN1.AP_ETAS_DashData2.BrakeSensor_Value ETCSignals.ES900.ES910.CAN1.CAN1.AP_ETAS_DashData2.APPS2_Value ETCSignals.ES900.ES910.CAN1.CAN1.AP_ETAS_DashData2.APPS1_Value ETCSignals.ES900.ES910.CAN1.CAN1.AP_ETAS_Synchronism.Sync_CAN1 ETCSignals.ES900.ES910.CAN2.Presence.PresenceGroup.PresenceFlag ETCSignals.ES900.ES910.CAN2.CAN2.AP_ELLIPSE_EKF_POS.LONGITUDE_EKF ETCSignals.ES900.ES910.CAN2.CAN2.AP_ELLIPSE_EKF_POS.LATITUDE_EKF ETCSignals.ES900.ES910.CAN2.CAN2.AP_ELLIPSE_IMU_ACCEL.ACCEL_Z_IMU ETCSignals.ES900.ES910.CAN2.CAN2.AP_ELLIPSE_IMU_ACCEL.ACCEL_Y_IMU ETCSignals.ES900.ES910.CAN2.CAN2.AP_ELLIPSE_IMU_ACCEL.ACCEL_X_IMU ETCSignals.ES900.ES910.CAN2.CAN2.AP_ELLIPSE_MAG.ACCEL_Z_MAG ETCSignals.ES900.ES910.CAN2.CAN2.AP_ELLIPSE_MAG.ACCEL_Y_MAG ETCSignals.ES900.ES910.CAN2.CAN2.AP_ELLIPSE_MAG.ACCEL_X_MAG ETCSignals.ES900.ES910.CAN2.CAN2.AP_ELLIPSE_EKF_EULER.YAW ETCSignals.ES900.ES910.CAN2.CAN2.AP_ELLIPSE_EKF_EULER.PITCH ETCSignals.ES900.ES910.CAN2.CAN2.AP_ELLIPSE_EKF_EULER.ROLL ETCSignals.ES900.ES910.CAN2.CAN2.AP_ELLIPSE_EKF_VEL_BODY.el_Vel_Z ETCSignals.ES900.ES910.CAN2.CAN2.AP_ELLIPSE_EKF_VEL_BODY.el_Vel_Y ETCSignals.ES900.ES910.CAN2.CAN2.AP_ELLIPSE_EKF_VEL_BODY.el_Vel_X ETCSignals.ES900.ES910.CAN2.CAN2.NM_ELLIPSE_Status.CLOCK ETCSignals.ES900.ES910.CAN2.CAN2.NM_ELLIPSE_Status.GENERAL ETCSignals.ES900.ES910.CAN2.CAN2.NM_ELLIPSE_Status.TIME_STAMP ETCSignals.ES900.ES910.CAN2.CAN2.AP_ELLIPSE_IMU_GYRO.GYRO_Z ETCSignals.ES900.ES910.CAN2.CAN2.AP_ELLIPSE_IMU_GYRO.GYRO_Y ETCSignals.ES900.ES910.CAN2.CAN2.AP_ELLIPSE_IMU_GYRO.GYRO_X ETCSignals.ES900.ES910.CAN2.CAN2.AP_ELLIPSE_SLIP_CURV.AUTO_STATUS ETCSignals.ES900.ES910.CAN2.CAN2.AP_ELLIPSE_SLIP_CURV.CURVATURE_RADIUS ETCSignals.ES900.ES910.CAN2.CAN2.AP_ELLIPSE_SLIP_CURV.ANGLE_SLIP ETCSignals.ES900.ES910.CAN2.CAN2.AP_ELLIPSE_SLIP_CURV.ANGLE_TRACK ETCSignals.ES900.ES910.CAN2.CAN2.MEAS_ETAS_Inverter_R_Data.Inv_R_TempMotor ETCSignals.ES900.ES910.CAN2.CAN2.MEAS_ETAS_Inverter_R_Data.Inv_R_TempIGBT ETCSignals.ES900.ES910.CAN2.CAN2.MEAS_ETAS_Inverter_R_Data.Inv_R_Speed ETCSignals.ES900.ES910.CAN2.CAN2.MEAS_ETAS_Inverter_R_Data.Inv_R_Iq ETCSignals.ES900.ES910.CAN2.CAN2.MEAS_ETAS_Inverter_R_Data.Inv_R_Icommand ETCSignals.ES900.ES910.CAN2.CAN2.MEAS_ETAS_Inverter_R_Data.Inv_R_Iactual ETCSignals.ES900.ES910.CAN2.CAN2.MEAS_ETAS_Inverter_L_Data.Inv_L_TempMotor ETCSignals.ES900.ES910.CAN2.CAN2.MEAS_ETAS_Inverter_L_Data.Inv_L_TempIGBT ETCSignals.ES900.ES910.CAN2.CAN2.MEAS_ETAS_Inverter_L_Data.Inv_L_Speed ETCSignals.ES900.ES910.CAN2.CAN2.MEAS_ETAS_Inverter_L_Data.Inv_L_Iq ETCSignals.ES900.ES910.CAN2.CAN2.MEAS_ETAS_Inverter_L_Data.Inv_L_Icommand ETCSignals.ES900.ES910.CAN2.CAN2.MEAS_ETAS_Inverter_L_Data.Inv_L_Iactual ETCSignals.ES900.ES910.CAN2.CAN2.MEAS_ETAS_VDCdata6.SUSP_F_R ETCSignals.ES900.ES910.CAN2.CAN2.MEAS_ETAS_VDCdata6.SUSP_F_L ETCSignals.ES900.ES910.CAN2.CAN2.MEAS_ETAS_VDCdata5.Gyro_F_Z_Deg ETCSignals.ES900.ES910.CAN2.CAN2.MEAS_ETAS_VDCdata5.Accel_F_Z_SI ETCSignals.ES900.ES910.CAN2.CAN2.MEAS_ETAS_VDCdata5.Accel_F_Y_SI ETCSignals.ES900.ES910.CAN2.CAN2.MEAS_ETAS_VDCdata5.Accel_F_X_SI ETCSignals.ES900.ES910.CAN2.CAN2.MEAS_ETAS_VDCdata4.Gyro_R_Z_Deg ETCSignals.ES900.ES910.CAN2.CAN2.MEAS_ETAS_VDCdata4.Accel_R_Z_SI ETCSignals.ES900.ES910.CAN2.CAN2.MEAS_ETAS_VDCdata4.Accel_R_Y_SI ETCSignals.ES900.ES910.CAN2.CAN2.MEAS_ETAS_VDCdata4.Accel_R_X_SI ETCSignals.ES900.ES910.CAN2.CAN2.AP_LV_Derivation_LVData.LVBattery_Voltage_Bits ETCSignals.ES900.ES910.CAN2.CAN2.MEAS_ETAS_VDCdata7.Torque_R ETCSignals.ES900.ES910.CAN2.CAN2.MEAS_ETAS_VDCdata7.Torque_L ETCSignals.ES900.ES910.CAN2.CAN2.MEAS_ETAS_VDCdata3.Handling ETCSignals.ES900.ES910.CAN2.CAN2.MEAS_ETAS_VDCdata3.Dash_Speed ETCSignals.ES900.ES910.CAN2.CAN2.MEAS_ETAS_VDCdata3.Mass ETCSignals.ES900.ES910.CAN2.CAN2.MEAS_ETAS_VDCdata2.Throttle ETCSignals.ES900.ES910.CAN2.CAN2.MEAS_ETAS_VDCdata2.Max_Fx_RR ETCSignals.ES900.ES910.CAN2.CAN2.MEAS_ETAS_VDCdata2.Max_Fx_RL ETCSignals.ES900.ES910.CAN2.CAN2.MEAS_ETAS_VDCdata2.Fy_R ETCSignals.ES900.ES910.CAN2.CAN2.MEAS_ETAS_VDCdata1.Max_Torque_RR ETCSignals.ES900.ES910.CAN2.CAN2.MEAS_ETAS_VDCdata1.Max_Torque_RL ETCSignals.ES900.ES910.CAN2.CAN2.MEAS_ETAS_VDCdata1.Torque_RRwc ETCSignals.ES900.ES910.CAN2.CAN2.MEAS_ETAS_VDCdata1.Torque_RLwc ETCSignals.ES900.ES910.CAN2.CAN2.AP_ACCEL_R_Data2.Susp_R_R_Bits ETCSignals.ES900.ES910.CAN2.CAN2.AP_ACCEL_R_Data2.Susp_R_L_Bits ETCSignals.ES900.ES910.CAN2.CAN2.NM_LV_Derivation_Keep_Alive.LV_Derivation_Alive ETCSignals.ES900.ES910.CAN2.CAN2.AP_ACCEL_F_Data.Gyroscope_F ETCSignals.ES900.ES910.CAN2.CAN2.AP_ACCEL_F_Data.ACCEL_F_Z ETCSignals.ES900.ES910.CAN2.CAN2.AP_ACCEL_F_Data.ACCEL_F_Y ETCSignals.ES900.ES910.CAN2.CAN2.AP_ACCEL_F_Data.ACCEL_F_X ETCSignals.ES900.ES910.CAN2.CAN2.NM_ACCEL_F_Keep_Alive.ACCEL_F_Alive ETCSignals.ES900.ES910.CAN2.CAN2.NM_ACCEL_R_Keep_Alive.ACCEL_R_Alive ETCSignals.ES900.ES910.CAN2.CAN2.AP_ACCEL_R_Data.Gyroscope_R ETCSignals.ES900.ES910.CAN2.CAN2.AP_ACCEL_R_Data.ACCEL_R_Z ETCSignals.ES900.ES910.CAN2.CAN2.AP_ACCEL_R_Data.ACCEL_R_Y ETCSignals.ES900.ES910.CAN2.CAN2.AP_ACCEL_R_Data.ACCEL_R_X ETCSignals.ES900.ES910.CAN2.CAN2.AP_ADCAN_Data2.Susp_F_R_Bits ETCSignals.ES900.ES910.CAN2.CAN2.AP_ADCAN_Data2.Susp_F_L_Bits ETCSignals.ES900.ES910.CAN2.CAN2.AP_ADCAN_Data1.SteeringSensor_Bits ETCSignals.ES900.ES910.CAN2.CAN2.AP_ADCAN_Data1.BrakeSensor_Bits ETCSignals.ES900.ES910.CAN2.CAN2.AP_ADCAN_Data1.APPS2_Bits ETCSignals.ES900.ES910.CAN2.CAN2.AP_ADCAN_Data1.APPS1_Bits ETCSignals.ES900.ES910.CAN2.CAN2.AP_ETAS_Synchronism.Sync_CAN2 ETCSignals.ES900.ES910.CAN2.CAN2.NM_ADCAN_Keep_Alive.ADCAN_Alive /end REF_MEASUREMENT
 /begin REF_CHARACTERISTIC ETCSignals.ES900.ES910.CAN2.CAN2.MEAS_ETAS_VDCdata2.Fy_R_calibrate ETCSignals.ES900.ES910.CAN2.CAN2.MEAS_ETAS_VDCdata1.Max_Torque_RR_calibrate ETCSignals.ES900.ES910.CAN2.CAN2.MEAS_ETAS_VDCdata1.Max_Torque_RL_calibrate ETCSignals.ES900.ES910.CAN2.CAN2.MEAS_ETAS_VDCdata1.Torque_RRwc_calibrate ETCSignals.ES900.ES910.CAN2.CAN2.MEAS_ETAS_VDCdata1.Torque_RLwc_calibrate ETCSignals.ES900.ES910.CAN2.CAN2.AP_ETAS_Synchronism.Sync_CAN2_calibrate /end REF_CHARACTERISTIC
/end GROUP
/begin GROUP ETCSignals.ES900.ES910 ""
 /begin REF_MEASUREMENT ETCSignals.ES900.ES910.CAN1.Presence.PresenceGroup.PresenceFlag ETCSignals.ES900.ES910.CAN1.CAN1.AP_BMS_Current_SOC_SOH.Accumulator_SOH ETCSignals.ES900.ES910.CAN1.CAN1.AP_BMS_Current_SOC_SOH.Accumulator_SOC ETCSignals.ES900.ES910.CAN1.CAN1.AP_BMS_Current_SOC_SOH.Accumulator_Current ETCSignals.ES900.ES910.CAN1.CAN1.AP_BMS_StateAndFailReport.BMS_AccumulatorIntck ETCSignals.ES900.ES910.CAN1.CAN1.AP_BMS_StateAndFailReport.State_PrechargeRelay ETCSignals.ES900.ES910.CAN1.CAN1.AP_BMS_StateAndFailReport.State_DivideCurrent ETCSignals.ES900.ES910.CAN1.CAN1.AP_BMS_StateAndFailReport.State_BMS_Ok ETCSignals.ES900.ES910.CAN1.CAN1.AP_BMS_StateAndFailReport.State_Balancing ETCSignals.ES900.ES910.CAN1.CAN1.AP_BMS_StateAndFailReport.State_Air_Plus ETCSignals.ES900.ES910.CAN1.CAN1.AP_BMS_StateAndFailReport.State_Air_Minus ETCSignals.ES900.ES910.CAN1.CAN1.AP_BMS_StateAndFailReport.State_AccumulatorFans ETCSignals.ES900.ES910.CAN1.CAN1.AP_BMS_StateAndFailReport.BMSerror_VoltageDisconnection ETCSignals.ES900.ES910.CAN1.CAN1.AP_BMS_StateAndFailReport.BMSerror_UnderVoltage ETCSignals.ES900.ES910.CAN1.CAN1.AP_BMS_StateAndFailReport.BMSerror_UnderTemperature ETCSignals.ES900.ES910.CAN1.CAN1.AP_BMS_StateAndFailReport.BMSerror_OverVoltage ETCSignals.ES900.ES910.CAN1.CAN1.AP_BMS_StateAndFailReport.BMSerror_OverTemperature ETCSignals.ES900.ES910.CAN1.CAN1.AP_BMS_StateAndFailReport.BMSerror_NTCDisconnection ETCSignals.ES900.ES910.CAN1.CAN1.AP_BMS_StateAndFailReport.BMSerror_CurrentSensDisc ETCSignals.ES900.ES910.CAN1.CAN1.AP_BMS_StateAndFailReport.BMSerror_CANDisconnection ETCSignals.ES900.ES910.CAN1.CAN1.AP_BMS_Voltages.Lowest_CellVoltage ETCSignals.ES900.ES910.CAN1.CAN1.AP_BMS_Voltages.Highest_CellVoltage ETCSignals.ES900.ES910.CAN1.CAN1.AP_BMS_Voltages.Accumulator_Voltage ETCSignals.ES900.ES910.CAN1.CAN1.AP_BMS_OnBoardTemperatures.Lowest_OnBoardTemp ETCSignals.ES900.ES910.CAN1.CAN1.AP_BMS_OnBoardTemperatures.Highest_OnBoardTemp ETCSignals.ES900.ES910.CAN1.CAN1.AP_BMS_OnBoardTemperatures.Average_OnBoardTemp ETCSignals.ES900.ES910.CAN1.CAN1.AP_BMS_ChargerParameters.Charger_MaxVoltage ETCSignals.ES900.ES910.CAN1.CAN1.AP_BMS_ChargerParameters.Charger_MaxCurrent ETCSignals.ES900.ES910.CAN1.CAN1.AP_BMS_BatteryTemperatures.Lowest_CellTemp ETCSignals.ES900.ES910.CAN1.CAN1.AP_BMS_BatteryTemperatures.Highest_CellTemp ETCSignals.ES900.ES910.CAN1.CAN1.AP_BMS_BatteryTemperatures.Average_CellTemp ETCSignals.ES900.ES910.CAN1.CAN1.AP_Inverter_R_Tx.Inv_R_RegID ETCSignals.ES900.ES910.CAN1.CAN1.AP_Inverter_R_Tx.Inv_R_RegID_M73_Inv_R_TempMotor ETCSignals.ES900.ES910.CAN1.CAN1.AP_Inverter_R_Tx.Inv_R_RegID_M74_Inv_R_TempIGBT ETCSignals.ES900.ES910.CAN1.CAN1.AP_Inverter_R_Tx.Inv_R_RegID_M48_Inv_R_Speed ETCSignals.ES900.ES910.CAN1.CAN1.AP_Inverter_R_Tx.Inv_R_RegID_M39_Inv_R_Iq ETCSignals.ES900.ES910.CAN1.CAN1.AP_Inverter_R_Tx.Inv_R_RegID_M38_Inv_R_Icommand ETCSignals.ES900.ES910.CAN1.CAN1.AP_Inverter_R_Tx.Inv_R_RegID_M32_Inv_R_Iactual ETCSignals.ES900.ES910.CAN1.CAN1.AP_Inverter_R_Tx.Inv_R_RegID_M232_Inv_R_Enable ETCSignals.ES900.ES910.CAN1.CAN1.AP_Inverter_R_Tx.Inv_R_RegID_M235_Inv_R_DCBus ETCSignals.ES900.ES910.CAN1.CAN1.AP_Inverter_L_Tx.Inv_L_RegID ETCSignals.ES900.ES910.CAN1.CAN1.AP_Inverter_L_Tx.Inv_L_RegID_M73_Inv_L_TempMotor ETCSignals.ES900.ES910.CAN1.CAN1.AP_Inverter_L_Tx.Inv_L_RegID_M74_Inv_L_TempIGBT ETCSignals.ES900.ES910.CAN1.CAN1.AP_Inverter_L_Tx.Inv_L_RegID_M48_Inv_L_Speed ETCSignals.ES900.ES910.CAN1.CAN1.AP_Inverter_L_Tx.Inv_L_RegID_M39_Inv_L_Iq ETCSignals.ES900.ES910.CAN1.CAN1.AP_Inverter_L_Tx.Inv_L_RegID_M38_Inv_L_Icommand ETCSignals.ES900.ES910.CAN1.CAN1.AP_Inverter_L_Tx.Inv_L_RegID_M32_Inv_L_Iactual ETCSignals.ES900.ES910.CAN1.CAN1.AP_Inverter_L_Tx.Inv_L_RegID_M232_Inv_L_Enable ETCSignals.ES900.ES910.CAN1.CAN1.AP_Inverter_L_Tx.Inv_L_RegID_M235_Inv_L_DCBus ETCSignals.ES900.ES910.CAN1.CAN1.AP_DASH_CustomMode.CustomMode_Identifier ETCSignals.ES900.ES910.CAN1.CAN1.AP_DASH_CustomMode.CustomMode_Data ETCSignals.ES900.ES910.CAN1.CAN1.AP_DASH_Mode.RacingMode ETCSignals.ES900.ES910.CAN1.CAN1.NM_BMS_Keep_Alive.BMS_Alive ETCSignals.ES900.ES910.CAN1.CAN1.AP_BMS_AIRs_State.AIRs_State ETCSignals.ES900.ES910.CAN1.CAN1.NM_DASH_Keep_Alive.Dash_Alive ETCSignals.ES900.ES910.CAN1.CAN1.AP_DASH_TorqueLockOn.Torque_LockOn ETCSignals.ES900.ES910.CAN1.CAN1.AP_DASH_PrechargeRequest.PrechargeRequest ETCSignals.ES900.ES910.CAN1.CAN1.AP_DASH_EnableDrive.EnableDrive_Order ETCSignals.ES900.ES910.CAN1.CAN1.AP_ETAS_DashData1.Speed ETCSignals.ES900.ES910.CAN1.CAN1.AP_ETAS_DashData1.Precharge_Voltage ETCSignals.ES900.ES910.CAN1.CAN1.AP_ETAS_DashData1.Precharge_Percentage ETCSignals.ES900.ES910.CAN1.CAN1.AP_ETAS_DashData1.LVbattery_Voltage ETCSignals.ES900.ES910.CAN1.CAN1.AP_ETAS_DashData1.LVbattery_SOC ETCSignals.ES900.ES910.CAN1.CAN1.AP_ETAS_VDCParams2.VDC_Cte_SKF ETCSignals.ES900.ES910.CAN1.CAN1.AP_ETAS_VDCParams2.VDC_Cte_CKF ETCSignals.ES900.ES910.CAN1.CAN1.AP_ETAS_VDCParams.VDC_CKF_Initial ETCSignals.ES900.ES910.CAN1.CAN1.AP_ETAS_VDCParams.VDC_SKF_Initial ETCSignals.ES900.ES910.CAN1.CAN1.AP_ETAS_VDCParams.VDC_Power_Limit ETCSignals.ES900.ES910.CAN1.CAN1.AP_ETAS_VDCParams.VDC_Max_Regenerative_Torque ETCSignals.ES900.ES910.CAN1.CAN1.AP_ETAS_VDCParams.VDC_K_Reduction_Temperature ETCSignals.ES900.ES910.CAN1.CAN1.AP_ETAS_VDCParams.VDC_K_Reduction_P ETCSignals.ES900.ES910.CAN1.CAN1.AP_ETAS_VDCParams.VDC_APPS_Sat_Up ETCSignals.ES900.ES910.CAN1.CAN1.AP_ETAS_VDCParams.VDC_APPS_Sat_Down ETCSignals.ES900.ES910.CAN1.CAN1.AP_ETAS_Inverter_R_Rx.Inverter_R_RegID ETCSignals.ES900.ES910.CAN1.CAN1.AP_ETAS_Inverter_R_Rx.Inverter_R_b7tob0 ETCSignals.ES900.ES910.CAN1.CAN1.AP_ETAS_Inverter_R_Rx.Inverter_R_b15tob8 ETCSignals.ES900.ES910.CAN1.CAN1.AP_ETAS_Inverter_L_Rx.Inverter_L_RegID ETCSignals.ES900.ES910.CAN1.CAN1.AP_ETAS_Inverter_L_Rx.Inverter_L_b7tob0 ETCSignals.ES900.ES910.CAN1.CAN1.AP_ETAS_Inverter_L_Rx.Inverter_L_b15tob8 ETCSignals.ES900.ES910.CAN1.CAN1.AP_ETAS_CarState.Car_State ETCSignals.ES900.ES910.CAN1.CAN1.AP_ETAS_AIRsRequest.AIRs_Request ETCSignals.ES900.ES910.CAN1.CAN1.AP_ETAS_AnalogicControl.BrakeLight_Control ETCSignals.ES900.ES910.CAN1.CAN1.AP_ETAS_AnalogicControl.Pumps_Control ETCSignals.ES900.ES910.CAN1.CAN1.MEAS_ETAS_InternalVars.CriticalDisconnection ETCSignals.ES900.ES910.CAN1.CAN1.MEAS_ETAS_InternalVars.CurrentPathDisconnectionFlag ETCSignals.ES900.ES910.CAN1.CAN1.MEAS_ETAS_InternalVars.Car_OK ETCSignals.ES900.ES910.CAN1.CAN1.MEAS_ETAS_InternalVars.Power ETCSignals.ES900.ES910.CAN1.CAN1.MEAS_ETAS_InternalVars.Torque_OK ETCSignals.ES900.ES910.CAN1.CAN1.MEAS_ETAS_InternalVars.TV_Mode ETCSignals.ES900.ES910.CAN1.CAN1.MEAS_ETAS_InternalVars.Critical_Signal_Disconnection ETCSignals.ES900.ES910.CAN1.CAN1.MEAS_ETAS_InternalVars.Critical_CAN_Disconnection ETCSignals.ES900.ES910.CAN1.CAN1.MEAS_ETAS_InternalVars.Brake_Implausibility ETCSignals.ES900.ES910.CAN1.CAN1.MEAS_ETAS_InternalVars.APPS_Implausibility ETCSignals.ES900.ES910.CAN1.CAN1.AP_SHUTDOWN_State.Shutdown_IMD_OKreading ETCSignals.ES900.ES910.CAN1.CAN1.AP_SHUTDOWN_State.Shutdown_IMD ETCSignals.ES900.ES910.CAN1.CAN1.AP_SHUTDOWN_State.Shutdown_HVBox ETCSignals.ES900.ES910.CAN1.CAN1.AP_SHUTDOWN_State.Shutdown_TSMS ETCSignals.ES900.ES910.CAN1.CAN1.AP_SHUTDOWN_State.Shutdown_TSMPintck ETCSignals.ES900.ES910.CAN1.CAN1.AP_SHUTDOWN_State.Shutdown_SetaRight ETCSignals.ES900.ES910.CAN1.CAN1.AP_SHUTDOWN_State.Shutdown_SetaLeft ETCSignals.ES900.ES910.CAN1.CAN1.AP_SHUTDOWN_State.Shutdown_SetaCockPit ETCSignals.ES900.ES910.CAN1.CAN1.AP_SHUTDOWN_State.Shutdown_PackageIntck ETCSignals.ES900.ES910.CAN1.CAN1.AP_SHUTDOWN_State.Shutdown_InverterRIntck ETCSignals.ES900.ES910.CAN1.CAN1.AP_SHUTDOWN_State.Shutdown_InverterLIntck ETCSignals.ES900.ES910.CAN1.CAN1.AP_SHUTDOWN_State.Shutdown_Inertia ETCSignals.ES900.ES910.CAN1.CAN1.AP_SHUTDOWN_State.Shutdown_HVD ETCSignals.ES900.ES910.CAN1.CAN1.AP_SHUTDOWN_State.Shutdown_BSPD_RelayReading ETCSignals.ES900.ES910.CAN1.CAN1.AP_SHUTDOWN_State.Shutdown_BSPD ETCSignals.ES900.ES910.CAN1.CAN1.AP_SHUTDOWN_State.Shutdown_BOTS ETCSignals.ES900.ES910.CAN1.CAN1.AP_SHUTDOWN_State.Shutdown_BMS_OKreading ETCSignals.ES900.ES910.CAN1.CAN1.AP_SHUTDOWN_State.Shutdown_BMS ETCSignals.ES900.ES910.CAN1.CAN1.AP_SHUTDOWN_State.Pumps_State ETCSignals.ES900.ES910.CAN1.CAN1.AP_SHUTDOWN_State.BrakeLight_State ETCSignals.ES900.ES910.CAN1.CAN1.NM_ETAS_Disconnections.Disconnection_LV_Derivation ETCSignals.ES900.ES910.CAN1.CAN1.NM_ETAS_Disconnections.Disconnection_DashBoard ETCSignals.ES900.ES910.CAN1.CAN1.NM_ETAS_Disconnections.Disconnection_BMS ETCSignals.ES900.ES910.CAN1.CAN1.NM_ETAS_Disconnections.Disconnection_Gyroscope_F ETCSignals.ES900.ES910.CAN1.CAN1.NM_ETAS_Disconnections.Disconnection_Gyroscope_R ETCSignals.ES900.ES910.CAN1.CAN1.NM_ETAS_Disconnections.Disconnection_Accel_F ETCSignals.ES900.ES910.CAN1.CAN1.NM_ETAS_Disconnections.Disconnection_Accel_R ETCSignals.ES900.ES910.CAN1.CAN1.NM_ETAS_Disconnections.Disconnection_SteeringSensor ETCSignals.ES900.ES910.CAN1.CAN1.NM_ETAS_Disconnections.Disconnection_Susp_R_R ETCSignals.ES900.ES910.CAN1.CAN1.NM_ETAS_Disconnections.Disconnection_Susp_R_L ETCSignals.ES900.ES910.CAN1.CAN1.NM_ETAS_Disconnections.Disconnection_Susp_F_R ETCSignals.ES900.ES910.CAN1.CAN1.NM_ETAS_Disconnections.Disconnection_Susp_F_L ETCSignals.ES900.ES910.CAN1.CAN1.NM_ETAS_Disconnections.Disconnection_Brake_Sensor ETCSignals.ES900.ES910.CAN1.CAN1.NM_ETAS_Disconnections.Disconnection_APPS2 ETCSignals.ES900.ES910.CAN1.CAN1.NM_ETAS_Disconnections.Disconnection_APPS1 ETCSignals.ES900.ES910.CAN1.CAN1.NM_ETAS_Disconnections.Disconnection_ADCAN ETCSignals.ES900.ES910.CAN1.CAN1.NM_ETAS_Disconnections.Disconnection_Shutdown ETCSignals.ES900.ES910.CAN1.CAN1.NM_SHUTDOWN_Keep_Alive.Shutdown_Alive ETCSignals.ES900.ES910.CAN1.CAN1.AP_ETAS_DashData2.SteeringSensor_Value ETCSignals.ES900.ES910.CAN1.CAN1.AP_ETAS_DashData2.SKF_actual ETCSignals.ES900.ES910.CAN1.CAN1.AP_ETAS_DashData2.CKF_actual ETCSignals.ES900.ES910.CAN1.CAN1.AP_ETAS_DashData2.BrakeSensor_Value ETCSignals.ES900.ES910.CAN1.CAN1.AP_ETAS_DashData2.APPS2_Value ETCSignals.ES900.ES910.CAN1.CAN1.AP_ETAS_DashData2.APPS1_Value ETCSignals.ES900.ES910.CAN1.CAN1.AP_ETAS_Synchronism.Sync_CAN1 ETCSignals.ES900.ES910.CAN2.Presence.PresenceGroup.PresenceFlag ETCSignals.ES900.ES910.CAN2.CAN2.AP_ELLIPSE_EKF_POS.LONGITUDE_EKF ETCSignals.ES900.ES910.CAN2.CAN2.AP_ELLIPSE_EKF_POS.LATITUDE_EKF ETCSignals.ES900.ES910.CAN2.CAN2.AP_ELLIPSE_IMU_ACCEL.ACCEL_Z_IMU ETCSignals.ES900.ES910.CAN2.CAN2.AP_ELLIPSE_IMU_ACCEL.ACCEL_Y_IMU ETCSignals.ES900.ES910.CAN2.CAN2.AP_ELLIPSE_IMU_ACCEL.ACCEL_X_IMU ETCSignals.ES900.ES910.CAN2.CAN2.AP_ELLIPSE_MAG.ACCEL_Z_MAG ETCSignals.ES900.ES910.CAN2.CAN2.AP_ELLIPSE_MAG.ACCEL_Y_MAG ETCSignals.ES900.ES910.CAN2.CAN2.AP_ELLIPSE_MAG.ACCEL_X_MAG ETCSignals.ES900.ES910.CAN2.CAN2.AP_ELLIPSE_EKF_EULER.YAW ETCSignals.ES900.ES910.CAN2.CAN2.AP_ELLIPSE_EKF_EULER.PITCH ETCSignals.ES900.ES910.CAN2.CAN2.AP_ELLIPSE_EKF_EULER.ROLL ETCSignals.ES900.ES910.CAN2.CAN2.AP_ELLIPSE_EKF_VEL_BODY.el_Vel_Z ETCSignals.ES900.ES910.CAN2.CAN2.AP_ELLIPSE_EKF_VEL_BODY.el_Vel_Y ETCSignals.ES900.ES910.CAN2.CAN2.AP_ELLIPSE_EKF_VEL_BODY.el_Vel_X ETCSignals.ES900.ES910.CAN2.CAN2.NM_ELLIPSE_Status.CLOCK ETCSignals.ES900.ES910.CAN2.CAN2.NM_ELLIPSE_Status.GENERAL ETCSignals.ES900.ES910.CAN2.CAN2.NM_ELLIPSE_Status.TIME_STAMP ETCSignals.ES900.ES910.CAN2.CAN2.AP_ELLIPSE_IMU_GYRO.GYRO_Z ETCSignals.ES900.ES910.CAN2.CAN2.AP_ELLIPSE_IMU_GYRO.GYRO_Y ETCSignals.ES900.ES910.CAN2.CAN2.AP_ELLIPSE_IMU_GYRO.GYRO_X ETCSignals.ES900.ES910.CAN2.CAN2.AP_ELLIPSE_SLIP_CURV.AUTO_STATUS ETCSignals.ES900.ES910.CAN2.CAN2.AP_ELLIPSE_SLIP_CURV.CURVATURE_RADIUS ETCSignals.ES900.ES910.CAN2.CAN2.AP_ELLIPSE_SLIP_CURV.ANGLE_SLIP ETCSignals.ES900.ES910.CAN2.CAN2.AP_ELLIPSE_SLIP_CURV.ANGLE_TRACK ETCSignals.ES900.ES910.CAN2.CAN2.MEAS_ETAS_Inverter_R_Data.Inv_R_TempMotor ETCSignals.ES900.ES910.CAN2.CAN2.MEAS_ETAS_Inverter_R_Data.Inv_R_TempIGBT ETCSignals.ES900.ES910.CAN2.CAN2.MEAS_ETAS_Inverter_R_Data.Inv_R_Speed ETCSignals.ES900.ES910.CAN2.CAN2.MEAS_ETAS_Inverter_R_Data.Inv_R_Iq ETCSignals.ES900.ES910.CAN2.CAN2.MEAS_ETAS_Inverter_R_Data.Inv_R_Icommand ETCSignals.ES900.ES910.CAN2.CAN2.MEAS_ETAS_Inverter_R_Data.Inv_R_Iactual ETCSignals.ES900.ES910.CAN2.CAN2.MEAS_ETAS_Inverter_L_Data.Inv_L_TempMotor ETCSignals.ES900.ES910.CAN2.CAN2.MEAS_ETAS_Inverter_L_Data.Inv_L_TempIGBT ETCSignals.ES900.ES910.CAN2.CAN2.MEAS_ETAS_Inverter_L_Data.Inv_L_Speed ETCSignals.ES900.ES910.CAN2.CAN2.MEAS_ETAS_Inverter_L_Data.Inv_L_Iq ETCSignals.ES900.ES910.CAN2.CAN2.MEAS_ETAS_Inverter_L_Data.Inv_L_Icommand ETCSignals.ES900.ES910.CAN2.CAN2.MEAS_ETAS_Inverter_L_Data.Inv_L_Iactual ETCSignals.ES900.ES910.CAN2.CAN2.MEAS_ETAS_VDCdata6.SUSP_F_R ETCSignals.ES900.ES910.CAN2.CAN2.MEAS_ETAS_VDCdata6.SUSP_F_L ETCSignals.ES900.ES910.CAN2.CAN2.MEAS_ETAS_VDCdata5.Gyro_F_Z_Deg ETCSignals.ES900.ES910.CAN2.CAN2.MEAS_ETAS_VDCdata5.Accel_F_Z_SI ETCSignals.ES900.ES910.CAN2.CAN2.MEAS_ETAS_VDCdata5.Accel_F_Y_SI ETCSignals.ES900.ES910.CAN2.CAN2.MEAS_ETAS_VDCdata5.Accel_F_X_SI ETCSignals.ES900.ES910.CAN2.CAN2.MEAS_ETAS_VDCdata4.Gyro_R_Z_Deg ETCSignals.ES900.ES910.CAN2.CAN2.MEAS_ETAS_VDCdata4.Accel_R_Z_SI ETCSignals.ES900.ES910.CAN2.CAN2.MEAS_ETAS_VDCdata4.Accel_R_Y_SI ETCSignals.ES900.ES910.CAN2.CAN2.MEAS_ETAS_VDCdata4.Accel_R_X_SI ETCSignals.ES900.ES910.CAN2.CAN2.AP_LV_Derivation_LVData.LVBattery_Voltage_Bits ETCSignals.ES900.ES910.CAN2.CAN2.MEAS_ETAS_VDCdata7.Torque_R ETCSignals.ES900.ES910.CAN2.CAN2.MEAS_ETAS_VDCdata7.Torque_L ETCSignals.ES900.ES910.CAN2.CAN2.MEAS_ETAS_VDCdata3.Handling ETCSignals.ES900.ES910.CAN2.CAN2.MEAS_ETAS_VDCdata3.Dash_Speed ETCSignals.ES900.ES910.CAN2.CAN2.MEAS_ETAS_VDCdata3.Mass ETCSignals.ES900.ES910.CAN2.CAN2.MEAS_ETAS_VDCdata2.Throttle ETCSignals.ES900.ES910.CAN2.CAN2.MEAS_ETAS_VDCdata2.Max_Fx_RR ETCSignals.ES900.ES910.CAN2.CAN2.MEAS_ETAS_VDCdata2.Max_Fx_RL ETCSignals.ES900.ES910.CAN2.CAN2.MEAS_ETAS_VDCdata2.Fy_R ETCSignals.ES900.ES910.CAN2.CAN2.MEAS_ETAS_VDCdata1.Max_Torque_RR ETCSignals.ES900.ES910.CAN2.CAN2.MEAS_ETAS_VDCdata1.Max_Torque_RL ETCSignals.ES900.ES910.CAN2.CAN2.MEAS_ETAS_VDCdata1.Torque_RRwc ETCSignals.ES900.ES910.CAN2.CAN2.MEAS_ETAS_VDCdata1.Torque_RLwc ETCSignals.ES900.ES910.CAN2.CAN2.AP_ACCEL_R_Data2.Susp_R_R_Bits ETCSignals.ES900.ES910.CAN2.CAN2.AP_ACCEL_R_Data2.Susp_R_L_Bits ETCSignals.ES900.ES910.CAN2.CAN2.NM_LV_Derivation_Keep_Alive.LV_Derivation_Alive ETCSignals.ES900.ES910.CAN2.CAN2.AP_ACCEL_F_Data.Gyroscope_F ETCSignals.ES900.ES910.CAN2.CAN2.AP_ACCEL_F_Data.ACCEL_F_Z ETCSignals.ES900.ES910.CAN2.CAN2.AP_ACCEL_F_Data.ACCEL_F_Y ETCSignals.ES900.ES910.CAN2.CAN2.AP_ACCEL_F_Data.ACCEL_F_X ETCSignals.ES900.ES910.CAN2.CAN2.NM_ACCEL_F_Keep_Alive.ACCEL_F_Alive ETCSignals.ES900.ES910.CAN2.CAN2.NM_ACCEL_R_Keep_Alive.ACCEL_R_Alive ETCSignals.ES900.ES910.CAN2.CAN2.AP_ACCEL_R_Data.Gyroscope_R ETCSignals.ES900.ES910.CAN2.CAN2.AP_ACCEL_R_Data.ACCEL_R_Z ETCSignals.ES900.ES910.CAN2.CAN2.AP_ACCEL_R_Data.ACCEL_R_Y ETCSignals.ES900.ES910.CAN2.CAN2.AP_ACCEL_R_Data.ACCEL_R_X ETCSignals.ES900.ES910.CAN2.CAN2.AP_ADCAN_Data2.Susp_F_R_Bits ETCSignals.ES900.ES910.CAN2.CAN2.AP_ADCAN_Data2.Susp_F_L_Bits ETCSignals.ES900.ES910.CAN2.CAN2.AP_ADCAN_Data1.SteeringSensor_Bits ETCSignals.ES900.ES910.CAN2.CAN2.AP_ADCAN_Data1.BrakeSensor_Bits ETCSignals.ES900.ES910.CAN2.CAN2.AP_ADCAN_Data1.APPS2_Bits ETCSignals.ES900.ES910.CAN2.CAN2.AP_ADCAN_Data1.APPS1_Bits ETCSignals.ES900.ES910.CAN2.CAN2.AP_ETAS_Synchronism.Sync_CAN2 ETCSignals.ES900.ES910.CAN2.CAN2.NM_ADCAN_Keep_Alive.ADCAN_Alive /end REF_MEASUREMENT
 /begin REF_CHARACTERISTIC ETCSignals.ES900.ES910.CAN2.CAN2.MEAS_ETAS_VDCdata2.Fy_R_calibrate ETCSignals.ES900.ES910.CAN2.CAN2.MEAS_ETAS_VDCdata1.Max_Torque_RR_calibrate ETCSignals.ES900.ES910.CAN2.CAN2.MEAS_ETAS_VDCdata1.Max_Torque_RL_calibrate ETCSignals.ES900.ES910.CAN2.CAN2.MEAS_ETAS_VDCdata1.Torque_RRwc_calibrate ETCSignals.ES900.ES910.CAN2.CAN2.MEAS_ETAS_VDCdata1.Torque_RLwc_calibrate ETCSignals.ES900.ES910.CAN2.CAN2.AP_ETAS_Synchronism.Sync_CAN2_calibrate /end REF_CHARACTERISTIC
/end GROUP
/begin GROUP ETCSignals.ES900.ES910.CAN1 ""
 /begin REF_MEASUREMENT ETCSignals.ES900.ES910.CAN1.Presence.PresenceGroup.PresenceFlag ETCSignals.ES900.ES910.CAN1.CAN1.AP_BMS_Current_SOC_SOH.Accumulator_SOH ETCSignals.ES900.ES910.CAN1.CAN1.AP_BMS_Current_SOC_SOH.Accumulator_SOC ETCSignals.ES900.ES910.CAN1.CAN1.AP_BMS_Current_SOC_SOH.Accumulator_Current ETCSignals.ES900.ES910.CAN1.CAN1.AP_BMS_StateAndFailReport.BMS_AccumulatorIntck ETCSignals.ES900.ES910.CAN1.CAN1.AP_BMS_StateAndFailReport.State_PrechargeRelay ETCSignals.ES900.ES910.CAN1.CAN1.AP_BMS_StateAndFailReport.State_DivideCurrent ETCSignals.ES900.ES910.CAN1.CAN1.AP_BMS_StateAndFailReport.State_BMS_Ok ETCSignals.ES900.ES910.CAN1.CAN1.AP_BMS_StateAndFailReport.State_Balancing ETCSignals.ES900.ES910.CAN1.CAN1.AP_BMS_StateAndFailReport.State_Air_Plus ETCSignals.ES900.ES910.CAN1.CAN1.AP_BMS_StateAndFailReport.State_Air_Minus ETCSignals.ES900.ES910.CAN1.CAN1.AP_BMS_StateAndFailReport.State_AccumulatorFans ETCSignals.ES900.ES910.CAN1.CAN1.AP_BMS_StateAndFailReport.BMSerror_VoltageDisconnection ETCSignals.ES900.ES910.CAN1.CAN1.AP_BMS_StateAndFailReport.BMSerror_UnderVoltage ETCSignals.ES900.ES910.CAN1.CAN1.AP_BMS_StateAndFailReport.BMSerror_UnderTemperature ETCSignals.ES900.ES910.CAN1.CAN1.AP_BMS_StateAndFailReport.BMSerror_OverVoltage ETCSignals.ES900.ES910.CAN1.CAN1.AP_BMS_StateAndFailReport.BMSerror_OverTemperature ETCSignals.ES900.ES910.CAN1.CAN1.AP_BMS_StateAndFailReport.BMSerror_NTCDisconnection ETCSignals.ES900.ES910.CAN1.CAN1.AP_BMS_StateAndFailReport.BMSerror_CurrentSensDisc ETCSignals.ES900.ES910.CAN1.CAN1.AP_BMS_StateAndFailReport.BMSerror_CANDisconnection ETCSignals.ES900.ES910.CAN1.CAN1.AP_BMS_Voltages.Lowest_CellVoltage ETCSignals.ES900.ES910.CAN1.CAN1.AP_BMS_Voltages.Highest_CellVoltage ETCSignals.ES900.ES910.CAN1.CAN1.AP_BMS_Voltages.Accumulator_Voltage ETCSignals.ES900.ES910.CAN1.CAN1.AP_BMS_OnBoardTemperatures.Lowest_OnBoardTemp ETCSignals.ES900.ES910.CAN1.CAN1.AP_BMS_OnBoardTemperatures.Highest_OnBoardTemp ETCSignals.ES900.ES910.CAN1.CAN1.AP_BMS_OnBoardTemperatures.Average_OnBoardTemp ETCSignals.ES900.ES910.CAN1.CAN1.AP_BMS_ChargerParameters.Charger_MaxVoltage ETCSignals.ES900.ES910.CAN1.CAN1.AP_BMS_ChargerParameters.Charger_MaxCurrent ETCSignals.ES900.ES910.CAN1.CAN1.AP_BMS_BatteryTemperatures.Lowest_CellTemp ETCSignals.ES900.ES910.CAN1.CAN1.AP_BMS_BatteryTemperatures.Highest_CellTemp ETCSignals.ES900.ES910.CAN1.CAN1.AP_BMS_BatteryTemperatures.Average_CellTemp ETCSignals.ES900.ES910.CAN1.CAN1.AP_Inverter_R_Tx.Inv_R_RegID ETCSignals.ES900.ES910.CAN1.CAN1.AP_Inverter_R_Tx.Inv_R_RegID_M73_Inv_R_TempMotor ETCSignals.ES900.ES910.CAN1.CAN1.AP_Inverter_R_Tx.Inv_R_RegID_M74_Inv_R_TempIGBT ETCSignals.ES900.ES910.CAN1.CAN1.AP_Inverter_R_Tx.Inv_R_RegID_M48_Inv_R_Speed ETCSignals.ES900.ES910.CAN1.CAN1.AP_Inverter_R_Tx.Inv_R_RegID_M39_Inv_R_Iq ETCSignals.ES900.ES910.CAN1.CAN1.AP_Inverter_R_Tx.Inv_R_RegID_M38_Inv_R_Icommand ETCSignals.ES900.ES910.CAN1.CAN1.AP_Inverter_R_Tx.Inv_R_RegID_M32_Inv_R_Iactual ETCSignals.ES900.ES910.CAN1.CAN1.AP_Inverter_R_Tx.Inv_R_RegID_M232_Inv_R_Enable ETCSignals.ES900.ES910.CAN1.CAN1.AP_Inverter_R_Tx.Inv_R_RegID_M235_Inv_R_DCBus ETCSignals.ES900.ES910.CAN1.CAN1.AP_Inverter_L_Tx.Inv_L_RegID ETCSignals.ES900.ES910.CAN1.CAN1.AP_Inverter_L_Tx.Inv_L_RegID_M73_Inv_L_TempMotor ETCSignals.ES900.ES910.CAN1.CAN1.AP_Inverter_L_Tx.Inv_L_RegID_M74_Inv_L_TempIGBT ETCSignals.ES900.ES910.CAN1.CAN1.AP_Inverter_L_Tx.Inv_L_RegID_M48_Inv_L_Speed ETCSignals.ES900.ES910.CAN1.CAN1.AP_Inverter_L_Tx.Inv_L_RegID_M39_Inv_L_Iq ETCSignals.ES900.ES910.CAN1.CAN1.AP_Inverter_L_Tx.Inv_L_RegID_M38_Inv_L_Icommand ETCSignals.ES900.ES910.CAN1.CAN1.AP_Inverter_L_Tx.Inv_L_RegID_M32_Inv_L_Iactual ETCSignals.ES900.ES910.CAN1.CAN1.AP_Inverter_L_Tx.Inv_L_RegID_M232_Inv_L_Enable ETCSignals.ES900.ES910.CAN1.CAN1.AP_Inverter_L_Tx.Inv_L_RegID_M235_Inv_L_DCBus ETCSignals.ES900.ES910.CAN1.CAN1.AP_DASH_CustomMode.CustomMode_Identifier ETCSignals.ES900.ES910.CAN1.CAN1.AP_DASH_CustomMode.CustomMode_Data ETCSignals.ES900.ES910.CAN1.CAN1.AP_DASH_Mode.RacingMode ETCSignals.ES900.ES910.CAN1.CAN1.NM_BMS_Keep_Alive.BMS_Alive ETCSignals.ES900.ES910.CAN1.CAN1.AP_BMS_AIRs_State.AIRs_State ETCSignals.ES900.ES910.CAN1.CAN1.NM_DASH_Keep_Alive.Dash_Alive ETCSignals.ES900.ES910.CAN1.CAN1.AP_DASH_TorqueLockOn.Torque_LockOn ETCSignals.ES900.ES910.CAN1.CAN1.AP_DASH_PrechargeRequest.PrechargeRequest ETCSignals.ES900.ES910.CAN1.CAN1.AP_DASH_EnableDrive.EnableDrive_Order ETCSignals.ES900.ES910.CAN1.CAN1.AP_ETAS_DashData1.Speed ETCSignals.ES900.ES910.CAN1.CAN1.AP_ETAS_DashData1.Precharge_Voltage ETCSignals.ES900.ES910.CAN1.CAN1.AP_ETAS_DashData1.Precharge_Percentage ETCSignals.ES900.ES910.CAN1.CAN1.AP_ETAS_DashData1.LVbattery_Voltage ETCSignals.ES900.ES910.CAN1.CAN1.AP_ETAS_DashData1.LVbattery_SOC ETCSignals.ES900.ES910.CAN1.CAN1.AP_ETAS_VDCParams2.VDC_Cte_SKF ETCSignals.ES900.ES910.CAN1.CAN1.AP_ETAS_VDCParams2.VDC_Cte_CKF ETCSignals.ES900.ES910.CAN1.CAN1.AP_ETAS_VDCParams.VDC_CKF_Initial ETCSignals.ES900.ES910.CAN1.CAN1.AP_ETAS_VDCParams.VDC_SKF_Initial ETCSignals.ES900.ES910.CAN1.CAN1.AP_ETAS_VDCParams.VDC_Power_Limit ETCSignals.ES900.ES910.CAN1.CAN1.AP_ETAS_VDCParams.VDC_Max_Regenerative_Torque ETCSignals.ES900.ES910.CAN1.CAN1.AP_ETAS_VDCParams.VDC_K_Reduction_Temperature ETCSignals.ES900.ES910.CAN1.CAN1.AP_ETAS_VDCParams.VDC_K_Reduction_P ETCSignals.ES900.ES910.CAN1.CAN1.AP_ETAS_VDCParams.VDC_APPS_Sat_Up ETCSignals.ES900.ES910.CAN1.CAN1.AP_ETAS_VDCParams.VDC_APPS_Sat_Down ETCSignals.ES900.ES910.CAN1.CAN1.AP_ETAS_Inverter_R_Rx.Inverter_R_RegID ETCSignals.ES900.ES910.CAN1.CAN1.AP_ETAS_Inverter_R_Rx.Inverter_R_b7tob0 ETCSignals.ES900.ES910.CAN1.CAN1.AP_ETAS_Inverter_R_Rx.Inverter_R_b15tob8 ETCSignals.ES900.ES910.CAN1.CAN1.AP_ETAS_Inverter_L_Rx.Inverter_L_RegID ETCSignals.ES900.ES910.CAN1.CAN1.AP_ETAS_Inverter_L_Rx.Inverter_L_b7tob0 ETCSignals.ES900.ES910.CAN1.CAN1.AP_ETAS_Inverter_L_Rx.Inverter_L_b15tob8 ETCSignals.ES900.ES910.CAN1.CAN1.AP_ETAS_CarState.Car_State ETCSignals.ES900.ES910.CAN1.CAN1.AP_ETAS_AIRsRequest.AIRs_Request ETCSignals.ES900.ES910.CAN1.CAN1.AP_ETAS_AnalogicControl.BrakeLight_Control ETCSignals.ES900.ES910.CAN1.CAN1.AP_ETAS_AnalogicControl.Pumps_Control ETCSignals.ES900.ES910.CAN1.CAN1.MEAS_ETAS_InternalVars.CriticalDisconnection ETCSignals.ES900.ES910.CAN1.CAN1.MEAS_ETAS_InternalVars.CurrentPathDisconnectionFlag ETCSignals.ES900.ES910.CAN1.CAN1.MEAS_ETAS_InternalVars.Car_OK ETCSignals.ES900.ES910.CAN1.CAN1.MEAS_ETAS_InternalVars.Power ETCSignals.ES900.ES910.CAN1.CAN1.MEAS_ETAS_InternalVars.Torque_OK ETCSignals.ES900.ES910.CAN1.CAN1.MEAS_ETAS_InternalVars.TV_Mode ETCSignals.ES900.ES910.CAN1.CAN1.MEAS_ETAS_InternalVars.Critical_Signal_Disconnection ETCSignals.ES900.ES910.CAN1.CAN1.MEAS_ETAS_InternalVars.Critical_CAN_Disconnection ETCSignals.ES900.ES910.CAN1.CAN1.MEAS_ETAS_InternalVars.Brake_Implausibility ETCSignals.ES900.ES910.CAN1.CAN1.MEAS_ETAS_InternalVars.APPS_Implausibility ETCSignals.ES900.ES910.CAN1.CAN1.AP_SHUTDOWN_State.Shutdown_IMD_OKreading ETCSignals.ES900.ES910.CAN1.CAN1.AP_SHUTDOWN_State.Shutdown_IMD ETCSignals.ES900.ES910.CAN1.CAN1.AP_SHUTDOWN_State.Shutdown_HVBox ETCSignals.ES900.ES910.CAN1.CAN1.AP_SHUTDOWN_State.Shutdown_TSMS ETCSignals.ES900.ES910.CAN1.CAN1.AP_SHUTDOWN_State.Shutdown_TSMPintck ETCSignals.ES900.ES910.CAN1.CAN1.AP_SHUTDOWN_State.Shutdown_SetaRight ETCSignals.ES900.ES910.CAN1.CAN1.AP_SHUTDOWN_State.Shutdown_SetaLeft ETCSignals.ES900.ES910.CAN1.CAN1.AP_SHUTDOWN_State.Shutdown_SetaCockPit ETCSignals.ES900.ES910.CAN1.CAN1.AP_SHUTDOWN_State.Shutdown_PackageIntck ETCSignals.ES900.ES910.CAN1.CAN1.AP_SHUTDOWN_State.Shutdown_InverterRIntck ETCSignals.ES900.ES910.CAN1.CAN1.AP_SHUTDOWN_State.Shutdown_InverterLIntck ETCSignals.ES900.ES910.CAN1.CAN1.AP_SHUTDOWN_State.Shutdown_Inertia ETCSignals.ES900.ES910.CAN1.CAN1.AP_SHUTDOWN_State.Shutdown_HVD ETCSignals.ES900.ES910.CAN1.CAN1.AP_SHUTDOWN_State.Shutdown_BSPD_RelayReading ETCSignals.ES900.ES910.CAN1.CAN1.AP_SHUTDOWN_State.Shutdown_BSPD ETCSignals.ES900.ES910.CAN1.CAN1.AP_SHUTDOWN_State.Shutdown_BOTS ETCSignals.ES900.ES910.CAN1.CAN1.AP_SHUTDOWN_State.Shutdown_BMS_OKreading ETCSignals.ES900.ES910.CAN1.CAN1.AP_SHUTDOWN_State.Shutdown_BMS ETCSignals.ES900.ES910.CAN1.CAN1.AP_SHUTDOWN_State.Pumps_State ETCSignals.ES900.ES910.CAN1.CAN1.AP_SHUTDOWN_State.BrakeLight_State ETCSignals.ES900.ES910.CAN1.CAN1.NM_ETAS_Disconnections.Disconnection_LV_Derivation ETCSignals.ES900.ES910.CAN1.CAN1.NM_ETAS_Disconnections.Disconnection_DashBoard ETCSignals.ES900.ES910.CAN1.CAN1.NM_ETAS_Disconnections.Disconnection_BMS ETCSignals.ES900.ES910.CAN1.CAN1.NM_ETAS_Disconnections.Disconnection_Gyroscope_F ETCSignals.ES900.ES910.CAN1.CAN1.NM_ETAS_Disconnections.Disconnection_Gyroscope_R ETCSignals.ES900.ES910.CAN1.CAN1.NM_ETAS_Disconnections.Disconnection_Accel_F ETCSignals.ES900.ES910.CAN1.CAN1.NM_ETAS_Disconnections.Disconnection_Accel_R ETCSignals.ES900.ES910.CAN1.CAN1.NM_ETAS_Disconnections.Disconnection_SteeringSensor ETCSignals.ES900.ES910.CAN1.CAN1.NM_ETAS_Disconnections.Disconnection_Susp_R_R ETCSignals.ES900.ES910.CAN1.CAN1.NM_ETAS_Disconnections.Disconnection_Susp_R_L ETCSignals.ES900.ES910.CAN1.CAN1.NM_ETAS_Disconnections.Disconnection_Susp_F_R ETCSignals.ES900.ES910.CAN1.CAN1.NM_ETAS_Disconnections.Disconnection_Susp_F_L ETCSignals.ES900.ES910.CAN1.CAN1.NM_ETAS_Disconnections.Disconnection_Brake_Sensor ETCSignals.ES900.ES910.CAN1.CAN1.NM_ETAS_Disconnections.Disconnection_APPS2 ETCSignals.ES900.ES910.CAN1.CAN1.NM_ETAS_Disconnections.Disconnection_APPS1 ETCSignals.ES900.ES910.CAN1.CAN1.NM_ETAS_Disconnections.Disconnection_ADCAN ETCSignals.ES900.ES910.CAN1.CAN1.NM_ETAS_Disconnections.Disconnection_Shutdown ETCSignals.ES900.ES910.CAN1.CAN1.NM_SHUTDOWN_Keep_Alive.Shutdown_Alive ETCSignals.ES900.ES910.CAN1.CAN1.AP_ETAS_DashData2.SteeringSensor_Value ETCSignals.ES900.ES910.CAN1.CAN1.AP_ETAS_DashData2.SKF_actual ETCSignals.ES900.ES910.CAN1.CAN1.AP_ETAS_DashData2.CKF_actual ETCSignals.ES900.ES910.CAN1.CAN1.AP_ETAS_DashData2.BrakeSensor_Value ETCSignals.ES900.ES910.CAN1.CAN1.AP_ETAS_DashData2.APPS2_Value ETCSignals.ES900.ES910.CAN1.CAN1.AP_ETAS_DashData2.APPS1_Value ETCSignals.ES900.ES910.CAN1.CAN1.AP_ETAS_Synchronism.Sync_CAN1 /end REF_MEASUREMENT
/end GROUP
/begin GROUP ETCSignals.ES900.ES910.CAN1.Presence ""
 /begin REF_MEASUREMENT ETCSignals.ES900.ES910.CAN1.Presence.PresenceGroup.PresenceFlag /end REF_MEASUREMENT
/end GROUP
/begin GROUP ETCSignals.ES900.ES910.CAN1.Presence.PresenceGroup ""
 /begin REF_MEASUREMENT ETCSignals.ES900.ES910.CAN1.Presence.PresenceGroup.PresenceFlag /end REF_MEASUREMENT
/end GROUP
/begin GROUP ETCSignals.ES900.ES910.CAN1.CAN1 ""
 /begin REF_MEASUREMENT ETCSignals.ES900.ES910.CAN1.CAN1.AP_BMS_Current_SOC_SOH.Accumulator_SOH ETCSignals.ES900.ES910.CAN1.CAN1.AP_BMS_Current_SOC_SOH.Accumulator_SOC ETCSignals.ES900.ES910.CAN1.CAN1.AP_BMS_Current_SOC_SOH.Accumulator_Current ETCSignals.ES900.ES910.CAN1.CAN1.AP_BMS_StateAndFailReport.BMS_AccumulatorIntck ETCSignals.ES900.ES910.CAN1.CAN1.AP_BMS_StateAndFailReport.State_PrechargeRelay ETCSignals.ES900.ES910.CAN1.CAN1.AP_BMS_StateAndFailReport.State_DivideCurrent ETCSignals.ES900.ES910.CAN1.CAN1.AP_BMS_StateAndFailReport.State_BMS_Ok ETCSignals.ES900.ES910.CAN1.CAN1.AP_BMS_StateAndFailReport.State_Balancing ETCSignals.ES900.ES910.CAN1.CAN1.AP_BMS_StateAndFailReport.State_Air_Plus ETCSignals.ES900.ES910.CAN1.CAN1.AP_BMS_StateAndFailReport.State_Air_Minus ETCSignals.ES900.ES910.CAN1.CAN1.AP_BMS_StateAndFailReport.State_AccumulatorFans ETCSignals.ES900.ES910.CAN1.CAN1.AP_BMS_StateAndFailReport.BMSerror_VoltageDisconnection ETCSignals.ES900.ES910.CAN1.CAN1.AP_BMS_StateAndFailReport.BMSerror_UnderVoltage ETCSignals.ES900.ES910.CAN1.CAN1.AP_BMS_StateAndFailReport.BMSerror_UnderTemperature ETCSignals.ES900.ES910.CAN1.CAN1.AP_BMS_StateAndFailReport.BMSerror_OverVoltage ETCSignals.ES900.ES910.CAN1.CAN1.AP_BMS_StateAndFailReport.BMSerror_OverTemperature ETCSignals.ES900.ES910.CAN1.CAN1.AP_BMS_StateAndFailReport.BMSerror_NTCDisconnection ETCSignals.ES900.ES910.CAN1.CAN1.AP_BMS_StateAndFailReport.BMSerror_CurrentSensDisc ETCSignals.ES900.ES910.CAN1.CAN1.AP_BMS_StateAndFailReport.BMSerror_CANDisconnection ETCSignals.ES900.ES910.CAN1.CAN1.AP_BMS_Voltages.Lowest_CellVoltage ETCSignals.ES900.ES910.CAN1.CAN1.AP_BMS_Voltages.Highest_CellVoltage ETCSignals.ES900.ES910.CAN1.CAN1.AP_BMS_Voltages.Accumulator_Voltage ETCSignals.ES900.ES910.CAN1.CAN1.AP_BMS_OnBoardTemperatures.Lowest_OnBoardTemp ETCSignals.ES900.ES910.CAN1.CAN1.AP_BMS_OnBoardTemperatures.Highest_OnBoardTemp ETCSignals.ES900.ES910.CAN1.CAN1.AP_BMS_OnBoardTemperatures.Average_OnBoardTemp ETCSignals.ES900.ES910.CAN1.CAN1.AP_BMS_ChargerParameters.Charger_MaxVoltage ETCSignals.ES900.ES910.CAN1.CAN1.AP_BMS_ChargerParameters.Charger_MaxCurrent ETCSignals.ES900.ES910.CAN1.CAN1.AP_BMS_BatteryTemperatures.Lowest_CellTemp ETCSignals.ES900.ES910.CAN1.CAN1.AP_BMS_BatteryTemperatures.Highest_CellTemp ETCSignals.ES900.ES910.CAN1.CAN1.AP_BMS_BatteryTemperatures.Average_CellTemp ETCSignals.ES900.ES910.CAN1.CAN1.AP_Inverter_R_Tx.Inv_R_RegID ETCSignals.ES900.ES910.CAN1.CAN1.AP_Inverter_R_Tx.Inv_R_RegID_M73_Inv_R_TempMotor ETCSignals.ES900.ES910.CAN1.CAN1.AP_Inverter_R_Tx.Inv_R_RegID_M74_Inv_R_TempIGBT ETCSignals.ES900.ES910.CAN1.CAN1.AP_Inverter_R_Tx.Inv_R_RegID_M48_Inv_R_Speed ETCSignals.ES900.ES910.CAN1.CAN1.AP_Inverter_R_Tx.Inv_R_RegID_M39_Inv_R_Iq ETCSignals.ES900.ES910.CAN1.CAN1.AP_Inverter_R_Tx.Inv_R_RegID_M38_Inv_R_Icommand ETCSignals.ES900.ES910.CAN1.CAN1.AP_Inverter_R_Tx.Inv_R_RegID_M32_Inv_R_Iactual ETCSignals.ES900.ES910.CAN1.CAN1.AP_Inverter_R_Tx.Inv_R_RegID_M232_Inv_R_Enable ETCSignals.ES900.ES910.CAN1.CAN1.AP_Inverter_R_Tx.Inv_R_RegID_M235_Inv_R_DCBus ETCSignals.ES900.ES910.CAN1.CAN1.AP_Inverter_L_Tx.Inv_L_RegID ETCSignals.ES900.ES910.CAN1.CAN1.AP_Inverter_L_Tx.Inv_L_RegID_M73_Inv_L_TempMotor ETCSignals.ES900.ES910.CAN1.CAN1.AP_Inverter_L_Tx.Inv_L_RegID_M74_Inv_L_TempIGBT ETCSignals.ES900.ES910.CAN1.CAN1.AP_Inverter_L_Tx.Inv_L_RegID_M48_Inv_L_Speed ETCSignals.ES900.ES910.CAN1.CAN1.AP_Inverter_L_Tx.Inv_L_RegID_M39_Inv_L_Iq ETCSignals.ES900.ES910.CAN1.CAN1.AP_Inverter_L_Tx.Inv_L_RegID_M38_Inv_L_Icommand ETCSignals.ES900.ES910.CAN1.CAN1.AP_Inverter_L_Tx.Inv_L_RegID_M32_Inv_L_Iactual ETCSignals.ES900.ES910.CAN1.CAN1.AP_Inverter_L_Tx.Inv_L_RegID_M232_Inv_L_Enable ETCSignals.ES900.ES910.CAN1.CAN1.AP_Inverter_L_Tx.Inv_L_RegID_M235_Inv_L_DCBus ETCSignals.ES900.ES910.CAN1.CAN1.AP_DASH_CustomMode.CustomMode_Identifier ETCSignals.ES900.ES910.CAN1.CAN1.AP_DASH_CustomMode.CustomMode_Data ETCSignals.ES900.ES910.CAN1.CAN1.AP_DASH_Mode.RacingMode ETCSignals.ES900.ES910.CAN1.CAN1.NM_BMS_Keep_Alive.BMS_Alive ETCSignals.ES900.ES910.CAN1.CAN1.AP_BMS_AIRs_State.AIRs_State ETCSignals.ES900.ES910.CAN1.CAN1.NM_DASH_Keep_Alive.Dash_Alive ETCSignals.ES900.ES910.CAN1.CAN1.AP_DASH_TorqueLockOn.Torque_LockOn ETCSignals.ES900.ES910.CAN1.CAN1.AP_DASH_PrechargeRequest.PrechargeRequest ETCSignals.ES900.ES910.CAN1.CAN1.AP_DASH_EnableDrive.EnableDrive_Order ETCSignals.ES900.ES910.CAN1.CAN1.AP_ETAS_DashData1.Speed ETCSignals.ES900.ES910.CAN1.CAN1.AP_ETAS_DashData1.Precharge_Voltage ETCSignals.ES900.ES910.CAN1.CAN1.AP_ETAS_DashData1.Precharge_Percentage ETCSignals.ES900.ES910.CAN1.CAN1.AP_ETAS_DashData1.LVbattery_Voltage ETCSignals.ES900.ES910.CAN1.CAN1.AP_ETAS_DashData1.LVbattery_SOC ETCSignals.ES900.ES910.CAN1.CAN1.AP_ETAS_VDCParams2.VDC_Cte_SKF ETCSignals.ES900.ES910.CAN1.CAN1.AP_ETAS_VDCParams2.VDC_Cte_CKF ETCSignals.ES900.ES910.CAN1.CAN1.AP_ETAS_VDCParams.VDC_CKF_Initial ETCSignals.ES900.ES910.CAN1.CAN1.AP_ETAS_VDCParams.VDC_SKF_Initial ETCSignals.ES900.ES910.CAN1.CAN1.AP_ETAS_VDCParams.VDC_Power_Limit ETCSignals.ES900.ES910.CAN1.CAN1.AP_ETAS_VDCParams.VDC_Max_Regenerative_Torque ETCSignals.ES900.ES910.CAN1.CAN1.AP_ETAS_VDCParams.VDC_K_Reduction_Temperature ETCSignals.ES900.ES910.CAN1.CAN1.AP_ETAS_VDCParams.VDC_K_Reduction_P ETCSignals.ES900.ES910.CAN1.CAN1.AP_ETAS_VDCParams.VDC_APPS_Sat_Up ETCSignals.ES900.ES910.CAN1.CAN1.AP_ETAS_VDCParams.VDC_APPS_Sat_Down ETCSignals.ES900.ES910.CAN1.CAN1.AP_ETAS_Inverter_R_Rx.Inverter_R_RegID ETCSignals.ES900.ES910.CAN1.CAN1.AP_ETAS_Inverter_R_Rx.Inverter_R_b7tob0 ETCSignals.ES900.ES910.CAN1.CAN1.AP_ETAS_Inverter_R_Rx.Inverter_R_b15tob8 ETCSignals.ES900.ES910.CAN1.CAN1.AP_ETAS_Inverter_L_Rx.Inverter_L_RegID ETCSignals.ES900.ES910.CAN1.CAN1.AP_ETAS_Inverter_L_Rx.Inverter_L_b7tob0 ETCSignals.ES900.ES910.CAN1.CAN1.AP_ETAS_Inverter_L_Rx.Inverter_L_b15tob8 ETCSignals.ES900.ES910.CAN1.CAN1.AP_ETAS_CarState.Car_State ETCSignals.ES900.ES910.CAN1.CAN1.AP_ETAS_AIRsRequest.AIRs_Request ETCSignals.ES900.ES910.CAN1.CAN1.AP_ETAS_AnalogicControl.BrakeLight_Control ETCSignals.ES900.ES910.CAN1.CAN1.AP_ETAS_AnalogicControl.Pumps_Control ETCSignals.ES900.ES910.CAN1.CAN1.MEAS_ETAS_InternalVars.CriticalDisconnection ETCSignals.ES900.ES910.CAN1.CAN1.MEAS_ETAS_InternalVars.CurrentPathDisconnectionFlag ETCSignals.ES900.ES910.CAN1.CAN1.MEAS_ETAS_InternalVars.Car_OK ETCSignals.ES900.ES910.CAN1.CAN1.MEAS_ETAS_InternalVars.Power ETCSignals.ES900.ES910.CAN1.CAN1.MEAS_ETAS_InternalVars.Torque_OK ETCSignals.ES900.ES910.CAN1.CAN1.MEAS_ETAS_InternalVars.TV_Mode ETCSignals.ES900.ES910.CAN1.CAN1.MEAS_ETAS_InternalVars.Critical_Signal_Disconnection ETCSignals.ES900.ES910.CAN1.CAN1.MEAS_ETAS_InternalVars.Critical_CAN_Disconnection ETCSignals.ES900.ES910.CAN1.CAN1.MEAS_ETAS_InternalVars.Brake_Implausibility ETCSignals.ES900.ES910.CAN1.CAN1.MEAS_ETAS_InternalVars.APPS_Implausibility ETCSignals.ES900.ES910.CAN1.CAN1.AP_SHUTDOWN_State.Shutdown_IMD_OKreading ETCSignals.ES900.ES910.CAN1.CAN1.AP_SHUTDOWN_State.Shutdown_IMD ETCSignals.ES900.ES910.CAN1.CAN1.AP_SHUTDOWN_State.Shutdown_HVBox ETCSignals.ES900.ES910.CAN1.CAN1.AP_SHUTDOWN_State.Shutdown_TSMS ETCSignals.ES900.ES910.CAN1.CAN1.AP_SHUTDOWN_State.Shutdown_TSMPintck ETCSignals.ES900.ES910.CAN1.CAN1.AP_SHUTDOWN_State.Shutdown_SetaRight ETCSignals.ES900.ES910.CAN1.CAN1.AP_SHUTDOWN_State.Shutdown_SetaLeft ETCSignals.ES900.ES910.CAN1.CAN1.AP_SHUTDOWN_State.Shutdown_SetaCockPit ETCSignals.ES900.ES910.CAN1.CAN1.AP_SHUTDOWN_State.Shutdown_PackageIntck ETCSignals.ES900.ES910.CAN1.CAN1.AP_SHUTDOWN_State.Shutdown_InverterRIntck ETCSignals.ES900.ES910.CAN1.CAN1.AP_SHUTDOWN_State.Shutdown_InverterLIntck ETCSignals.ES900.ES910.CAN1.CAN1.AP_SHUTDOWN_State.Shutdown_Inertia ETCSignals.ES900.ES910.CAN1.CAN1.AP_SHUTDOWN_State.Shutdown_HVD ETCSignals.ES900.ES910.CAN1.CAN1.AP_SHUTDOWN_State.Shutdown_BSPD_RelayReading ETCSignals.ES900.ES910.CAN1.CAN1.AP_SHUTDOWN_State.Shutdown_BSPD ETCSignals.ES900.ES910.CAN1.CAN1.AP_SHUTDOWN_State.Shutdown_BOTS ETCSignals.ES900.ES910.CAN1.CAN1.AP_SHUTDOWN_State.Shutdown_BMS_OKreading ETCSignals.ES900.ES910.CAN1.CAN1.AP_SHUTDOWN_State.Shutdown_BMS ETCSignals.ES900.ES910.CAN1.CAN1.AP_SHUTDOWN_State.Pumps_State ETCSignals.ES900.ES910.CAN1.CAN1.AP_SHUTDOWN_State.BrakeLight_State ETCSignals.ES900.ES910.CAN1.CAN1.NM_ETAS_Disconnections.Disconnection_LV_Derivation ETCSignals.ES900.ES910.CAN1.CAN1.NM_ETAS_Disconnections.Disconnection_DashBoard ETCSignals.ES900.ES910.CAN1.CAN1.NM_ETAS_Disconnections.Disconnection_BMS ETCSignals.ES900.ES910.CAN1.CAN1.NM_ETAS_Disconnections.Disconnection_Gyroscope_F ETCSignals.ES900.ES910.CAN1.CAN1.NM_ETAS_Disconnections.Disconnection_Gyroscope_R ETCSignals.ES900.ES910.CAN1.CAN1.NM_ETAS_Disconnections.Disconnection_Accel_F ETCSignals.ES900.ES910.CAN1.CAN1.NM_ETAS_Disconnections.Disconnection_Accel_R ETCSignals.ES900.ES910.CAN1.CAN1.NM_ETAS_Disconnections.Disconnection_SteeringSensor ETCSignals.ES900.ES910.CAN1.CAN1.NM_ETAS_Disconnections.Disconnection_Susp_R_R ETCSignals.ES900.ES910.CAN1.CAN1.NM_ETAS_Disconnections.Disconnection_Susp_R_L ETCSignals.ES900.ES910.CAN1.CAN1.NM_ETAS_Disconnections.Disconnection_Susp_F_R ETCSignals.ES900.ES910.CAN1.CAN1.NM_ETAS_Disconnections.Disconnection_Susp_F_L ETCSignals.ES900.ES910.CAN1.CAN1.NM_ETAS_Disconnections.Disconnection_Brake_Sensor ETCSignals.ES900.ES910.CAN1.CAN1.NM_ETAS_Disconnections.Disconnection_APPS2 ETCSignals.ES900.ES910.CAN1.CAN1.NM_ETAS_Disconnections.Disconnection_APPS1 ETCSignals.ES900.ES910.CAN1.CAN1.NM_ETAS_Disconnections.Disconnection_ADCAN ETCSignals.ES900.ES910.CAN1.CAN1.NM_ETAS_Disconnections.Disconnection_Shutdown ETCSignals.ES900.ES910.CAN1.CAN1.NM_SHUTDOWN_Keep_Alive.Shutdown_Alive ETCSignals.ES900.ES910.CAN1.CAN1.AP_ETAS_DashData2.SteeringSensor_Value ETCSignals.ES900.ES910.CAN1.CAN1.AP_ETAS_DashData2.SKF_actual ETCSignals.ES900.ES910.CAN1.CAN1.AP_ETAS_DashData2.CKF_actual ETCSignals.ES900.ES910.CAN1.CAN1.AP_ETAS_DashData2.BrakeSensor_Value ETCSignals.ES900.ES910.CAN1.CAN1.AP_ETAS_DashData2.APPS2_Value ETCSignals.ES900.ES910.CAN1.CAN1.AP_ETAS_DashData2.APPS1_Value ETCSignals.ES900.ES910.CAN1.CAN1.AP_ETAS_Synchronism.Sync_CAN1 /end REF_MEASUREMENT
/end GROUP
/begin GROUP ETCSignals.ES900.ES910.CAN1.CAN1.AP_BMS_Current_SOC_SOH ""
 /begin REF_MEASUREMENT ETCSignals.ES900.ES910.CAN1.CAN1.AP_BMS_Current_SOC_SOH.Accumulator_SOH ETCSignals.ES900.ES910.CAN1.CAN1.AP_BMS_Current_SOC_SOH.Accumulator_SOC ETCSignals.ES900.ES910.CAN1.CAN1.AP_BMS_Current_SOC_SOH.Accumulator_Current /end REF_MEASUREMENT
/end GROUP
/begin GROUP ETCSignals.ES900.ES910.CAN1.CAN1.AP_BMS_StateAndFailReport ""
 /begin REF_MEASUREMENT ETCSignals.ES900.ES910.CAN1.CAN1.AP_BMS_StateAndFailReport.BMS_AccumulatorIntck ETCSignals.ES900.ES910.CAN1.CAN1.AP_BMS_StateAndFailReport.State_PrechargeRelay ETCSignals.ES900.ES910.CAN1.CAN1.AP_BMS_StateAndFailReport.State_DivideCurrent ETCSignals.ES900.ES910.CAN1.CAN1.AP_BMS_StateAndFailReport.State_BMS_Ok ETCSignals.ES900.ES910.CAN1.CAN1.AP_BMS_StateAndFailReport.State_Balancing ETCSignals.ES900.ES910.CAN1.CAN1.AP_BMS_StateAndFailReport.State_Air_Plus ETCSignals.ES900.ES910.CAN1.CAN1.AP_BMS_StateAndFailReport.State_Air_Minus ETCSignals.ES900.ES910.CAN1.CAN1.AP_BMS_StateAndFailReport.State_AccumulatorFans ETCSignals.ES900.ES910.CAN1.CAN1.AP_BMS_StateAndFailReport.BMSerror_VoltageDisconnection ETCSignals.ES900.ES910.CAN1.CAN1.AP_BMS_StateAndFailReport.BMSerror_UnderVoltage ETCSignals.ES900.ES910.CAN1.CAN1.AP_BMS_StateAndFailReport.BMSerror_UnderTemperature ETCSignals.ES900.ES910.CAN1.CAN1.AP_BMS_StateAndFailReport.BMSerror_OverVoltage ETCSignals.ES900.ES910.CAN1.CAN1.AP_BMS_StateAndFailReport.BMSerror_OverTemperature ETCSignals.ES900.ES910.CAN1.CAN1.AP_BMS_StateAndFailReport.BMSerror_NTCDisconnection ETCSignals.ES900.ES910.CAN1.CAN1.AP_BMS_StateAndFailReport.BMSerror_CurrentSensDisc ETCSignals.ES900.ES910.CAN1.CAN1.AP_BMS_StateAndFailReport.BMSerror_CANDisconnection /end REF_MEASUREMENT
/end GROUP
/begin GROUP ETCSignals.ES900.ES910.CAN1.CAN1.AP_BMS_Voltages ""
 /begin REF_MEASUREMENT ETCSignals.ES900.ES910.CAN1.CAN1.AP_BMS_Voltages.Lowest_CellVoltage ETCSignals.ES900.ES910.CAN1.CAN1.AP_BMS_Voltages.Highest_CellVoltage ETCSignals.ES900.ES910.CAN1.CAN1.AP_BMS_Voltages.Accumulator_Voltage /end REF_MEASUREMENT
/end GROUP
/begin GROUP ETCSignals.ES900.ES910.CAN1.CAN1.AP_BMS_OnBoardTemperatures ""
 /begin REF_MEASUREMENT ETCSignals.ES900.ES910.CAN1.CAN1.AP_BMS_OnBoardTemperatures.Lowest_OnBoardTemp ETCSignals.ES900.ES910.CAN1.CAN1.AP_BMS_OnBoardTemperatures.Highest_OnBoardTemp ETCSignals.ES900.ES910.CAN1.CAN1.AP_BMS_OnBoardTemperatures.Average_OnBoardTemp /end REF_MEASUREMENT
/end GROUP
/begin GROUP ETCSignals.ES900.ES910.CAN1.CAN1.AP_BMS_ChargerParameters ""
 /begin REF_MEASUREMENT ETCSignals.ES900.ES910.CAN1.CAN1.AP_BMS_ChargerParameters.Charger_MaxVoltage ETCSignals.ES900.ES910.CAN1.CAN1.AP_BMS_ChargerParameters.Charger_MaxCurrent /end REF_MEASUREMENT
/end GROUP
/begin GROUP ETCSignals.ES900.ES910.CAN1.CAN1.AP_BMS_BatteryTemperatures ""
 /begin REF_MEASUREMENT ETCSignals.ES900.ES910.CAN1.CAN1.AP_BMS_BatteryTemperatures.Lowest_CellTemp ETCSignals.ES900.ES910.CAN1.CAN1.AP_BMS_BatteryTemperatures.Highest_CellTemp ETCSignals.ES900.ES910.CAN1.CAN1.AP_BMS_BatteryTemperatures.Average_CellTemp /end REF_MEASUREMENT
/end GROUP
/begin GROUP ETCSignals.ES900.ES910.CAN1.CAN1.AP_Inverter_R_Tx ""
 /begin REF_MEASUREMENT ETCSignals.ES900.ES910.CAN1.CAN1.AP_Inverter_R_Tx.Inv_R_RegID ETCSignals.ES900.ES910.CAN1.CAN1.AP_Inverter_R_Tx.Inv_R_RegID_M73_Inv_R_TempMotor ETCSignals.ES900.ES910.CAN1.CAN1.AP_Inverter_R_Tx.Inv_R_RegID_M74_Inv_R_TempIGBT ETCSignals.ES900.ES910.CAN1.CAN1.AP_Inverter_R_Tx.Inv_R_RegID_M48_Inv_R_Speed ETCSignals.ES900.ES910.CAN1.CAN1.AP_Inverter_R_Tx.Inv_R_RegID_M39_Inv_R_Iq ETCSignals.ES900.ES910.CAN1.CAN1.AP_Inverter_R_Tx.Inv_R_RegID_M38_Inv_R_Icommand ETCSignals.ES900.ES910.CAN1.CAN1.AP_Inverter_R_Tx.Inv_R_RegID_M32_Inv_R_Iactual ETCSignals.ES900.ES910.CAN1.CAN1.AP_Inverter_R_Tx.Inv_R_RegID_M232_Inv_R_Enable ETCSignals.ES900.ES910.CAN1.CAN1.AP_Inverter_R_Tx.Inv_R_RegID_M235_Inv_R_DCBus /end REF_MEASUREMENT
/end GROUP
/begin GROUP ETCSignals.ES900.ES910.CAN1.CAN1.AP_Inverter_L_Tx ""
 /begin REF_MEASUREMENT ETCSignals.ES900.ES910.CAN1.CAN1.AP_Inverter_L_Tx.Inv_L_RegID ETCSignals.ES900.ES910.CAN1.CAN1.AP_Inverter_L_Tx.Inv_L_RegID_M73_Inv_L_TempMotor ETCSignals.ES900.ES910.CAN1.CAN1.AP_Inverter_L_Tx.Inv_L_RegID_M74_Inv_L_TempIGBT ETCSignals.ES900.ES910.CAN1.CAN1.AP_Inverter_L_Tx.Inv_L_RegID_M48_Inv_L_Speed ETCSignals.ES900.ES910.CAN1.CAN1.AP_Inverter_L_Tx.Inv_L_RegID_M39_Inv_L_Iq ETCSignals.ES900.ES910.CAN1.CAN1.AP_Inverter_L_Tx.Inv_L_RegID_M38_Inv_L_Icommand ETCSignals.ES900.ES910.CAN1.CAN1.AP_Inverter_L_Tx.Inv_L_RegID_M32_Inv_L_Iactual ETCSignals.ES900.ES910.CAN1.CAN1.AP_Inverter_L_Tx.Inv_L_RegID_M232_Inv_L_Enable ETCSignals.ES900.ES910.CAN1.CAN1.AP_Inverter_L_Tx.Inv_L_RegID_M235_Inv_L_DCBus /end REF_MEASUREMENT
/end GROUP
/begin GROUP ETCSignals.ES900.ES910.CAN1.CAN1.AP_DASH_CustomMode ""
 /begin REF_MEASUREMENT ETCSignals.ES900.ES910.CAN1.CAN1.AP_DASH_CustomMode.CustomMode_Identifier ETCSignals.ES900.ES910.CAN1.CAN1.AP_DASH_CustomMode.CustomMode_Data /end REF_MEASUREMENT
/end GROUP
/begin GROUP ETCSignals.ES900.ES910.CAN1.CAN1.AP_DASH_Mode "" /begin REF_MEASUREMENT ETCSignals.ES900.ES910.CAN1.CAN1.AP_DASH_Mode.RacingMode /end REF_MEASUREMENT /end GROUP
/begin GROUP ETCSignals.ES900.ES910.CAN1.CAN1.NM_BMS_Keep_Alive ""
 /begin REF_MEASUREMENT ETCSignals.ES900.ES910.CAN1.CAN1.NM_BMS_Keep_Alive.BMS_Alive /end REF_MEASUREMENT
/end GROUP
/begin GROUP ETCSignals.ES900.ES910.CAN1.CAN1.AP_BMS_AIRs_State ""
 /begin REF_MEASUREMENT ETCSignals.ES900.ES910.CAN1.CAN1.AP_BMS_AIRs_State.AIRs_State /end REF_MEASUREMENT
/end GROUP
/begin GROUP ETCSignals.ES900.ES910.CAN1.CAN1.NM_DASH_Keep_Alive ""
 /begin REF_MEASUREMENT ETCSignals.ES900.ES910.CAN1.CAN1.NM_DASH_Keep_Alive.Dash_Alive /end REF_MEASUREMENT
/end GROUP
/begin GROUP ETCSignals.ES900.ES910.CAN1.CAN1.AP_DASH_TorqueLockOn ""
 /begin REF_MEASUREMENT ETCSignals.ES900.ES910.CAN1.CAN1.AP_DASH_TorqueLockOn.Torque_LockOn /end REF_MEASUREMENT
/end GROUP
/begin GROUP ETCSignals.ES900.ES910.CAN1.CAN1.AP_DASH_PrechargeRequest ""
 /begin REF_MEASUREMENT ETCSignals.ES900.ES910.CAN1.CAN1.AP_DASH_PrechargeRequest.PrechargeRequest /end REF_MEASUREMENT
/end GROUP
/begin GROUP ETCSignals.ES900.ES910.CAN1.CAN1.AP_DASH_EnableDrive ""
 /begin REF_MEASUREMENT ETCSignals.ES900.ES910.CAN1.CAN1.AP_DASH_EnableDrive.EnableDrive_Order /end REF_MEASUREMENT
/end GROUP
/begin GROUP ETCSignals.ES900.ES910.CAN1.CAN1.AP_ETAS_DashData1 ""
 /begin REF_MEASUREMENT ETCSignals.ES900.ES910.CAN1.CAN1.AP_ETAS_DashData1.Speed ETCSignals.ES900.ES910.CAN1.CAN1.AP_ETAS_DashData1.Precharge_Voltage ETCSignals.ES900.ES910.CAN1.CAN1.AP_ETAS_DashData1.Precharge_Percentage ETCSignals.ES900.ES910.CAN1.CAN1.AP_ETAS_DashData1.LVbattery_Voltage ETCSignals.ES900.ES910.CAN1.CAN1.AP_ETAS_DashData1.LVbattery_SOC /end REF_MEASUREMENT
/end GROUP
/begin GROUP ETCSignals.ES900.ES910.CAN1.CAN1.AP_ETAS_VDCParams2 ""
 /begin REF_MEASUREMENT ETCSignals.ES900.ES910.CAN1.CAN1.AP_ETAS_VDCParams2.VDC_Cte_SKF ETCSignals.ES900.ES910.CAN1.CAN1.AP_ETAS_VDCParams2.VDC_Cte_CKF /end REF_MEASUREMENT
/end GROUP
/begin GROUP ETCSignals.ES900.ES910.CAN1.CAN1.AP_ETAS_VDCParams ""
 /begin REF_MEASUREMENT ETCSignals.ES900.ES910.CAN1.CAN1.AP_ETAS_VDCParams.VDC_CKF_Initial ETCSignals.ES900.ES910.CAN1.CAN1.AP_ETAS_VDCParams.VDC_SKF_Initial ETCSignals.ES900.ES910.CAN1.CAN1.AP_ETAS_VDCParams.VDC_Power_Limit ETCSignals.ES900.ES910.CAN1.CAN1.AP_ETAS_VDCParams.VDC_Max_Regenerative_Torque ETCSignals.ES900.ES910.CAN1.CAN1.AP_ETAS_VDCParams.VDC_K_Reduction_Temperature ETCSignals.ES900.ES910.CAN1.CAN1.AP_ETAS_VDCParams.VDC_K_Reduction_P ETCSignals.ES900.ES910.CAN1.CAN1.AP_ETAS_VDCParams.VDC_APPS_Sat_Up ETCSignals.ES900.ES910.CAN1.CAN1.AP_ETAS_VDCParams.VDC_APPS_Sat_Down /end REF_MEASUREMENT
/end GROUP
/begin GROUP ETCSignals.ES900.ES910.CAN1.CAN1.AP_ETAS_Inverter_R_Rx ""
 /begin REF_MEASUREMENT ETCSignals.ES900.ES910.CAN1.CAN1.AP_ETAS_Inverter_R_Rx.Inverter_R_RegID ETCSignals.ES900.ES910.CAN1.CAN1.AP_ETAS_Inverter_R_Rx.Inverter_R_b7tob0 ETCSignals.ES900.ES910.CAN1.CAN1.AP_ETAS_Inverter_R_Rx.Inverter_R_b15tob8 /end REF_MEASUREMENT
/end GROUP
/begin GROUP ETCSignals.ES900.ES910.CAN1.CAN1.AP_ETAS_Inverter_L_Rx ""
 /begin REF_MEASUREMENT ETCSignals.ES900.ES910.CAN1.CAN1.AP_ETAS_Inverter_L_Rx.Inverter_L_RegID ETCSignals.ES900.ES910.CAN1.CAN1.AP_ETAS_Inverter_L_Rx.Inverter_L_b7tob0 ETCSignals.ES900.ES910.CAN1.CAN1.AP_ETAS_Inverter_L_Rx.Inverter_L_b15tob8 /end REF_MEASUREMENT
/end GROUP
/begin GROUP ETCSignals.ES900.ES910.CAN1.CAN1.AP_ETAS_CarState ""
 /begin REF_MEASUREMENT ETCSignals.ES900.ES910.CAN1.CAN1.AP_ETAS_CarState.Car_State /end REF_MEASUREMENT
/end GROUP
/begin GROUP ETCSignals.ES900.ES910.CAN1.CAN1.AP_ETAS_AIRsRequest ""
 /begin REF_MEASUREMENT ETCSignals.ES900.ES910.CAN1.CAN1.AP_ETAS_AIRsRequest.AIRs_Request /end REF_MEASUREMENT
/end GROUP
/begin GROUP ETCSignals.ES900.ES910.CAN1.CAN1.AP_ETAS_AnalogicControl ""
 /begin REF_MEASUREMENT ETCSignals.ES900.ES910.CAN1.CAN1.AP_ETAS_AnalogicControl.BrakeLight_Control ETCSignals.ES900.ES910.CAN1.CAN1.AP_ETAS_AnalogicControl.Pumps_Control /end REF_MEASUREMENT
/end GROUP
/begin GROUP ETCSignals.ES900.ES910.CAN1.CAN1.MEAS_ETAS_InternalVars ""
 /begin REF_MEASUREMENT ETCSignals.ES900.ES910.CAN1.CAN1.MEAS_ETAS_InternalVars.CriticalDisconnection ETCSignals.ES900.ES910.CAN1.CAN1.MEAS_ETAS_InternalVars.CurrentPathDisconnectionFlag ETCSignals.ES900.ES910.CAN1.CAN1.MEAS_ETAS_InternalVars.Car_OK ETCSignals.ES900.ES910.CAN1.CAN1.MEAS_ETAS_InternalVars.Power ETCSignals.ES900.ES910.CAN1.CAN1.MEAS_ETAS_InternalVars.Torque_OK ETCSignals.ES900.ES910.CAN1.CAN1.MEAS_ETAS_InternalVars.TV_Mode ETCSignals.ES900.ES910.CAN1.CAN1.MEAS_ETAS_InternalVars.Critical_Signal_Disconnection ETCSignals.ES900.ES910.CAN1.CAN1.MEAS_ETAS_InternalVars.Critical_CAN_Disconnection ETCSignals.ES900.ES910.CAN1.CAN1.MEAS_ETAS_InternalVars.Brake_Implausibility ETCSignals.ES900.ES910.CAN1.CAN1.MEAS_ETAS_InternalVars.APPS_Implausibility /end REF_MEASUREMENT
/end GROUP
/begin GROUP ETCSignals.ES900.ES910.CAN1.CAN1.AP_SHUTDOWN_State ""
 /begin REF_MEASUREMENT ETCSignals.ES900.ES910.CAN1.CAN1.AP_SHUTDOWN_State.Shutdown_IMD_OKreading ETCSignals.ES900.ES910.CAN1.CAN1.AP_SHUTDOWN_State.Shutdown_IMD ETCSignals.ES900.ES910.CAN1.CAN1.AP_SHUTDOWN_State.Shutdown_HVBox ETCSignals.ES900.ES910.CAN1.CAN1.AP_SHUTDOWN_State.Shutdown_TSMS ETCSignals.ES900.ES910.CAN1.CAN1.AP_SHUTDOWN_State.Shutdown_TSMPintck ETCSignals.ES900.ES910.CAN1.CAN1.AP_SHUTDOWN_State.Shutdown_SetaRight ETCSignals.ES900.ES910.CAN1.CAN1.AP_SHUTDOWN_State.Shutdown_SetaLeft ETCSignals.ES900.ES910.CAN1.CAN1.AP_SHUTDOWN_State.Shutdown_SetaCockPit ETCSignals.ES900.ES910.CAN1.CAN1.AP_SHUTDOWN_State.Shutdown_PackageIntck ETCSignals.ES900.ES910.CAN1.CAN1.AP_SHUTDOWN_State.Shutdown_InverterRIntck ETCSignals.ES900.ES910.CAN1.CAN1.AP_SHUTDOWN_State.Shutdown_InverterLIntck ETCSignals.ES900.ES910.CAN1.CAN1.AP_SHUTDOWN_State.Shutdown_Inertia ETCSignals.ES900.ES910.CAN1.CAN1.AP_SHUTDOWN_State.Shutdown_HVD ETCSignals.ES900.ES910.CAN1.CAN1.AP_SHUTDOWN_State.Shutdown_BSPD_RelayReading ETCSignals.ES900.ES910.CAN1.CAN1.AP_SHUTDOWN_State.Shutdown_BSPD ETCSignals.ES900.ES910.CAN1.CAN1.AP_SHUTDOWN_State.Shutdown_BOTS ETCSignals.ES900.ES910.CAN1.CAN1.AP_SHUTDOWN_State.Shutdown_BMS_OKreading ETCSignals.ES900.ES910.CAN1.CAN1.AP_SHUTDOWN_State.Shutdown_BMS ETCSignals.ES900.ES910.CAN1.CAN1.AP_SHUTDOWN_State.Pumps_State ETCSignals.ES900.ES910.CAN1.CAN1.AP_SHUTDOWN_State.BrakeLight_State /end REF_MEASUREMENT
/end GROUP
/begin GROUP ETCSignals.ES900.ES910.CAN1.CAN1.NM_ETAS_Disconnections ""
 /begin REF_MEASUREMENT ETCSignals.ES900.ES910.CAN1.CAN1.NM_ETAS_Disconnections.Disconnection_LV_Derivation ETCSignals.ES900.ES910.CAN1.CAN1.NM_ETAS_Disconnections.Disconnection_DashBoard ETCSignals.ES900.ES910.CAN1.CAN1.NM_ETAS_Disconnections.Disconnection_BMS ETCSignals.ES900.ES910.CAN1.CAN1.NM_ETAS_Disconnections.Disconnection_Gyroscope_F ETCSignals.ES900.ES910.CAN1.CAN1.NM_ETAS_Disconnections.Disconnection_Gyroscope_R ETCSignals.ES900.ES910.CAN1.CAN1.NM_ETAS_Disconnections.Disconnection_Accel_F ETCSignals.ES900.ES910.CAN1.CAN1.NM_ETAS_Disconnections.Disconnection_Accel_R ETCSignals.ES900.ES910.CAN1.CAN1.NM_ETAS_Disconnections.Disconnection_SteeringSensor ETCSignals.ES900.ES910.CAN1.CAN1.NM_ETAS_Disconnections.Disconnection_Susp_R_R ETCSignals.ES900.ES910.CAN1.CAN1.NM_ETAS_Disconnections.Disconnection_Susp_R_L ETCSignals.ES900.ES910.CAN1.CAN1.NM_ETAS_Disconnections.Disconnection_Susp_F_R ETCSignals.ES900.ES910.CAN1.CAN1.NM_ETAS_Disconnections.Disconnection_Susp_F_L ETCSignals.ES900.ES910.CAN1.CAN1.NM_ETAS_Disconnections.Disconnection_Brake_Sensor ETCSignals.ES900.ES910.CAN1.CAN1.NM_ETAS_Disconnections.Disconnection_APPS2 ETCSignals.ES900.ES910.CAN1.CAN1.NM_ETAS_Disconnections.Disconnection_APPS1 ETCSignals.ES900.ES910.CAN1.CAN1.NM_ETAS_Disconnections.Disconnection_ADCAN ETCSignals.ES900.ES910.CAN1.CAN1.NM_ETAS_Disconnections.Disconnection_Shutdown /end REF_MEASUREMENT
/end GROUP
/begin GROUP ETCSignals.ES900.ES910.CAN1.CAN1.NM_SHUTDOWN_Keep_Alive ""
 /begin REF_MEASUREMENT ETCSignals.ES900.ES910.CAN1.CAN1.NM_SHUTDOWN_Keep_Alive.Shutdown_Alive /end REF_MEASUREMENT
/end GROUP
/begin GROUP ETCSignals.ES900.ES910.CAN1.CAN1.AP_ETAS_DashData2 ""
 /begin REF_MEASUREMENT ETCSignals.ES900.ES910.CAN1.CAN1.AP_ETAS_DashData2.SteeringSensor_Value ETCSignals.ES900.ES910.CAN1.CAN1.AP_ETAS_DashData2.SKF_actual ETCSignals.ES900.ES910.CAN1.CAN1.AP_ETAS_DashData2.CKF_actual ETCSignals.ES900.ES910.CAN1.CAN1.AP_ETAS_DashData2.BrakeSensor_Value ETCSignals.ES900.ES910.CAN1.CAN1.AP_ETAS_DashData2.APPS2_Value ETCSignals.ES900.ES910.CAN1.CAN1.AP_ETAS_DashData2.APPS1_Value /end REF_MEASUREMENT
/end GROUP
/begin GROUP ETCSignals.ES900.ES910.CAN1.CAN1.AP_ETAS_Synchronism ""
 /begin REF_MEASUREMENT ETCSignals.ES900.ES910.CAN1.CAN1.AP_ETAS_Synchronism.Sync_CAN1 /end REF_MEASUREMENT
/end GROUP
/begin GROUP ETCSignals.ES900.ES910.CAN2 ""
 /begin REF_MEASUREMENT ETCSignals.ES900.ES910.CAN2.Presence.PresenceGroup.PresenceFlag ETCSignals.ES900.ES910.CAN2.CAN2.AP_ELLIPSE_EKF_POS.LONGITUDE_EKF ETCSignals.ES900.ES910.CAN2.CAN2.AP_ELLIPSE_EKF_POS.LATITUDE_EKF ETCSignals.ES900.ES910.CAN2.CAN2.AP_ELLIPSE_IMU_ACCEL.ACCEL_Z_IMU ETCSignals.ES900.ES910.CAN2.CAN2.AP_ELLIPSE_IMU_ACCEL.ACCEL_Y_IMU ETCSignals.ES900.ES910.CAN2.CAN2.AP_ELLIPSE_IMU_ACCEL.ACCEL_X_IMU ETCSignals.ES900.ES910.CAN2.CAN2.AP_ELLIPSE_MAG.ACCEL_Z_MAG ETCSignals.ES900.ES910.CAN2.CAN2.AP_ELLIPSE_MAG.ACCEL_Y_MAG ETCSignals.ES900.ES910.CAN2.CAN2.AP_ELLIPSE_MAG.ACCEL_X_MAG ETCSignals.ES900.ES910.CAN2.CAN2.AP_ELLIPSE_EKF_EULER.YAW ETCSignals.ES900.ES910.CAN2.CAN2.AP_ELLIPSE_EKF_EULER.PITCH ETCSignals.ES900.ES910.CAN2.CAN2.AP_ELLIPSE_EKF_EULER.ROLL ETCSignals.ES900.ES910.CAN2.CAN2.AP_ELLIPSE_EKF_VEL_BODY.el_Vel_Z ETCSignals.ES900.ES910.CAN2.CAN2.AP_ELLIPSE_EKF_VEL_BODY.el_Vel_Y ETCSignals.ES900.ES910.CAN2.CAN2.AP_ELLIPSE_EKF_VEL_BODY.el_Vel_X ETCSignals.ES900.ES910.CAN2.CAN2.NM_ELLIPSE_Status.CLOCK ETCSignals.ES900.ES910.CAN2.CAN2.NM_ELLIPSE_Status.GENERAL ETCSignals.ES900.ES910.CAN2.CAN2.NM_ELLIPSE_Status.TIME_STAMP ETCSignals.ES900.ES910.CAN2.CAN2.AP_ELLIPSE_IMU_GYRO.GYRO_Z ETCSignals.ES900.ES910.CAN2.CAN2.AP_ELLIPSE_IMU_GYRO.GYRO_Y ETCSignals.ES900.ES910.CAN2.CAN2.AP_ELLIPSE_IMU_GYRO.GYRO_X ETCSignals.ES900.ES910.CAN2.CAN2.AP_ELLIPSE_SLIP_CURV.AUTO_STATUS ETCSignals.ES900.ES910.CAN2.CAN2.AP_ELLIPSE_SLIP_CURV.CURVATURE_RADIUS ETCSignals.ES900.ES910.CAN2.CAN2.AP_ELLIPSE_SLIP_CURV.ANGLE_SLIP ETCSignals.ES900.ES910.CAN2.CAN2.AP_ELLIPSE_SLIP_CURV.ANGLE_TRACK ETCSignals.ES900.ES910.CAN2.CAN2.MEAS_ETAS_Inverter_R_Data.Inv_R_TempMotor ETCSignals.ES900.ES910.CAN2.CAN2.MEAS_ETAS_Inverter_R_Data.Inv_R_TempIGBT ETCSignals.ES900.ES910.CAN2.CAN2.MEAS_ETAS_Inverter_R_Data.Inv_R_Speed ETCSignals.ES900.ES910.CAN2.CAN2.MEAS_ETAS_Inverter_R_Data.Inv_R_Iq ETCSignals.ES900.ES910.CAN2.CAN2.MEAS_ETAS_Inverter_R_Data.Inv_R_Icommand ETCSignals.ES900.ES910.CAN2.CAN2.MEAS_ETAS_Inverter_R_Data.Inv_R_Iactual ETCSignals.ES900.ES910.CAN2.CAN2.MEAS_ETAS_Inverter_L_Data.Inv_L_TempMotor ETCSignals.ES900.ES910.CAN2.CAN2.MEAS_ETAS_Inverter_L_Data.Inv_L_TempIGBT ETCSignals.ES900.ES910.CAN2.CAN2.MEAS_ETAS_Inverter_L_Data.Inv_L_Speed ETCSignals.ES900.ES910.CAN2.CAN2.MEAS_ETAS_Inverter_L_Data.Inv_L_Iq ETCSignals.ES900.ES910.CAN2.CAN2.MEAS_ETAS_Inverter_L_Data.Inv_L_Icommand ETCSignals.ES900.ES910.CAN2.CAN2.MEAS_ETAS_Inverter_L_Data.Inv_L_Iactual ETCSignals.ES900.ES910.CAN2.CAN2.MEAS_ETAS_VDCdata6.SUSP_F_R ETCSignals.ES900.ES910.CAN2.CAN2.MEAS_ETAS_VDCdata6.SUSP_F_L ETCSignals.ES900.ES910.CAN2.CAN2.MEAS_ETAS_VDCdata5.Gyro_F_Z_Deg ETCSignals.ES900.ES910.CAN2.CAN2.MEAS_ETAS_VDCdata5.Accel_F_Z_SI ETCSignals.ES900.ES910.CAN2.CAN2.MEAS_ETAS_VDCdata5.Accel_F_Y_SI ETCSignals.ES900.ES910.CAN2.CAN2.MEAS_ETAS_VDCdata5.Accel_F_X_SI ETCSignals.ES900.ES910.CAN2.CAN2.MEAS_ETAS_VDCdata4.Gyro_R_Z_Deg ETCSignals.ES900.ES910.CAN2.CAN2.MEAS_ETAS_VDCdata4.Accel_R_Z_SI ETCSignals.ES900.ES910.CAN2.CAN2.MEAS_ETAS_VDCdata4.Accel_R_Y_SI ETCSignals.ES900.ES910.CAN2.CAN2.MEAS_ETAS_VDCdata4.Accel_R_X_SI ETCSignals.ES900.ES910.CAN2.CAN2.AP_LV_Derivation_LVData.LVBattery_Voltage_Bits ETCSignals.ES900.ES910.CAN2.CAN2.MEAS_ETAS_VDCdata7.Torque_R ETCSignals.ES900.ES910.CAN2.CAN2.MEAS_ETAS_VDCdata7.Torque_L ETCSignals.ES900.ES910.CAN2.CAN2.MEAS_ETAS_VDCdata3.Handling ETCSignals.ES900.ES910.CAN2.CAN2.MEAS_ETAS_VDCdata3.Dash_Speed ETCSignals.ES900.ES910.CAN2.CAN2.MEAS_ETAS_VDCdata3.Mass ETCSignals.ES900.ES910.CAN2.CAN2.MEAS_ETAS_VDCdata2.Throttle ETCSignals.ES900.ES910.CAN2.CAN2.MEAS_ETAS_VDCdata2.Max_Fx_RR ETCSignals.ES900.ES910.CAN2.CAN2.MEAS_ETAS_VDCdata2.Max_Fx_RL ETCSignals.ES900.ES910.CAN2.CAN2.MEAS_ETAS_VDCdata2.Fy_R ETCSignals.ES900.ES910.CAN2.CAN2.MEAS_ETAS_VDCdata1.Max_Torque_RR ETCSignals.ES900.ES910.CAN2.CAN2.MEAS_ETAS_VDCdata1.Max_Torque_RL ETCSignals.ES900.ES910.CAN2.CAN2.MEAS_ETAS_VDCdata1.Torque_RRwc ETCSignals.ES900.ES910.CAN2.CAN2.MEAS_ETAS_VDCdata1.Torque_RLwc ETCSignals.ES900.ES910.CAN2.CAN2.AP_ACCEL_R_Data2.Susp_R_R_Bits ETCSignals.ES900.ES910.CAN2.CAN2.AP_ACCEL_R_Data2.Susp_R_L_Bits ETCSignals.ES900.ES910.CAN2.CAN2.NM_LV_Derivation_Keep_Alive.LV_Derivation_Alive ETCSignals.ES900.ES910.CAN2.CAN2.AP_ACCEL_F_Data.Gyroscope_F ETCSignals.ES900.ES910.CAN2.CAN2.AP_ACCEL_F_Data.ACCEL_F_Z ETCSignals.ES900.ES910.CAN2.CAN2.AP_ACCEL_F_Data.ACCEL_F_Y ETCSignals.ES900.ES910.CAN2.CAN2.AP_ACCEL_F_Data.ACCEL_F_X ETCSignals.ES900.ES910.CAN2.CAN2.NM_ACCEL_F_Keep_Alive.ACCEL_F_Alive ETCSignals.ES900.ES910.CAN2.CAN2.NM_ACCEL_R_Keep_Alive.ACCEL_R_Alive ETCSignals.ES900.ES910.CAN2.CAN2.AP_ACCEL_R_Data.Gyroscope_R ETCSignals.ES900.ES910.CAN2.CAN2.AP_ACCEL_R_Data.ACCEL_R_Z ETCSignals.ES900.ES910.CAN2.CAN2.AP_ACCEL_R_Data.ACCEL_R_Y ETCSignals.ES900.ES910.CAN2.CAN2.AP_ACCEL_R_Data.ACCEL_R_X ETCSignals.ES900.ES910.CAN2.CAN2.AP_ADCAN_Data2.Susp_F_R_Bits ETCSignals.ES900.ES910.CAN2.CAN2.AP_ADCAN_Data2.Susp_F_L_Bits ETCSignals.ES900.ES910.CAN2.CAN2.AP_ADCAN_Data1.SteeringSensor_Bits ETCSignals.ES900.ES910.CAN2.CAN2.AP_ADCAN_Data1.BrakeSensor_Bits ETCSignals.ES900.ES910.CAN2.CAN2.AP_ADCAN_Data1.APPS2_Bits ETCSignals.ES900.ES910.CAN2.CAN2.AP_ADCAN_Data1.APPS1_Bits ETCSignals.ES900.ES910.CAN2.CAN2.AP_ETAS_Synchronism.Sync_CAN2 ETCSignals.ES900.ES910.CAN2.CAN2.NM_ADCAN_Keep_Alive.ADCAN_Alive /end REF_MEASUREMENT
 /begin REF_CHARACTERISTIC ETCSignals.ES900.ES910.CAN2.CAN2.MEAS_ETAS_VDCdata2.Fy_R_calibrate ETCSignals.ES900.ES910.CAN2.CAN2.MEAS_ETAS_VDCdata1.Max_Torque_RR_calibrate ETCSignals.ES900.ES910.CAN2.CAN2.MEAS_ETAS_VDCdata1.Max_Torque_RL_calibrate ETCSignals.ES900.ES910.CAN2.CAN2.MEAS_ETAS_VDCdata1.Torque_RRwc_calibrate ETCSignals.ES900.ES910.CAN2.CAN2.MEAS_ETAS_VDCdata1.Torque_RLwc_calibrate ETCSignals.ES900.ES910.CAN2.CAN2.AP_ETAS_Synchronism.Sync_CAN2_calibrate /end REF_CHARACTERISTIC
/end GROUP
/begin GROUP ETCSignals.ES900.ES910.CAN2.Presence ""
 /begin REF_MEASUREMENT ETCSignals.ES900.ES910.CAN2.Presence.PresenceGroup.PresenceFlag /end REF_MEASUREMENT
/end GROUP
/begin GROUP ETCSignals.ES900.ES910.CAN2.Presence.PresenceGroup ""
 /begin REF_MEASUREMENT ETCSignals.ES900.ES910.CAN2.Presence.PresenceGroup.PresenceFlag /end REF_MEASUREMENT
/end GROUP
/begin GROUP ETCSignals.ES900.ES910.CAN2.CAN2 ""
 /begin REF_MEASUREMENT ETCSignals.ES900.ES910.CAN2.CAN2.AP_ELLIPSE_EKF_POS.LONGITUDE_EKF ETCSignals.ES900.ES910.CAN2.CAN2.AP_ELLIPSE_EKF_POS.LATITUDE_EKF ETCSignals.ES900.ES910.CAN2.CAN2.AP_ELLIPSE_IMU_ACCEL.ACCEL_Z_IMU ETCSignals.ES900.ES910.CAN2.CAN2.AP_ELLIPSE_IMU_ACCEL.ACCEL_Y_IMU ETCSignals.ES900.ES910.CAN2.CAN2.AP_ELLIPSE_IMU_ACCEL.ACCEL_X_IMU ETCSignals.ES900.ES910.CAN2.CAN2.AP_ELLIPSE_MAG.ACCEL_Z_MAG ETCSignals.ES900.ES910.CAN2.CAN2.AP_ELLIPSE_MAG.ACCEL_Y_MAG ETCSignals.ES900.ES910.CAN2.CAN2.AP_ELLIPSE_MAG.ACCEL_X_MAG ETCSignals.ES900.ES910.CAN2.CAN2.AP_ELLIPSE_EKF_EULER.YAW ETCSignals.ES900.ES910.CAN2.CAN2.AP_ELLIPSE_EKF_EULER.PITCH ETCSignals.ES900.ES910.CAN2.CAN2.AP_ELLIPSE_EKF_EULER.ROLL ETCSignals.ES900.ES910.CAN2.CAN2.AP_ELLIPSE_EKF_VEL_BODY.el_Vel_Z ETCSignals.ES900.ES910.CAN2.CAN2.AP_ELLIPSE_EKF_VEL_BODY.el_Vel_Y ETCSignals.ES900.ES910.CAN2.CAN2.AP_ELLIPSE_EKF_VEL_BODY.el_Vel_X ETCSignals.ES900.ES910.CAN2.CAN2.NM_ELLIPSE_Status.CLOCK ETCSignals.ES900.ES910.CAN2.CAN2.NM_ELLIPSE_Status.GENERAL ETCSignals.ES900.ES910.CAN2.CAN2.NM_ELLIPSE_Status.TIME_STAMP ETCSignals.ES900.ES910.CAN2.CAN2.AP_ELLIPSE_IMU_GYRO.GYRO_Z ETCSignals.ES900.ES910.CAN2.CAN2.AP_ELLIPSE_IMU_GYRO.GYRO_Y ETCSignals.ES900.ES910.CAN2.CAN2.AP_ELLIPSE_IMU_GYRO.GYRO_X ETCSignals.ES900.ES910.CAN2.CAN2.AP_ELLIPSE_SLIP_CURV.AUTO_STATUS ETCSignals.ES900.ES910.CAN2.CAN2.AP_ELLIPSE_SLIP_CURV.CURVATURE_RADIUS ETCSignals.ES900.ES910.CAN2.CAN2.AP_ELLIPSE_SLIP_CURV.ANGLE_SLIP ETCSignals.ES900.ES910.CAN2.CAN2.AP_ELLIPSE_SLIP_CURV.ANGLE_TRACK ETCSignals.ES900.ES910.CAN2.CAN2.MEAS_ETAS_Inverter_R_Data.Inv_R_TempMotor ETCSignals.ES900.ES910.CAN2.CAN2.MEAS_ETAS_Inverter_R_Data.Inv_R_TempIGBT ETCSignals.ES900.ES910.CAN2.CAN2.MEAS_ETAS_Inverter_R_Data.Inv_R_Speed ETCSignals.ES900.ES910.CAN2.CAN2.MEAS_ETAS_Inverter_R_Data.Inv_R_Iq ETCSignals.ES900.ES910.CAN2.CAN2.MEAS_ETAS_Inverter_R_Data.Inv_R_Icommand ETCSignals.ES900.ES910.CAN2.CAN2.MEAS_ETAS_Inverter_R_Data.Inv_R_Iactual ETCSignals.ES900.ES910.CAN2.CAN2.MEAS_ETAS_Inverter_L_Data.Inv_L_TempMotor ETCSignals.ES900.ES910.CAN2.CAN2.MEAS_ETAS_Inverter_L_Data.Inv_L_TempIGBT ETCSignals.ES900.ES910.CAN2.CAN2.MEAS_ETAS_Inverter_L_Data.Inv_L_Speed ETCSignals.ES900.ES910.CAN2.CAN2.MEAS_ETAS_Inverter_L_Data.Inv_L_Iq ETCSignals.ES900.ES910.CAN2.CAN2.MEAS_ETAS_Inverter_L_Data.Inv_L_Icommand ETCSignals.ES900.ES910.CAN2.CAN2.MEAS_ETAS_Inverter_L_Data.Inv_L_Iactual ETCSignals.ES900.ES910.CAN2.CAN2.MEAS_ETAS_VDCdata6.SUSP_F_R ETCSignals.ES900.ES910.CAN2.CAN2.MEAS_ETAS_VDCdata6.SUSP_F_L ETCSignals.ES900.ES910.CAN2.CAN2.MEAS_ETAS_VDCdata5.Gyro_F_Z_Deg ETCSignals.ES900.ES910.CAN2.CAN2.MEAS_ETAS_VDCdata5.Accel_F_Z_SI ETCSignals.ES900.ES910.CAN2.CAN2.MEAS_ETAS_VDCdata5.Accel_F_Y_SI ETCSignals.ES900.ES910.CAN2.CAN2.MEAS_ETAS_VDCdata5.Accel_F_X_SI ETCSignals.ES900.ES910.CAN2.CAN2.MEAS_ETAS_VDCdata4.Gyro_R_Z_Deg ETCSignals.ES900.ES910.CAN2.CAN2.MEAS_ETAS_VDCdata4.Accel_R_Z_SI ETCSignals.ES900.ES910.CAN2.CAN2.MEAS_ETAS_VDCdata4.Accel_R_Y_SI ETCSignals.ES900.ES910.CAN2.CAN2.MEAS_ETAS_VDCdata4.Accel_R_X_SI ETCSignals.ES900.ES910.CAN2.CAN2.AP_LV_Derivation_LVData.LVBattery_Voltage_Bits ETCSignals.ES900.ES910.CAN2.CAN2.MEAS_ETAS_VDCdata7.Torque_R ETCSignals.ES900.ES910.CAN2.CAN2.MEAS_ETAS_VDCdata7.Torque_L ETCSignals.ES900.ES910.CAN2.CAN2.MEAS_ETAS_VDCdata3.Handling ETCSignals.ES900.ES910.CAN2.CAN2.MEAS_ETAS_VDCdata3.Dash_Speed ETCSignals.ES900.ES910.CAN2.CAN2.MEAS_ETAS_VDCdata3.Mass ETCSignals.ES900.ES910.CAN2.CAN2.MEAS_ETAS_VDCdata2.Throttle ETCSignals.ES900.ES910.CAN2.CAN2.MEAS_ETAS_VDCdata2.Max_Fx_RR ETCSignals.ES900.ES910.CAN2.CAN2.MEAS_ETAS_VDCdata2.Max_Fx_RL ETCSignals.ES900.ES910.CAN2.CAN2.MEAS_ETAS_VDCdata2.Fy_R ETCSignals.ES900.ES910.CAN2.CAN2.MEAS_ETAS_VDCdata1.Max_Torque_RR ETCSignals.ES900.ES910.CAN2.CAN2.MEAS_ETAS_VDCdata1.Max_Torque_RL ETCSignals.ES900.ES910.CAN2.CAN2.MEAS_ETAS_VDCdata1.Torque_RRwc ETCSignals.ES900.ES910.CAN2.CAN2.MEAS_ETAS_VDCdata1.Torque_RLwc ETCSignals.ES900.ES910.CAN2.CAN2.AP_ACCEL_R_Data2.Susp_R_R_Bits ETCSignals.ES900.ES910.CAN2.CAN2.AP_ACCEL_R_Data2.Susp_R_L_Bits ETCSignals.ES900.ES910.CAN2.CAN2.NM_LV_Derivation_Keep_Alive.LV_Derivation_Alive ETCSignals.ES900.ES910.CAN2.CAN2.AP_ACCEL_F_Data.Gyroscope_F ETCSignals.ES900.ES910.CAN2.CAN2.AP_ACCEL_F_Data.ACCEL_F_Z ETCSignals.ES900.ES910.CAN2.CAN2.AP_ACCEL_F_Data.ACCEL_F_Y ETCSignals.ES900.ES910.CAN2.CAN2.AP_ACCEL_F_Data.ACCEL_F_X ETCSignals.ES900.ES910.CAN2.CAN2.NM_ACCEL_F_Keep_Alive.ACCEL_F_Alive ETCSignals.ES900.ES910.CAN2.CAN2.NM_ACCEL_R_Keep_Alive.ACCEL_R_Alive ETCSignals.ES900.ES910.CAN2.CAN2.AP_ACCEL_R_Data.Gyroscope_R ETCSignals.ES900.ES910.CAN2.CAN2.AP_ACCEL_R_Data.ACCEL_R_Z ETCSignals.ES900.ES910.CAN2.CAN2.AP_ACCEL_R_Data.ACCEL_R_Y ETCSignals.ES900.ES910.CAN2.CAN2.AP_ACCEL_R_Data.ACCEL_R_X ETCSignals.ES900.ES910.CAN2.CAN2.AP_ADCAN_Data2.Susp_F_R_Bits ETCSignals.ES900.ES910.CAN2.CAN2.AP_ADCAN_Data2.Susp_F_L_Bits ETCSignals.ES900.ES910.CAN2.CAN2.AP_ADCAN_Data1.SteeringSensor_Bits ETCSignals.ES900.ES910.CAN2.CAN2.AP_ADCAN_Data1.BrakeSensor_Bits ETCSignals.ES900.ES910.CAN2.CAN2.AP_ADCAN_Data1.APPS2_Bits ETCSignals.ES900.ES910.CAN2.CAN2.AP_ADCAN_Data1.APPS1_Bits ETCSignals.ES900.ES910.CAN2.CAN2.AP_ETAS_Synchronism.Sync_CAN2 ETCSignals.ES900.ES910.CAN2.CAN2.NM_ADCAN_Keep_Alive.ADCAN_Alive /end REF_MEASUREMENT
 /begin REF_CHARACTERISTIC ETCSignals.ES900.ES910.CAN2.CAN2.MEAS_ETAS_VDCdata2.Fy_R_calibrate ETCSignals.ES900.ES910.CAN2.CAN2.MEAS_ETAS_VDCdata1.Max_Torque_RR_calibrate ETCSignals.ES900.ES910.CAN2.CAN2.MEAS_ETAS_VDCdata1.Max_Torque_RL_calibrate ETCSignals.ES900.ES910.CAN2.CAN2.MEAS_ETAS_VDCdata1.Torque_RRwc_calibrate ETCSignals.ES900.ES910.CAN2.CAN2.MEAS_ETAS_VDCdata1.Torque_RLwc_calibrate ETCSignals.ES900.ES910.CAN2.CAN2.AP_ETAS_Synchronism.Sync_CAN2_calibrate /end REF_CHARACTERISTIC
/end GROUP
/begin GROUP ETCSignals.ES900.ES910.CAN2.CAN2.AP_ELLIPSE_EKF_POS ""
 /begin REF_MEASUREMENT ETCSignals.ES900.ES910.CAN2.CAN2.AP_ELLIPSE_EKF_POS.LONGITUDE_EKF ETCSignals.ES900.ES910.CAN2.CAN2.AP_ELLIPSE_EKF_POS.LATITUDE_EKF /end REF_MEASUREMENT
/end GROUP
/begin GROUP ETCSignals.ES900.ES910.CAN2.CAN2.AP_ELLIPSE_IMU_ACCEL ""
 /begin REF_MEASUREMENT ETCSignals.ES900.ES910.CAN2.CAN2.AP_ELLIPSE_IMU_ACCEL.ACCEL_Z_IMU ETCSignals.ES900.ES910.CAN2.CAN2.AP_ELLIPSE_IMU_ACCEL.ACCEL_Y_IMU ETCSignals.ES900.ES910.CAN2.CAN2.AP_ELLIPSE_IMU_ACCEL.ACCEL_X_IMU /end REF_MEASUREMENT
/end GROUP
/begin GROUP ETCSignals.ES900.ES910.CAN2.CAN2.AP_ELLIPSE_MAG ""
 /begin REF_MEASUREMENT ETCSignals.ES900.ES910.CAN2.CAN2.AP_ELLIPSE_MAG.ACCEL_Z_MAG ETCSignals.ES900.ES910.CAN2.CAN2.AP_ELLIPSE_MAG.ACCEL_Y_MAG ETCSignals.ES900.ES910.CAN2.CAN2.AP_ELLIPSE_MAG.ACCEL_X_MAG /end REF_MEASUREMENT
/end GROUP
/begin GROUP ETCSignals.ES900.ES910.CAN2.CAN2.AP_ELLIPSE_EKF_EULER ""
 /begin REF_MEASUREMENT ETCSignals.ES900.ES910.CAN2.CAN2.AP_ELLIPSE_EKF_EULER.YAW ETCSignals.ES900.ES910.CAN2.CAN2.AP_ELLIPSE_EKF_EULER.PITCH ETCSignals.ES900.ES910.CAN2.CAN2.AP_ELLIPSE_EKF_EULER.ROLL /end REF_MEASUREMENT
/end GROUP
/begin GROUP ETCSignals.ES900.ES910.CAN2.CAN2.AP_ELLIPSE_EKF_VEL_BODY ""
 /begin REF_MEASUREMENT ETCSignals.ES900.ES910.CAN2.CAN2.AP_ELLIPSE_EKF_VEL_BODY.el_Vel_Z ETCSignals.ES900.ES910.CAN2.CAN2.AP_ELLIPSE_EKF_VEL_BODY.el_Vel_Y ETCSignals.ES900.ES910.CAN2.CAN2.AP_ELLIPSE_EKF_VEL_BODY.el_Vel_X /end REF_MEASUREMENT
/end GROUP
/begin GROUP ETCSignals.ES900.ES910.CAN2.CAN2.NM_ELLIPSE_Status ""
 /begin REF_MEASUREMENT ETCSignals.ES900.ES910.CAN2.CAN2.NM_ELLIPSE_Status.CLOCK ETCSignals.ES900.ES910.CAN2.CAN2.NM_ELLIPSE_Status.GENERAL ETCSignals.ES900.ES910.CAN2.CAN2.NM_ELLIPSE_Status.TIME_STAMP /end REF_MEASUREMENT
/end GROUP
/begin GROUP ETCSignals.ES900.ES910.CAN2.CAN2.AP_ELLIPSE_IMU_GYRO ""
 /begin REF_MEASUREMENT ETCSignals.ES900.ES910.CAN2.CAN2.AP_ELLIPSE_IMU_GYRO.GYRO_Z ETCSignals.ES900.ES910.CAN2.CAN2.AP_ELLIPSE_IMU_GYRO.GYRO_Y ETCSignals.ES900.ES910.CAN2.CAN2.AP_ELLIPSE_IMU_GYRO.GYRO_X /end REF_MEASUREMENT
/end GROUP
/begin GROUP ETCSignals.ES900.ES910.CAN2.CAN2.AP_ELLIPSE_SLIP_CURV ""
 /begin REF_MEASUREMENT ETCSignals.ES900.ES910.CAN2.CAN2.AP_ELLIPSE_SLIP_CURV.AUTO_STATUS ETCSignals.ES900.ES910.CAN2.CAN2.AP_ELLIPSE_SLIP_CURV.CURVATURE_RADIUS ETCSignals.ES900.ES910.CAN2.CAN2.AP_ELLIPSE_SLIP_CURV.ANGLE_SLIP ETCSignals.ES900.ES910.CAN2.CAN2.AP_ELLIPSE_SLIP_CURV.ANGLE_TRACK /end REF_MEASUREMENT
/end GROUP
/begin GROUP ETCSignals.ES900.ES910.CAN2.CAN2.MEAS_ETAS_Inverter_R_Data ""
 /begin REF_MEASUREMENT ETCSignals.ES900.ES910.CAN2.CAN2.MEAS_ETAS_Inverter_R_Data.Inv_R_TempMotor ETCSignals.ES900.ES910.CAN2.CAN2.MEAS_ETAS_Inverter_R_Data.Inv_R_TempIGBT ETCSignals.ES900.ES910.CAN2.CAN2.MEAS_ETAS_Inverter_R_Data.Inv_R_Speed ETCSignals.ES900.ES910.CAN2.CAN2.MEAS_ETAS_Inverter_R_Data.Inv_R_Iq ETCSignals.ES900.ES910.CAN2.CAN2.MEAS_ETAS_Inverter_R_Data.Inv_R_Icommand ETCSignals.ES900.ES910.CAN2.CAN2.MEAS_ETAS_Inverter_R_Data.Inv_R_Iactual /end REF_MEASUREMENT
/end GROUP
/begin GROUP ETCSignals.ES900.ES910.CAN2.CAN2.MEAS_ETAS_Inverter_L_Data ""
 /begin REF_MEASUREMENT ETCSignals.ES900.ES910.CAN2.CAN2.MEAS_ETAS_Inverter_L_Data.Inv_L_TempMotor ETCSignals.ES900.ES910.CAN2.CAN2.MEAS_ETAS_Inverter_L_Data.Inv_L_TempIGBT ETCSignals.ES900.ES910.CAN2.CAN2.MEAS_ETAS_Inverter_L_Data.Inv_L_Speed ETCSignals.ES900.ES910.CAN2.CAN2.MEAS_ETAS_Inverter_L_Data.Inv_L_Iq ETCSignals.ES900.ES910.CAN2.CAN2.MEAS_ETAS_Inverter_L_Data.Inv_L_Icommand ETCSignals.ES900.ES910.CAN2.CAN2.MEAS_ETAS_Inverter_L_Data.Inv_L_Iactual /end REF_MEASUREMENT
/end GROUP
/begin GROUP ETCSignals.ES900.ES910.CAN2.CAN2.MEAS_ETAS_VDCdata6 ""
 /begin REF_MEASUREMENT ETCSignals.ES900.ES910.CAN2.CAN2.MEAS_ETAS_VDCdata6.SUSP_F_R ETCSignals.ES900.ES910.CAN2.CAN2.MEAS_ETAS_VDCdata6.SUSP_F_L /end REF_MEASUREMENT
/end GROUP
/begin GROUP ETCSignals.ES900.ES910.CAN2.CAN2.MEAS_ETAS_VDCdata5 ""
 /begin REF_MEASUREMENT ETCSignals.ES900.ES910.CAN2.CAN2.MEAS_ETAS_VDCdata5.Gyro_F_Z_Deg ETCSignals.ES900.ES910.CAN2.CAN2.MEAS_ETAS_VDCdata5.Accel_F_Z_SI ETCSignals.ES900.ES910.CAN2.CAN2.MEAS_ETAS_VDCdata5.Accel_F_Y_SI ETCSignals.ES900.ES910.CAN2.CAN2.MEAS_ETAS_VDCdata5.Accel_F_X_SI /end REF_MEASUREMENT
/end GROUP
/begin GROUP ETCSignals.ES900.ES910.CAN2.CAN2.MEAS_ETAS_VDCdata4 ""
 /begin REF_MEASUREMENT ETCSignals.ES900.ES910.CAN2.CAN2.MEAS_ETAS_VDCdata4.Gyro_R_Z_Deg ETCSignals.ES900.ES910.CAN2.CAN2.MEAS_ETAS_VDCdata4.Accel_R_Z_SI ETCSignals.ES900.ES910.CAN2.CAN2.MEAS_ETAS_VDCdata4.Accel_R_Y_SI ETCSignals.ES900.ES910.CAN2.CAN2.MEAS_ETAS_VDCdata4.Accel_R_X_SI /end REF_MEASUREMENT
/end GROUP
/begin GROUP ETCSignals.ES900.ES910.CAN2.CAN2.AP_LV_Derivation_LVData ""
 /begin REF_MEASUREMENT ETCSignals.ES900.ES910.CAN2.CAN2.AP_LV_Derivation_LVData.LVBattery_Voltage_Bits /end REF_MEASUREMENT
/end GROUP
/begin GROUP ETCSignals.ES900.ES910.CAN2.CAN2.MEAS_ETAS_VDCdata7 ""
 /begin REF_MEASUREMENT ETCSignals.ES900.ES910.CAN2.CAN2.MEAS_ETAS_VDCdata7.Torque_R ETCSignals.ES900.ES910.CAN2.CAN2.MEAS_ETAS_VDCdata7.Torque_L /end REF_MEASUREMENT
/end GROUP
/begin GROUP ETCSignals.ES900.ES910.CAN2.CAN2.MEAS_ETAS_VDCdata3 ""
 /begin REF_MEASUREMENT ETCSignals.ES900.ES910.CAN2.CAN2.MEAS_ETAS_VDCdata3.Handling ETCSignals.ES900.ES910.CAN2.CAN2.MEAS_ETAS_VDCdata3.Dash_Speed ETCSignals.ES900.ES910.CAN2.CAN2.MEAS_ETAS_VDCdata3.Mass /end REF_MEASUREMENT
/end GROUP
/begin GROUP ETCSignals.ES900.ES910.CAN2.CAN2.MEAS_ETAS_VDCdata2 ""
 /begin REF_MEASUREMENT ETCSignals.ES900.ES910.CAN2.CAN2.MEAS_ETAS_VDCdata2.Throttle ETCSignals.ES900.ES910.CAN2.CAN2.MEAS_ETAS_VDCdata2.Max_Fx_RR ETCSignals.ES900.ES910.CAN2.CAN2.MEAS_ETAS_VDCdata2.Max_Fx_RL ETCSignals.ES900.ES910.CAN2.CAN2.MEAS_ETAS_VDCdata2.Fy_R /end REF_MEASUREMENT
 /begin REF_CHARACTERISTIC ETCSignals.ES900.ES910.CAN2.CAN2.MEAS_ETAS_VDCdata2.Fy_R_calibrate /end REF_CHARACTERISTIC
/end GROUP
/begin GROUP ETCSignals.ES900.ES910.CAN2.CAN2.MEAS_ETAS_VDCdata1 ""
 /begin REF_MEASUREMENT ETCSignals.ES900.ES910.CAN2.CAN2.MEAS_ETAS_VDCdata1.Max_Torque_RR ETCSignals.ES900.ES910.CAN2.CAN2.MEAS_ETAS_VDCdata1.Max_Torque_RL ETCSignals.ES900.ES910.CAN2.CAN2.MEAS_ETAS_VDCdata1.Torque_RRwc ETCSignals.ES900.ES910.CAN2.CAN2.MEAS_ETAS_VDCdata1.Torque_RLwc /end REF_MEASUREMENT
 /begin REF_CHARACTERISTIC ETCSignals.ES900.ES910.CAN2.CAN2.MEAS_ETAS_VDCdata1.Max_Torque_RR_calibrate ETCSignals.ES900.ES910.CAN2.CAN2.MEAS_ETAS_VDCdata1.Max_Torque_RL_calibrate ETCSignals.ES900.ES910.CAN2.CAN2.MEAS_ETAS_VDCdata1.Torque_RRwc_calibrate ETCSignals.ES900.ES910.CAN2.CAN2.MEAS_ETAS_VDCdata1.Torque_RLwc_calibrate /end REF_CHARACTERISTIC
/end GROUP
/begin GROUP ETCSignals.ES900.ES910.CAN2.CAN2.AP_ACCEL_R_Data2 ""
 /begin REF_MEASUREMENT ETCSignals.ES900.ES910.CAN2.CAN2.AP_ACCEL_R_Data2.Susp_R_R_Bits ETCSignals.ES900.ES910.CAN2.CAN2.AP_ACCEL_R_Data2.Susp_R_L_Bits /end REF_MEASUREMENT
/end GROUP
/begin GROUP ETCSignals.ES900.ES910.CAN2.CAN2.NM_LV_Derivation_Keep_Alive ""
 /begin REF_MEASUREMENT ETCSignals.ES900.ES910.CAN2.CAN2.NM_LV_Derivation_Keep_Alive.LV_Derivation_Alive /end REF_MEASUREMENT
/end GROUP
/begin GROUP ETCSignals.ES900.ES910.CAN2.CAN2.AP_ACCEL_F_Data ""
 /begin REF_MEASUREMENT ETCSignals.ES900.ES910.CAN2.CAN2.AP_ACCEL_F_Data.Gyroscope_F ETCSignals.ES900.ES910.CAN2.CAN2.AP_ACCEL_F_Data.ACCEL_F_Z ETCSignals.ES900.ES910.CAN2.CAN2.AP_ACCEL_F_Data.ACCEL_F_Y ETCSignals.ES900.ES910.CAN2.CAN2.AP_ACCEL_F_Data.ACCEL_F_X /end REF_MEASUREMENT
/end GROUP
/begin GROUP ETCSignals.ES900.ES910.CAN2.CAN2.NM_ACCEL_F_Keep_Alive ""
 /begin REF_MEASUREMENT ETCSignals.ES900.ES910.CAN2.CAN2.NM_ACCEL_F_Keep_Alive.ACCEL_F_Alive /end REF_MEASUREMENT
/end GROUP
/begin GROUP ETCSignals.ES900.ES910.CAN2.CAN2.NM_ACCEL_R_Keep_Alive ""
 /begin REF_MEASUREMENT ETCSignals.ES900.ES910.CAN2.CAN2.NM_ACCEL_R_Keep_Alive.ACCEL_R_Alive /end REF_MEASUREMENT
/end GROUP
/begin GROUP ETCSignals.ES900.ES910.CAN2.CAN2.AP_ACCEL_R_Data ""
 /begin REF_MEASUREMENT ETCSignals.ES900.ES910.CAN2.CAN2.AP_ACCEL_R_Data.Gyroscope_R ETCSignals.ES900.ES910.CAN2.CAN2.AP_ACCEL_R_Data.ACCEL_R_Z ETCSignals.ES900.ES910.CAN2.CAN2.AP_ACCEL_R_Data.ACCEL_R_Y ETCSignals.ES900.ES910.CAN2.CAN2.AP_ACCEL_R_Data.ACCEL_R_X /end REF_MEASUREMENT
/end GROUP
/begin GROUP ETCSignals.ES900.ES910.CAN2.CAN2.AP_ADCAN_Data2 ""
 /begin REF_MEASUREMENT ETCSignals.ES900.ES910.CAN2.CAN2.AP_ADCAN_Data2.Susp_F_R_Bits ETCSignals.ES900.ES910.CAN2.CAN2.AP_ADCAN_Data2.Susp_F_L_Bits /end REF_MEASUREMENT
/end GROUP
/begin GROUP ETCSignals.ES900.ES910.CAN2.CAN2.AP_ADCAN_Data1 ""
 /begin REF_MEASUREMENT ETCSignals.ES900.ES910.CAN2.CAN2.AP_ADCAN_Data1.SteeringSensor_Bits ETCSignals.ES900.ES910.CAN2.CAN2.AP_ADCAN_Data1.BrakeSensor_Bits ETCSignals.ES900.ES910.CAN2.CAN2.AP_ADCAN_Data1.APPS2_Bits ETCSignals.ES900.ES910.CAN2.CAN2.AP_ADCAN_Data1.APPS1_Bits /end REF_MEASUREMENT
/end GROUP
/begin GROUP ETCSignals.ES900.ES910.CAN2.CAN2.AP_ETAS_Synchronism ""
 /begin REF_MEASUREMENT ETCSignals.ES900.ES910.CAN2.CAN2.AP_ETAS_Synchronism.Sync_CAN2 /end REF_MEASUREMENT
 /begin REF_CHARACTERISTIC ETCSignals.ES900.ES910.CAN2.CAN2.AP_ETAS_Synchronism.Sync_CAN2_calibrate /end REF_CHARACTERISTIC
/end GROUP
/begin GROUP ETCSignals.ES900.ES910.CAN2.CAN2.NM_ADCAN_Keep_Alive ""
 /begin REF_MEASUREMENT ETCSignals.ES900.ES910.CAN2.CAN2.NM_ADCAN_Keep_Alive.ADCAN_Alive /end REF_MEASUREMENT
/end GROUP
/end MODULE
/end PROJECT
