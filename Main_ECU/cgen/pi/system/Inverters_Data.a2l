ASAP2_VERSION
/begin PROJECT "Generated by ETAS from INTECRIO integration project"
/begin HEADER "" VERSION "" PROJECT_NO Y /end HEADER
/begin MODULE Inverters_Data "Generated by ETAS from INTECRIO integration project"
/begin MOD_PAR "" VERSION "" ADDR_EPK 0x0 EPK "" SUPPLIER "ETAS GmbH" CUSTOMER "" CUSTOMER_NO "" USER "" PHONE_NO "" ECU "NO_ECU" CPU_TYPE "MPC750" NO_OF_INTERFACES 1 /end MOD_PAR
/begin MOD_COMMON "Common definitions" BYTE_ORDER MSB_FIRST ALIGNMENT_BYTE 1 ALIGNMENT_WORD 2 ALIGNMENT_LONG 4 ALIGNMENT_FLOAT32_IEEE 4 ALIGNMENT_FLOAT64_IEEE 8 /end MOD_COMMON
/begin MEASUREMENT Inverters_Data_DW.Last_alive "" FLOAT64_IEEE Inverters_Data_CM_double 0 0 -1.7e+308 1.7e+308 ECU_ADDRESS 0x0 DISPLAY_IDENTIFIER Inverters_Data.Life_check_InverterL.Data_Store_Memory.Last_alive /end MEASUREMENT
/begin COMPU_METHOD Inverters_Data_CM_double "Q = V" /* ConversionType */ RAT_FUNC /* Format */ "%9.6" /* Unit */ "NO_PHYSICAL_QTY" COEFFS 0.0 1.0 0.0 0.0 0.0 1.0 /end COMPU_METHOD
/begin MEASUREMENT Inverters_Data_DW.Last_alive_h "" FLOAT64_IEEE Inverters_Data_CM_double 0 0 -1.7e+308 1.7e+308 ECU_ADDRESS 0x0 DISPLAY_IDENTIFIER Inverters_Data.Life_check_InverterR.Data_Store_Memory.Last_alive_h /end MEASUREMENT
/begin MEASUREMENT Inverters_Data_DW.Tot_Errors "" FLOAT64_IEEE Inverters_Data_CM_double 0 0 -1.7e+308 1.7e+308 ECU_ADDRESS 0x0 DISPLAY_IDENTIFIER Inverters_Data.Life_check_InverterL.Data_Store_Memory1.Tot_Errors /end MEASUREMENT
/begin MEASUREMENT Inverters_Data_DW.Tot_Errors_c "" FLOAT64_IEEE Inverters_Data_CM_double 0 0 -1.7e+308 1.7e+308 ECU_ADDRESS 0x0 DISPLAY_IDENTIFIER Inverters_Data.Life_check_InverterR.Data_Store_Memory1.Tot_Errors_c /end MEASUREMENT
/begin MEASUREMENT Inverters_Data_U.Inv_L_RegID "" FLOAT64_IEEE Inverters_Data_CM_double 0 0 -1.7e+308 1.7e+308 ECU_ADDRESS 0x0 DISPLAY_IDENTIFIER Inverters_Data.Inv_L_RegID /end MEASUREMENT
/begin MEASUREMENT Inverters_Data_U.Inv_L_RegID_M235_Inv_L_DCBus "" FLOAT64_IEEE Inverters_Data_CM_double 0 0 -1.7e+308 1.7e+308 ECU_ADDRESS 0x0 DISPLAY_IDENTIFIER Inverters_Data.Inv_L_RegID_M235_Inv_L_DCBus /end MEASUREMENT
/begin MEASUREMENT Inverters_Data_U.Inv_L_RegID_M48_Inv_L_Speed "" FLOAT64_IEEE Inverters_Data_CM_double 0 0 -1.7e+308 1.7e+308 ECU_ADDRESS 0x0 DISPLAY_IDENTIFIER Inverters_Data.Inv_L_RegID_M48_Inv_L_Speed /end MEASUREMENT
/begin MEASUREMENT Inverters_Data_U.Inv_L_RegID_M73_Inv_L_TempMotor "" FLOAT64_IEEE Inverters_Data_CM_double 0 0 -1.7e+308 1.7e+308 ECU_ADDRESS 0x0 DISPLAY_IDENTIFIER Inverters_Data.Inv_L_RegID_M73_Inv_L_TempMotor /end MEASUREMENT
/begin MEASUREMENT Inverters_Data_U.Inv_L_RegID_M74_Inv_L_TempIGBT "" FLOAT64_IEEE Inverters_Data_CM_double 0 0 -1.7e+308 1.7e+308 ECU_ADDRESS 0x0 DISPLAY_IDENTIFIER Inverters_Data.Inv_L_RegID_M74_Inv_L_TempIGBT /end MEASUREMENT
/begin MEASUREMENT Inverters_Data_U.Inv_R_RegID "" FLOAT64_IEEE Inverters_Data_CM_double 0 0 -1.7e+308 1.7e+308 ECU_ADDRESS 0x0 DISPLAY_IDENTIFIER Inverters_Data.Inv_R_RegID /end MEASUREMENT
/begin MEASUREMENT Inverters_Data_U.Inv_R_RegID_M235_Inv_R_DCBus "" FLOAT64_IEEE Inverters_Data_CM_double 0 0 -1.7e+308 1.7e+308 ECU_ADDRESS 0x0 DISPLAY_IDENTIFIER Inverters_Data.Inv_R_RegID_M235_Inv_R_DCBus /end MEASUREMENT
/begin MEASUREMENT Inverters_Data_U.Inv_R_RegID_M48_Inv_R_Speed "" FLOAT64_IEEE Inverters_Data_CM_double 0 0 -1.7e+308 1.7e+308 ECU_ADDRESS 0x0 DISPLAY_IDENTIFIER Inverters_Data.Inv_R_RegID_M48_Inv_R_Speed /end MEASUREMENT
/begin MEASUREMENT Inverters_Data_U.Inv_R_RegID_M73_Inv_R_TempMotor "" FLOAT64_IEEE Inverters_Data_CM_double 0 0 -1.7e+308 1.7e+308 ECU_ADDRESS 0x0 DISPLAY_IDENTIFIER Inverters_Data.Inv_R_RegID_M73_Inv_R_TempMotor /end MEASUREMENT
/begin MEASUREMENT Inverters_Data_U.Inv_R_RegID_M74_Inv_R_TempIGBT "" FLOAT64_IEEE Inverters_Data_CM_double 0 0 -1.7e+308 1.7e+308 ECU_ADDRESS 0x0 DISPLAY_IDENTIFIER Inverters_Data.Inv_R_RegID_M74_Inv_R_TempIGBT /end MEASUREMENT
/begin MEASUREMENT Inverters_Data_Y.Disconnection_InvL "" FLOAT64_IEEE Inverters_Data_CM_double 0 0 -1.7e+308 1.7e+308 ECU_ADDRESS 0x0 DISPLAY_IDENTIFIER Inverters_Data.Disconnection_InvL /end MEASUREMENT
/begin MEASUREMENT Inverters_Data_Y.Disconnection_InvR "" FLOAT64_IEEE Inverters_Data_CM_double 0 0 -1.7e+308 1.7e+308 ECU_ADDRESS 0x0 DISPLAY_IDENTIFIER Inverters_Data.Disconnection_InvR /end MEASUREMENT
/begin MEASUREMENT Inverters_Data_Y.Inv_L_TempIGBT "" FLOAT64_IEEE Inverters_Data_CM_double 0 0 -1.7e+308 1.7e+308 ECU_ADDRESS 0x0 DISPLAY_IDENTIFIER Inverters_Data.Inv_L_TempIGBT /end MEASUREMENT
/begin MEASUREMENT Inverters_Data_Y.Inv_L_TempMotor "" FLOAT64_IEEE Inverters_Data_CM_double 0 0 -1.7e+308 1.7e+308 ECU_ADDRESS 0x0 DISPLAY_IDENTIFIER Inverters_Data.Inv_L_TempMotor /end MEASUREMENT
/begin MEASUREMENT Inverters_Data_Y.Inv_R_TempIGBT "" FLOAT64_IEEE Inverters_Data_CM_double 0 0 -1.7e+308 1.7e+308 ECU_ADDRESS 0x0 DISPLAY_IDENTIFIER Inverters_Data.Inv_R_TempIGBT /end MEASUREMENT
/begin MEASUREMENT Inverters_Data_Y.Inv_R_TempMotor "" FLOAT64_IEEE Inverters_Data_CM_double 0 0 -1.7e+308 1.7e+308 ECU_ADDRESS 0x0 DISPLAY_IDENTIFIER Inverters_Data.Inv_R_TempMotor /end MEASUREMENT
/begin MEASUREMENT Inverters_Data_Y.InvertersMinDCBus "" FLOAT64_IEEE Inverters_Data_CM_double 0 0 -1.7e+308 1.7e+308 ECU_ADDRESS 0x0 DISPLAY_IDENTIFIER Inverters_Data.InvertersMinDCBus /end MEASUREMENT
/begin MEASUREMENT Inverters_Data_Y.Max_Temp_IGBT "" FLOAT64_IEEE Inverters_Data_CM_double 0 0 -1.7e+308 1.7e+308 ECU_ADDRESS 0x0 DISPLAY_IDENTIFIER Inverters_Data.Max_Temp_IGBT /end MEASUREMENT
/begin MEASUREMENT Inverters_Data_Y.Max_Temp_Motors "" FLOAT64_IEEE Inverters_Data_CM_double 0 0 -1.7e+308 1.7e+308 ECU_ADDRESS 0x0 DISPLAY_IDENTIFIER Inverters_Data.Max_Temp_Motors /end MEASUREMENT
/begin MEASUREMENT Inverters_Data_Y.RL_Vel_ms_Wheel "" FLOAT64_IEEE Inverters_Data_CM_double 0 0 -1.7e+308 1.7e+308 ECU_ADDRESS 0x0 DISPLAY_IDENTIFIER Inverters_Data.RL_Vel_ms_Wheel /end MEASUREMENT
/begin MEASUREMENT Inverters_Data_Y.RL_rads_Motor "" FLOAT64_IEEE Inverters_Data_CM_double 0 0 -1.7e+308 1.7e+308 ECU_ADDRESS 0x0 DISPLAY_IDENTIFIER Inverters_Data.RL_rads_Motor /end MEASUREMENT
/begin MEASUREMENT Inverters_Data_Y.RR_Vel_ms_Wheel "" FLOAT64_IEEE Inverters_Data_CM_double 0 0 -1.7e+308 1.7e+308 ECU_ADDRESS 0x0 DISPLAY_IDENTIFIER Inverters_Data.RR_Vel_ms_Wheel /end MEASUREMENT
/begin MEASUREMENT Inverters_Data_Y.RR_rads_Motor "" FLOAT64_IEEE Inverters_Data_CM_double 0 0 -1.7e+308 1.7e+308 ECU_ADDRESS 0x0 DISPLAY_IDENTIFIER Inverters_Data.RR_rads_Motor /end MEASUREMENT
/begin MEASUREMENT Inverters_Data_Y.Speed "" FLOAT64_IEEE Inverters_Data_CM_double 0 0 -1.7e+308 1.7e+308 ECU_ADDRESS 0x0 DISPLAY_IDENTIFIER Inverters_Data.Speed /end MEASUREMENT
/end MODULE
/* Inverters_Data */
/end PROJECT
