ASAP2_VERSION
/begin PROJECT "Generated by ETAS from INTECRIO integration project"
/begin HEADER "" VERSION "" PROJECT_NO Y /end HEADER
/begin MODULE Inverters_Data "Generated by ETAS from INTECRIO integration project"
/begin MOD_PAR "" VERSION "" ADDR_EPK 0x0 EPK "" SUPPLIER "ETAS GmbH" CUSTOMER "" CUSTOMER_NO "" USER "" PHONE_NO "" ECU "NO_ECU" CPU_TYPE "MPC750" NO_OF_INTERFACES 1 /end MOD_PAR
/begin MOD_COMMON "Common definitions" BYTE_ORDER MSB_FIRST ALIGNMENT_BYTE 1 ALIGNMENT_WORD 2 ALIGNMENT_LONG 4 ALIGNMENT_FLOAT32_IEEE 4 ALIGNMENT_FLOAT64_IEEE 8 /end MOD_COMMON
/begin CHARACTERISTIC Inverters_Data_P.A1_Value "" VALUE 0x0 SCALAR_FLOAT64_IEEE 3.5e+305 Inverters_Data_CM_double -1.7e+308 1.7e+308 DISPLAY_IDENTIFIER Inverters_Data.Subsystem4.A1.Value /end CHARACTERISTIC
/begin RECORD_LAYOUT SCALAR_FLOAT64_IEEE FNC_VALUES 1 FLOAT64_IEEE COLUMN_DIR DIRECT /end RECORD_LAYOUT
/begin COMPU_METHOD Inverters_Data_CM_double "Q = V" /* ConversionType */ RAT_FUNC /* Format */ "%9.6" /* Unit */ "NO_PHYSICAL_QTY" COEFFS 0.0 1.0 0.0 0.0 0.0 1.0 /end COMPU_METHOD
/begin CHARACTERISTIC Inverters_Data_P.A1_Value_e "" VALUE 0x0 SCALAR_FLOAT64_IEEE 3.5e+305 Inverters_Data_CM_double -1.7e+308 1.7e+308 DISPLAY_IDENTIFIER Inverters_Data.Subsystem5.A1.Value /end CHARACTERISTIC
/begin CHARACTERISTIC Inverters_Data_P.B1_Value "" VALUE 0x0 SCALAR_FLOAT64_IEEE 3.5e+305 Inverters_Data_CM_double -1.7e+308 1.7e+308 DISPLAY_IDENTIFIER Inverters_Data.Subsystem4.B1.Value /end CHARACTERISTIC
/begin CHARACTERISTIC Inverters_Data_P.B1_Value_i "" VALUE 0x0 SCALAR_FLOAT64_IEEE 3.5e+305 Inverters_Data_CM_double -1.7e+308 1.7e+308 DISPLAY_IDENTIFIER Inverters_Data.Subsystem5.B1.Value /end CHARACTERISTIC
/begin CHARACTERISTIC Inverters_Data_P.Bitct_Value "" VALUE 0x0 SCALAR_FLOAT64_IEEE 3.5e+305 Inverters_Data_CM_double -1.7e+308 1.7e+308 DISPLAY_IDENTIFIER Inverters_Data.IL1.Bit_ct.Value /end CHARACTERISTIC
/begin CHARACTERISTIC Inverters_Data_P.Bitct_Value_h "" VALUE 0x0 SCALAR_FLOAT64_IEEE 3.5e+305 Inverters_Data_CM_double -1.7e+308 1.7e+308 DISPLAY_IDENTIFIER Inverters_Data.IL.Bit_ct.Value /end CHARACTERISTIC
/begin CHARACTERISTIC Inverters_Data_P.C1_Value "" VALUE 0x0 SCALAR_FLOAT64_IEEE 3.5e+305 Inverters_Data_CM_double -1.7e+308 1.7e+308 DISPLAY_IDENTIFIER Inverters_Data.Subsystem4.C1.Value /end CHARACTERISTIC
/begin CHARACTERISTIC Inverters_Data_P.C1_Value_d "" VALUE 0x0 SCALAR_FLOAT64_IEEE 3.5e+305 Inverters_Data_CM_double -1.7e+308 1.7e+308 DISPLAY_IDENTIFIER Inverters_Data.Subsystem6.C1.Value /end CHARACTERISTIC
/begin CHARACTERISTIC Inverters_Data_P.C1_Value_n "" VALUE 0x0 SCALAR_FLOAT64_IEEE 3.5e+305 Inverters_Data_CM_double -1.7e+308 1.7e+308 DISPLAY_IDENTIFIER Inverters_Data.Subsystem5.C1.Value /end CHARACTERISTIC
/begin CHARACTERISTIC Inverters_Data_P.C1_Value_n0 "" VALUE 0x0 SCALAR_FLOAT64_IEEE 3.5e+305 Inverters_Data_CM_double -1.7e+308 1.7e+308 DISPLAY_IDENTIFIER Inverters_Data.Subsystem7.C1.Value /end CHARACTERISTIC
/begin CHARACTERISTIC Inverters_Data_P.Constant1_Value "" VALUE 0x0 SCALAR_FLOAT64_IEEE 3.5e+305 Inverters_Data_CM_double -1.7e+308 1.7e+308 DISPLAY_IDENTIFIER Inverters_Data.Subsystem4.Constant1.Value /end CHARACTERISTIC
/begin CHARACTERISTIC Inverters_Data_P.Constant1_Value_e "" VALUE 0x0 SCALAR_FLOAT64_IEEE 3.5e+305 Inverters_Data_CM_double -1.7e+308 1.7e+308 DISPLAY_IDENTIFIER Inverters_Data.Subsystem5.Constant1.Value /end CHARACTERISTIC
/begin CHARACTERISTIC Inverters_Data_P.D1_Value "" VALUE 0x0 SCALAR_FLOAT64_IEEE 3.5e+305 Inverters_Data_CM_double -1.7e+308 1.7e+308 DISPLAY_IDENTIFIER Inverters_Data.Subsystem4.D1.Value /end CHARACTERISTIC
/begin CHARACTERISTIC Inverters_Data_P.D1_Value_d "" VALUE 0x0 SCALAR_FLOAT64_IEEE 3.5e+305 Inverters_Data_CM_double -1.7e+308 1.7e+308 DISPLAY_IDENTIFIER Inverters_Data.Subsystem6.D1.Value /end CHARACTERISTIC
/begin CHARACTERISTIC Inverters_Data_P.D1_Value_f "" VALUE 0x0 SCALAR_FLOAT64_IEEE 3.5e+305 Inverters_Data_CM_double -1.7e+308 1.7e+308 DISPLAY_IDENTIFIER Inverters_Data.Subsystem5.D1.Value /end CHARACTERISTIC
/begin CHARACTERISTIC Inverters_Data_P.D1_Value_j "" VALUE 0x0 SCALAR_FLOAT64_IEEE 3.5e+305 Inverters_Data_CM_double -1.7e+308 1.7e+308 DISPLAY_IDENTIFIER Inverters_Data.Subsystem7.D1.Value /end CHARACTERISTIC
/begin CHARACTERISTIC Inverters_Data_P.Diameterm_Gain "" VALUE 0x0 SCALAR_FLOAT64_IEEE 3.5e+305 Inverters_Data_CM_double -1.7e+308 1.7e+308 DISPLAY_IDENTIFIER Inverters_Data.Subsystem2.Wheel.Diameter_[m].Gain /end CHARACTERISTIC
/begin CHARACTERISTIC Inverters_Data_P.Diameterm_Gain_p "" VALUE 0x0 SCALAR_FLOAT64_IEEE 3.5e+305 Inverters_Data_CM_double -1.7e+308 1.7e+308 DISPLAY_IDENTIFIER Inverters_Data.Subsystem1.Wheel.Diameter_[m].Gain /end CHARACTERISTIC
/begin CHARACTERISTIC Inverters_Data_P.Gain_Gain "" VALUE 0x0 SCALAR_FLOAT64_IEEE 3.5e+305 Inverters_Data_CM_double -1.7e+308 1.7e+308 DISPLAY_IDENTIFIER Inverters_Data.Subsystem2.Transmission.Gain.Gain /end CHARACTERISTIC
/begin CHARACTERISTIC Inverters_Data_P.Gain_Gain_a "" VALUE 0x0 SCALAR_FLOAT64_IEEE 3.5e+305 Inverters_Data_CM_double -1.7e+308 1.7e+308 DISPLAY_IDENTIFIER Inverters_Data.Subsystem1.Transmission.Gain.Gain /end CHARACTERISTIC
/begin CHARACTERISTIC Inverters_Data_P.Gain_Gain_e "" VALUE 0x0 SCALAR_FLOAT64_IEEE 3.5e+305 Inverters_Data_CM_double -1.7e+308 1.7e+308 DISPLAY_IDENTIFIER Inverters_Data.Subsystem.Gain.Gain /end CHARACTERISTIC
/begin CHARACTERISTIC Inverters_Data_P.Gain_Gain_f "" VALUE 0x0 SCALAR_FLOAT64_IEEE 3.5e+305 Inverters_Data_CM_double -1.7e+308 1.7e+308 DISPLAY_IDENTIFIER Inverters_Data.Subsystem3.Gain.Gain /end CHARACTERISTIC
/begin CHARACTERISTIC Inverters_Data_P.Gain_Gain_m "" VALUE 0x0 SCALAR_FLOAT64_IEEE 3.5e+305 Inverters_Data_CM_double -1.7e+308 1.7e+308 DISPLAY_IDENTIFIER Inverters_Data.Average.Gain.Gain /end CHARACTERISTIC
/begin CHARACTERISTIC Inverters_Data_P.MaxRPM_Value "" VALUE 0x0 SCALAR_FLOAT64_IEEE 3.5e+305 Inverters_Data_CM_double -1.7e+308 1.7e+308 DISPLAY_IDENTIFIER Inverters_Data.IL1.Max_RPM.Value /end CHARACTERISTIC
/begin CHARACTERISTIC Inverters_Data_P.MaxRPM_Value_m "" VALUE 0x0 SCALAR_FLOAT64_IEEE 3.5e+305 Inverters_Data_CM_double -1.7e+308 1.7e+308 DISPLAY_IDENTIFIER Inverters_Data.IL.Max_RPM.Value /end CHARACTERISTIC
/begin CHARACTERISTIC Inverters_Data_P.conversionratio1_Gain "" VALUE 0x0 SCALAR_FLOAT64_IEEE 3.5e+305 Inverters_Data_CM_double -1.7e+308 1.7e+308 DISPLAY_IDENTIFIER Inverters_Data.IL2.conversion_ratio1.Gain /end CHARACTERISTIC
/begin CHARACTERISTIC Inverters_Data_P.conversionratio_Gain "" VALUE 0x0 SCALAR_FLOAT64_IEEE 3.5e+305 Inverters_Data_CM_double -1.7e+308 1.7e+308 DISPLAY_IDENTIFIER Inverters_Data.IL_4.conversion_ratio.Gain /end CHARACTERISTIC
/begin CHARACTERISTIC Inverters_Data_P.conversionratio_Gain_c "" VALUE 0x0 SCALAR_FLOAT64_IEEE 3.5e+305 Inverters_Data_CM_double -1.7e+308 1.7e+308 DISPLAY_IDENTIFIER Inverters_Data.IL_2.conversion_ratio.Gain /end CHARACTERISTIC
/begin CHARACTERISTIC Inverters_Data_P.conversionratio_Gain_j "" VALUE 0x0 SCALAR_FLOAT64_IEEE 3.5e+305 Inverters_Data_CM_double -1.7e+308 1.7e+308 DISPLAY_IDENTIFIER Inverters_Data.IL_1.conversion_ratio.Gain /end CHARACTERISTIC
/begin CHARACTERISTIC Inverters_Data_P.conversionratio_Gain_k "" VALUE 0x0 SCALAR_FLOAT64_IEEE 3.5e+305 Inverters_Data_CM_double -1.7e+308 1.7e+308 DISPLAY_IDENTIFIER Inverters_Data.IL_3.conversion_ratio.Gain /end CHARACTERISTIC
/begin CHARACTERISTIC Inverters_Data_P.conversionratio_Gain_o "" VALUE 0x0 SCALAR_FLOAT64_IEEE 3.5e+305 Inverters_Data_CM_double -1.7e+308 1.7e+308 DISPLAY_IDENTIFIER Inverters_Data.IL_5.conversion_ratio.Gain /end CHARACTERISTIC
/begin CHARACTERISTIC Inverters_Data_P.direction_Gain "" VALUE 0x0 SCALAR_FLOAT64_IEEE 3.5e+305 Inverters_Data_CM_double -1.7e+308 1.7e+308 DISPLAY_IDENTIFIER Inverters_Data.IL1.direction.Gain /end CHARACTERISTIC
/begin CHARACTERISTIC Inverters_Data_P.direction_Gain_f "" VALUE 0x0 SCALAR_FLOAT64_IEEE 3.5e+305 Inverters_Data_CM_double -1.7e+308 1.7e+308 DISPLAY_IDENTIFIER Inverters_Data.IL.direction.Gain /end CHARACTERISTIC
/begin CHARACTERISTIC Inverters_Data_P.ratio_Gain "" VALUE 0x0 SCALAR_FLOAT64_IEEE 3.5e+305 Inverters_Data_CM_double -1.7e+308 1.7e+308 DISPLAY_IDENTIFIER Inverters_Data.Subsystem2.m__s_to_km__h.ratio.Gain /end CHARACTERISTIC
/begin CHARACTERISTIC Inverters_Data_P.ratio_Gain_k "" VALUE 0x0 SCALAR_FLOAT64_IEEE 3.5e+305 Inverters_Data_CM_double -1.7e+308 1.7e+308 DISPLAY_IDENTIFIER Inverters_Data.Subsystem1.m__s_to_km__h.ratio.Gain /end CHARACTERISTIC
/begin CHARACTERISTIC Inverters_Data_P.upi60_Gain "" VALUE 0x0 SCALAR_FLOAT64_IEEE 3.5e+305 Inverters_Data_CM_double -1.7e+308 1.7e+308 DISPLAY_IDENTIFIER Inverters_Data.Subsystem2.RPM_to_rad__s.2_pi__60.Gain /end CHARACTERISTIC
/begin CHARACTERISTIC Inverters_Data_P.upi60_Gain_i "" VALUE 0x0 SCALAR_FLOAT64_IEEE 3.5e+305 Inverters_Data_CM_double -1.7e+308 1.7e+308 DISPLAY_IDENTIFIER Inverters_Data.Subsystem1.RPM_to_rad__s.2_pi__60.Gain /end CHARACTERISTIC
/begin MEASUREMENT Inverters_Data_U.Inv_L_RegID_M235_Inv_L_DCBus "" FLOAT64_IEEE Inverters_Data_CM_double 0 0 -1.7e+308 1.7e+308 ECU_ADDRESS 0x0 DISPLAY_IDENTIFIER Inverters_Data.Inv_L_RegID_M235_Inv_L_DCBus /end MEASUREMENT
/begin MEASUREMENT Inverters_Data_U.Inv_L_RegID_M32_Inv_L_Iactual "" FLOAT64_IEEE Inverters_Data_CM_double 0 0 -1.7e+308 1.7e+308 ECU_ADDRESS 0x0 DISPLAY_IDENTIFIER Inverters_Data.Inv_L_RegID_M32_Inv_L_Iactual /end MEASUREMENT
/begin MEASUREMENT Inverters_Data_U.Inv_L_RegID_M38_Inv_L_Icommand "" FLOAT64_IEEE Inverters_Data_CM_double 0 0 -1.7e+308 1.7e+308 ECU_ADDRESS 0x0 DISPLAY_IDENTIFIER Inverters_Data.Inv_L_RegID_M38_Inv_L_Icommand /end MEASUREMENT
/begin MEASUREMENT Inverters_Data_U.Inv_L_RegID_M39_Inv_L_Iq "" FLOAT64_IEEE Inverters_Data_CM_double 0 0 -1.7e+308 1.7e+308 ECU_ADDRESS 0x0 DISPLAY_IDENTIFIER Inverters_Data.Inv_L_RegID_M39_Inv_L_Iq /end MEASUREMENT
/begin MEASUREMENT Inverters_Data_U.Inv_L_RegID_M48_Inv_L_Speed "" FLOAT64_IEEE Inverters_Data_CM_double 0 0 -1.7e+308 1.7e+308 ECU_ADDRESS 0x0 DISPLAY_IDENTIFIER Inverters_Data.Inv_L_RegID_M48_Inv_L_Speed /end MEASUREMENT
/begin MEASUREMENT Inverters_Data_U.Inv_L_RegID_M73_Inv_L_TempMotor "" FLOAT64_IEEE Inverters_Data_CM_double 0 0 -1.7e+308 1.7e+308 ECU_ADDRESS 0x0 DISPLAY_IDENTIFIER Inverters_Data.Inv_L_RegID_M73_Inv_L_TempMotor /end MEASUREMENT
/begin MEASUREMENT Inverters_Data_U.Inv_L_RegID_M74_Inv_L_TempIGBT "" FLOAT64_IEEE Inverters_Data_CM_double 0 0 -1.7e+308 1.7e+308 ECU_ADDRESS 0x0 DISPLAY_IDENTIFIER Inverters_Data.Inv_L_RegID_M74_Inv_L_TempIGBT /end MEASUREMENT
/begin MEASUREMENT Inverters_Data_U.Inv_R_RegID_M235_Inv_R_DCBus "" FLOAT64_IEEE Inverters_Data_CM_double 0 0 -1.7e+308 1.7e+308 ECU_ADDRESS 0x0 DISPLAY_IDENTIFIER Inverters_Data.Inv_R_RegID_M235_Inv_R_DCBus /end MEASUREMENT
/begin MEASUREMENT Inverters_Data_U.Inv_R_RegID_M32_Inv_R_Iactual "" FLOAT64_IEEE Inverters_Data_CM_double 0 0 -1.7e+308 1.7e+308 ECU_ADDRESS 0x0 DISPLAY_IDENTIFIER Inverters_Data.Inv_R_RegID_M32_Inv_R_Iactual /end MEASUREMENT
/begin MEASUREMENT Inverters_Data_U.Inv_R_RegID_M38_Inv_R_Icommand "" FLOAT64_IEEE Inverters_Data_CM_double 0 0 -1.7e+308 1.7e+308 ECU_ADDRESS 0x0 DISPLAY_IDENTIFIER Inverters_Data.Inv_R_RegID_M38_Inv_R_Icommand /end MEASUREMENT
/begin MEASUREMENT Inverters_Data_U.Inv_R_RegID_M39_Inv_R_Iq "" FLOAT64_IEEE Inverters_Data_CM_double 0 0 -1.7e+308 1.7e+308 ECU_ADDRESS 0x0 DISPLAY_IDENTIFIER Inverters_Data.Inv_R_RegID_M39_Inv_R_Iq /end MEASUREMENT
/begin MEASUREMENT Inverters_Data_U.Inv_R_RegID_M48_Inv_R_Speed "" FLOAT64_IEEE Inverters_Data_CM_double 0 0 -1.7e+308 1.7e+308 ECU_ADDRESS 0x0 DISPLAY_IDENTIFIER Inverters_Data.Inv_R_RegID_M48_Inv_R_Speed /end MEASUREMENT
/begin MEASUREMENT Inverters_Data_U.Inv_R_RegID_M73_Inv_R_TempMotor "" FLOAT64_IEEE Inverters_Data_CM_double 0 0 -1.7e+308 1.7e+308 ECU_ADDRESS 0x0 DISPLAY_IDENTIFIER Inverters_Data.Inv_R_RegID_M73_Inv_R_TempMotor /end MEASUREMENT
/begin MEASUREMENT Inverters_Data_U.Inv_R_RegID_M74_Inv_R_TempIGBT "" FLOAT64_IEEE Inverters_Data_CM_double 0 0 -1.7e+308 1.7e+308 ECU_ADDRESS 0x0 DISPLAY_IDENTIFIER Inverters_Data.Inv_R_RegID_M74_Inv_R_TempIGBT /end MEASUREMENT
/begin MEASUREMENT Inverters_Data_U.Torque_L "" FLOAT64_IEEE Inverters_Data_CM_double 0 0 -1.7e+308 1.7e+308 ECU_ADDRESS 0x0 DISPLAY_IDENTIFIER Inverters_Data.Torque_L /end MEASUREMENT
/begin MEASUREMENT Inverters_Data_U.Torque_R "" FLOAT64_IEEE Inverters_Data_CM_double 0 0 -1.7e+308 1.7e+308 ECU_ADDRESS 0x0 DISPLAY_IDENTIFIER Inverters_Data.Torque_R /end MEASUREMENT
/begin MEASUREMENT Inverters_Data_Y.Inv_L_Iactual "" FLOAT64_IEEE Inverters_Data_CM_double 0 0 -1.7e+308 1.7e+308 ECU_ADDRESS 0x0 DISPLAY_IDENTIFIER Inverters_Data.Inv_L_Iactual /end MEASUREMENT
/begin MEASUREMENT Inverters_Data_Y.Inv_L_Icommand "" FLOAT64_IEEE Inverters_Data_CM_double 0 0 -1.7e+308 1.7e+308 ECU_ADDRESS 0x0 DISPLAY_IDENTIFIER Inverters_Data.Inv_L_Icommand /end MEASUREMENT
/begin MEASUREMENT Inverters_Data_Y.Inv_L_Iq "" FLOAT64_IEEE Inverters_Data_CM_double 0 0 -1.7e+308 1.7e+308 ECU_ADDRESS 0x0 DISPLAY_IDENTIFIER Inverters_Data.Inv_L_Iq /end MEASUREMENT
/begin MEASUREMENT Inverters_Data_Y.Inv_L_Speed "" FLOAT64_IEEE Inverters_Data_CM_double 0 0 -1.7e+308 1.7e+308 ECU_ADDRESS 0x0 DISPLAY_IDENTIFIER Inverters_Data.Inv_L_Speed /end MEASUREMENT
/begin MEASUREMENT Inverters_Data_Y.Inv_L_TempIGBT "" FLOAT64_IEEE Inverters_Data_CM_double 0 0 -1.7e+308 1.7e+308 ECU_ADDRESS 0x0 DISPLAY_IDENTIFIER Inverters_Data.Inv_L_TempIGBT /end MEASUREMENT
/begin MEASUREMENT Inverters_Data_Y.Inv_L_TempMotor "" FLOAT64_IEEE Inverters_Data_CM_double 0 0 -1.7e+308 1.7e+308 ECU_ADDRESS 0x0 DISPLAY_IDENTIFIER Inverters_Data.Inv_L_TempMotor /end MEASUREMENT
/begin MEASUREMENT Inverters_Data_Y.Inv_L_VdcBus "" FLOAT64_IEEE Inverters_Data_CM_double 0 0 -1.7e+308 1.7e+308 ECU_ADDRESS 0x0 DISPLAY_IDENTIFIER Inverters_Data.Inv_L_VdcBus /end MEASUREMENT
/begin MEASUREMENT Inverters_Data_Y.Inv_R_Iactual "" FLOAT64_IEEE Inverters_Data_CM_double 0 0 -1.7e+308 1.7e+308 ECU_ADDRESS 0x0 DISPLAY_IDENTIFIER Inverters_Data.Inv_R_Iactual /end MEASUREMENT
/begin MEASUREMENT Inverters_Data_Y.Inv_R_Icommand "" FLOAT64_IEEE Inverters_Data_CM_double 0 0 -1.7e+308 1.7e+308 ECU_ADDRESS 0x0 DISPLAY_IDENTIFIER Inverters_Data.Inv_R_Icommand /end MEASUREMENT
/begin MEASUREMENT Inverters_Data_Y.Inv_R_Iq "" FLOAT64_IEEE Inverters_Data_CM_double 0 0 -1.7e+308 1.7e+308 ECU_ADDRESS 0x0 DISPLAY_IDENTIFIER Inverters_Data.Inv_R_Iq /end MEASUREMENT
/begin MEASUREMENT Inverters_Data_Y.Inv_R_Speed "" FLOAT64_IEEE Inverters_Data_CM_double 0 0 -1.7e+308 1.7e+308 ECU_ADDRESS 0x0 DISPLAY_IDENTIFIER Inverters_Data.Inv_R_Speed /end MEASUREMENT
/begin MEASUREMENT Inverters_Data_Y.Inv_R_TempIGBT "" FLOAT64_IEEE Inverters_Data_CM_double 0 0 -1.7e+308 1.7e+308 ECU_ADDRESS 0x0 DISPLAY_IDENTIFIER Inverters_Data.Inv_R_TempIGBT /end MEASUREMENT
/begin MEASUREMENT Inverters_Data_Y.Inv_R_TempMotor "" FLOAT64_IEEE Inverters_Data_CM_double 0 0 -1.7e+308 1.7e+308 ECU_ADDRESS 0x0 DISPLAY_IDENTIFIER Inverters_Data.Inv_R_TempMotor /end MEASUREMENT
/begin MEASUREMENT Inverters_Data_Y.Inv_R_VdcBus "" FLOAT64_IEEE Inverters_Data_CM_double 0 0 -1.7e+308 1.7e+308 ECU_ADDRESS 0x0 DISPLAY_IDENTIFIER Inverters_Data.Inv_R_VdcBus /end MEASUREMENT
/begin MEASUREMENT Inverters_Data_Y.InvertersMinDCBus "" FLOAT64_IEEE Inverters_Data_CM_double 0 0 -1.7e+308 1.7e+308 ECU_ADDRESS 0x0 DISPLAY_IDENTIFIER Inverters_Data.InvertersMinDCBus /end MEASUREMENT
/begin MEASUREMENT Inverters_Data_Y.Mech_Power "" FLOAT64_IEEE Inverters_Data_CM_double 0 0 -1.7e+308 1.7e+308 ECU_ADDRESS 0x0 DISPLAY_IDENTIFIER Inverters_Data.Mech_Power /end MEASUREMENT
/begin MEASUREMENT Inverters_Data_Y.RL_rads "" FLOAT64_IEEE Inverters_Data_CM_double 0 0 -1.7e+308 1.7e+308 ECU_ADDRESS 0x0 DISPLAY_IDENTIFIER Inverters_Data.RL_rads /end MEASUREMENT
/begin MEASUREMENT Inverters_Data_Y.RR_rads "" FLOAT64_IEEE Inverters_Data_CM_double 0 0 -1.7e+308 1.7e+308 ECU_ADDRESS 0x0 DISPLAY_IDENTIFIER Inverters_Data.RR_rads /end MEASUREMENT
/begin MEASUREMENT Inverters_Data_Y.Speed "" FLOAT64_IEEE Inverters_Data_CM_double 0 0 -1.7e+308 1.7e+308 ECU_ADDRESS 0x0 DISPLAY_IDENTIFIER Inverters_Data.Speed /end MEASUREMENT
/begin MEASUREMENT Inverters_Data_Y.Temp_IGBT "" FLOAT64_IEEE Inverters_Data_CM_double 0 0 -1.7e+308 1.7e+308 ECU_ADDRESS 0x0 DISPLAY_IDENTIFIER Inverters_Data.Temp_IGBT /end MEASUREMENT
/begin MEASUREMENT Inverters_Data_Y.Temp_Motors "" FLOAT64_IEEE Inverters_Data_CM_double 0 0 -1.7e+308 1.7e+308 ECU_ADDRESS 0x0 DISPLAY_IDENTIFIER Inverters_Data.Temp_Motors /end MEASUREMENT
/begin MEASUREMENT Inverters_Data_Y.Vel_RL_kmh "" FLOAT64_IEEE Inverters_Data_CM_double 0 0 -1.7e+308 1.7e+308 ECU_ADDRESS 0x0 DISPLAY_IDENTIFIER Inverters_Data.Vel_RL_kmh /end MEASUREMENT
/begin MEASUREMENT Inverters_Data_Y.Vel_RR_kmh "" FLOAT64_IEEE Inverters_Data_CM_double 0 0 -1.7e+308 1.7e+308 ECU_ADDRESS 0x0 DISPLAY_IDENTIFIER Inverters_Data.Vel_RR_kmh /end MEASUREMENT
/end MODULE
/* Inverters_Data */
/end PROJECT
