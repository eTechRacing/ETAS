ASAP2_VERSION
/begin PROJECT "Generated by ETAS from INTECRIO integration project"
/begin HEADER "" VERSION "" PROJECT_NO Y /end HEADER
/begin MODULE VDCv2mk2 "Generated by ETAS from INTECRIO integration project"
/begin MOD_PAR "" VERSION "" ADDR_EPK 0x0 EPK "" SUPPLIER "ETAS GmbH" CUSTOMER "" CUSTOMER_NO "" USER "" PHONE_NO "" ECU "NO_ECU" CPU_TYPE "MPC750" NO_OF_INTERFACES 1 /end MOD_PAR
/begin MOD_COMMON "Common definitions" BYTE_ORDER MSB_FIRST ALIGNMENT_BYTE 1 ALIGNMENT_WORD 2 ALIGNMENT_LONG 4 ALIGNMENT_FLOAT32_IEEE 4 ALIGNMENT_FLOAT64_IEEE 8 /end MOD_COMMON
/begin MEASUREMENT VDCv2mk2_B.Merge "" FLOAT64_IEEE VDCv2mk2_CM_double 0 0 -1.7e+308 1.7e+308 ECU_ADDRESS 0x0 DISPLAY_IDENTIFIER VDCv2mk2.ENDURANCE.Merge.Merge /end MEASUREMENT
/begin COMPU_METHOD VDCv2mk2_CM_double "Q = V" /* ConversionType */ RAT_FUNC /* Format */ "%9.6" /* Unit */ "NO_PHYSICAL_QTY" COEFFS 0.0 1.0 0.0 0.0 0.0 1.0 /end COMPU_METHOD
/begin MEASUREMENT VDCv2mk2_B.Merge1 "" FLOAT64_IEEE VDCv2mk2_CM_double 0 0 -1.7e+308 1.7e+308 ECU_ADDRESS 0x0 DISPLAY_IDENTIFIER VDCv2mk2.Merge1.Merge1 /end MEASUREMENT
/begin MEASUREMENT VDCv2mk2_B.Merge1_f "" FLOAT64_IEEE VDCv2mk2_CM_double 0 0 -1.7e+308 1.7e+308 ECU_ADDRESS 0x0 DISPLAY_IDENTIFIER VDCv2mk2.ENDURANCE.Merge1.Merge1_f /end MEASUREMENT
/begin MEASUREMENT VDCv2mk2_B.Merge2 "" FLOAT64_IEEE VDCv2mk2_CM_double 0 0 -1.7e+308 1.7e+308 ECU_ADDRESS 0x0 DISPLAY_IDENTIFIER VDCv2mk2.Merge2.Merge2 /end MEASUREMENT
/begin MEASUREMENT VDCv2mk2_B.Merge2_l "" FLOAT64_IEEE VDCv2mk2_CM_double 0 0 -1.7e+308 1.7e+308 ECU_ADDRESS 0x0 DISPLAY_IDENTIFIER VDCv2mk2.ENDURANCE.Merge2.Merge2_l /end MEASUREMENT
/begin MEASUREMENT VDCv2mk2_B.Merge3 "" FLOAT64_IEEE VDCv2mk2_CM_double 0 0 -1.7e+308 1.7e+308 ECU_ADDRESS 0x0 DISPLAY_IDENTIFIER VDCv2mk2.Merge3.Merge3 /end MEASUREMENT
/begin MEASUREMENT VDCv2mk2_B.Merge3_n "" FLOAT64_IEEE VDCv2mk2_CM_double 0 0 -1.7e+308 1.7e+308 ECU_ADDRESS 0x0 DISPLAY_IDENTIFIER VDCv2mk2.ENDURANCE.Merge3.Merge3_n /end MEASUREMENT
/begin MEASUREMENT VDCv2mk2_B.Merge4 "" FLOAT64_IEEE VDCv2mk2_CM_double 0 0 -1.7e+308 1.7e+308 ECU_ADDRESS 0x0 DISPLAY_IDENTIFIER VDCv2mk2.Merge4.Merge4 /end MEASUREMENT
/begin MEASUREMENT VDCv2mk2_B.sf_MATLABFunction.Torque_L_Nm "" FLOAT64_IEEE VDCv2mk2_CM_double 0 0 -1.7e+308 1.7e+308 ECU_ADDRESS 0x0 DISPLAY_IDENTIFIER VDCv2mk2.SKIDPAD.TC_TV.MATLAB_Function.Torque_L_Nm /end MEASUREMENT
/begin MEASUREMENT VDCv2mk2_B.sf_MATLABFunction.Torque_R_Nm "" FLOAT64_IEEE VDCv2mk2_CM_double 0 0 -1.7e+308 1.7e+308 ECU_ADDRESS 0x0 DISPLAY_IDENTIFIER VDCv2mk2.SKIDPAD.TC_TV.MATLAB_Function.Torque_R_Nm /end MEASUREMENT
/begin MEASUREMENT VDCv2mk2_B.sf_MATLABFunction_a.Torque_L_Nm "" FLOAT64_IEEE VDCv2mk2_CM_double 0 0 -1.7e+308 1.7e+308 ECU_ADDRESS 0x0 DISPLAY_IDENTIFIER VDCv2mk2.SKIDPAD.TV_with_TC_OFF.MATLAB_Function.Torque_L_Nm /end MEASUREMENT
/begin MEASUREMENT VDCv2mk2_B.sf_MATLABFunction_a.Torque_R_Nm "" FLOAT64_IEEE VDCv2mk2_CM_double 0 0 -1.7e+308 1.7e+308 ECU_ADDRESS 0x0 DISPLAY_IDENTIFIER VDCv2mk2.SKIDPAD.TV_with_TC_OFF.MATLAB_Function.Torque_R_Nm /end MEASUREMENT
/begin MEASUREMENT VDCv2mk2_B.sf_Torquedemandedbythedriver_a.Throttle_Torque "" FLOAT64_IEEE VDCv2mk2_CM_double 0 0 -1.7e+308 1.7e+308 ECU_ADDRESS 0x0 DISPLAY_IDENTIFIER VDCv2mk2.AUTOX1.Torque_demanded_by_the_driver.Throttle_Torque /end MEASUREMENT
/begin MEASUREMENT VDCv2mk2_B.sf_Torquedemandedbythedriver_k.Throttle_Torque "" FLOAT64_IEEE VDCv2mk2_CM_double 0 0 -1.7e+308 1.7e+308 ECU_ADDRESS 0x0 DISPLAY_IDENTIFIER VDCv2mk2.ACCELERATION.Torque_demanded_by_the_driver.Throttle_Torque /end MEASUREMENT
/begin MEASUREMENT VDCv2mk2_B.sf_Torquedemandedbythedriver_m.Throttle_Torque "" FLOAT64_IEEE VDCv2mk2_CM_double 0 0 -1.7e+308 1.7e+308 ECU_ADDRESS 0x0 DISPLAY_IDENTIFIER VDCv2mk2.SKIDPAD.Torque_demanded_by_the_driver.Throttle_Torque /end MEASUREMENT
/begin MEASUREMENT VDCv2mk2_B.state "" FLOAT64_IEEE VDCv2mk2_CM_double 0 0 -1.7e+308 1.7e+308 ECU_ADDRESS 0x0 DISPLAY_IDENTIFIER VDCv2mk2.ENDURANCE.Torque.state.state /end MEASUREMENT
/begin MEASUREMENT VDCv2mk2_DW.A "" FLOAT64_IEEE VDCv2mk2_CM_double 0 0 -1.7e+308 1.7e+308 ECU_ADDRESS 0x0 DISPLAY_IDENTIFIER VDCv2mk2.Accumulator_Power.PowerLimitDetection.Data_Store_Memory10.A /end MEASUREMENT
/begin MEASUREMENT VDCv2mk2_DW.ERROR_Counter "" FLOAT64_IEEE VDCv2mk2_CM_double 0 0 -1.7e+308 1.7e+308 ECU_ADDRESS 0x0 DISPLAY_IDENTIFIER VDCv2mk2.SAFETY_BLOCK.APPS_IMPLAUSIBILITY.Data_Store_Memory1.ERROR_Counter /end MEASUREMENT
/begin MEASUREMENT VDCv2mk2_U.APPS1_Value "" FLOAT64_IEEE VDCv2mk2_CM_double 0 0 -1.7e+308 1.7e+308 ECU_ADDRESS 0x0 DISPLAY_IDENTIFIER VDCv2mk2.APPS1_Value /end MEASUREMENT
/begin MEASUREMENT VDCv2mk2_U.APPS2_Value "" FLOAT64_IEEE VDCv2mk2_CM_double 0 0 -1.7e+308 1.7e+308 ECU_ADDRESS 0x0 DISPLAY_IDENTIFIER VDCv2mk2.APPS2_Value /end MEASUREMENT
/begin MEASUREMENT VDCv2mk2_U.Accumulator_Current "" FLOAT64_IEEE VDCv2mk2_CM_double 0 0 -1.7e+308 1.7e+308 ECU_ADDRESS 0x0 DISPLAY_IDENTIFIER VDCv2mk2.Accumulator_Current /end MEASUREMENT
/begin MEASUREMENT VDCv2mk2_U.Accumulator_Voltage "" FLOAT64_IEEE VDCv2mk2_CM_double 0 0 -1.7e+308 1.7e+308 ECU_ADDRESS 0x0 DISPLAY_IDENTIFIER VDCv2mk2.Accumulator_Voltage /end MEASUREMENT
/begin MEASUREMENT VDCv2mk2_U.BrakePedal_Value "" FLOAT64_IEEE VDCv2mk2_CM_double 0 0 -1.7e+308 1.7e+308 ECU_ADDRESS 0x0 DISPLAY_IDENTIFIER VDCv2mk2.BrakePedal_Value /end MEASUREMENT
/begin MEASUREMENT VDCv2mk2_U.Car_State "" FLOAT64_IEEE VDCv2mk2_CM_double 0 0 -1.7e+308 1.7e+308 ECU_ADDRESS 0x0 DISPLAY_IDENTIFIER VDCv2mk2.Car_State /end MEASUREMENT
/begin MEASUREMENT VDCv2mk2_U.CriticalDisconnection "" UBYTE VDCv2mk2_CM_boolean 0 0 0 1 ECU_ADDRESS 0x0 DISPLAY_IDENTIFIER VDCv2mk2.CriticalDisconnection /end MEASUREMENT
/begin COMPU_METHOD VDCv2mk2_CM_boolean "Q = V" /* ConversionType */ RAT_FUNC /* Format */ "%9.6" /* Unit */ "NO_PHYSICAL_QTY" COEFFS 0.0 1.0 0.0 0.0 0.0 1.0 /end COMPU_METHOD
/begin MEASUREMENT VDCv2mk2_U.Disconnection_Mode "" FLOAT64_IEEE VDCv2mk2_CM_double 0 0 -1.7e+308 1.7e+308 ECU_ADDRESS 0x0 DISPLAY_IDENTIFIER VDCv2mk2.Disconnection_Mode /end MEASUREMENT
/begin MEASUREMENT VDCv2mk2_U.RL_Vel_ms_Wheel "" FLOAT64_IEEE VDCv2mk2_CM_double 0 0 -1.7e+308 1.7e+308 ECU_ADDRESS 0x0 DISPLAY_IDENTIFIER VDCv2mk2.RL_Vel_ms_Wheel /end MEASUREMENT
/begin MEASUREMENT VDCv2mk2_U.RL_rads_Motor "" FLOAT64_IEEE VDCv2mk2_CM_double 0 0 -1.7e+308 1.7e+308 ECU_ADDRESS 0x0 DISPLAY_IDENTIFIER VDCv2mk2.RL_rads_Motor /end MEASUREMENT
/begin MEASUREMENT VDCv2mk2_U.RR_Vel_ms_Wheel "" FLOAT64_IEEE VDCv2mk2_CM_double 0 0 -1.7e+308 1.7e+308 ECU_ADDRESS 0x0 DISPLAY_IDENTIFIER VDCv2mk2.RR_Vel_ms_Wheel /end MEASUREMENT
/begin MEASUREMENT VDCv2mk2_U.RR_rads_Motor "" FLOAT64_IEEE VDCv2mk2_CM_double 0 0 -1.7e+308 1.7e+308 ECU_ADDRESS 0x0 DISPLAY_IDENTIFIER VDCv2mk2.RR_rads_Motor /end MEASUREMENT
/begin MEASUREMENT VDCv2mk2_U.RacingMode "" FLOAT64_IEEE VDCv2mk2_CM_double 0 0 -1.7e+308 1.7e+308 ECU_ADDRESS 0x0 DISPLAY_IDENTIFIER VDCv2mk2.RacingMode /end MEASUREMENT
/begin MEASUREMENT VDCv2mk2_U.Shutdown_PackageIntck "" UBYTE VDCv2mk2_CM_boolean 0 0 0 1 ECU_ADDRESS 0x0 DISPLAY_IDENTIFIER VDCv2mk2.Shutdown_PackageIntck /end MEASUREMENT
/begin MEASUREMENT VDCv2mk2_U.SoC_High "" FLOAT64_IEEE VDCv2mk2_CM_double 0 0 -1.7e+308 1.7e+308 ECU_ADDRESS 0x0 DISPLAY_IDENTIFIER VDCv2mk2.SoC_High /end MEASUREMENT
/begin MEASUREMENT VDCv2mk2_U.SteeringSensor_Value "" FLOAT64_IEEE VDCv2mk2_CM_double 0 0 -1.7e+308 1.7e+308 ECU_ADDRESS 0x0 DISPLAY_IDENTIFIER VDCv2mk2.SteeringSensor_Value /end MEASUREMENT
/begin MEASUREMENT VDCv2mk2_U.Susp_F_L "" FLOAT64_IEEE VDCv2mk2_CM_double 0 0 -1.7e+308 1.7e+308 ECU_ADDRESS 0x0 DISPLAY_IDENTIFIER VDCv2mk2.Susp_F_L /end MEASUREMENT
/begin MEASUREMENT VDCv2mk2_U.Susp_F_R "" FLOAT64_IEEE VDCv2mk2_CM_double 0 0 -1.7e+308 1.7e+308 ECU_ADDRESS 0x0 DISPLAY_IDENTIFIER VDCv2mk2.Susp_F_R /end MEASUREMENT
/begin MEASUREMENT VDCv2mk2_U.Susp_R_L "" FLOAT64_IEEE VDCv2mk2_CM_double 0 0 -1.7e+308 1.7e+308 ECU_ADDRESS 0x0 DISPLAY_IDENTIFIER VDCv2mk2.Susp_R_L /end MEASUREMENT
/begin MEASUREMENT VDCv2mk2_U.Susp_R_R "" FLOAT64_IEEE VDCv2mk2_CM_double 0 0 -1.7e+308 1.7e+308 ECU_ADDRESS 0x0 DISPLAY_IDENTIFIER VDCv2mk2.Susp_R_R /end MEASUREMENT
/begin MEASUREMENT VDCv2mk2_U.TorqueEnable "" UBYTE VDCv2mk2_CM_boolean 0 0 0 1 ECU_ADDRESS 0x0 DISPLAY_IDENTIFIER VDCv2mk2.TorqueEnable /end MEASUREMENT
/begin MEASUREMENT VDCv2mk2_U.el_ACCEL_X "" FLOAT64_IEEE VDCv2mk2_CM_double 0 0 -1.7e+308 1.7e+308 ECU_ADDRESS 0x0 DISPLAY_IDENTIFIER VDCv2mk2.el_ACCEL_X /end MEASUREMENT
/begin MEASUREMENT VDCv2mk2_U.el_ACCEL_Y "" FLOAT64_IEEE VDCv2mk2_CM_double 0 0 -1.7e+308 1.7e+308 ECU_ADDRESS 0x0 DISPLAY_IDENTIFIER VDCv2mk2.el_ACCEL_Y /end MEASUREMENT
/begin MEASUREMENT VDCv2mk2_U.el_ACCEL_Z "" FLOAT64_IEEE VDCv2mk2_CM_double 0 0 -1.7e+308 1.7e+308 ECU_ADDRESS 0x0 DISPLAY_IDENTIFIER VDCv2mk2.el_ACCEL_Z /end MEASUREMENT
/begin MEASUREMENT VDCv2mk2_U.el_GYRO_X "" FLOAT64_IEEE VDCv2mk2_CM_double 0 0 -1.7e+308 1.7e+308 ECU_ADDRESS 0x0 DISPLAY_IDENTIFIER VDCv2mk2.el_GYRO_X /end MEASUREMENT
/begin MEASUREMENT VDCv2mk2_U.el_GYRO_Y "" FLOAT64_IEEE VDCv2mk2_CM_double 0 0 -1.7e+308 1.7e+308 ECU_ADDRESS 0x0 DISPLAY_IDENTIFIER VDCv2mk2.el_GYRO_Y /end MEASUREMENT
/begin MEASUREMENT VDCv2mk2_U.el_GYRO_Z "" FLOAT64_IEEE VDCv2mk2_CM_double 0 0 -1.7e+308 1.7e+308 ECU_ADDRESS 0x0 DISPLAY_IDENTIFIER VDCv2mk2.el_GYRO_Z /end MEASUREMENT
/begin MEASUREMENT VDCv2mk2_U.el_PITCH "" FLOAT64_IEEE VDCv2mk2_CM_double 0 0 -1.7e+308 1.7e+308 ECU_ADDRESS 0x0 DISPLAY_IDENTIFIER VDCv2mk2.el_PITCH /end MEASUREMENT
/begin MEASUREMENT VDCv2mk2_U.el_ROLL "" FLOAT64_IEEE VDCv2mk2_CM_double 0 0 -1.7e+308 1.7e+308 ECU_ADDRESS 0x0 DISPLAY_IDENTIFIER VDCv2mk2.el_ROLL /end MEASUREMENT
/begin MEASUREMENT VDCv2mk2_U.el_SlipAngle "" FLOAT64_IEEE VDCv2mk2_CM_double 0 0 -1.7e+308 1.7e+308 ECU_ADDRESS 0x0 DISPLAY_IDENTIFIER VDCv2mk2.el_SlipAngle /end MEASUREMENT
/begin MEASUREMENT VDCv2mk2_U.el_Vel_X "" FLOAT64_IEEE VDCv2mk2_CM_double 0 0 -1.7e+308 1.7e+308 ECU_ADDRESS 0x0 DISPLAY_IDENTIFIER VDCv2mk2.el_Vel_X /end MEASUREMENT
/begin MEASUREMENT VDCv2mk2_U.el_Vel_Y "" FLOAT64_IEEE VDCv2mk2_CM_double 0 0 -1.7e+308 1.7e+308 ECU_ADDRESS 0x0 DISPLAY_IDENTIFIER VDCv2mk2.el_Vel_Y /end MEASUREMENT
/begin MEASUREMENT VDCv2mk2_U.el_Vel_Z "" FLOAT64_IEEE VDCv2mk2_CM_double 0 0 -1.7e+308 1.7e+308 ECU_ADDRESS 0x0 DISPLAY_IDENTIFIER VDCv2mk2.el_Vel_Z /end MEASUREMENT
/begin MEASUREMENT VDCv2mk2_U.el_YAW "" FLOAT64_IEEE VDCv2mk2_CM_double 0 0 -1.7e+308 1.7e+308 ECU_ADDRESS 0x0 DISPLAY_IDENTIFIER VDCv2mk2.el_YAW /end MEASUREMENT
/begin MEASUREMENT VDCv2mk2_Y.APPS_Implausibility "" FLOAT64_IEEE VDCv2mk2_CM_double 0 0 -1.7e+308 1.7e+308 ECU_ADDRESS 0x0 DISPLAY_IDENTIFIER VDCv2mk2.APPS_Implausibility /end MEASUREMENT
/begin MEASUREMENT VDCv2mk2_Y.BrakeLight_Control "" FLOAT64_IEEE VDCv2mk2_CM_double 0 0 -1.7e+308 1.7e+308 ECU_ADDRESS 0x0 DISPLAY_IDENTIFIER VDCv2mk2.BrakeLight_Control /end MEASUREMENT
/begin MEASUREMENT VDCv2mk2_Y.Power "" FLOAT64_IEEE VDCv2mk2_CM_double 0 0 -1.7e+308 1.7e+308 ECU_ADDRESS 0x0 DISPLAY_IDENTIFIER VDCv2mk2.Power /end MEASUREMENT
/begin MEASUREMENT VDCv2mk2_Y.PowerLimitReached "" FLOAT64_IEEE VDCv2mk2_CM_double 0 0 -1.7e+308 1.7e+308 ECU_ADDRESS 0x0 DISPLAY_IDENTIFIER VDCv2mk2.PowerLimitReached /end MEASUREMENT
/begin MEASUREMENT VDCv2mk2_Y.PowerMean500ms "" FLOAT64_IEEE VDCv2mk2_CM_double 0 0 -1.7e+308 1.7e+308 ECU_ADDRESS 0x0 DISPLAY_IDENTIFIER VDCv2mk2.PowerMean500ms /end MEASUREMENT
/begin MEASUREMENT VDCv2mk2_Y.Regenerative_Enable "" FLOAT64_IEEE VDCv2mk2_CM_double 0 0 -1.7e+308 1.7e+308 ECU_ADDRESS 0x0 DISPLAY_IDENTIFIER VDCv2mk2.Regenerative_Enable /end MEASUREMENT
/begin MEASUREMENT VDCv2mk2_Y.TV_Mode "" FLOAT64_IEEE VDCv2mk2_CM_double 0 0 -1.7e+308 1.7e+308 ECU_ADDRESS 0x0 DISPLAY_IDENTIFIER VDCv2mk2.TV_Mode /end MEASUREMENT
/begin MEASUREMENT VDCv2mk2_Y.Throttle_Torque "" FLOAT64_IEEE VDCv2mk2_CM_double 0 0 -1.7e+308 1.7e+308 ECU_ADDRESS 0x0 DISPLAY_IDENTIFIER VDCv2mk2.Throttle_Torque /end MEASUREMENT
/begin MEASUREMENT VDCv2mk2_Y.Torque_L_out "" FLOAT64_IEEE VDCv2mk2_CM_double 0 0 -1.7e+308 1.7e+308 ECU_ADDRESS 0x0 DISPLAY_IDENTIFIER VDCv2mk2.Torque_L_out /end MEASUREMENT
/begin MEASUREMENT VDCv2mk2_Y.Torque_OK "" FLOAT64_IEEE VDCv2mk2_CM_double 0 0 -1.7e+308 1.7e+308 ECU_ADDRESS 0x0 DISPLAY_IDENTIFIER VDCv2mk2.Torque_OK /end MEASUREMENT
/begin MEASUREMENT VDCv2mk2_Y.Torque_R_out "" FLOAT64_IEEE VDCv2mk2_CM_double 0 0 -1.7e+308 1.7e+308 ECU_ADDRESS 0x0 DISPLAY_IDENTIFIER VDCv2mk2.Torque_R_out /end MEASUREMENT
/begin MEASUREMENT VDCv2mk2_Y.VDC_Max_Tyre_Slip "" FLOAT64_IEEE VDCv2mk2_CM_double 0 0 -1.7e+308 1.7e+308 ECU_ADDRESS 0x0 DISPLAY_IDENTIFIER VDCv2mk2.VDC_Max_Tyre_Slip /end MEASUREMENT
/end MODULE
/* VDCv2mk2 */
/end PROJECT
