/* Generated by INTECRIO ETarget Configurator Plugin */
/* (c) 2004 ETAS (ETAS GmbH) */ ASAP2_VERSION 1 41
/* Version 1.41 */
/begin PROJECT ETC "ETC generated ASAM-2MC description file fragment"
/begin HEADER " " /end HEADER
/begin MOD_PAR " " /end MOD_PAR
/begin MOD_COMMON "BYTE_ORDER: Motorola = MSB_FIRST, Intel = MSB_LAST" BYTE_ORDER MSB_FIRST /end MOD_COMMON
/begin MODULE ETCSignals " "
/begin MEASUREMENT ES900.ES910.CAN1.Presence.PresenceGroup.PresenceFlag "" FLOAT64_IEEE LINEAR_FUNCTION_M1_T0_U1 1 100 0 1 /begin IF_DATA E_TARGET KP_BLOB 0xFFFFFFFF 0xFFFFFFFF 2 1001 1 1001 0 /end IF_DATA /end MEASUREMENT
/begin MEASUREMENT ES900.ES910.CAN1.CAN1.AP_BMS_Current_SOC_SOH.Accumulator_SOH "" FLOAT64_IEEE LINEAR_FUNCTION_M1_T0_U1 1 100 0 0 /begin IF_DATA E_TARGET KP_BLOB 0xFFFFFFFF 0xFFFFFFFF 2 1001 1 1001 1 /end IF_DATA /end MEASUREMENT
/begin MEASUREMENT ES900.ES910.CAN1.CAN1.AP_BMS_Current_SOC_SOH.Accumulator_SOC "" FLOAT64_IEEE LINEAR_FUNCTION_M1_T0_U1 1 100 0 0 /begin IF_DATA E_TARGET KP_BLOB 0xFFFFFFFF 0xFFFFFFFF 2 1001 1 1001 2 /end IF_DATA /end MEASUREMENT
/begin MEASUREMENT ES900.ES910.CAN1.CAN1.AP_BMS_Current_SOC_SOH.Accumulator_Current "" FLOAT64_IEEE LINEAR_FUNCTION_M1_T0_U1 1 100 0 0 /begin IF_DATA E_TARGET KP_BLOB 0xFFFFFFFF 0xFFFFFFFF 2 1001 1 1001 3 /end IF_DATA /end MEASUREMENT
/begin MEASUREMENT ES900.ES910.CAN1.CAN1.AP_BMS_StateAndFailReport.BMS_AccumulatorIntck "" FLOAT64_IEEE LINEAR_FUNCTION_M1_T0_U1 1 100 0 0 /begin IF_DATA E_TARGET KP_BLOB 0xFFFFFFFF 0xFFFFFFFF 2 1001 1 1001 4 /end IF_DATA /end MEASUREMENT
/begin MEASUREMENT ES900.ES910.CAN1.CAN1.AP_BMS_StateAndFailReport.State_PrechargeRelay "" FLOAT64_IEEE LINEAR_FUNCTION_M1_T0_U1 1 100 0 0 /begin IF_DATA E_TARGET KP_BLOB 0xFFFFFFFF 0xFFFFFFFF 2 1001 1 1001 5 /end IF_DATA /end MEASUREMENT
/begin MEASUREMENT ES900.ES910.CAN1.CAN1.AP_BMS_StateAndFailReport.State_DivideCurrent "" FLOAT64_IEEE LINEAR_FUNCTION_M1_T0_U1 1 100 0 0 /begin IF_DATA E_TARGET KP_BLOB 0xFFFFFFFF 0xFFFFFFFF 2 1001 1 1001 6 /end IF_DATA /end MEASUREMENT
/begin MEASUREMENT ES900.ES910.CAN1.CAN1.AP_BMS_StateAndFailReport.State_BMS_Ok "" FLOAT64_IEEE LINEAR_FUNCTION_M1_T0_U1 1 100 0 0 /begin IF_DATA E_TARGET KP_BLOB 0xFFFFFFFF 0xFFFFFFFF 2 1001 1 1001 7 /end IF_DATA /end MEASUREMENT
/begin MEASUREMENT ES900.ES910.CAN1.CAN1.AP_BMS_StateAndFailReport.State_Balancing "" FLOAT64_IEEE LINEAR_FUNCTION_M1_T0_U1 1 100 0 0 /begin IF_DATA E_TARGET KP_BLOB 0xFFFFFFFF 0xFFFFFFFF 2 1001 1 1001 8 /end IF_DATA /end MEASUREMENT
/begin MEASUREMENT ES900.ES910.CAN1.CAN1.AP_BMS_StateAndFailReport.State_Air_Plus "" FLOAT64_IEEE LINEAR_FUNCTION_M1_T0_U1 1 100 0 0 /begin IF_DATA E_TARGET KP_BLOB 0xFFFFFFFF 0xFFFFFFFF 2 1001 1 1001 9 /end IF_DATA /end MEASUREMENT
/begin MEASUREMENT ES900.ES910.CAN1.CAN1.AP_BMS_StateAndFailReport.State_Air_Minus "" FLOAT64_IEEE LINEAR_FUNCTION_M1_T0_U1 1 100 0 0 /begin IF_DATA E_TARGET KP_BLOB 0xFFFFFFFF 0xFFFFFFFF 2 1001 1 1001 10 /end IF_DATA /end MEASUREMENT
/begin MEASUREMENT ES900.ES910.CAN1.CAN1.AP_BMS_StateAndFailReport.State_AccumulatorFans "" FLOAT64_IEEE LINEAR_FUNCTION_M1_T0_U1 1 100 0 0 /begin IF_DATA E_TARGET KP_BLOB 0xFFFFFFFF 0xFFFFFFFF 2 1001 1 1001 11 /end IF_DATA /end MEASUREMENT
/begin MEASUREMENT ES900.ES910.CAN1.CAN1.AP_BMS_StateAndFailReport.BMSerror_VoltageDisconnection "" FLOAT64_IEEE LINEAR_FUNCTION_M1_T0_U1 1 100 0 0 /begin IF_DATA E_TARGET KP_BLOB 0xFFFFFFFF 0xFFFFFFFF 2 1001 1 1001 12 /end IF_DATA /end MEASUREMENT
/begin MEASUREMENT ES900.ES910.CAN1.CAN1.AP_BMS_StateAndFailReport.BMSerror_UnderVoltage "" FLOAT64_IEEE LINEAR_FUNCTION_M1_T0_U1 1 100 0 0 /begin IF_DATA E_TARGET KP_BLOB 0xFFFFFFFF 0xFFFFFFFF 2 1001 1 1001 13 /end IF_DATA /end MEASUREMENT
/begin MEASUREMENT ES900.ES910.CAN1.CAN1.AP_BMS_StateAndFailReport.BMSerror_UnderTemperature "" FLOAT64_IEEE LINEAR_FUNCTION_M1_T0_U1 1 100 0 0 /begin IF_DATA E_TARGET KP_BLOB 0xFFFFFFFF 0xFFFFFFFF 2 1001 1 1001 14 /end IF_DATA /end MEASUREMENT
/begin MEASUREMENT ES900.ES910.CAN1.CAN1.AP_BMS_StateAndFailReport.BMSerror_OverVoltage "" FLOAT64_IEEE LINEAR_FUNCTION_M1_T0_U1 1 100 0 0 /begin IF_DATA E_TARGET KP_BLOB 0xFFFFFFFF 0xFFFFFFFF 2 1001 1 1001 15 /end IF_DATA /end MEASUREMENT
/begin MEASUREMENT ES900.ES910.CAN1.CAN1.AP_BMS_StateAndFailReport.BMSerror_OverTemperature "" FLOAT64_IEEE LINEAR_FUNCTION_M1_T0_U1 1 100 0 0 /begin IF_DATA E_TARGET KP_BLOB 0xFFFFFFFF 0xFFFFFFFF 2 1001 1 1001 16 /end IF_DATA /end MEASUREMENT
/begin MEASUREMENT ES900.ES910.CAN1.CAN1.AP_BMS_StateAndFailReport.BMSerror_NTCDisconnection "" FLOAT64_IEEE LINEAR_FUNCTION_M1_T0_U1 1 100 0 0 /begin IF_DATA E_TARGET KP_BLOB 0xFFFFFFFF 0xFFFFFFFF 2 1001 1 1001 17 /end IF_DATA /end MEASUREMENT
/begin MEASUREMENT ES900.ES910.CAN1.CAN1.AP_BMS_StateAndFailReport.BMSerror_CurrentSensDisc "" FLOAT64_IEEE LINEAR_FUNCTION_M1_T0_U1 1 100 0 0 /begin IF_DATA E_TARGET KP_BLOB 0xFFFFFFFF 0xFFFFFFFF 2 1001 1 1001 18 /end IF_DATA /end MEASUREMENT
/begin MEASUREMENT ES900.ES910.CAN1.CAN1.AP_BMS_StateAndFailReport.BMSerror_CANDisconnection "" FLOAT64_IEEE LINEAR_FUNCTION_M1_T0_U1 1 100 0 0 /begin IF_DATA E_TARGET KP_BLOB 0xFFFFFFFF 0xFFFFFFFF 2 1001 1 1001 19 /end IF_DATA /end MEASUREMENT
/begin MEASUREMENT ES900.ES910.CAN1.CAN1.AP_BMS_Voltages.Lowest_CellVoltage "" FLOAT64_IEEE LINEAR_FUNCTION_M1_T0_U1 1 100 0 0 /begin IF_DATA E_TARGET KP_BLOB 0xFFFFFFFF 0xFFFFFFFF 2 1001 1 1001 20 /end IF_DATA /end MEASUREMENT
/begin MEASUREMENT ES900.ES910.CAN1.CAN1.AP_BMS_Voltages.Highest_CellVoltage "" FLOAT64_IEEE LINEAR_FUNCTION_M1_T0_U1 1 100 0 0 /begin IF_DATA E_TARGET KP_BLOB 0xFFFFFFFF 0xFFFFFFFF 2 1001 1 1001 21 /end IF_DATA /end MEASUREMENT
/begin MEASUREMENT ES900.ES910.CAN1.CAN1.AP_BMS_Voltages.Accumulator_Voltage "" FLOAT64_IEEE LINEAR_FUNCTION_M1_T0_U1 1 100 0 0 /begin IF_DATA E_TARGET KP_BLOB 0xFFFFFFFF 0xFFFFFFFF 2 1001 1 1001 22 /end IF_DATA /end MEASUREMENT
/begin MEASUREMENT ES900.ES910.CAN1.CAN1.AP_BMS_OnBoardTemperatures.Lowest_OnBoardTemp "" FLOAT64_IEEE LINEAR_FUNCTION_M1_T0_U1 1 100 0 0 /begin IF_DATA E_TARGET KP_BLOB 0xFFFFFFFF 0xFFFFFFFF 2 1001 1 1001 23 /end IF_DATA /end MEASUREMENT
/begin MEASUREMENT ES900.ES910.CAN1.CAN1.AP_BMS_OnBoardTemperatures.Highest_OnBoardTemp "" FLOAT64_IEEE LINEAR_FUNCTION_M1_T0_U1 1 100 0 0 /begin IF_DATA E_TARGET KP_BLOB 0xFFFFFFFF 0xFFFFFFFF 2 1001 1 1001 24 /end IF_DATA /end MEASUREMENT
/begin MEASUREMENT ES900.ES910.CAN1.CAN1.AP_BMS_OnBoardTemperatures.Average_OnBoardTemp "" FLOAT64_IEEE LINEAR_FUNCTION_M1_T0_U1 1 100 0 0 /begin IF_DATA E_TARGET KP_BLOB 0xFFFFFFFF 0xFFFFFFFF 2 1001 1 1001 25 /end IF_DATA /end MEASUREMENT
/begin MEASUREMENT ES900.ES910.CAN1.CAN1.AP_BMS_ChargerParameters.Charger_MaxVoltage "" FLOAT64_IEEE LINEAR_FUNCTION_M1_T0_U1 1 100 0 0 /begin IF_DATA E_TARGET KP_BLOB 0xFFFFFFFF 0xFFFFFFFF 2 1001 1 1001 26 /end IF_DATA /end MEASUREMENT
/begin MEASUREMENT ES900.ES910.CAN1.CAN1.AP_BMS_ChargerParameters.Charger_MaxCurrent "" FLOAT64_IEEE LINEAR_FUNCTION_M1_T0_U1 1 100 0 0 /begin IF_DATA E_TARGET KP_BLOB 0xFFFFFFFF 0xFFFFFFFF 2 1001 1 1001 27 /end IF_DATA /end MEASUREMENT
/begin MEASUREMENT ES900.ES910.CAN1.CAN1.AP_BMS_BatteryTemperatures.Lowest_CellTemp "" FLOAT64_IEEE LINEAR_FUNCTION_M1_T0_U1 1 100 0 0 /begin IF_DATA E_TARGET KP_BLOB 0xFFFFFFFF 0xFFFFFFFF 2 1001 1 1001 28 /end IF_DATA /end MEASUREMENT
/begin MEASUREMENT ES900.ES910.CAN1.CAN1.AP_BMS_BatteryTemperatures.Highest_CellTemp "" FLOAT64_IEEE LINEAR_FUNCTION_M1_T0_U1 1 100 0 0 /begin IF_DATA E_TARGET KP_BLOB 0xFFFFFFFF 0xFFFFFFFF 2 1001 1 1001 29 /end IF_DATA /end MEASUREMENT
/begin MEASUREMENT ES900.ES910.CAN1.CAN1.AP_BMS_BatteryTemperatures.Average_CellTemp "" FLOAT64_IEEE LINEAR_FUNCTION_M1_T0_U1 1 100 0 0 /begin IF_DATA E_TARGET KP_BLOB 0xFFFFFFFF 0xFFFFFFFF 2 1001 1 1001 30 /end IF_DATA /end MEASUREMENT
/begin MEASUREMENT ES900.ES910.CAN1.CAN1.AP_Inverter_R_Tx.Inv_R_RegID "" FLOAT64_IEEE LINEAR_FUNCTION_M1_T0_U1 1 100 0 0 /begin IF_DATA E_TARGET KP_BLOB 0xFFFFFFFF 0xFFFFFFFF 2 1001 1 1001 31 /end IF_DATA /end MEASUREMENT
/begin MEASUREMENT ES900.ES910.CAN1.CAN1.AP_Inverter_R_Tx.Inv_R_RegID_M73_Inv_R_TempMotor "" FLOAT64_IEEE LINEAR_FUNCTION_M1_T0_U1 1 100 0 0 /begin IF_DATA E_TARGET KP_BLOB 0xFFFFFFFF 0xFFFFFFFF 2 1001 1 1001 32 /end IF_DATA /end MEASUREMENT
/begin MEASUREMENT ES900.ES910.CAN1.CAN1.AP_Inverter_R_Tx.Inv_R_RegID_M74_Inv_R_TempIGBT "" FLOAT64_IEEE LINEAR_FUNCTION_M1_T0_U1 1 100 0 0 /begin IF_DATA E_TARGET KP_BLOB 0xFFFFFFFF 0xFFFFFFFF 2 1001 1 1001 33 /end IF_DATA /end MEASUREMENT
/begin MEASUREMENT ES900.ES910.CAN1.CAN1.AP_Inverter_R_Tx.Inv_R_RegID_M48_Inv_R_Speed "" FLOAT64_IEEE LINEAR_FUNCTION_M1_T0_U1 1 100 0 0 /begin IF_DATA E_TARGET KP_BLOB 0xFFFFFFFF 0xFFFFFFFF 2 1001 1 1001 34 /end IF_DATA /end MEASUREMENT
/begin MEASUREMENT ES900.ES910.CAN1.CAN1.AP_Inverter_R_Tx.Inv_R_RegID_M39_Inv_R_Iq "" FLOAT64_IEEE LINEAR_FUNCTION_M1_T0_U1 1 100 0 0 /begin IF_DATA E_TARGET KP_BLOB 0xFFFFFFFF 0xFFFFFFFF 2 1001 1 1001 35 /end IF_DATA /end MEASUREMENT
/begin MEASUREMENT ES900.ES910.CAN1.CAN1.AP_Inverter_R_Tx.Inv_R_RegID_M38_Inv_R_Icommand "" FLOAT64_IEEE LINEAR_FUNCTION_M1_T0_U1 1 100 0 0 /begin IF_DATA E_TARGET KP_BLOB 0xFFFFFFFF 0xFFFFFFFF 2 1001 1 1001 36 /end IF_DATA /end MEASUREMENT
/begin MEASUREMENT ES900.ES910.CAN1.CAN1.AP_Inverter_R_Tx.Inv_R_RegID_M32_Inv_R_Iactual "" FLOAT64_IEEE LINEAR_FUNCTION_M1_T0_U1 1 100 0 0 /begin IF_DATA E_TARGET KP_BLOB 0xFFFFFFFF 0xFFFFFFFF 2 1001 1 1001 37 /end IF_DATA /end MEASUREMENT
/begin MEASUREMENT ES900.ES910.CAN1.CAN1.AP_Inverter_R_Tx.Inv_R_RegID_M232_Inv_R_Enable "" FLOAT64_IEEE LINEAR_FUNCTION_M1_T0_U1 1 100 0 0 /begin IF_DATA E_TARGET KP_BLOB 0xFFFFFFFF 0xFFFFFFFF 2 1001 1 1001 38 /end IF_DATA /end MEASUREMENT
/begin MEASUREMENT ES900.ES910.CAN1.CAN1.AP_Inverter_R_Tx.Inv_R_RegID_M235_Inv_R_DCBus "" FLOAT64_IEEE LINEAR_FUNCTION_M1_T0_U1 1 100 0 0 /begin IF_DATA E_TARGET KP_BLOB 0xFFFFFFFF 0xFFFFFFFF 2 1001 1 1001 39 /end IF_DATA /end MEASUREMENT
/begin MEASUREMENT ES900.ES910.CAN1.CAN1.AP_Inverter_L_Tx.Inv_L_RegID "" FLOAT64_IEEE LINEAR_FUNCTION_M1_T0_U1 1 100 0 0 /begin IF_DATA E_TARGET KP_BLOB 0xFFFFFFFF 0xFFFFFFFF 2 1001 1 1001 40 /end IF_DATA /end MEASUREMENT
/begin MEASUREMENT ES900.ES910.CAN1.CAN1.AP_Inverter_L_Tx.Inv_L_RegID_M73_Inv_L_TempMotor "" FLOAT64_IEEE LINEAR_FUNCTION_M1_T0_U1 1 100 0 0 /begin IF_DATA E_TARGET KP_BLOB 0xFFFFFFFF 0xFFFFFFFF 2 1001 1 1001 41 /end IF_DATA /end MEASUREMENT
/begin MEASUREMENT ES900.ES910.CAN1.CAN1.AP_Inverter_L_Tx.Inv_L_RegID_M74_Inv_L_TempIGBT "" FLOAT64_IEEE LINEAR_FUNCTION_M1_T0_U1 1 100 0 0 /begin IF_DATA E_TARGET KP_BLOB 0xFFFFFFFF 0xFFFFFFFF 2 1001 1 1001 42 /end IF_DATA /end MEASUREMENT
/begin MEASUREMENT ES900.ES910.CAN1.CAN1.AP_Inverter_L_Tx.Inv_L_RegID_M48_Inv_L_Speed "" FLOAT64_IEEE LINEAR_FUNCTION_M1_T0_U1 1 100 0 0 /begin IF_DATA E_TARGET KP_BLOB 0xFFFFFFFF 0xFFFFFFFF 2 1001 1 1001 43 /end IF_DATA /end MEASUREMENT
/begin MEASUREMENT ES900.ES910.CAN1.CAN1.AP_Inverter_L_Tx.Inv_L_RegID_M39_Inv_L_Iq "" FLOAT64_IEEE LINEAR_FUNCTION_M1_T0_U1 1 100 0 0 /begin IF_DATA E_TARGET KP_BLOB 0xFFFFFFFF 0xFFFFFFFF 2 1001 1 1001 44 /end IF_DATA /end MEASUREMENT
/begin MEASUREMENT ES900.ES910.CAN1.CAN1.AP_Inverter_L_Tx.Inv_L_RegID_M38_Inv_L_Icommand "" FLOAT64_IEEE LINEAR_FUNCTION_M1_T0_U1 1 100 0 0 /begin IF_DATA E_TARGET KP_BLOB 0xFFFFFFFF 0xFFFFFFFF 2 1001 1 1001 45 /end IF_DATA /end MEASUREMENT
/begin MEASUREMENT ES900.ES910.CAN1.CAN1.AP_Inverter_L_Tx.Inv_L_RegID_M32_Inv_L_Iactual "" FLOAT64_IEEE LINEAR_FUNCTION_M1_T0_U1 1 100 0 0 /begin IF_DATA E_TARGET KP_BLOB 0xFFFFFFFF 0xFFFFFFFF 2 1001 1 1001 46 /end IF_DATA /end MEASUREMENT
/begin MEASUREMENT ES900.ES910.CAN1.CAN1.AP_Inverter_L_Tx.Inv_L_RegID_M232_Inv_L_Enable "" FLOAT64_IEEE LINEAR_FUNCTION_M1_T0_U1 1 100 0 0 /begin IF_DATA E_TARGET KP_BLOB 0xFFFFFFFF 0xFFFFFFFF 2 1001 1 1001 47 /end IF_DATA /end MEASUREMENT
/begin MEASUREMENT ES900.ES910.CAN1.CAN1.AP_Inverter_L_Tx.Inv_L_RegID_M235_Inv_L_DCBus "" FLOAT64_IEEE LINEAR_FUNCTION_M1_T0_U1 1 100 0 0 /begin IF_DATA E_TARGET KP_BLOB 0xFFFFFFFF 0xFFFFFFFF 2 1001 1 1001 48 /end IF_DATA /end MEASUREMENT
/begin MEASUREMENT ES900.ES910.CAN1.CAN1.AP_DASH_CustomMode.CustomMode_Identifier "" FLOAT64_IEEE LINEAR_FUNCTION_M1_T0_U1 1 100 0 0 /begin IF_DATA E_TARGET KP_BLOB 0xFFFFFFFF 0xFFFFFFFF 2 1001 1 1001 49 /end IF_DATA /end MEASUREMENT
/begin MEASUREMENT ES900.ES910.CAN1.CAN1.AP_DASH_CustomMode.CustomMode_Data "" FLOAT64_IEEE LINEAR_FUNCTION_M1_T0_U1 1 100 0 0 /begin IF_DATA E_TARGET KP_BLOB 0xFFFFFFFF 0xFFFFFFFF 2 1001 1 1001 50 /end IF_DATA /end MEASUREMENT
/begin MEASUREMENT ES900.ES910.CAN1.CAN1.AP_DASH_Mode.RacingMode "" FLOAT64_IEEE LINEAR_FUNCTION_M1_T0_U1 1 100 0 0 /begin IF_DATA E_TARGET KP_BLOB 0xFFFFFFFF 0xFFFFFFFF 2 1001 1 1001 51 /end IF_DATA /end MEASUREMENT
/begin MEASUREMENT ES900.ES910.CAN1.CAN1.NM_BMS_Keep_Alive.BMS_Alive "" FLOAT64_IEEE LINEAR_FUNCTION_M1_T0_U1 1 100 0 0 /begin IF_DATA E_TARGET KP_BLOB 0xFFFFFFFF 0xFFFFFFFF 2 1001 1 1001 52 /end IF_DATA /end MEASUREMENT
/begin MEASUREMENT ES900.ES910.CAN1.CAN1.AP_BMS_AIRs_State.AIRs_State "" FLOAT64_IEEE LINEAR_FUNCTION_M1_T0_U1 1 100 0 0 /begin IF_DATA E_TARGET KP_BLOB 0xFFFFFFFF 0xFFFFFFFF 2 1001 1 1001 53 /end IF_DATA /end MEASUREMENT
/begin MEASUREMENT ES900.ES910.CAN1.CAN1.NM_DASH_Keep_Alive.Dash_Alive "" FLOAT64_IEEE LINEAR_FUNCTION_M1_T0_U1 1 100 0 0 /begin IF_DATA E_TARGET KP_BLOB 0xFFFFFFFF 0xFFFFFFFF 2 1001 1 1001 54 /end IF_DATA /end MEASUREMENT
/begin MEASUREMENT ES900.ES910.CAN1.CAN1.AP_DASH_TorqueLockOn.Torque_LockOn "" FLOAT64_IEEE LINEAR_FUNCTION_M1_T0_U1 1 100 0 0 /begin IF_DATA E_TARGET KP_BLOB 0xFFFFFFFF 0xFFFFFFFF 2 1001 1 1001 55 /end IF_DATA /end MEASUREMENT
/begin MEASUREMENT ES900.ES910.CAN1.CAN1.AP_DASH_PrechargeRequest.PrechargeRequest "" FLOAT64_IEEE LINEAR_FUNCTION_M1_T0_U1 1 100 0 0 /begin IF_DATA E_TARGET KP_BLOB 0xFFFFFFFF 0xFFFFFFFF 2 1001 1 1001 56 /end IF_DATA /end MEASUREMENT
/begin MEASUREMENT ES900.ES910.CAN1.CAN1.AP_DASH_EnableDrive.EnableDrive_Order "" FLOAT64_IEEE LINEAR_FUNCTION_M1_T0_U1 1 100 0 0 /begin IF_DATA E_TARGET KP_BLOB 0xFFFFFFFF 0xFFFFFFFF 2 1001 1 1001 57 /end IF_DATA /end MEASUREMENT
/begin MEASUREMENT ES900.ES910.CAN1.CAN1.AP_ETAS_DashData1.Speed "" FLOAT64_IEEE LINEAR_FUNCTION_M1_T0_U1 1 100 -128 127 /begin IF_DATA E_TARGET KP_BLOB 0xFFFFFFFF 0xFFFFFFFF 2 1001 1 1001 59 /end IF_DATA /end MEASUREMENT
/begin MEASUREMENT ES900.ES910.CAN1.CAN1.AP_ETAS_DashData1.Precharge_Voltage "" FLOAT64_IEEE LINEAR_FUNCTION_M1_T0_U1 1 100 0 655.35 /begin IF_DATA E_TARGET KP_BLOB 0xFFFFFFFF 0xFFFFFFFF 2 1001 1 1001 60 /end IF_DATA /end MEASUREMENT
/begin MEASUREMENT ES900.ES910.CAN1.CAN1.AP_ETAS_DashData1.Precharge_Percentage "" FLOAT64_IEEE LINEAR_FUNCTION_M1_T0_U1 1 100 0 100 /begin IF_DATA E_TARGET KP_BLOB 0xFFFFFFFF 0xFFFFFFFF 2 1001 1 1001 61 /end IF_DATA /end MEASUREMENT
/begin MEASUREMENT ES900.ES910.CAN1.CAN1.AP_ETAS_DashData1.LVbattery_Voltage "" FLOAT64_IEEE LINEAR_FUNCTION_M1_T0_U1 1 100 0 32.7675 /begin IF_DATA E_TARGET KP_BLOB 0xFFFFFFFF 0xFFFFFFFF 2 1001 1 1001 62 /end IF_DATA /end MEASUREMENT
/begin MEASUREMENT ES900.ES910.CAN1.CAN1.AP_ETAS_DashData1.LVbattery_SOC "" FLOAT64_IEEE LINEAR_FUNCTION_M1_T0_U1 1 100 0 100 /begin IF_DATA E_TARGET KP_BLOB 0xFFFFFFFF 0xFFFFFFFF 2 1001 1 1001 63 /end IF_DATA /end MEASUREMENT
/begin MEASUREMENT ES900.ES910.CAN1.CAN1.AP_ETAS_VDCParams2.VDC_Cte_SKF "" FLOAT64_IEEE LINEAR_FUNCTION_M1_T0_U1 1 100 0 1 /begin IF_DATA E_TARGET KP_BLOB 0xFFFFFFFF 0xFFFFFFFF 2 1001 1 1001 65 /end IF_DATA /end MEASUREMENT
/begin MEASUREMENT ES900.ES910.CAN1.CAN1.AP_ETAS_VDCParams2.VDC_Cte_CKF "" FLOAT64_IEEE LINEAR_FUNCTION_M1_T0_U1 1 100 0 1 /begin IF_DATA E_TARGET KP_BLOB 0xFFFFFFFF 0xFFFFFFFF 2 1001 1 1001 66 /end IF_DATA /end MEASUREMENT
/begin MEASUREMENT ES900.ES910.CAN1.CAN1.AP_ETAS_VDCParams.VDC_CKF_Initial "" FLOAT64_IEEE LINEAR_FUNCTION_M1_T0_U1 1 100 0 1 /begin IF_DATA E_TARGET KP_BLOB 0xFFFFFFFF 0xFFFFFFFF 2 1001 1 1001 68 /end IF_DATA /end MEASUREMENT
/begin MEASUREMENT ES900.ES910.CAN1.CAN1.AP_ETAS_VDCParams.VDC_SKF_Initial "" FLOAT64_IEEE LINEAR_FUNCTION_M1_T0_U1 1 100 0 1 /begin IF_DATA E_TARGET KP_BLOB 0xFFFFFFFF 0xFFFFFFFF 2 1001 1 1001 69 /end IF_DATA /end MEASUREMENT
/begin MEASUREMENT ES900.ES910.CAN1.CAN1.AP_ETAS_VDCParams.VDC_Power_Limit "" FLOAT64_IEEE LINEAR_FUNCTION_M1_T0_U1 1 100 0 85 /begin IF_DATA E_TARGET KP_BLOB 0xFFFFFFFF 0xFFFFFFFF 2 1001 1 1001 70 /end IF_DATA /end MEASUREMENT
/begin MEASUREMENT ES900.ES910.CAN1.CAN1.AP_ETAS_VDCParams.VDC_Max_Regenerative_Torque "" FLOAT64_IEEE LINEAR_FUNCTION_M1_T0_U1 1 100 0 10.2 /begin IF_DATA E_TARGET KP_BLOB 0xFFFFFFFF 0xFFFFFFFF 2 1001 1 1001 71 /end IF_DATA /end MEASUREMENT
/begin MEASUREMENT ES900.ES910.CAN1.CAN1.AP_ETAS_VDCParams.VDC_K_Reduction_Temperature "" FLOAT64_IEEE LINEAR_FUNCTION_M1_T0_U1 1 100 0 1 /begin IF_DATA E_TARGET KP_BLOB 0xFFFFFFFF 0xFFFFFFFF 2 1001 1 1001 72 /end IF_DATA /end MEASUREMENT
/begin MEASUREMENT ES900.ES910.CAN1.CAN1.AP_ETAS_VDCParams.VDC_K_Reduction_P "" FLOAT64_IEEE LINEAR_FUNCTION_M1_T0_U1 1 100 0 1 /begin IF_DATA E_TARGET KP_BLOB 0xFFFFFFFF 0xFFFFFFFF 2 1001 1 1001 73 /end IF_DATA /end MEASUREMENT
/begin MEASUREMENT ES900.ES910.CAN1.CAN1.AP_ETAS_VDCParams.VDC_APPS_Sat_Up "" FLOAT64_IEEE LINEAR_FUNCTION_M1_T0_U1 1 100 0 1 /begin IF_DATA E_TARGET KP_BLOB 0xFFFFFFFF 0xFFFFFFFF 2 1001 1 1001 74 /end IF_DATA /end MEASUREMENT
/begin MEASUREMENT ES900.ES910.CAN1.CAN1.AP_ETAS_VDCParams.VDC_APPS_Sat_Down "" FLOAT64_IEEE LINEAR_FUNCTION_M1_T0_U1 1 100 0 1 /begin IF_DATA E_TARGET KP_BLOB 0xFFFFFFFF 0xFFFFFFFF 2 1001 1 1001 75 /end IF_DATA /end MEASUREMENT
/begin MEASUREMENT ES900.ES910.CAN1.CAN1.AP_ETAS_Inverter_R_Rx.Inverter_R_RegID "" FLOAT64_IEEE LINEAR_FUNCTION_M1_T0_U1 1 100 0 255 /begin IF_DATA E_TARGET KP_BLOB 0xFFFFFFFF 0xFFFFFFFF 2 1001 1 1001 77 /end IF_DATA /end MEASUREMENT
/begin MEASUREMENT ES900.ES910.CAN1.CAN1.AP_ETAS_Inverter_R_Rx.Inverter_R_b7tob0 "" FLOAT64_IEEE LINEAR_FUNCTION_M1_T0_U1 1 100 0 255 /begin IF_DATA E_TARGET KP_BLOB 0xFFFFFFFF 0xFFFFFFFF 2 1001 1 1001 78 /end IF_DATA /end MEASUREMENT
/begin MEASUREMENT ES900.ES910.CAN1.CAN1.AP_ETAS_Inverter_R_Rx.Inverter_R_b15tob8 "" FLOAT64_IEEE LINEAR_FUNCTION_M1_T0_U1 1 100 0 255 /begin IF_DATA E_TARGET KP_BLOB 0xFFFFFFFF 0xFFFFFFFF 2 1001 1 1001 79 /end IF_DATA /end MEASUREMENT
/begin MEASUREMENT ES900.ES910.CAN1.CAN1.AP_ETAS_Inverter_L_Rx.Inverter_L_RegID "" FLOAT64_IEEE LINEAR_FUNCTION_M1_T0_U1 1 100 0 255 /begin IF_DATA E_TARGET KP_BLOB 0xFFFFFFFF 0xFFFFFFFF 2 1001 1 1001 81 /end IF_DATA /end MEASUREMENT
/begin MEASUREMENT ES900.ES910.CAN1.CAN1.AP_ETAS_Inverter_L_Rx.Inverter_L_b7tob0 "" FLOAT64_IEEE LINEAR_FUNCTION_M1_T0_U1 1 100 0 255 /begin IF_DATA E_TARGET KP_BLOB 0xFFFFFFFF 0xFFFFFFFF 2 1001 1 1001 82 /end IF_DATA /end MEASUREMENT
/begin MEASUREMENT ES900.ES910.CAN1.CAN1.AP_ETAS_Inverter_L_Rx.Inverter_L_b15tob8 "" FLOAT64_IEEE LINEAR_FUNCTION_M1_T0_U1 1 100 0 255 /begin IF_DATA E_TARGET KP_BLOB 0xFFFFFFFF 0xFFFFFFFF 2 1001 1 1001 83 /end IF_DATA /end MEASUREMENT
/begin MEASUREMENT ES900.ES910.CAN1.CAN1.AP_ETAS_CarState.Car_State "" FLOAT64_IEEE LINEAR_FUNCTION_M1_T0_U1 1 100 0 255 /begin IF_DATA E_TARGET KP_BLOB 0xFFFFFFFF 0xFFFFFFFF 2 1001 1 1001 85 /end IF_DATA /end MEASUREMENT
/begin MEASUREMENT ES900.ES910.CAN1.CAN1.AP_ETAS_AIRsRequest.AIRs_Request "" FLOAT64_IEEE LINEAR_FUNCTION_M1_T0_U1 1 100 0 255 /begin IF_DATA E_TARGET KP_BLOB 0xFFFFFFFF 0xFFFFFFFF 2 1001 1 1001 87 /end IF_DATA /end MEASUREMENT
/begin MEASUREMENT ES900.ES910.CAN1.CAN1.AP_ETAS_AnalogicControl.BrakeLight_Control "" FLOAT64_IEEE LINEAR_FUNCTION_M1_T0_U1 1 100 0 1 /begin IF_DATA E_TARGET KP_BLOB 0xFFFFFFFF 0xFFFFFFFF 2 1001 1 1001 89 /end IF_DATA /end MEASUREMENT
/begin MEASUREMENT ES900.ES910.CAN1.CAN1.AP_ETAS_AnalogicControl.Pumps_Control "" FLOAT64_IEEE LINEAR_FUNCTION_M1_T0_U1 1 100 0 1 /begin IF_DATA E_TARGET KP_BLOB 0xFFFFFFFF 0xFFFFFFFF 2 1001 1 1001 90 /end IF_DATA /end MEASUREMENT
/begin MEASUREMENT ES900.ES910.CAN1.CAN1.MEAS_ETAS_InternalVars.CriticalDisconnection "" FLOAT64_IEEE LINEAR_FUNCTION_M1_T0_U1 1 100 0 1 /begin IF_DATA E_TARGET KP_BLOB 0xFFFFFFFF 0xFFFFFFFF 2 1001 1 1001 92 /end IF_DATA /end MEASUREMENT
/begin MEASUREMENT ES900.ES910.CAN1.CAN1.MEAS_ETAS_InternalVars.CurrentPathDisconnectionFlag "" FLOAT64_IEEE LINEAR_FUNCTION_M1_T0_U1 1 100 0 1 /begin IF_DATA E_TARGET KP_BLOB 0xFFFFFFFF 0xFFFFFFFF 2 1001 1 1001 93 /end IF_DATA /end MEASUREMENT
/begin MEASUREMENT ES900.ES910.CAN1.CAN1.MEAS_ETAS_InternalVars.Car_OK "" FLOAT64_IEEE LINEAR_FUNCTION_M1_T0_U1 1 100 0 1 /begin IF_DATA E_TARGET KP_BLOB 0xFFFFFFFF 0xFFFFFFFF 2 1001 1 1001 94 /end IF_DATA /end MEASUREMENT
/begin MEASUREMENT ES900.ES910.CAN1.CAN1.MEAS_ETAS_InternalVars.Power "" FLOAT64_IEEE LINEAR_FUNCTION_M1_T0_U1 1 100 0 255 /begin IF_DATA E_TARGET KP_BLOB 0xFFFFFFFF 0xFFFFFFFF 2 1001 1 1001 95 /end IF_DATA /end MEASUREMENT
/begin MEASUREMENT ES900.ES910.CAN1.CAN1.MEAS_ETAS_InternalVars.Torque_OK "" FLOAT64_IEEE LINEAR_FUNCTION_M1_T0_U1 1 100 0 1 /begin IF_DATA E_TARGET KP_BLOB 0xFFFFFFFF 0xFFFFFFFF 2 1001 1 1001 96 /end IF_DATA /end MEASUREMENT
/begin MEASUREMENT ES900.ES910.CAN1.CAN1.MEAS_ETAS_InternalVars.TV_Mode "" FLOAT64_IEEE LINEAR_FUNCTION_M1_T0_U1 1 100 0 7 /begin IF_DATA E_TARGET KP_BLOB 0xFFFFFFFF 0xFFFFFFFF 2 1001 1 1001 97 /end IF_DATA /end MEASUREMENT
/begin MEASUREMENT ES900.ES910.CAN1.CAN1.MEAS_ETAS_InternalVars.Critical_Signal_Disconnection "" FLOAT64_IEEE LINEAR_FUNCTION_M1_T0_U1 1 100 0 1 /begin IF_DATA E_TARGET KP_BLOB 0xFFFFFFFF 0xFFFFFFFF 2 1001 1 1001 98 /end IF_DATA /end MEASUREMENT
/begin MEASUREMENT ES900.ES910.CAN1.CAN1.MEAS_ETAS_InternalVars.Critical_CAN_Disconnection "" FLOAT64_IEEE LINEAR_FUNCTION_M1_T0_U1 1 100 0 1 /begin IF_DATA E_TARGET KP_BLOB 0xFFFFFFFF 0xFFFFFFFF 2 1001 1 1001 99 /end IF_DATA /end MEASUREMENT
/begin MEASUREMENT ES900.ES910.CAN1.CAN1.MEAS_ETAS_InternalVars.Brake_Implausibility "" FLOAT64_IEEE LINEAR_FUNCTION_M1_T0_U1 1 100 0 1 /begin IF_DATA E_TARGET KP_BLOB 0xFFFFFFFF 0xFFFFFFFF 2 1001 1 1001 100 /end IF_DATA /end MEASUREMENT
/begin MEASUREMENT ES900.ES910.CAN1.CAN1.MEAS_ETAS_InternalVars.APPS_Implausibility "" FLOAT64_IEEE LINEAR_FUNCTION_M1_T0_U1 1 100 0 1 /begin IF_DATA E_TARGET KP_BLOB 0xFFFFFFFF 0xFFFFFFFF 2 1001 1 1001 101 /end IF_DATA /end MEASUREMENT
/begin MEASUREMENT ES900.ES910.CAN1.CAN1.AP_SHUTDOWN_State.Shutdown_IMD_OKreading "" FLOAT64_IEEE LINEAR_FUNCTION_M1_T0_U1 1 100 0 0 /begin IF_DATA E_TARGET KP_BLOB 0xFFFFFFFF 0xFFFFFFFF 2 1001 1 1001 102 /end IF_DATA /end MEASUREMENT
/begin MEASUREMENT ES900.ES910.CAN1.CAN1.AP_SHUTDOWN_State.Shutdown_IMD "" FLOAT64_IEEE LINEAR_FUNCTION_M1_T0_U1 1 100 0 0 /begin IF_DATA E_TARGET KP_BLOB 0xFFFFFFFF 0xFFFFFFFF 2 1001 1 1001 103 /end IF_DATA /end MEASUREMENT
/begin MEASUREMENT ES900.ES910.CAN1.CAN1.AP_SHUTDOWN_State.Shutdown_HVBox "" FLOAT64_IEEE LINEAR_FUNCTION_M1_T0_U1 1 100 0 0 /begin IF_DATA E_TARGET KP_BLOB 0xFFFFFFFF 0xFFFFFFFF 2 1001 1 1001 104 /end IF_DATA /end MEASUREMENT
/begin MEASUREMENT ES900.ES910.CAN1.CAN1.AP_SHUTDOWN_State.Shutdown_TSMS "" FLOAT64_IEEE LINEAR_FUNCTION_M1_T0_U1 1 100 0 0 /begin IF_DATA E_TARGET KP_BLOB 0xFFFFFFFF 0xFFFFFFFF 2 1001 1 1001 105 /end IF_DATA /end MEASUREMENT
/begin MEASUREMENT ES900.ES910.CAN1.CAN1.AP_SHUTDOWN_State.Shutdown_TSMPintck "" FLOAT64_IEEE LINEAR_FUNCTION_M1_T0_U1 1 100 0 0 /begin IF_DATA E_TARGET KP_BLOB 0xFFFFFFFF 0xFFFFFFFF 2 1001 1 1001 106 /end IF_DATA /end MEASUREMENT
/begin MEASUREMENT ES900.ES910.CAN1.CAN1.AP_SHUTDOWN_State.Shutdown_SetaRight "" FLOAT64_IEEE LINEAR_FUNCTION_M1_T0_U1 1 100 0 0 /begin IF_DATA E_TARGET KP_BLOB 0xFFFFFFFF 0xFFFFFFFF 2 1001 1 1001 107 /end IF_DATA /end MEASUREMENT
/begin MEASUREMENT ES900.ES910.CAN1.CAN1.AP_SHUTDOWN_State.Shutdown_SetaLeft "" FLOAT64_IEEE LINEAR_FUNCTION_M1_T0_U1 1 100 0 0 /begin IF_DATA E_TARGET KP_BLOB 0xFFFFFFFF 0xFFFFFFFF 2 1001 1 1001 108 /end IF_DATA /end MEASUREMENT
/begin MEASUREMENT ES900.ES910.CAN1.CAN1.AP_SHUTDOWN_State.Shutdown_SetaCockPit "" FLOAT64_IEEE LINEAR_FUNCTION_M1_T0_U1 1 100 0 0 /begin IF_DATA E_TARGET KP_BLOB 0xFFFFFFFF 0xFFFFFFFF 2 1001 1 1001 109 /end IF_DATA /end MEASUREMENT
/begin MEASUREMENT ES900.ES910.CAN1.CAN1.AP_SHUTDOWN_State.Shutdown_PackageIntck "" FLOAT64_IEEE LINEAR_FUNCTION_M1_T0_U1 1 100 0 0 /begin IF_DATA E_TARGET KP_BLOB 0xFFFFFFFF 0xFFFFFFFF 2 1001 1 1001 110 /end IF_DATA /end MEASUREMENT
/begin MEASUREMENT ES900.ES910.CAN1.CAN1.AP_SHUTDOWN_State.Shutdown_InverterRIntck "" FLOAT64_IEEE LINEAR_FUNCTION_M1_T0_U1 1 100 0 0 /begin IF_DATA E_TARGET KP_BLOB 0xFFFFFFFF 0xFFFFFFFF 2 1001 1 1001 111 /end IF_DATA /end MEASUREMENT
/begin MEASUREMENT ES900.ES910.CAN1.CAN1.AP_SHUTDOWN_State.Shutdown_InverterLIntck "" FLOAT64_IEEE LINEAR_FUNCTION_M1_T0_U1 1 100 0 0 /begin IF_DATA E_TARGET KP_BLOB 0xFFFFFFFF 0xFFFFFFFF 2 1001 1 1001 112 /end IF_DATA /end MEASUREMENT
/begin MEASUREMENT ES900.ES910.CAN1.CAN1.AP_SHUTDOWN_State.Shutdown_Inertia "" FLOAT64_IEEE LINEAR_FUNCTION_M1_T0_U1 1 100 0 0 /begin IF_DATA E_TARGET KP_BLOB 0xFFFFFFFF 0xFFFFFFFF 2 1001 1 1001 113 /end IF_DATA /end MEASUREMENT
/begin MEASUREMENT ES900.ES910.CAN1.CAN1.AP_SHUTDOWN_State.Shutdown_HVD "" FLOAT64_IEEE LINEAR_FUNCTION_M1_T0_U1 1 100 0 0 /begin IF_DATA E_TARGET KP_BLOB 0xFFFFFFFF 0xFFFFFFFF 2 1001 1 1001 114 /end IF_DATA /end MEASUREMENT
/begin MEASUREMENT ES900.ES910.CAN1.CAN1.AP_SHUTDOWN_State.Shutdown_BSPD_RelayReading "" FLOAT64_IEEE LINEAR_FUNCTION_M1_T0_U1 1 100 0 0 /begin IF_DATA E_TARGET KP_BLOB 0xFFFFFFFF 0xFFFFFFFF 2 1001 1 1001 115 /end IF_DATA /end MEASUREMENT
/begin MEASUREMENT ES900.ES910.CAN1.CAN1.AP_SHUTDOWN_State.Shutdown_BSPD "" FLOAT64_IEEE LINEAR_FUNCTION_M1_T0_U1 1 100 0 0 /begin IF_DATA E_TARGET KP_BLOB 0xFFFFFFFF 0xFFFFFFFF 2 1001 1 1001 116 /end IF_DATA /end MEASUREMENT
/begin MEASUREMENT ES900.ES910.CAN1.CAN1.AP_SHUTDOWN_State.Shutdown_BOTS "" FLOAT64_IEEE LINEAR_FUNCTION_M1_T0_U1 1 100 0 0 /begin IF_DATA E_TARGET KP_BLOB 0xFFFFFFFF 0xFFFFFFFF 2 1001 1 1001 117 /end IF_DATA /end MEASUREMENT
/begin MEASUREMENT ES900.ES910.CAN1.CAN1.AP_SHUTDOWN_State.Shutdown_BMS_OKreading "" FLOAT64_IEEE LINEAR_FUNCTION_M1_T0_U1 1 100 0 0 /begin IF_DATA E_TARGET KP_BLOB 0xFFFFFFFF 0xFFFFFFFF 2 1001 1 1001 118 /end IF_DATA /end MEASUREMENT
/begin MEASUREMENT ES900.ES910.CAN1.CAN1.AP_SHUTDOWN_State.Shutdown_BMS "" FLOAT64_IEEE LINEAR_FUNCTION_M1_T0_U1 1 100 0 0 /begin IF_DATA E_TARGET KP_BLOB 0xFFFFFFFF 0xFFFFFFFF 2 1001 1 1001 119 /end IF_DATA /end MEASUREMENT
/begin MEASUREMENT ES900.ES910.CAN1.CAN1.AP_SHUTDOWN_State.Pumps_State "" FLOAT64_IEEE LINEAR_FUNCTION_M1_T0_U1 1 100 0 0 /begin IF_DATA E_TARGET KP_BLOB 0xFFFFFFFF 0xFFFFFFFF 2 1001 1 1001 120 /end IF_DATA /end MEASUREMENT
/begin MEASUREMENT ES900.ES910.CAN1.CAN1.AP_SHUTDOWN_State.BrakeLight_State "" FLOAT64_IEEE LINEAR_FUNCTION_M1_T0_U1 1 100 0 0 /begin IF_DATA E_TARGET KP_BLOB 0xFFFFFFFF 0xFFFFFFFF 2 1001 1 1001 121 /end IF_DATA /end MEASUREMENT
/begin MEASUREMENT ES900.ES910.CAN1.CAN1.NM_ETAS_Disconnections.Disconnection_LV_Derivation "" FLOAT64_IEEE LINEAR_FUNCTION_M1_T0_U1 1 100 0 1 /begin IF_DATA E_TARGET KP_BLOB 0xFFFFFFFF 0xFFFFFFFF 2 1001 1 1001 123 /end IF_DATA /end MEASUREMENT
/begin MEASUREMENT ES900.ES910.CAN1.CAN1.NM_ETAS_Disconnections.Disconnection_DashBoard "" FLOAT64_IEEE LINEAR_FUNCTION_M1_T0_U1 1 100 0 1 /begin IF_DATA E_TARGET KP_BLOB 0xFFFFFFFF 0xFFFFFFFF 2 1001 1 1001 124 /end IF_DATA /end MEASUREMENT
/begin MEASUREMENT ES900.ES910.CAN1.CAN1.NM_ETAS_Disconnections.Disconnection_BMS "" FLOAT64_IEEE LINEAR_FUNCTION_M1_T0_U1 1 100 0 1 /begin IF_DATA E_TARGET KP_BLOB 0xFFFFFFFF 0xFFFFFFFF 2 1001 1 1001 125 /end IF_DATA /end MEASUREMENT
/begin MEASUREMENT ES900.ES910.CAN1.CAN1.NM_ETAS_Disconnections.Disconnection_Gyroscope_F "" FLOAT64_IEEE LINEAR_FUNCTION_M1_T0_U1 1 100 0 1 /begin IF_DATA E_TARGET KP_BLOB 0xFFFFFFFF 0xFFFFFFFF 2 1001 1 1001 126 /end IF_DATA /end MEASUREMENT
/begin MEASUREMENT ES900.ES910.CAN1.CAN1.NM_ETAS_Disconnections.Disconnection_Gyroscope_R "" FLOAT64_IEEE LINEAR_FUNCTION_M1_T0_U1 1 100 0 1 /begin IF_DATA E_TARGET KP_BLOB 0xFFFFFFFF 0xFFFFFFFF 2 1001 1 1001 127 /end IF_DATA /end MEASUREMENT
/begin MEASUREMENT ES900.ES910.CAN1.CAN1.NM_ETAS_Disconnections.Disconnection_Accel_F "" FLOAT64_IEEE LINEAR_FUNCTION_M1_T0_U1 1 100 0 1 /begin IF_DATA E_TARGET KP_BLOB 0xFFFFFFFF 0xFFFFFFFF 2 1001 1 1001 128 /end IF_DATA /end MEASUREMENT
/begin MEASUREMENT ES900.ES910.CAN1.CAN1.NM_ETAS_Disconnections.Disconnection_Accel_R "" FLOAT64_IEEE LINEAR_FUNCTION_M1_T0_U1 1 100 0 1 /begin IF_DATA E_TARGET KP_BLOB 0xFFFFFFFF 0xFFFFFFFF 2 1001 1 1001 129 /end IF_DATA /end MEASUREMENT
/begin MEASUREMENT ES900.ES910.CAN1.CAN1.NM_ETAS_Disconnections.Disconnection_SteeringSensor "" FLOAT64_IEEE LINEAR_FUNCTION_M1_T0_U1 1 100 0 1 /begin IF_DATA E_TARGET KP_BLOB 0xFFFFFFFF 0xFFFFFFFF 2 1001 1 1001 130 /end IF_DATA /end MEASUREMENT
/begin MEASUREMENT ES900.ES910.CAN1.CAN1.NM_ETAS_Disconnections.Disconnection_Susp_R_R "" FLOAT64_IEEE LINEAR_FUNCTION_M1_T0_U1 1 100 0 1 /begin IF_DATA E_TARGET KP_BLOB 0xFFFFFFFF 0xFFFFFFFF 2 1001 1 1001 131 /end IF_DATA /end MEASUREMENT
/begin MEASUREMENT ES900.ES910.CAN1.CAN1.NM_ETAS_Disconnections.Disconnection_Susp_R_L "" FLOAT64_IEEE LINEAR_FUNCTION_M1_T0_U1 1 100 0 1 /begin IF_DATA E_TARGET KP_BLOB 0xFFFFFFFF 0xFFFFFFFF 2 1001 1 1001 132 /end IF_DATA /end MEASUREMENT
/begin MEASUREMENT ES900.ES910.CAN1.CAN1.NM_ETAS_Disconnections.Disconnection_Susp_F_R "" FLOAT64_IEEE LINEAR_FUNCTION_M1_T0_U1 1 100 0 1 /begin IF_DATA E_TARGET KP_BLOB 0xFFFFFFFF 0xFFFFFFFF 2 1001 1 1001 133 /end IF_DATA /end MEASUREMENT
/begin MEASUREMENT ES900.ES910.CAN1.CAN1.NM_ETAS_Disconnections.Disconnection_Susp_F_L "" FLOAT64_IEEE LINEAR_FUNCTION_M1_T0_U1 1 100 0 1 /begin IF_DATA E_TARGET KP_BLOB 0xFFFFFFFF 0xFFFFFFFF 2 1001 1 1001 134 /end IF_DATA /end MEASUREMENT
/begin MEASUREMENT ES900.ES910.CAN1.CAN1.NM_ETAS_Disconnections.Disconnection_Brake_Sensor "" FLOAT64_IEEE LINEAR_FUNCTION_M1_T0_U1 1 100 0 1 /begin IF_DATA E_TARGET KP_BLOB 0xFFFFFFFF 0xFFFFFFFF 2 1001 1 1001 135 /end IF_DATA /end MEASUREMENT
/begin MEASUREMENT ES900.ES910.CAN1.CAN1.NM_ETAS_Disconnections.Disconnection_APPS2 "" FLOAT64_IEEE LINEAR_FUNCTION_M1_T0_U1 1 100 0 1 /begin IF_DATA E_TARGET KP_BLOB 0xFFFFFFFF 0xFFFFFFFF 2 1001 1 1001 136 /end IF_DATA /end MEASUREMENT
/begin MEASUREMENT ES900.ES910.CAN1.CAN1.NM_ETAS_Disconnections.Disconnection_APPS1 "" FLOAT64_IEEE LINEAR_FUNCTION_M1_T0_U1 1 100 0 1 /begin IF_DATA E_TARGET KP_BLOB 0xFFFFFFFF 0xFFFFFFFF 2 1001 1 1001 137 /end IF_DATA /end MEASUREMENT
/begin MEASUREMENT ES900.ES910.CAN1.CAN1.NM_ETAS_Disconnections.Disconnection_ADCAN "" FLOAT64_IEEE LINEAR_FUNCTION_M1_T0_U1 1 100 0 1 /begin IF_DATA E_TARGET KP_BLOB 0xFFFFFFFF 0xFFFFFFFF 2 1001 1 1001 138 /end IF_DATA /end MEASUREMENT
/begin MEASUREMENT ES900.ES910.CAN1.CAN1.NM_ETAS_Disconnections.Disconnection_Shutdown "" FLOAT64_IEEE LINEAR_FUNCTION_M1_T0_U1 1 100 0 1 /begin IF_DATA E_TARGET KP_BLOB 0xFFFFFFFF 0xFFFFFFFF 2 1001 1 1001 139 /end IF_DATA /end MEASUREMENT
/begin MEASUREMENT ES900.ES910.CAN1.CAN1.NM_SHUTDOWN_Keep_Alive.Shutdown_Alive "" FLOAT64_IEEE LINEAR_FUNCTION_M1_T0_U1 1 100 0 0 /begin IF_DATA E_TARGET KP_BLOB 0xFFFFFFFF 0xFFFFFFFF 2 1001 1 1001 140 /end IF_DATA /end MEASUREMENT
/begin MEASUREMENT ES900.ES910.CAN1.CAN1.AP_ETAS_DashData2.SteeringSensor_Value "" FLOAT64_IEEE LINEAR_FUNCTION_M1_T0_U1 1 100 -128 127 /begin IF_DATA E_TARGET KP_BLOB 0xFFFFFFFF 0xFFFFFFFF 2 1001 1 1001 142 /end IF_DATA /end MEASUREMENT
/begin MEASUREMENT ES900.ES910.CAN1.CAN1.AP_ETAS_DashData2.SKF_actual "" FLOAT64_IEEE LINEAR_FUNCTION_M1_T0_U1 1 100 0 25.5 /begin IF_DATA E_TARGET KP_BLOB 0xFFFFFFFF 0xFFFFFFFF 2 1001 1 1001 143 /end IF_DATA /end MEASUREMENT
/begin MEASUREMENT ES900.ES910.CAN1.CAN1.AP_ETAS_DashData2.CKF_actual "" FLOAT64_IEEE LINEAR_FUNCTION_M1_T0_U1 1 100 0 25.5 /begin IF_DATA E_TARGET KP_BLOB 0xFFFFFFFF 0xFFFFFFFF 2 1001 1 1001 144 /end IF_DATA /end MEASUREMENT
/begin MEASUREMENT ES900.ES910.CAN1.CAN1.AP_ETAS_DashData2.BrakeSensor_Value "" FLOAT64_IEEE LINEAR_FUNCTION_M1_T0_U1 1 100 0 1 /begin IF_DATA E_TARGET KP_BLOB 0xFFFFFFFF 0xFFFFFFFF 2 1001 1 1001 145 /end IF_DATA /end MEASUREMENT
/begin MEASUREMENT ES900.ES910.CAN1.CAN1.AP_ETAS_DashData2.APPS2_Value "" FLOAT64_IEEE LINEAR_FUNCTION_M1_T0_U1 1 100 0 1 /begin IF_DATA E_TARGET KP_BLOB 0xFFFFFFFF 0xFFFFFFFF 2 1001 1 1001 146 /end IF_DATA /end MEASUREMENT
/begin MEASUREMENT ES900.ES910.CAN1.CAN1.AP_ETAS_DashData2.APPS1_Value "" FLOAT64_IEEE LINEAR_FUNCTION_M1_T0_U1 1 100 0 1 /begin IF_DATA E_TARGET KP_BLOB 0xFFFFFFFF 0xFFFFFFFF 2 1001 1 1001 147 /end IF_DATA /end MEASUREMENT
/begin MEASUREMENT ES900.ES910.CAN1.CAN1.AP_ETAS_Synchronism.Sync_CAN1 "" FLOAT64_IEEE LINEAR_FUNCTION_M1_T0_U1 1 100 0 255 /begin IF_DATA E_TARGET KP_BLOB 0xFFFFFFFF 0xFFFFFFFF 2 1001 1 1001 149 /end IF_DATA /end MEASUREMENT
/begin MEASUREMENT ES900.ES910.CAN2.Presence.PresenceGroup.PresenceFlag "" FLOAT64_IEEE LINEAR_FUNCTION_M1_T0_U1 1 100 0 1 /begin IF_DATA E_TARGET KP_BLOB 0xFFFFFFFF 0xFFFFFFFF 2 1001 1 1001 150 /end IF_DATA /end MEASUREMENT
/begin MEASUREMENT ES900.ES910.CAN2.CAN2.AP_ELLIPSE_EKF_POS.LONGITUDE_EKF "" FLOAT64_IEEE LINEAR_FUNCTION_M1_T0_U2 1 100 0 0 /begin IF_DATA E_TARGET KP_BLOB 0xFFFFFFFF 0xFFFFFFFF 2 1001 1 1001 151 /end IF_DATA /end MEASUREMENT
/begin MEASUREMENT ES900.ES910.CAN2.CAN2.AP_ELLIPSE_EKF_POS.LATITUDE_EKF "" FLOAT64_IEEE LINEAR_FUNCTION_M1_T0_U2 1 100 0 0 /begin IF_DATA E_TARGET KP_BLOB 0xFFFFFFFF 0xFFFFFFFF 2 1001 1 1001 152 /end IF_DATA /end MEASUREMENT
/begin MEASUREMENT ES900.ES910.CAN2.CAN2.AP_ELLIPSE_IMU_ACCEL.ACCEL_Z_IMU "" FLOAT64_IEEE LINEAR_FUNCTION_M1_T0_U3 1 100 0 0 /begin IF_DATA E_TARGET KP_BLOB 0xFFFFFFFF 0xFFFFFFFF 2 1001 1 1001 153 /end IF_DATA /end MEASUREMENT
/begin MEASUREMENT ES900.ES910.CAN2.CAN2.AP_ELLIPSE_IMU_ACCEL.ACCEL_Y_IMU "" FLOAT64_IEEE LINEAR_FUNCTION_M1_T0_U3 1 100 0 0 /begin IF_DATA E_TARGET KP_BLOB 0xFFFFFFFF 0xFFFFFFFF 2 1001 1 1001 154 /end IF_DATA /end MEASUREMENT
/begin MEASUREMENT ES900.ES910.CAN2.CAN2.AP_ELLIPSE_IMU_ACCEL.ACCEL_X_IMU "" FLOAT64_IEEE LINEAR_FUNCTION_M1_T0_U3 1 100 0 0 /begin IF_DATA E_TARGET KP_BLOB 0xFFFFFFFF 0xFFFFFFFF 2 1001 1 1001 155 /end IF_DATA /end MEASUREMENT
/begin MEASUREMENT ES900.ES910.CAN2.CAN2.AP_ELLIPSE_MAG.ACCEL_Z_MAG "" FLOAT64_IEEE LINEAR_FUNCTION_M1_T0_U3 1 100 0 0 /begin IF_DATA E_TARGET KP_BLOB 0xFFFFFFFF 0xFFFFFFFF 2 1001 1 1001 156 /end IF_DATA /end MEASUREMENT
/begin MEASUREMENT ES900.ES910.CAN2.CAN2.AP_ELLIPSE_MAG.ACCEL_Y_MAG "" FLOAT64_IEEE LINEAR_FUNCTION_M1_T0_U3 1 100 0 0 /begin IF_DATA E_TARGET KP_BLOB 0xFFFFFFFF 0xFFFFFFFF 2 1001 1 1001 157 /end IF_DATA /end MEASUREMENT
/begin MEASUREMENT ES900.ES910.CAN2.CAN2.AP_ELLIPSE_MAG.ACCEL_X_MAG "" FLOAT64_IEEE LINEAR_FUNCTION_M1_T0_U3 1 100 0 0 /begin IF_DATA E_TARGET KP_BLOB 0xFFFFFFFF 0xFFFFFFFF 2 1001 1 1001 158 /end IF_DATA /end MEASUREMENT
/begin MEASUREMENT ES900.ES910.CAN2.CAN2.AP_ELLIPSE_EKF_EULER.YAW "" FLOAT64_IEEE LINEAR_FUNCTION_M1_T0_U4 1 100 0 0 /begin IF_DATA E_TARGET KP_BLOB 0xFFFFFFFF 0xFFFFFFFF 2 1001 1 1001 159 /end IF_DATA /end MEASUREMENT
/begin MEASUREMENT ES900.ES910.CAN2.CAN2.AP_ELLIPSE_EKF_EULER.PITCH "" FLOAT64_IEEE LINEAR_FUNCTION_M1_T0_U4 1 100 0 0 /begin IF_DATA E_TARGET KP_BLOB 0xFFFFFFFF 0xFFFFFFFF 2 1001 1 1001 160 /end IF_DATA /end MEASUREMENT
/begin MEASUREMENT ES900.ES910.CAN2.CAN2.AP_ELLIPSE_EKF_EULER.ROLL "" FLOAT64_IEEE LINEAR_FUNCTION_M1_T0_U4 1 100 0 0 /begin IF_DATA E_TARGET KP_BLOB 0xFFFFFFFF 0xFFFFFFFF 2 1001 1 1001 161 /end IF_DATA /end MEASUREMENT
/begin MEASUREMENT ES900.ES910.CAN2.CAN2.AP_ELLIPSE_EKF_VEL_BODY.el_Vel_Z "" FLOAT64_IEEE LINEAR_FUNCTION_M1_T0_U5 1 100 0 0 /begin IF_DATA E_TARGET KP_BLOB 0xFFFFFFFF 0xFFFFFFFF 2 1001 1 1001 162 /end IF_DATA /end MEASUREMENT
/begin MEASUREMENT ES900.ES910.CAN2.CAN2.AP_ELLIPSE_EKF_VEL_BODY.el_Vel_Y "" FLOAT64_IEEE LINEAR_FUNCTION_M1_T0_U5 1 100 0 0 /begin IF_DATA E_TARGET KP_BLOB 0xFFFFFFFF 0xFFFFFFFF 2 1001 1 1001 163 /end IF_DATA /end MEASUREMENT
/begin MEASUREMENT ES900.ES910.CAN2.CAN2.AP_ELLIPSE_EKF_VEL_BODY.el_Vel_X "" FLOAT64_IEEE LINEAR_FUNCTION_M1_T0_U5 1 100 0 0 /begin IF_DATA E_TARGET KP_BLOB 0xFFFFFFFF 0xFFFFFFFF 2 1001 1 1001 164 /end IF_DATA /end MEASUREMENT
/begin MEASUREMENT ES900.ES910.CAN2.CAN2.NM_ELLIPSE_Status.CLOCK "" FLOAT64_IEEE LINEAR_FUNCTION_M1_T0_U1 1 100 0 0 /begin IF_DATA E_TARGET KP_BLOB 0xFFFFFFFF 0xFFFFFFFF 2 1001 1 1001 165 /end IF_DATA /end MEASUREMENT
/begin MEASUREMENT ES900.ES910.CAN2.CAN2.NM_ELLIPSE_Status.GENERAL "" FLOAT64_IEEE LINEAR_FUNCTION_M1_T0_U1 1 100 0 0 /begin IF_DATA E_TARGET KP_BLOB 0xFFFFFFFF 0xFFFFFFFF 2 1001 1 1001 166 /end IF_DATA /end MEASUREMENT
/begin MEASUREMENT ES900.ES910.CAN2.CAN2.NM_ELLIPSE_Status.TIME_STAMP "" FLOAT64_IEEE LINEAR_FUNCTION_M1_T0_U6 1 100 0 0 /begin IF_DATA E_TARGET KP_BLOB 0xFFFFFFFF 0xFFFFFFFF 2 1001 1 1001 167 /end IF_DATA /end MEASUREMENT
/begin MEASUREMENT ES900.ES910.CAN2.CAN2.AP_ELLIPSE_IMU_GYRO.GYRO_Z "" FLOAT64_IEEE LINEAR_FUNCTION_M1_T0_U7 1 100 0 0 /begin IF_DATA E_TARGET KP_BLOB 0xFFFFFFFF 0xFFFFFFFF 2 1001 1 1001 168 /end IF_DATA /end MEASUREMENT
/begin MEASUREMENT ES900.ES910.CAN2.CAN2.AP_ELLIPSE_IMU_GYRO.GYRO_Y "" FLOAT64_IEEE LINEAR_FUNCTION_M1_T0_U7 1 100 0 0 /begin IF_DATA E_TARGET KP_BLOB 0xFFFFFFFF 0xFFFFFFFF 2 1001 1 1001 169 /end IF_DATA /end MEASUREMENT
/begin MEASUREMENT ES900.ES910.CAN2.CAN2.AP_ELLIPSE_IMU_GYRO.GYRO_X "" FLOAT64_IEEE LINEAR_FUNCTION_M1_T0_U7 1 100 0 0 /begin IF_DATA E_TARGET KP_BLOB 0xFFFFFFFF 0xFFFFFFFF 2 1001 1 1001 170 /end IF_DATA /end MEASUREMENT
/begin MEASUREMENT ES900.ES910.CAN2.CAN2.AP_ELLIPSE_SLIP_CURV.AUTO_STATUS "" FLOAT64_IEEE LINEAR_FUNCTION_M1_T0_U1 1 100 0 0 /begin IF_DATA E_TARGET KP_BLOB 0xFFFFFFFF 0xFFFFFFFF 2 1001 1 1001 171 /end IF_DATA /end MEASUREMENT
/begin MEASUREMENT ES900.ES910.CAN2.CAN2.AP_ELLIPSE_SLIP_CURV.CURVATURE_RADIUS "" FLOAT64_IEEE LINEAR_FUNCTION_M1_T0_U8 1 100 0 0 /begin IF_DATA E_TARGET KP_BLOB 0xFFFFFFFF 0xFFFFFFFF 2 1001 1 1001 172 /end IF_DATA /end MEASUREMENT
/begin MEASUREMENT ES900.ES910.CAN2.CAN2.AP_ELLIPSE_SLIP_CURV.ANGLE_SLIP "" FLOAT64_IEEE LINEAR_FUNCTION_M1_T0_U4 1 100 0 0 /begin IF_DATA E_TARGET KP_BLOB 0xFFFFFFFF 0xFFFFFFFF 2 1001 1 1001 173 /end IF_DATA /end MEASUREMENT
/begin MEASUREMENT ES900.ES910.CAN2.CAN2.AP_ELLIPSE_SLIP_CURV.ANGLE_TRACK "" FLOAT64_IEEE LINEAR_FUNCTION_M1_T0_U4 1 100 0 0 /begin IF_DATA E_TARGET KP_BLOB 0xFFFFFFFF 0xFFFFFFFF 2 1001 1 1001 174 /end IF_DATA /end MEASUREMENT
/begin MEASUREMENT ES900.ES910.CAN2.CAN2.MEAS_ETAS_Inverter_R_Data.Inv_R_TempMotor "" FLOAT64_IEEE LINEAR_FUNCTION_M1_T0_U1 1 100 -28 227 /begin IF_DATA E_TARGET KP_BLOB 0xFFFFFFFF 0xFFFFFFFF 2 1001 1 1001 176 /end IF_DATA /end MEASUREMENT
/begin MEASUREMENT ES900.ES910.CAN2.CAN2.MEAS_ETAS_Inverter_R_Data.Inv_R_TempIGBT "" FLOAT64_IEEE LINEAR_FUNCTION_M1_T0_U1 1 100 -28 227 /begin IF_DATA E_TARGET KP_BLOB 0xFFFFFFFF 0xFFFFFFFF 2 1001 1 1001 177 /end IF_DATA /end MEASUREMENT
/begin MEASUREMENT ES900.ES910.CAN2.CAN2.MEAS_ETAS_Inverter_R_Data.Inv_R_Speed "" FLOAT64_IEEE LINEAR_FUNCTION_M1_T0_U1 1 100 -5120 5080 /begin IF_DATA E_TARGET KP_BLOB 0xFFFFFFFF 0xFFFFFFFF 2 1001 1 1001 178 /end IF_DATA /end MEASUREMENT
/begin MEASUREMENT ES900.ES910.CAN2.CAN2.MEAS_ETAS_Inverter_R_Data.Inv_R_Iq "" FLOAT64_IEEE LINEAR_FUNCTION_M1_T0_U1 1 100 -320 317.5 /begin IF_DATA E_TARGET KP_BLOB 0xFFFFFFFF 0xFFFFFFFF 2 1001 1 1001 179 /end IF_DATA /end MEASUREMENT
/begin MEASUREMENT ES900.ES910.CAN2.CAN2.MEAS_ETAS_Inverter_R_Data.Inv_R_Icommand "" FLOAT64_IEEE LINEAR_FUNCTION_M1_T0_U1 1 100 -320 317.5 /begin IF_DATA E_TARGET KP_BLOB 0xFFFFFFFF 0xFFFFFFFF 2 1001 1 1001 180 /end IF_DATA /end MEASUREMENT
/begin MEASUREMENT ES900.ES910.CAN2.CAN2.MEAS_ETAS_Inverter_R_Data.Inv_R_Iactual "" FLOAT64_IEEE LINEAR_FUNCTION_M1_T0_U1 1 100 -320 317.5 /begin IF_DATA E_TARGET KP_BLOB 0xFFFFFFFF 0xFFFFFFFF 2 1001 1 1001 181 /end IF_DATA /end MEASUREMENT
/begin MEASUREMENT ES900.ES910.CAN2.CAN2.MEAS_ETAS_Inverter_L_Data.Inv_L_TempMotor "" FLOAT64_IEEE LINEAR_FUNCTION_M1_T0_U1 1 100 -28 227 /begin IF_DATA E_TARGET KP_BLOB 0xFFFFFFFF 0xFFFFFFFF 2 1001 1 1001 183 /end IF_DATA /end MEASUREMENT
/begin MEASUREMENT ES900.ES910.CAN2.CAN2.MEAS_ETAS_Inverter_L_Data.Inv_L_TempIGBT "" FLOAT64_IEEE LINEAR_FUNCTION_M1_T0_U1 1 100 -28 227 /begin IF_DATA E_TARGET KP_BLOB 0xFFFFFFFF 0xFFFFFFFF 2 1001 1 1001 184 /end IF_DATA /end MEASUREMENT
/begin MEASUREMENT ES900.ES910.CAN2.CAN2.MEAS_ETAS_Inverter_L_Data.Inv_L_Speed "" FLOAT64_IEEE LINEAR_FUNCTION_M1_T0_U1 1 100 -5120 5080 /begin IF_DATA E_TARGET KP_BLOB 0xFFFFFFFF 0xFFFFFFFF 2 1001 1 1001 185 /end IF_DATA /end MEASUREMENT
/begin MEASUREMENT ES900.ES910.CAN2.CAN2.MEAS_ETAS_Inverter_L_Data.Inv_L_Iq "" FLOAT64_IEEE LINEAR_FUNCTION_M1_T0_U1 1 100 -320 317.5 /begin IF_DATA E_TARGET KP_BLOB 0xFFFFFFFF 0xFFFFFFFF 2 1001 1 1001 186 /end IF_DATA /end MEASUREMENT
/begin MEASUREMENT ES900.ES910.CAN2.CAN2.MEAS_ETAS_Inverter_L_Data.Inv_L_Icommand "" FLOAT64_IEEE LINEAR_FUNCTION_M1_T0_U1 1 100 -320 317.5 /begin IF_DATA E_TARGET KP_BLOB 0xFFFFFFFF 0xFFFFFFFF 2 1001 1 1001 187 /end IF_DATA /end MEASUREMENT
/begin MEASUREMENT ES900.ES910.CAN2.CAN2.MEAS_ETAS_Inverter_L_Data.Inv_L_Iactual "" FLOAT64_IEEE LINEAR_FUNCTION_M1_T0_U1 1 100 -320 317.5 /begin IF_DATA E_TARGET KP_BLOB 0xFFFFFFFF 0xFFFFFFFF 2 1001 1 1001 188 /end IF_DATA /end MEASUREMENT
/begin MEASUREMENT ES900.ES910.CAN2.CAN2.MEAS_ETAS_VDCdata6.SUSP_F_R "" FLOAT64_IEEE LINEAR_FUNCTION_M1_T0_U1 1 100 -327.68 327.67 /begin IF_DATA E_TARGET KP_BLOB 0xFFFFFFFF 0xFFFFFFFF 2 1001 1 1001 190 /end IF_DATA /end MEASUREMENT
/begin MEASUREMENT ES900.ES910.CAN2.CAN2.MEAS_ETAS_VDCdata6.SUSP_F_L "" FLOAT64_IEEE LINEAR_FUNCTION_M1_T0_U1 1 100 -327.68 327.67 /begin IF_DATA E_TARGET KP_BLOB 0xFFFFFFFF 0xFFFFFFFF 2 1001 1 1001 191 /end IF_DATA /end MEASUREMENT
/begin MEASUREMENT ES900.ES910.CAN2.CAN2.MEAS_ETAS_VDCdata5.Gyro_F_Z_Deg "" FLOAT64_IEEE LINEAR_FUNCTION_M1_T0_U1 1 100 0 393.21 /begin IF_DATA E_TARGET KP_BLOB 0xFFFFFFFF 0xFFFFFFFF 2 1001 1 1001 193 /end IF_DATA /end MEASUREMENT
/begin MEASUREMENT ES900.ES910.CAN2.CAN2.MEAS_ETAS_VDCdata5.Accel_F_Z_SI "" FLOAT64_IEEE LINEAR_FUNCTION_M1_T0_U1 1 100 -327.68 327.67 /begin IF_DATA E_TARGET KP_BLOB 0xFFFFFFFF 0xFFFFFFFF 2 1001 1 1001 194 /end IF_DATA /end MEASUREMENT
/begin MEASUREMENT ES900.ES910.CAN2.CAN2.MEAS_ETAS_VDCdata5.Accel_F_Y_SI "" FLOAT64_IEEE LINEAR_FUNCTION_M1_T0_U1 1 100 -327.68 327.67 /begin IF_DATA E_TARGET KP_BLOB 0xFFFFFFFF 0xFFFFFFFF 2 1001 1 1001 195 /end IF_DATA /end MEASUREMENT
/begin MEASUREMENT ES900.ES910.CAN2.CAN2.MEAS_ETAS_VDCdata5.Accel_F_X_SI "" FLOAT64_IEEE LINEAR_FUNCTION_M1_T0_U1 1 100 -327.68 327.67 /begin IF_DATA E_TARGET KP_BLOB 0xFFFFFFFF 0xFFFFFFFF 2 1001 1 1001 196 /end IF_DATA /end MEASUREMENT
/begin MEASUREMENT ES900.ES910.CAN2.CAN2.MEAS_ETAS_VDCdata4.Gyro_R_Z_Deg "" FLOAT64_IEEE LINEAR_FUNCTION_M1_T0_U1 1 100 0 393.21 /begin IF_DATA E_TARGET KP_BLOB 0xFFFFFFFF 0xFFFFFFFF 2 1001 1 1001 198 /end IF_DATA /end MEASUREMENT
/begin MEASUREMENT ES900.ES910.CAN2.CAN2.MEAS_ETAS_VDCdata4.Accel_R_Z_SI "" FLOAT64_IEEE LINEAR_FUNCTION_M1_T0_U1 1 100 -327.68 327.67 /begin IF_DATA E_TARGET KP_BLOB 0xFFFFFFFF 0xFFFFFFFF 2 1001 1 1001 199 /end IF_DATA /end MEASUREMENT
/begin MEASUREMENT ES900.ES910.CAN2.CAN2.MEAS_ETAS_VDCdata4.Accel_R_Y_SI "" FLOAT64_IEEE LINEAR_FUNCTION_M1_T0_U1 1 100 -327.68 327.67 /begin IF_DATA E_TARGET KP_BLOB 0xFFFFFFFF 0xFFFFFFFF 2 1001 1 1001 200 /end IF_DATA /end MEASUREMENT
/begin MEASUREMENT ES900.ES910.CAN2.CAN2.MEAS_ETAS_VDCdata4.Accel_R_X_SI "" FLOAT64_IEEE LINEAR_FUNCTION_M1_T0_U1 1 100 -327.68 327.67 /begin IF_DATA E_TARGET KP_BLOB 0xFFFFFFFF 0xFFFFFFFF 2 1001 1 1001 201 /end IF_DATA /end MEASUREMENT
/begin MEASUREMENT ES900.ES910.CAN2.CAN2.AP_LV_Derivation_LVData.LVBattery_Voltage_Bits "" FLOAT64_IEEE LINEAR_FUNCTION_M1_T0_U1 1 100 0 0 /begin IF_DATA E_TARGET KP_BLOB 0xFFFFFFFF 0xFFFFFFFF 2 1001 1 1001 202 /end IF_DATA /end MEASUREMENT
/begin MEASUREMENT ES900.ES910.CAN2.CAN2.MEAS_ETAS_VDCdata7.Torque_R "" FLOAT64_IEEE LINEAR_FUNCTION_M1_T0_U1 1 100 -254 254 /begin IF_DATA E_TARGET KP_BLOB 0xFFFFFFFF 0xFFFFFFFF 2 1001 1 1001 204 /end IF_DATA /end MEASUREMENT
/begin MEASUREMENT ES900.ES910.CAN2.CAN2.MEAS_ETAS_VDCdata7.Torque_L "" FLOAT64_IEEE LINEAR_FUNCTION_M1_T0_U1 1 100 -256 254 /begin IF_DATA E_TARGET KP_BLOB 0xFFFFFFFF 0xFFFFFFFF 2 1001 1 1001 205 /end IF_DATA /end MEASUREMENT
/begin MEASUREMENT ES900.ES910.CAN2.CAN2.MEAS_ETAS_VDCdata3.Handling "" FLOAT64_IEEE LINEAR_FUNCTION_M1_T0_U1 1 100 0 65535 /begin IF_DATA E_TARGET KP_BLOB 0xFFFFFFFF 0xFFFFFFFF 2 1001 1 1001 207 /end IF_DATA /end MEASUREMENT
/begin MEASUREMENT ES900.ES910.CAN2.CAN2.MEAS_ETAS_VDCdata3.Dash_Speed "" FLOAT64_IEEE LINEAR_FUNCTION_M1_T0_U1 1 100 -32768 32767 /begin IF_DATA E_TARGET KP_BLOB 0xFFFFFFFF 0xFFFFFFFF 2 1001 1 1001 208 /end IF_DATA /end MEASUREMENT
/begin MEASUREMENT ES900.ES910.CAN2.CAN2.MEAS_ETAS_VDCdata3.Mass "" FLOAT64_IEEE LINEAR_FUNCTION_M1_T0_U1 1 100 0 65535 /begin IF_DATA E_TARGET KP_BLOB 0xFFFFFFFF 0xFFFFFFFF 2 1001 1 1001 209 /end IF_DATA /end MEASUREMENT
/begin MEASUREMENT ES900.ES910.CAN2.CAN2.MEAS_ETAS_VDCdata2.Throttle "" FLOAT64_IEEE LINEAR_FUNCTION_M1_T0_U1 1 100 0 65535 /begin IF_DATA E_TARGET KP_BLOB 0xFFFFFFFF 0xFFFFFFFF 2 1001 1 1001 211 /end IF_DATA /end MEASUREMENT
/begin MEASUREMENT ES900.ES910.CAN2.CAN2.MEAS_ETAS_VDCdata2.Max_Fx_RR "" FLOAT64_IEEE LINEAR_FUNCTION_M1_T0_U1 1 100 0 65535 /begin IF_DATA E_TARGET KP_BLOB 0xFFFFFFFF 0xFFFFFFFF 2 1001 1 1001 212 /end IF_DATA /end MEASUREMENT
/begin MEASUREMENT ES900.ES910.CAN2.CAN2.MEAS_ETAS_VDCdata2.Max_Fx_RL "" FLOAT64_IEEE LINEAR_FUNCTION_M1_T0_U1 1 100 0 65535 /begin IF_DATA E_TARGET KP_BLOB 0xFFFFFFFF 0xFFFFFFFF 2 1001 1 1001 213 /end IF_DATA /end MEASUREMENT
/begin MEASUREMENT ES900.ES910.CAN2.CAN2.MEAS_ETAS_VDCdata2.Fy_R "" FLOAT64_IEEE LINEAR_FUNCTION_M1_T0_U1 1 100 0 65535 /begin IF_DATA E_TARGET KP_BLOB 0xFFFFFFFF 0xFFFFFFFF 2 1001 1 1001 214 /end IF_DATA /end MEASUREMENT
/begin MEASUREMENT ES900.ES910.CAN2.CAN2.MEAS_ETAS_VDCdata1.Max_Torque_RR "" FLOAT64_IEEE LINEAR_FUNCTION_M1_T0_U1 1 100 0 65535 /begin IF_DATA E_TARGET KP_BLOB 0xFFFFFFFF 0xFFFFFFFF 2 1001 1 1001 216 /end IF_DATA /end MEASUREMENT
/begin MEASUREMENT ES900.ES910.CAN2.CAN2.MEAS_ETAS_VDCdata1.Max_Torque_RL "" FLOAT64_IEEE LINEAR_FUNCTION_M1_T0_U1 1 100 0 65535 /begin IF_DATA E_TARGET KP_BLOB 0xFFFFFFFF 0xFFFFFFFF 2 1001 1 1001 217 /end IF_DATA /end MEASUREMENT
/begin MEASUREMENT ES900.ES910.CAN2.CAN2.MEAS_ETAS_VDCdata1.Torque_RRwc "" FLOAT64_IEEE LINEAR_FUNCTION_M1_T0_U1 1 100 0 65535 /begin IF_DATA E_TARGET KP_BLOB 0xFFFFFFFF 0xFFFFFFFF 2 1001 1 1001 218 /end IF_DATA /end MEASUREMENT
/begin MEASUREMENT ES900.ES910.CAN2.CAN2.MEAS_ETAS_VDCdata1.Torque_RLwc "" FLOAT64_IEEE LINEAR_FUNCTION_M1_T0_U1 1 100 0 65535 /begin IF_DATA E_TARGET KP_BLOB 0xFFFFFFFF 0xFFFFFFFF 2 1001 1 1001 219 /end IF_DATA /end MEASUREMENT
/begin MEASUREMENT ES900.ES910.CAN2.CAN2.AP_ACCEL_R_Data2.Susp_R_R_Bits "" FLOAT64_IEEE LINEAR_FUNCTION_M1_T0_U1 1 100 0 0 /begin IF_DATA E_TARGET KP_BLOB 0xFFFFFFFF 0xFFFFFFFF 2 1001 1 1001 220 /end IF_DATA /end MEASUREMENT
/begin MEASUREMENT ES900.ES910.CAN2.CAN2.AP_ACCEL_R_Data2.Susp_R_L_Bits "" FLOAT64_IEEE LINEAR_FUNCTION_M1_T0_U1 1 100 0 0 /begin IF_DATA E_TARGET KP_BLOB 0xFFFFFFFF 0xFFFFFFFF 2 1001 1 1001 221 /end IF_DATA /end MEASUREMENT
/begin MEASUREMENT ES900.ES910.CAN2.CAN2.NM_LV_Derivation_Keep_Alive.LV_Derivation_Alive "" FLOAT64_IEEE LINEAR_FUNCTION_M1_T0_U1 1 100 0 0 /begin IF_DATA E_TARGET KP_BLOB 0xFFFFFFFF 0xFFFFFFFF 2 1001 1 1001 222 /end IF_DATA /end MEASUREMENT
/begin MEASUREMENT ES900.ES910.CAN2.CAN2.AP_ACCEL_F_Data.Gyroscope_F "" FLOAT64_IEEE LINEAR_FUNCTION_M1_T0_U1 1 100 0 0 /begin IF_DATA E_TARGET KP_BLOB 0xFFFFFFFF 0xFFFFFFFF 2 1001 1 1001 223 /end IF_DATA /end MEASUREMENT
/begin MEASUREMENT ES900.ES910.CAN2.CAN2.AP_ACCEL_F_Data.ACCEL_F_Z "" FLOAT64_IEEE LINEAR_FUNCTION_M1_T0_U1 1 100 0 0 /begin IF_DATA E_TARGET KP_BLOB 0xFFFFFFFF 0xFFFFFFFF 2 1001 1 1001 224 /end IF_DATA /end MEASUREMENT
/begin MEASUREMENT ES900.ES910.CAN2.CAN2.AP_ACCEL_F_Data.ACCEL_F_Y "" FLOAT64_IEEE LINEAR_FUNCTION_M1_T0_U1 1 100 0 0 /begin IF_DATA E_TARGET KP_BLOB 0xFFFFFFFF 0xFFFFFFFF 2 1001 1 1001 225 /end IF_DATA /end MEASUREMENT
/begin MEASUREMENT ES900.ES910.CAN2.CAN2.AP_ACCEL_F_Data.ACCEL_F_X "" FLOAT64_IEEE LINEAR_FUNCTION_M1_T0_U1 1 100 0 0 /begin IF_DATA E_TARGET KP_BLOB 0xFFFFFFFF 0xFFFFFFFF 2 1001 1 1001 226 /end IF_DATA /end MEASUREMENT
/begin MEASUREMENT ES900.ES910.CAN2.CAN2.NM_ACCEL_F_Keep_Alive.ACCEL_F_Alive "" FLOAT64_IEEE LINEAR_FUNCTION_M1_T0_U1 1 100 0 0 /begin IF_DATA E_TARGET KP_BLOB 0xFFFFFFFF 0xFFFFFFFF 2 1001 1 1001 227 /end IF_DATA /end MEASUREMENT
/begin MEASUREMENT ES900.ES910.CAN2.CAN2.NM_ACCEL_R_Keep_Alive.ACCEL_R_Alive "" FLOAT64_IEEE LINEAR_FUNCTION_M1_T0_U1 1 100 0 0 /begin IF_DATA E_TARGET KP_BLOB 0xFFFFFFFF 0xFFFFFFFF 2 1001 1 1001 228 /end IF_DATA /end MEASUREMENT
/begin MEASUREMENT ES900.ES910.CAN2.CAN2.AP_ACCEL_R_Data.Gyroscope_R "" FLOAT64_IEEE LINEAR_FUNCTION_M1_T0_U1 1 100 0 0 /begin IF_DATA E_TARGET KP_BLOB 0xFFFFFFFF 0xFFFFFFFF 2 1001 1 1001 229 /end IF_DATA /end MEASUREMENT
/begin MEASUREMENT ES900.ES910.CAN2.CAN2.AP_ACCEL_R_Data.ACCEL_R_Z "" FLOAT64_IEEE LINEAR_FUNCTION_M1_T0_U1 1 100 0 0 /begin IF_DATA E_TARGET KP_BLOB 0xFFFFFFFF 0xFFFFFFFF 2 1001 1 1001 230 /end IF_DATA /end MEASUREMENT
/begin MEASUREMENT ES900.ES910.CAN2.CAN2.AP_ACCEL_R_Data.ACCEL_R_Y "" FLOAT64_IEEE LINEAR_FUNCTION_M1_T0_U1 1 100 0 0 /begin IF_DATA E_TARGET KP_BLOB 0xFFFFFFFF 0xFFFFFFFF 2 1001 1 1001 231 /end IF_DATA /end MEASUREMENT
/begin MEASUREMENT ES900.ES910.CAN2.CAN2.AP_ACCEL_R_Data.ACCEL_R_X "" FLOAT64_IEEE LINEAR_FUNCTION_M1_T0_U1 1 100 0 0 /begin IF_DATA E_TARGET KP_BLOB 0xFFFFFFFF 0xFFFFFFFF 2 1001 1 1001 232 /end IF_DATA /end MEASUREMENT
/begin MEASUREMENT ES900.ES910.CAN2.CAN2.AP_ADCAN_Data2.Susp_F_R_Bits "" FLOAT64_IEEE LINEAR_FUNCTION_M1_T0_U1 1 100 0 0 /begin IF_DATA E_TARGET KP_BLOB 0xFFFFFFFF 0xFFFFFFFF 2 1001 1 1001 233 /end IF_DATA /end MEASUREMENT
/begin MEASUREMENT ES900.ES910.CAN2.CAN2.AP_ADCAN_Data2.Susp_F_L_Bits "" FLOAT64_IEEE LINEAR_FUNCTION_M1_T0_U1 1 100 0 0 /begin IF_DATA E_TARGET KP_BLOB 0xFFFFFFFF 0xFFFFFFFF 2 1001 1 1001 234 /end IF_DATA /end MEASUREMENT
/begin MEASUREMENT ES900.ES910.CAN2.CAN2.AP_ADCAN_Data1.SteeringSensor_Bits "" FLOAT64_IEEE LINEAR_FUNCTION_M1_T0_U1 1 100 0 0 /begin IF_DATA E_TARGET KP_BLOB 0xFFFFFFFF 0xFFFFFFFF 2 1001 1 1001 235 /end IF_DATA /end MEASUREMENT
/begin MEASUREMENT ES900.ES910.CAN2.CAN2.AP_ADCAN_Data1.BrakeSensor_Bits "" FLOAT64_IEEE LINEAR_FUNCTION_M1_T0_U1 1 100 0 0 /begin IF_DATA E_TARGET KP_BLOB 0xFFFFFFFF 0xFFFFFFFF 2 1001 1 1001 236 /end IF_DATA /end MEASUREMENT
/begin MEASUREMENT ES900.ES910.CAN2.CAN2.AP_ADCAN_Data1.APPS2_Bits "" FLOAT64_IEEE LINEAR_FUNCTION_M1_T0_U1 1 100 0 0 /begin IF_DATA E_TARGET KP_BLOB 0xFFFFFFFF 0xFFFFFFFF 2 1001 1 1001 237 /end IF_DATA /end MEASUREMENT
/begin MEASUREMENT ES900.ES910.CAN2.CAN2.AP_ADCAN_Data1.APPS1_Bits "" FLOAT64_IEEE LINEAR_FUNCTION_M1_T0_U1 1 100 0 0 /begin IF_DATA E_TARGET KP_BLOB 0xFFFFFFFF 0xFFFFFFFF 2 1001 1 1001 238 /end IF_DATA /end MEASUREMENT
/begin MEASUREMENT ES900.ES910.CAN2.CAN2.AP_ETAS_Synchronism.Sync_CAN2 "" FLOAT64_IEEE LINEAR_FUNCTION_M1_T0_U1 1 100 0 255 /begin IF_DATA E_TARGET KP_BLOB 0xFFFFFFFF 0xFFFFFFFF 2 1001 1 1001 240 /end IF_DATA /end MEASUREMENT
/begin MEASUREMENT ES900.ES910.CAN2.CAN2.NM_ADCAN_Keep_Alive.ADCAN_Alive "" FLOAT64_IEEE LINEAR_FUNCTION_M1_T0_U1 1 100 0 0 /begin IF_DATA E_TARGET KP_BLOB 0xFFFFFFFF 0xFFFFFFFF 2 1001 1 1001 241 /end IF_DATA /end MEASUREMENT
/begin CHARACTERISTIC ES900.ES910.CAN1.CAN1.AP_ETAS_DashData1.Speed_calibrate "" VALUE 0x0 STANDARD_VALUE_R64 0.0 LINEAR_FUNCTION_M1_T0_U1 -128 127 MAX_REFRESH 6 1 /end CHARACTERISTIC
/begin CHARACTERISTIC ES900.ES910.CAN1.CAN1.AP_ETAS_DashData1.Precharge_Voltage_calibrate "" VALUE 0x0 STANDARD_VALUE_R64 0.0 LINEAR_FUNCTION_M1_T0_U1 0 655.35 MAX_REFRESH 6 1 /end CHARACTERISTIC
/begin CHARACTERISTIC ES900.ES910.CAN1.CAN1.AP_ETAS_DashData1.Precharge_Percentage_calibrate "" VALUE 0x0 STANDARD_VALUE_R64 0.0 LINEAR_FUNCTION_M1_T0_U1 0 100 MAX_REFRESH 6 1 /end CHARACTERISTIC
/begin CHARACTERISTIC ES900.ES910.CAN1.CAN1.AP_ETAS_DashData1.LVbattery_Voltage_calibrate "" VALUE 0x0 STANDARD_VALUE_R64 0.0 LINEAR_FUNCTION_M1_T0_U1 0 32.7675 MAX_REFRESH 6 1 /end CHARACTERISTIC
/begin CHARACTERISTIC ES900.ES910.CAN1.CAN1.AP_ETAS_DashData1.LVbattery_SOC_calibrate "" VALUE 0x0 STANDARD_VALUE_R64 0.0 LINEAR_FUNCTION_M1_T0_U1 0 100 MAX_REFRESH 6 1 /end CHARACTERISTIC
/begin CHARACTERISTIC ES900.ES910.CAN1.CAN1.AP_ETAS_VDCParams2.VDC_Cte_SKF_calibrate "" VALUE 0x0 STANDARD_VALUE_R64 0.0 LINEAR_FUNCTION_M1_T0_U1 0 1 MAX_REFRESH 6 1 /end CHARACTERISTIC
/begin CHARACTERISTIC ES900.ES910.CAN1.CAN1.AP_ETAS_VDCParams2.VDC_Cte_CKF_calibrate "" VALUE 0x0 STANDARD_VALUE_R64 0.0 LINEAR_FUNCTION_M1_T0_U1 0 1 MAX_REFRESH 6 1 /end CHARACTERISTIC
/begin CHARACTERISTIC ES900.ES910.CAN1.CAN1.AP_ETAS_VDCParams.VDC_CKF_Initial_calibrate "" VALUE 0x0 STANDARD_VALUE_R64 0.0 LINEAR_FUNCTION_M1_T0_U1 0 1 MAX_REFRESH 6 1 /end CHARACTERISTIC
/begin CHARACTERISTIC ES900.ES910.CAN1.CAN1.AP_ETAS_VDCParams.VDC_SKF_Initial_calibrate "" VALUE 0x0 STANDARD_VALUE_R64 0.0 LINEAR_FUNCTION_M1_T0_U1 0 1 MAX_REFRESH 6 1 /end CHARACTERISTIC
/begin CHARACTERISTIC ES900.ES910.CAN1.CAN1.AP_ETAS_VDCParams.VDC_Power_Limit_calibrate "" VALUE 0x0 STANDARD_VALUE_R64 0.0 LINEAR_FUNCTION_M1_T0_U1 0 85 MAX_REFRESH 6 1 /end CHARACTERISTIC
/begin CHARACTERISTIC ES900.ES910.CAN1.CAN1.AP_ETAS_VDCParams.VDC_Max_Regenerative_Torque_calibrate "" VALUE 0x0 STANDARD_VALUE_R64 0.0 LINEAR_FUNCTION_M1_T0_U1 0 10.2 MAX_REFRESH 6 1 /end CHARACTERISTIC
/begin CHARACTERISTIC ES900.ES910.CAN1.CAN1.AP_ETAS_VDCParams.VDC_K_Reduction_Temperature_calibrate "" VALUE 0x0 STANDARD_VALUE_R64 0.0 LINEAR_FUNCTION_M1_T0_U1 0 1 MAX_REFRESH 6 1 /end CHARACTERISTIC
/begin CHARACTERISTIC ES900.ES910.CAN1.CAN1.AP_ETAS_VDCParams.VDC_K_Reduction_P_calibrate "" VALUE 0x0 STANDARD_VALUE_R64 0.0 LINEAR_FUNCTION_M1_T0_U1 0 1 MAX_REFRESH 6 1 /end CHARACTERISTIC
/begin CHARACTERISTIC ES900.ES910.CAN1.CAN1.AP_ETAS_VDCParams.VDC_APPS_Sat_Up_calibrate "" VALUE 0x0 STANDARD_VALUE_R64 0.0 LINEAR_FUNCTION_M1_T0_U1 0 1 MAX_REFRESH 6 1 /end CHARACTERISTIC
/begin CHARACTERISTIC ES900.ES910.CAN1.CAN1.AP_ETAS_VDCParams.VDC_APPS_Sat_Down_calibrate "" VALUE 0x0 STANDARD_VALUE_R64 0.0 LINEAR_FUNCTION_M1_T0_U1 0 1 MAX_REFRESH 6 1 /end CHARACTERISTIC
/begin CHARACTERISTIC ES900.ES910.CAN1.CAN1.AP_ETAS_Inverter_R_Rx.Inverter_R_RegID_calibrate "" VALUE 0x0 STANDARD_VALUE_R64 0.0 LINEAR_FUNCTION_M1_T0_U1 0 255 MAX_REFRESH 6 1 /end CHARACTERISTIC
/begin CHARACTERISTIC ES900.ES910.CAN1.CAN1.AP_ETAS_Inverter_R_Rx.Inverter_R_b7tob0_calibrate "" VALUE 0x0 STANDARD_VALUE_R64 0.0 LINEAR_FUNCTION_M1_T0_U1 0 255 MAX_REFRESH 6 1 /end CHARACTERISTIC
/begin CHARACTERISTIC ES900.ES910.CAN1.CAN1.AP_ETAS_Inverter_R_Rx.Inverter_R_b15tob8_calibrate "" VALUE 0x0 STANDARD_VALUE_R64 0.0 LINEAR_FUNCTION_M1_T0_U1 0 255 MAX_REFRESH 6 1 /end CHARACTERISTIC
/begin CHARACTERISTIC ES900.ES910.CAN1.CAN1.AP_ETAS_Inverter_L_Rx.Inverter_L_RegID_calibrate "" VALUE 0x0 STANDARD_VALUE_R64 0.0 LINEAR_FUNCTION_M1_T0_U1 0 255 MAX_REFRESH 6 1 /end CHARACTERISTIC
/begin CHARACTERISTIC ES900.ES910.CAN1.CAN1.AP_ETAS_Inverter_L_Rx.Inverter_L_b7tob0_calibrate "" VALUE 0x0 STANDARD_VALUE_R64 0.0 LINEAR_FUNCTION_M1_T0_U1 0 255 MAX_REFRESH 6 1 /end CHARACTERISTIC
/begin CHARACTERISTIC ES900.ES910.CAN1.CAN1.AP_ETAS_Inverter_L_Rx.Inverter_L_b15tob8_calibrate "" VALUE 0x0 STANDARD_VALUE_R64 0.0 LINEAR_FUNCTION_M1_T0_U1 0 255 MAX_REFRESH 6 1 /end CHARACTERISTIC
/begin CHARACTERISTIC ES900.ES910.CAN1.CAN1.AP_ETAS_CarState.Car_State_calibrate "" VALUE 0x0 STANDARD_VALUE_R64 0.0 LINEAR_FUNCTION_M1_T0_U1 0 255 MAX_REFRESH 6 1 /end CHARACTERISTIC
/begin CHARACTERISTIC ES900.ES910.CAN1.CAN1.AP_ETAS_AIRsRequest.AIRs_Request_calibrate "" VALUE 0x0 STANDARD_VALUE_R64 0.0 LINEAR_FUNCTION_M1_T0_U1 0 255 MAX_REFRESH 6 1 /end CHARACTERISTIC
/begin CHARACTERISTIC ES900.ES910.CAN1.CAN1.AP_ETAS_AnalogicControl.BrakeLight_Control_calibrate "" VALUE 0x0 STANDARD_VALUE_R64 0.0 LINEAR_FUNCTION_M1_T0_U1 0 1 MAX_REFRESH 6 1 /end CHARACTERISTIC
/begin CHARACTERISTIC ES900.ES910.CAN1.CAN1.AP_ETAS_AnalogicControl.Pumps_Control_calibrate "" VALUE 0x0 STANDARD_VALUE_R64 0.0 LINEAR_FUNCTION_M1_T0_U1 0 1 MAX_REFRESH 6 1 /end CHARACTERISTIC
/begin CHARACTERISTIC ES900.ES910.CAN1.CAN1.MEAS_ETAS_InternalVars.CriticalDisconnection_calibrate "" VALUE 0x0 STANDARD_VALUE_R64 0.0 LINEAR_FUNCTION_M1_T0_U1 0 1 MAX_REFRESH 6 1 /end CHARACTERISTIC
/begin CHARACTERISTIC ES900.ES910.CAN1.CAN1.MEAS_ETAS_InternalVars.CurrentPathDisconnectionFlag_calibrate "" VALUE 0x0 STANDARD_VALUE_R64 0.0 LINEAR_FUNCTION_M1_T0_U1 0 1 MAX_REFRESH 6 1 /end CHARACTERISTIC
/begin CHARACTERISTIC ES900.ES910.CAN1.CAN1.MEAS_ETAS_InternalVars.Car_OK_calibrate "" VALUE 0x0 STANDARD_VALUE_R64 0.0 LINEAR_FUNCTION_M1_T0_U1 0 1 MAX_REFRESH 6 1 /end CHARACTERISTIC
/begin CHARACTERISTIC ES900.ES910.CAN1.CAN1.MEAS_ETAS_InternalVars.Power_calibrate "" VALUE 0x0 STANDARD_VALUE_R64 0.0 LINEAR_FUNCTION_M1_T0_U1 0 255 MAX_REFRESH 6 1 /end CHARACTERISTIC
/begin CHARACTERISTIC ES900.ES910.CAN1.CAN1.MEAS_ETAS_InternalVars.Torque_OK_calibrate "" VALUE 0x0 STANDARD_VALUE_R64 0.0 LINEAR_FUNCTION_M1_T0_U1 0 1 MAX_REFRESH 6 1 /end CHARACTERISTIC
/begin CHARACTERISTIC ES900.ES910.CAN1.CAN1.MEAS_ETAS_InternalVars.TV_Mode_calibrate "" VALUE 0x0 STANDARD_VALUE_R64 0.0 LINEAR_FUNCTION_M1_T0_U1 0 7 MAX_REFRESH 6 1 /end CHARACTERISTIC
/begin CHARACTERISTIC ES900.ES910.CAN1.CAN1.MEAS_ETAS_InternalVars.Critical_Signal_Disconnection_calibrate "" VALUE 0x0 STANDARD_VALUE_R64 0.0 LINEAR_FUNCTION_M1_T0_U1 0 1 MAX_REFRESH 6 1 /end CHARACTERISTIC
/begin CHARACTERISTIC ES900.ES910.CAN1.CAN1.MEAS_ETAS_InternalVars.Critical_CAN_Disconnection_calibrate "" VALUE 0x0 STANDARD_VALUE_R64 0.0 LINEAR_FUNCTION_M1_T0_U1 0 1 MAX_REFRESH 6 1 /end CHARACTERISTIC
/begin CHARACTERISTIC ES900.ES910.CAN1.CAN1.MEAS_ETAS_InternalVars.Brake_Implausibility_calibrate "" VALUE 0x0 STANDARD_VALUE_R64 0.0 LINEAR_FUNCTION_M1_T0_U1 0 1 MAX_REFRESH 6 1 /end CHARACTERISTIC
/begin CHARACTERISTIC ES900.ES910.CAN1.CAN1.MEAS_ETAS_InternalVars.APPS_Implausibility_calibrate "" VALUE 0x0 STANDARD_VALUE_R64 0.0 LINEAR_FUNCTION_M1_T0_U1 0 1 MAX_REFRESH 6 1 /end CHARACTERISTIC
/begin CHARACTERISTIC ES900.ES910.CAN1.CAN1.NM_ETAS_Disconnections.Disconnection_LV_Derivation_calibrate "" VALUE 0x0 STANDARD_VALUE_R64 0.0 LINEAR_FUNCTION_M1_T0_U1 0 1 MAX_REFRESH 6 1 /end CHARACTERISTIC
/begin CHARACTERISTIC ES900.ES910.CAN1.CAN1.NM_ETAS_Disconnections.Disconnection_DashBoard_calibrate "" VALUE 0x0 STANDARD_VALUE_R64 0.0 LINEAR_FUNCTION_M1_T0_U1 0 1 MAX_REFRESH 6 1 /end CHARACTERISTIC
/begin CHARACTERISTIC ES900.ES910.CAN1.CAN1.NM_ETAS_Disconnections.Disconnection_BMS_calibrate "" VALUE 0x0 STANDARD_VALUE_R64 0.0 LINEAR_FUNCTION_M1_T0_U1 0 1 MAX_REFRESH 6 1 /end CHARACTERISTIC
/begin CHARACTERISTIC ES900.ES910.CAN1.CAN1.NM_ETAS_Disconnections.Disconnection_Gyroscope_F_calibrate "" VALUE 0x0 STANDARD_VALUE_R64 0.0 LINEAR_FUNCTION_M1_T0_U1 0 1 MAX_REFRESH 6 1 /end CHARACTERISTIC
/begin CHARACTERISTIC ES900.ES910.CAN1.CAN1.NM_ETAS_Disconnections.Disconnection_Gyroscope_R_calibrate "" VALUE 0x0 STANDARD_VALUE_R64 0.0 LINEAR_FUNCTION_M1_T0_U1 0 1 MAX_REFRESH 6 1 /end CHARACTERISTIC
/begin CHARACTERISTIC ES900.ES910.CAN1.CAN1.NM_ETAS_Disconnections.Disconnection_Accel_F_calibrate "" VALUE 0x0 STANDARD_VALUE_R64 0.0 LINEAR_FUNCTION_M1_T0_U1 0 1 MAX_REFRESH 6 1 /end CHARACTERISTIC
/begin CHARACTERISTIC ES900.ES910.CAN1.CAN1.NM_ETAS_Disconnections.Disconnection_Accel_R_calibrate "" VALUE 0x0 STANDARD_VALUE_R64 0.0 LINEAR_FUNCTION_M1_T0_U1 0 1 MAX_REFRESH 6 1 /end CHARACTERISTIC
/begin CHARACTERISTIC ES900.ES910.CAN1.CAN1.NM_ETAS_Disconnections.Disconnection_SteeringSensor_calibrate "" VALUE 0x0 STANDARD_VALUE_R64 0.0 LINEAR_FUNCTION_M1_T0_U1 0 1 MAX_REFRESH 6 1 /end CHARACTERISTIC
/begin CHARACTERISTIC ES900.ES910.CAN1.CAN1.NM_ETAS_Disconnections.Disconnection_Susp_R_R_calibrate "" VALUE 0x0 STANDARD_VALUE_R64 0.0 LINEAR_FUNCTION_M1_T0_U1 0 1 MAX_REFRESH 6 1 /end CHARACTERISTIC
/begin CHARACTERISTIC ES900.ES910.CAN1.CAN1.NM_ETAS_Disconnections.Disconnection_Susp_R_L_calibrate "" VALUE 0x0 STANDARD_VALUE_R64 0.0 LINEAR_FUNCTION_M1_T0_U1 0 1 MAX_REFRESH 6 1 /end CHARACTERISTIC
/begin CHARACTERISTIC ES900.ES910.CAN1.CAN1.NM_ETAS_Disconnections.Disconnection_Susp_F_R_calibrate "" VALUE 0x0 STANDARD_VALUE_R64 0.0 LINEAR_FUNCTION_M1_T0_U1 0 1 MAX_REFRESH 6 1 /end CHARACTERISTIC
/begin CHARACTERISTIC ES900.ES910.CAN1.CAN1.NM_ETAS_Disconnections.Disconnection_Susp_F_L_calibrate "" VALUE 0x0 STANDARD_VALUE_R64 0.0 LINEAR_FUNCTION_M1_T0_U1 0 1 MAX_REFRESH 6 1 /end CHARACTERISTIC
/begin CHARACTERISTIC ES900.ES910.CAN1.CAN1.NM_ETAS_Disconnections.Disconnection_Brake_Sensor_calibrate "" VALUE 0x0 STANDARD_VALUE_R64 0.0 LINEAR_FUNCTION_M1_T0_U1 0 1 MAX_REFRESH 6 1 /end CHARACTERISTIC
/begin CHARACTERISTIC ES900.ES910.CAN1.CAN1.NM_ETAS_Disconnections.Disconnection_APPS2_calibrate "" VALUE 0x0 STANDARD_VALUE_R64 0.0 LINEAR_FUNCTION_M1_T0_U1 0 1 MAX_REFRESH 6 1 /end CHARACTERISTIC
/begin CHARACTERISTIC ES900.ES910.CAN1.CAN1.NM_ETAS_Disconnections.Disconnection_APPS1_calibrate "" VALUE 0x0 STANDARD_VALUE_R64 0.0 LINEAR_FUNCTION_M1_T0_U1 0 1 MAX_REFRESH 6 1 /end CHARACTERISTIC
/begin CHARACTERISTIC ES900.ES910.CAN1.CAN1.NM_ETAS_Disconnections.Disconnection_ADCAN_calibrate "" VALUE 0x0 STANDARD_VALUE_R64 0.0 LINEAR_FUNCTION_M1_T0_U1 0 1 MAX_REFRESH 6 1 /end CHARACTERISTIC
/begin CHARACTERISTIC ES900.ES910.CAN1.CAN1.NM_ETAS_Disconnections.Disconnection_Shutdown_calibrate "" VALUE 0x0 STANDARD_VALUE_R64 0.0 LINEAR_FUNCTION_M1_T0_U1 0 1 MAX_REFRESH 6 1 /end CHARACTERISTIC
/begin CHARACTERISTIC ES900.ES910.CAN1.CAN1.AP_ETAS_DashData2.SteeringSensor_Value_calibrate "" VALUE 0x0 STANDARD_VALUE_R64 0.0 LINEAR_FUNCTION_M1_T0_U1 -128 127 MAX_REFRESH 6 1 /end CHARACTERISTIC
/begin CHARACTERISTIC ES900.ES910.CAN1.CAN1.AP_ETAS_DashData2.SKF_actual_calibrate "" VALUE 0x0 STANDARD_VALUE_R64 0.0 LINEAR_FUNCTION_M1_T0_U1 0 25.5 MAX_REFRESH 6 1 /end CHARACTERISTIC
/begin CHARACTERISTIC ES900.ES910.CAN1.CAN1.AP_ETAS_DashData2.CKF_actual_calibrate "" VALUE 0x0 STANDARD_VALUE_R64 0.0 LINEAR_FUNCTION_M1_T0_U1 0 25.5 MAX_REFRESH 6 1 /end CHARACTERISTIC
/begin CHARACTERISTIC ES900.ES910.CAN1.CAN1.AP_ETAS_DashData2.BrakeSensor_Value_calibrate "" VALUE 0x0 STANDARD_VALUE_R64 0.0 LINEAR_FUNCTION_M1_T0_U1 0 1 MAX_REFRESH 6 1 /end CHARACTERISTIC
/begin CHARACTERISTIC ES900.ES910.CAN1.CAN1.AP_ETAS_DashData2.APPS2_Value_calibrate "" VALUE 0x0 STANDARD_VALUE_R64 0.0 LINEAR_FUNCTION_M1_T0_U1 0 1 MAX_REFRESH 6 1 /end CHARACTERISTIC
/begin CHARACTERISTIC ES900.ES910.CAN1.CAN1.AP_ETAS_DashData2.APPS1_Value_calibrate "" VALUE 0x0 STANDARD_VALUE_R64 0.0 LINEAR_FUNCTION_M1_T0_U1 0 1 MAX_REFRESH 6 1 /end CHARACTERISTIC
/begin CHARACTERISTIC ES900.ES910.CAN1.CAN1.AP_ETAS_Synchronism.Sync_CAN1_calibrate "" VALUE 0x0 STANDARD_VALUE_R64 0.0 LINEAR_FUNCTION_M1_T0_U1 0 255 MAX_REFRESH 6 1 /end CHARACTERISTIC
/begin CHARACTERISTIC ES900.ES910.CAN2.CAN2.MEAS_ETAS_Inverter_R_Data.Inv_R_TempMotor_calibrate "" VALUE 0x0 STANDARD_VALUE_R64 0.0 LINEAR_FUNCTION_M1_T0_U1 -28 227 MAX_REFRESH 6 1 /end CHARACTERISTIC
/begin CHARACTERISTIC ES900.ES910.CAN2.CAN2.MEAS_ETAS_Inverter_R_Data.Inv_R_TempIGBT_calibrate "" VALUE 0x0 STANDARD_VALUE_R64 0.0 LINEAR_FUNCTION_M1_T0_U1 -28 227 MAX_REFRESH 6 1 /end CHARACTERISTIC
/begin CHARACTERISTIC ES900.ES910.CAN2.CAN2.MEAS_ETAS_Inverter_R_Data.Inv_R_Speed_calibrate "" VALUE 0x0 STANDARD_VALUE_R64 0.0 LINEAR_FUNCTION_M1_T0_U1 -5120 5080 MAX_REFRESH 6 1 /end CHARACTERISTIC
/begin CHARACTERISTIC ES900.ES910.CAN2.CAN2.MEAS_ETAS_Inverter_R_Data.Inv_R_Iq_calibrate "" VALUE 0x0 STANDARD_VALUE_R64 0.0 LINEAR_FUNCTION_M1_T0_U1 -320 317.5 MAX_REFRESH 6 1 /end CHARACTERISTIC
/begin CHARACTERISTIC ES900.ES910.CAN2.CAN2.MEAS_ETAS_Inverter_R_Data.Inv_R_Icommand_calibrate "" VALUE 0x0 STANDARD_VALUE_R64 0.0 LINEAR_FUNCTION_M1_T0_U1 -320 317.5 MAX_REFRESH 6 1 /end CHARACTERISTIC
/begin CHARACTERISTIC ES900.ES910.CAN2.CAN2.MEAS_ETAS_Inverter_R_Data.Inv_R_Iactual_calibrate "" VALUE 0x0 STANDARD_VALUE_R64 0.0 LINEAR_FUNCTION_M1_T0_U1 -320 317.5 MAX_REFRESH 6 1 /end CHARACTERISTIC
/begin CHARACTERISTIC ES900.ES910.CAN2.CAN2.MEAS_ETAS_Inverter_L_Data.Inv_L_TempMotor_calibrate "" VALUE 0x0 STANDARD_VALUE_R64 0.0 LINEAR_FUNCTION_M1_T0_U1 -28 227 MAX_REFRESH 6 1 /end CHARACTERISTIC
/begin CHARACTERISTIC ES900.ES910.CAN2.CAN2.MEAS_ETAS_Inverter_L_Data.Inv_L_TempIGBT_calibrate "" VALUE 0x0 STANDARD_VALUE_R64 0.0 LINEAR_FUNCTION_M1_T0_U1 -28 227 MAX_REFRESH 6 1 /end CHARACTERISTIC
/begin CHARACTERISTIC ES900.ES910.CAN2.CAN2.MEAS_ETAS_Inverter_L_Data.Inv_L_Speed_calibrate "" VALUE 0x0 STANDARD_VALUE_R64 0.0 LINEAR_FUNCTION_M1_T0_U1 -5120 5080 MAX_REFRESH 6 1 /end CHARACTERISTIC
/begin CHARACTERISTIC ES900.ES910.CAN2.CAN2.MEAS_ETAS_Inverter_L_Data.Inv_L_Iq_calibrate "" VALUE 0x0 STANDARD_VALUE_R64 0.0 LINEAR_FUNCTION_M1_T0_U1 -320 317.5 MAX_REFRESH 6 1 /end CHARACTERISTIC
/begin CHARACTERISTIC ES900.ES910.CAN2.CAN2.MEAS_ETAS_Inverter_L_Data.Inv_L_Icommand_calibrate "" VALUE 0x0 STANDARD_VALUE_R64 0.0 LINEAR_FUNCTION_M1_T0_U1 -320 317.5 MAX_REFRESH 6 1 /end CHARACTERISTIC
/begin CHARACTERISTIC ES900.ES910.CAN2.CAN2.MEAS_ETAS_Inverter_L_Data.Inv_L_Iactual_calibrate "" VALUE 0x0 STANDARD_VALUE_R64 0.0 LINEAR_FUNCTION_M1_T0_U1 -320 317.5 MAX_REFRESH 6 1 /end CHARACTERISTIC
/begin CHARACTERISTIC ES900.ES910.CAN2.CAN2.MEAS_ETAS_VDCdata6.SUSP_F_R_calibrate "" VALUE 0x0 STANDARD_VALUE_R64 0.0 LINEAR_FUNCTION_M1_T0_U1 -327.68 327.67 MAX_REFRESH 6 1 /end CHARACTERISTIC
/begin CHARACTERISTIC ES900.ES910.CAN2.CAN2.MEAS_ETAS_VDCdata6.SUSP_F_L_calibrate "" VALUE 0x0 STANDARD_VALUE_R64 0.0 LINEAR_FUNCTION_M1_T0_U1 -327.68 327.67 MAX_REFRESH 6 1 /end CHARACTERISTIC
/begin CHARACTERISTIC ES900.ES910.CAN2.CAN2.MEAS_ETAS_VDCdata5.Gyro_F_Z_Deg_calibrate "" VALUE 0x0 STANDARD_VALUE_R64 0.0 LINEAR_FUNCTION_M1_T0_U1 0 393.21 MAX_REFRESH 6 1 /end CHARACTERISTIC
/begin CHARACTERISTIC ES900.ES910.CAN2.CAN2.MEAS_ETAS_VDCdata5.Accel_F_Z_SI_calibrate "" VALUE 0x0 STANDARD_VALUE_R64 0.0 LINEAR_FUNCTION_M1_T0_U1 -327.68 327.67 MAX_REFRESH 6 1 /end CHARACTERISTIC
/begin CHARACTERISTIC ES900.ES910.CAN2.CAN2.MEAS_ETAS_VDCdata5.Accel_F_Y_SI_calibrate "" VALUE 0x0 STANDARD_VALUE_R64 0.0 LINEAR_FUNCTION_M1_T0_U1 -327.68 327.67 MAX_REFRESH 6 1 /end CHARACTERISTIC
/begin CHARACTERISTIC ES900.ES910.CAN2.CAN2.MEAS_ETAS_VDCdata5.Accel_F_X_SI_calibrate "" VALUE 0x0 STANDARD_VALUE_R64 0.0 LINEAR_FUNCTION_M1_T0_U1 -327.68 327.67 MAX_REFRESH 6 1 /end CHARACTERISTIC
/begin CHARACTERISTIC ES900.ES910.CAN2.CAN2.MEAS_ETAS_VDCdata4.Gyro_R_Z_Deg_calibrate "" VALUE 0x0 STANDARD_VALUE_R64 0.0 LINEAR_FUNCTION_M1_T0_U1 0 393.21 MAX_REFRESH 6 1 /end CHARACTERISTIC
/begin CHARACTERISTIC ES900.ES910.CAN2.CAN2.MEAS_ETAS_VDCdata4.Accel_R_Z_SI_calibrate "" VALUE 0x0 STANDARD_VALUE_R64 0.0 LINEAR_FUNCTION_M1_T0_U1 -327.68 327.67 MAX_REFRESH 6 1 /end CHARACTERISTIC
/begin CHARACTERISTIC ES900.ES910.CAN2.CAN2.MEAS_ETAS_VDCdata4.Accel_R_Y_SI_calibrate "" VALUE 0x0 STANDARD_VALUE_R64 0.0 LINEAR_FUNCTION_M1_T0_U1 -327.68 327.67 MAX_REFRESH 6 1 /end CHARACTERISTIC
/begin CHARACTERISTIC ES900.ES910.CAN2.CAN2.MEAS_ETAS_VDCdata4.Accel_R_X_SI_calibrate "" VALUE 0x0 STANDARD_VALUE_R64 0.0 LINEAR_FUNCTION_M1_T0_U1 -327.68 327.67 MAX_REFRESH 6 1 /end CHARACTERISTIC
/begin CHARACTERISTIC ES900.ES910.CAN2.CAN2.MEAS_ETAS_VDCdata7.Torque_R_calibrate "" VALUE 0x0 STANDARD_VALUE_R64 0.0 LINEAR_FUNCTION_M1_T0_U1 -254 254 MAX_REFRESH 6 1 /end CHARACTERISTIC
/begin CHARACTERISTIC ES900.ES910.CAN2.CAN2.MEAS_ETAS_VDCdata7.Torque_L_calibrate "" VALUE 0x0 STANDARD_VALUE_R64 0.0 LINEAR_FUNCTION_M1_T0_U1 -256 254 MAX_REFRESH 6 1 /end CHARACTERISTIC
/begin CHARACTERISTIC ES900.ES910.CAN2.CAN2.MEAS_ETAS_VDCdata3.Handling_calibrate "" VALUE 0x0 STANDARD_VALUE_R64 0.0 LINEAR_FUNCTION_M1_T0_U1 0 65535 MAX_REFRESH 6 1 /end CHARACTERISTIC
/begin CHARACTERISTIC ES900.ES910.CAN2.CAN2.MEAS_ETAS_VDCdata3.Dash_Speed_calibrate "" VALUE 0x0 STANDARD_VALUE_R64 0.0 LINEAR_FUNCTION_M1_T0_U1 -32768 32767 MAX_REFRESH 6 1 /end CHARACTERISTIC
/begin CHARACTERISTIC ES900.ES910.CAN2.CAN2.MEAS_ETAS_VDCdata3.Mass_calibrate "" VALUE 0x0 STANDARD_VALUE_R64 0.0 LINEAR_FUNCTION_M1_T0_U1 0 65535 MAX_REFRESH 6 1 /end CHARACTERISTIC
/begin CHARACTERISTIC ES900.ES910.CAN2.CAN2.MEAS_ETAS_VDCdata2.Throttle_calibrate "" VALUE 0x0 STANDARD_VALUE_R64 0.0 LINEAR_FUNCTION_M1_T0_U1 0 65535 MAX_REFRESH 6 1 /end CHARACTERISTIC
/begin CHARACTERISTIC ES900.ES910.CAN2.CAN2.MEAS_ETAS_VDCdata2.Max_Fx_RR_calibrate "" VALUE 0x0 STANDARD_VALUE_R64 0.0 LINEAR_FUNCTION_M1_T0_U1 0 65535 MAX_REFRESH 6 1 /end CHARACTERISTIC
/begin CHARACTERISTIC ES900.ES910.CAN2.CAN2.MEAS_ETAS_VDCdata2.Max_Fx_RL_calibrate "" VALUE 0x0 STANDARD_VALUE_R64 0.0 LINEAR_FUNCTION_M1_T0_U1 0 65535 MAX_REFRESH 6 1 /end CHARACTERISTIC
/begin CHARACTERISTIC ES900.ES910.CAN2.CAN2.MEAS_ETAS_VDCdata2.Fy_R_calibrate "" VALUE 0x0 STANDARD_VALUE_R64 0.0 LINEAR_FUNCTION_M1_T0_U1 0 65535 MAX_REFRESH 6 1 /end CHARACTERISTIC
/begin CHARACTERISTIC ES900.ES910.CAN2.CAN2.MEAS_ETAS_VDCdata1.Max_Torque_RR_calibrate "" VALUE 0x0 STANDARD_VALUE_R64 0.0 LINEAR_FUNCTION_M1_T0_U1 0 65535 MAX_REFRESH 6 1 /end CHARACTERISTIC
/begin CHARACTERISTIC ES900.ES910.CAN2.CAN2.MEAS_ETAS_VDCdata1.Max_Torque_RL_calibrate "" VALUE 0x0 STANDARD_VALUE_R64 0.0 LINEAR_FUNCTION_M1_T0_U1 0 65535 MAX_REFRESH 6 1 /end CHARACTERISTIC
/begin CHARACTERISTIC ES900.ES910.CAN2.CAN2.MEAS_ETAS_VDCdata1.Torque_RRwc_calibrate "" VALUE 0x0 STANDARD_VALUE_R64 0.0 LINEAR_FUNCTION_M1_T0_U1 0 65535 MAX_REFRESH 6 1 /end CHARACTERISTIC
/begin CHARACTERISTIC ES900.ES910.CAN2.CAN2.MEAS_ETAS_VDCdata1.Torque_RLwc_calibrate "" VALUE 0x0 STANDARD_VALUE_R64 0.0 LINEAR_FUNCTION_M1_T0_U1 0 65535 MAX_REFRESH 6 1 /end CHARACTERISTIC
/begin CHARACTERISTIC ES900.ES910.CAN2.CAN2.AP_ETAS_Synchronism.Sync_CAN2_calibrate "" VALUE 0x0 STANDARD_VALUE_R64 0.0 LINEAR_FUNCTION_M1_T0_U1 0 255 MAX_REFRESH 6 1 /end CHARACTERISTIC
/begin COMPU_METHOD LINEAR_FUNCTION_M1_T0_U1 "" RAT_FUNC "%8.4" "" COEFFS 0 1 0 0 0 1 /end COMPU_METHOD
/begin COMPU_METHOD LINEAR_FUNCTION_M1_T0_U2 "" RAT_FUNC "%8.4" "°" COEFFS 0 1 0 0 0 1 /end COMPU_METHOD
/begin COMPU_METHOD LINEAR_FUNCTION_M1_T0_U3 "" RAT_FUNC "%8.4" "m.s-2" COEFFS 0 1 0 0 0 1 /end COMPU_METHOD
/begin COMPU_METHOD LINEAR_FUNCTION_M1_T0_U4 "" RAT_FUNC "%8.4" "rad" COEFFS 0 1 0 0 0 1 /end COMPU_METHOD
/begin COMPU_METHOD LINEAR_FUNCTION_M1_T0_U5 "" RAT_FUNC "%8.4" "m.s-1" COEFFS 0 1 0 0 0 1 /end COMPU_METHOD
/begin COMPU_METHOD LINEAR_FUNCTION_M1_T0_U6 "" RAT_FUNC "%8.4" "µs" COEFFS 0 1 0 0 0 1 /end COMPU_METHOD
/begin COMPU_METHOD LINEAR_FUNCTION_M1_T0_U7 "" RAT_FUNC "%8.4" "rad.s-1" COEFFS 0 1 0 0 0 1 /end COMPU_METHOD
/begin COMPU_METHOD LINEAR_FUNCTION_M1_T0_U8 "" RAT_FUNC "%8.4" "m" COEFFS 0 1 0 0 0 1 /end COMPU_METHOD
/begin RECORD_LAYOUT STANDARD_VALUE_R64 FNC_VALUES 1 FLOAT64_IEEE COLUMN_DIR DIRECT /end RECORD_LAYOUT
/end MODULE
/end PROJECT
/* EOF signals.a2l */
