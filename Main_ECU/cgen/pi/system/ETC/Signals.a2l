/* Generated by INTECRIO ETarget Configurator Plugin */
/* (c) 2004 ETAS (ETAS GmbH) */ ASAP2_VERSION 1 41
/* Version 1.41 */
/begin PROJECT ETC "ETC generated ASAM-2MC description file fragment"
/begin HEADER " " /end HEADER
/begin MOD_PAR " " /end MOD_PAR
/begin MOD_COMMON "BYTE_ORDER: Motorola = MSB_FIRST, Intel = MSB_LAST" BYTE_ORDER MSB_FIRST /end MOD_COMMON
/begin MODULE ETCSignals " "
/begin MEASUREMENT ES900.ES910.CAN1.Presence.PresenceGroup.PresenceFlag "" FLOAT64_IEEE LINEAR_FUNCTION_M1_T0_U1 1 100 0 1 /begin IF_DATA E_TARGET KP_BLOB 0xFFFFFFFF 0xFFFFFFFF 2 1001 1 1001 0 /end IF_DATA /end MEASUREMENT
/begin MEASUREMENT ES900.ES910.CAN1.CAN1.AP_BMS_SDC.Shutdown_PackageIntck "" FLOAT64_IEEE LINEAR_FUNCTION_M1_T0_U2 1 100 0 0 /begin IF_DATA E_TARGET KP_BLOB 0xFFFFFFFF 0xFFFFFFFF 2 1001 1 1001 1 /end IF_DATA /end MEASUREMENT
/begin MEASUREMENT ES900.ES910.CAN1.CAN1.AP_BMS_SDC.Shutdown_IMD "" FLOAT64_IEEE LINEAR_FUNCTION_M1_T0_U2 1 100 0 0 /begin IF_DATA E_TARGET KP_BLOB 0xFFFFFFFF 0xFFFFFFFF 2 1001 1 1001 2 /end IF_DATA /end MEASUREMENT
/begin MEASUREMENT ES900.ES910.CAN1.CAN1.AP_BMS_SDC.Shutdown_BMS "" FLOAT64_IEEE LINEAR_FUNCTION_M1_T0_U2 1 100 0 0 /begin IF_DATA E_TARGET KP_BLOB 0xFFFFFFFF 0xFFFFFFFF 2 1001 1 1001 3 /end IF_DATA /end MEASUREMENT
/begin MEASUREMENT ES900.ES910.CAN1.CAN1.AP_CurrentSensor.ERROR "" FLOAT64_IEEE LINEAR_FUNCTION_M1_T0_U2 1 100 0 0 /begin IF_DATA E_TARGET KP_BLOB 0xFFFFFFFF 0xFFFFFFFF 2 1001 1 1001 4 /end IF_DATA /end MEASUREMENT
/begin MEASUREMENT ES900.ES910.CAN1.CAN1.AP_CurrentSensor.Accumulator_Current "" FLOAT64_IEEE LINEAR_FUNCTION_M1_T0_U3 1 100 0 0 /begin IF_DATA E_TARGET KP_BLOB 0xFFFFFFFF 0xFFFFFFFF 2 1001 1 1001 5 /end IF_DATA /end MEASUREMENT
/begin MEASUREMENT ES900.ES910.CAN1.CAN1.AP_BMS_Voltages.Lowest_CellVoltage "" FLOAT64_IEEE LINEAR_FUNCTION_M1_T0_U4 1 100 0 0 /begin IF_DATA E_TARGET KP_BLOB 0xFFFFFFFF 0xFFFFFFFF 2 1001 1 1001 6 /end IF_DATA /end MEASUREMENT
/begin MEASUREMENT ES900.ES910.CAN1.CAN1.AP_BMS_Voltages.Highest_CellVoltage "" FLOAT64_IEEE LINEAR_FUNCTION_M1_T0_U4 1 100 0 0 /begin IF_DATA E_TARGET KP_BLOB 0xFFFFFFFF 0xFFFFFFFF 2 1001 1 1001 7 /end IF_DATA /end MEASUREMENT
/begin MEASUREMENT ES900.ES910.CAN1.CAN1.AP_BMS_Voltages.Accumulator_Voltage "" FLOAT64_IEEE LINEAR_FUNCTION_M1_T0_U4 1 100 0 0 /begin IF_DATA E_TARGET KP_BLOB 0xFFFFFFFF 0xFFFFFFFF 2 1001 1 1001 8 /end IF_DATA /end MEASUREMENT
/begin MEASUREMENT ES900.ES910.CAN1.CAN1.AP_BMS_ChargerParameters.Charger_MaxVoltage "" FLOAT64_IEEE LINEAR_FUNCTION_M1_T0_U1 1 100 0 0 /begin IF_DATA E_TARGET KP_BLOB 0xFFFFFFFF 0xFFFFFFFF 2 1001 1 1001 9 /end IF_DATA /end MEASUREMENT
/begin MEASUREMENT ES900.ES910.CAN1.CAN1.AP_BMS_ChargerParameters.Charger_MaxCurrent "" FLOAT64_IEEE LINEAR_FUNCTION_M1_T0_U1 1 100 0 0 /begin IF_DATA E_TARGET KP_BLOB 0xFFFFFFFF 0xFFFFFFFF 2 1001 1 1001 10 /end IF_DATA /end MEASUREMENT
/begin MEASUREMENT ES900.ES910.CAN1.CAN1.AP_BMS_Temperatures.Lowest_CellTemp "" FLOAT64_IEEE LINEAR_FUNCTION_M1_T0_U5 1 100 0 0 /begin IF_DATA E_TARGET KP_BLOB 0xFFFFFFFF 0xFFFFFFFF 2 1001 1 1001 11 /end IF_DATA /end MEASUREMENT
/begin MEASUREMENT ES900.ES910.CAN1.CAN1.AP_BMS_Temperatures.Highest_CellTemp "" FLOAT64_IEEE LINEAR_FUNCTION_M1_T0_U5 1 100 0 0 /begin IF_DATA E_TARGET KP_BLOB 0xFFFFFFFF 0xFFFFFFFF 2 1001 1 1001 12 /end IF_DATA /end MEASUREMENT
/begin MEASUREMENT ES900.ES910.CAN1.CAN1.AP_BMS_Temperatures.Average_CellTemp "" FLOAT64_IEEE LINEAR_FUNCTION_M1_T0_U5 1 100 0 0 /begin IF_DATA E_TARGET KP_BLOB 0xFFFFFFFF 0xFFFFFFFF 2 1001 1 1001 13 /end IF_DATA /end MEASUREMENT
/begin MEASUREMENT ES900.ES910.CAN1.CAN1.AP_Inverter_R_Tx.Inv_R_RegID "" FLOAT64_IEEE LINEAR_FUNCTION_M1_T0_U6 1 100 0 0 /begin IF_DATA E_TARGET KP_BLOB 0xFFFFFFFF 0xFFFFFFFF 2 1001 1 1001 14 /end IF_DATA /end MEASUREMENT
/begin MEASUREMENT ES900.ES910.CAN1.CAN1.AP_Inverter_R_Tx.Inv_R_RegID_M73_Inv_R_TempMotor "" FLOAT64_IEEE LINEAR_FUNCTION_M1_T0_U7 1 100 0 0 /begin IF_DATA E_TARGET KP_BLOB 0xFFFFFFFF 0xFFFFFFFF 2 1001 1 1001 15 /end IF_DATA /end MEASUREMENT
/begin MEASUREMENT ES900.ES910.CAN1.CAN1.AP_Inverter_R_Tx.Inv_R_RegID_M74_Inv_R_TempIGBT "" FLOAT64_IEEE LINEAR_FUNCTION_M1_T0_U7 1 100 0 0 /begin IF_DATA E_TARGET KP_BLOB 0xFFFFFFFF 0xFFFFFFFF 2 1001 1 1001 16 /end IF_DATA /end MEASUREMENT
/begin MEASUREMENT ES900.ES910.CAN1.CAN1.AP_Inverter_R_Tx.Inv_R_RegID_M48_Inv_R_Speed "" FLOAT64_IEEE LINEAR_FUNCTION_M1_T0_U8 1 100 0 0 /begin IF_DATA E_TARGET KP_BLOB 0xFFFFFFFF 0xFFFFFFFF 2 1001 1 1001 17 /end IF_DATA /end MEASUREMENT
/begin MEASUREMENT ES900.ES910.CAN1.CAN1.AP_Inverter_R_Tx.Inv_R_RegID_M39_Inv_R_Iq "" FLOAT64_IEEE LINEAR_FUNCTION_M1_T0_U3 1 100 0 0 /begin IF_DATA E_TARGET KP_BLOB 0xFFFFFFFF 0xFFFFFFFF 2 1001 1 1001 18 /end IF_DATA /end MEASUREMENT
/begin MEASUREMENT ES900.ES910.CAN1.CAN1.AP_Inverter_R_Tx.Inv_R_RegID_M38_Inv_R_Icommand "" FLOAT64_IEEE LINEAR_FUNCTION_M1_T0_U3 1 100 0 0 /begin IF_DATA E_TARGET KP_BLOB 0xFFFFFFFF 0xFFFFFFFF 2 1001 1 1001 19 /end IF_DATA /end MEASUREMENT
/begin MEASUREMENT ES900.ES910.CAN1.CAN1.AP_Inverter_R_Tx.Inv_R_RegID_M32_Inv_R_Iactual "" FLOAT64_IEEE LINEAR_FUNCTION_M1_T0_U3 1 100 0 0 /begin IF_DATA E_TARGET KP_BLOB 0xFFFFFFFF 0xFFFFFFFF 2 1001 1 1001 20 /end IF_DATA /end MEASUREMENT
/begin MEASUREMENT ES900.ES910.CAN1.CAN1.AP_Inverter_R_Tx.Inv_R_RegID_M235_Inv_R_DCBus "" FLOAT64_IEEE LINEAR_FUNCTION_M1_T0_U4 1 100 0 0 /begin IF_DATA E_TARGET KP_BLOB 0xFFFFFFFF 0xFFFFFFFF 2 1001 1 1001 21 /end IF_DATA /end MEASUREMENT
/begin MEASUREMENT ES900.ES910.CAN1.CAN1.AP_Inverter_L_Tx.Inv_L_RegID "" FLOAT64_IEEE LINEAR_FUNCTION_M1_T0_U6 1 100 0 0 /begin IF_DATA E_TARGET KP_BLOB 0xFFFFFFFF 0xFFFFFFFF 2 1001 1 1001 22 /end IF_DATA /end MEASUREMENT
/begin MEASUREMENT ES900.ES910.CAN1.CAN1.AP_Inverter_L_Tx.Inv_L_RegID_M73_Inv_L_TempMotor "" FLOAT64_IEEE LINEAR_FUNCTION_M1_T0_U7 1 100 0 0 /begin IF_DATA E_TARGET KP_BLOB 0xFFFFFFFF 0xFFFFFFFF 2 1001 1 1001 23 /end IF_DATA /end MEASUREMENT
/begin MEASUREMENT ES900.ES910.CAN1.CAN1.AP_Inverter_L_Tx.Inv_L_RegID_M74_Inv_L_TempIGBT "" FLOAT64_IEEE LINEAR_FUNCTION_M1_T0_U7 1 100 0 0 /begin IF_DATA E_TARGET KP_BLOB 0xFFFFFFFF 0xFFFFFFFF 2 1001 1 1001 24 /end IF_DATA /end MEASUREMENT
/begin MEASUREMENT ES900.ES910.CAN1.CAN1.AP_Inverter_L_Tx.Inv_L_RegID_M48_Inv_L_Speed "" FLOAT64_IEEE LINEAR_FUNCTION_M1_T0_U8 1 100 0 0 /begin IF_DATA E_TARGET KP_BLOB 0xFFFFFFFF 0xFFFFFFFF 2 1001 1 1001 25 /end IF_DATA /end MEASUREMENT
/begin MEASUREMENT ES900.ES910.CAN1.CAN1.AP_Inverter_L_Tx.Inv_L_RegID_M39_Inv_L_Iq "" FLOAT64_IEEE LINEAR_FUNCTION_M1_T0_U3 1 100 0 0 /begin IF_DATA E_TARGET KP_BLOB 0xFFFFFFFF 0xFFFFFFFF 2 1001 1 1001 26 /end IF_DATA /end MEASUREMENT
/begin MEASUREMENT ES900.ES910.CAN1.CAN1.AP_Inverter_L_Tx.Inv_L_RegID_M38_Inv_L_Icommand "" FLOAT64_IEEE LINEAR_FUNCTION_M1_T0_U3 1 100 0 0 /begin IF_DATA E_TARGET KP_BLOB 0xFFFFFFFF 0xFFFFFFFF 2 1001 1 1001 27 /end IF_DATA /end MEASUREMENT
/begin MEASUREMENT ES900.ES910.CAN1.CAN1.AP_Inverter_L_Tx.Inv_L_RegID_M32_Inv_L_Iactual "" FLOAT64_IEEE LINEAR_FUNCTION_M1_T0_U3 1 100 0 0 /begin IF_DATA E_TARGET KP_BLOB 0xFFFFFFFF 0xFFFFFFFF 2 1001 1 1001 28 /end IF_DATA /end MEASUREMENT
/begin MEASUREMENT ES900.ES910.CAN1.CAN1.AP_Inverter_L_Tx.Inv_L_RegID_M235_Inv_L_DCBus "" FLOAT64_IEEE LINEAR_FUNCTION_M1_T0_U4 1 100 0 0 /begin IF_DATA E_TARGET KP_BLOB 0xFFFFFFFF 0xFFFFFFFF 2 1001 1 1001 29 /end IF_DATA /end MEASUREMENT
/begin MEASUREMENT ES900.ES910.CAN1.CAN1.AP_DASH_Mode.RacingMode "" FLOAT64_IEEE LINEAR_FUNCTION_M1_T0_U1 1 100 0 0 /begin IF_DATA E_TARGET KP_BLOB 0xFFFFFFFF 0xFFFFFFFF 2 1001 1 1001 30 /end IF_DATA /end MEASUREMENT
/begin MEASUREMENT ES900.ES910.CAN1.CAN1.NM_BMS_Keep_Alive.BMS_Alive "" FLOAT64_IEEE LINEAR_FUNCTION_M1_T0_U1 1 100 0 0 /begin IF_DATA E_TARGET KP_BLOB 0xFFFFFFFF 0xFFFFFFFF 2 1001 1 1001 31 /end IF_DATA /end MEASUREMENT
/begin MEASUREMENT ES900.ES910.CAN1.CAN1.AP_BMS_AIRs_State.AIRs_State "" FLOAT64_IEEE LINEAR_FUNCTION_M1_T0_U1 1 100 0 0 /begin IF_DATA E_TARGET KP_BLOB 0xFFFFFFFF 0xFFFFFFFF 2 1001 1 1001 32 /end IF_DATA /end MEASUREMENT
/begin MEASUREMENT ES900.ES910.CAN1.CAN1.NM_DASH_Keep_Alive.Dash_Alive "" FLOAT64_IEEE LINEAR_FUNCTION_M1_T0_U1 1 100 0 0 /begin IF_DATA E_TARGET KP_BLOB 0xFFFFFFFF 0xFFFFFFFF 2 1001 1 1001 33 /end IF_DATA /end MEASUREMENT
/begin MEASUREMENT ES900.ES910.CAN1.CAN1.AP_DASH_PrechargeRequest.PrechargeRequest "" FLOAT64_IEEE LINEAR_FUNCTION_M1_T0_U1 1 100 0 0 /begin IF_DATA E_TARGET KP_BLOB 0xFFFFFFFF 0xFFFFFFFF 2 1001 1 1001 34 /end IF_DATA /end MEASUREMENT
/begin MEASUREMENT ES900.ES910.CAN1.CAN1.AP_DASH_EnableDrive.EnableDrive_Order "" FLOAT64_IEEE LINEAR_FUNCTION_M1_T0_U2 1 100 0 0 /begin IF_DATA E_TARGET KP_BLOB 0xFFFFFFFF 0xFFFFFFFF 2 1001 1 1001 35 /end IF_DATA /end MEASUREMENT
/begin MEASUREMENT ES900.ES910.CAN1.CAN1.AP_ETAS_DashData.SoC_KF "" FLOAT64_IEEE LINEAR_FUNCTION_M1_T0_U9 1 100 0 255 /begin IF_DATA E_TARGET KP_BLOB 0xFFFFFFFF 0xFFFFFFFF 2 1001 1 1001 37 /end IF_DATA /end MEASUREMENT
/begin MEASUREMENT ES900.ES910.CAN1.CAN1.AP_ETAS_DashData.Speed "" FLOAT64_IEEE LINEAR_FUNCTION_M1_T0_U10 1 100 -128 127 /begin IF_DATA E_TARGET KP_BLOB 0xFFFFFFFF 0xFFFFFFFF 2 1001 1 1001 38 /end IF_DATA /end MEASUREMENT
/begin MEASUREMENT ES900.ES910.CAN1.CAN1.AP_ETAS_DashData.Precharge_Voltage "" FLOAT64_IEEE LINEAR_FUNCTION_M1_T0_U4 1 100 0 655.35 /begin IF_DATA E_TARGET KP_BLOB 0xFFFFFFFF 0xFFFFFFFF 2 1001 1 1001 39 /end IF_DATA /end MEASUREMENT
/begin MEASUREMENT ES900.ES910.CAN1.CAN1.AP_ETAS_DashData.Precharge_Percentage "" FLOAT64_IEEE LINEAR_FUNCTION_M1_T0_U11 1 100 0 100 /begin IF_DATA E_TARGET KP_BLOB 0xFFFFFFFF 0xFFFFFFFF 2 1001 1 1001 40 /end IF_DATA /end MEASUREMENT
/begin MEASUREMENT ES900.ES910.CAN1.CAN1.AP_ETAS_VDCParams.VDC_Max_Tyre_Slip "" FLOAT64_IEEE LINEAR_FUNCTION_M1_T0_U6 1 100 0 2.55 /begin IF_DATA E_TARGET KP_BLOB 0xFFFFFFFF 0xFFFFFFFF 2 1001 1 1001 42 /end IF_DATA /end MEASUREMENT
/begin MEASUREMENT ES900.ES910.CAN1.CAN1.AP_ETAS_Inverter_R_Rx.Inverter_R_RegID "" FLOAT64_IEEE LINEAR_FUNCTION_M1_T0_U1 1 100 0 255 /begin IF_DATA E_TARGET KP_BLOB 0xFFFFFFFF 0xFFFFFFFF 2 1001 1 1001 44 /end IF_DATA /end MEASUREMENT
/begin MEASUREMENT ES900.ES910.CAN1.CAN1.AP_ETAS_Inverter_R_Rx.Inverter_R_b7tob0 "" FLOAT64_IEEE LINEAR_FUNCTION_M1_T0_U1 1 100 0 255 /begin IF_DATA E_TARGET KP_BLOB 0xFFFFFFFF 0xFFFFFFFF 2 1001 1 1001 45 /end IF_DATA /end MEASUREMENT
/begin MEASUREMENT ES900.ES910.CAN1.CAN1.AP_ETAS_Inverter_R_Rx.Inverter_R_b15tob8 "" FLOAT64_IEEE LINEAR_FUNCTION_M1_T0_U1 1 100 0 255 /begin IF_DATA E_TARGET KP_BLOB 0xFFFFFFFF 0xFFFFFFFF 2 1001 1 1001 46 /end IF_DATA /end MEASUREMENT
/begin MEASUREMENT ES900.ES910.CAN1.CAN1.AP_ETAS_Inverter_L_Rx.Inverter_L_RegID "" FLOAT64_IEEE LINEAR_FUNCTION_M1_T0_U1 1 100 0 255 /begin IF_DATA E_TARGET KP_BLOB 0xFFFFFFFF 0xFFFFFFFF 2 1001 1 1001 48 /end IF_DATA /end MEASUREMENT
/begin MEASUREMENT ES900.ES910.CAN1.CAN1.AP_ETAS_Inverter_L_Rx.Inverter_L_b7tob0 "" FLOAT64_IEEE LINEAR_FUNCTION_M1_T0_U1 1 100 0 255 /begin IF_DATA E_TARGET KP_BLOB 0xFFFFFFFF 0xFFFFFFFF 2 1001 1 1001 49 /end IF_DATA /end MEASUREMENT
/begin MEASUREMENT ES900.ES910.CAN1.CAN1.AP_ETAS_Inverter_L_Rx.Inverter_L_b15tob8 "" FLOAT64_IEEE LINEAR_FUNCTION_M1_T0_U1 1 100 0 255 /begin IF_DATA E_TARGET KP_BLOB 0xFFFFFFFF 0xFFFFFFFF 2 1001 1 1001 50 /end IF_DATA /end MEASUREMENT
/begin MEASUREMENT ES900.ES910.CAN1.CAN1.AP_ETAS_CarState.Car_State "" FLOAT64_IEEE LINEAR_FUNCTION_M1_T0_U1 1 100 0 21 /begin IF_DATA E_TARGET KP_BLOB 0xFFFFFFFF 0xFFFFFFFF 2 1001 1 1001 52 /end IF_DATA /end MEASUREMENT
/begin MEASUREMENT ES900.ES910.CAN1.CAN1.AP_ETAS_AIRsRequest.AIRs_Request "" FLOAT64_IEEE LINEAR_FUNCTION_M1_T0_U1 1 100 0 15 /begin IF_DATA E_TARGET KP_BLOB 0xFFFFFFFF 0xFFFFFFFF 2 1001 1 1001 54 /end IF_DATA /end MEASUREMENT
/begin MEASUREMENT ES900.ES910.CAN1.CAN1.MEAS_ETAS_InternalVars.InvertersAction "" FLOAT64_IEEE LINEAR_FUNCTION_M1_T0_U6 1 100 0 31 /begin IF_DATA E_TARGET KP_BLOB 0xFFFFFFFF 0xFFFFFFFF 2 1001 1 1001 56 /end IF_DATA /end MEASUREMENT
/begin MEASUREMENT ES900.ES910.CAN1.CAN1.MEAS_ETAS_InternalVars.el_Vel_OK "" FLOAT64_IEEE LINEAR_FUNCTION_M1_T0_U2 1 100 0 1 /begin IF_DATA E_TARGET KP_BLOB 0xFFFFFFFF 0xFFFFFFFF 2 1001 1 1001 57 /end IF_DATA /end MEASUREMENT
/begin MEASUREMENT ES900.ES910.CAN1.CAN1.MEAS_ETAS_InternalVars.TC_Warning "" FLOAT64_IEEE LINEAR_FUNCTION_M1_T0_U2 1 100 0 1 /begin IF_DATA E_TARGET KP_BLOB 0xFFFFFFFF 0xFFFFFFFF 2 1001 1 1001 58 /end IF_DATA /end MEASUREMENT
/begin MEASUREMENT ES900.ES910.CAN1.CAN1.MEAS_ETAS_InternalVars.Regenerative_Enable "" FLOAT64_IEEE LINEAR_FUNCTION_M1_T0_U2 1 100 0 1 /begin IF_DATA E_TARGET KP_BLOB 0xFFFFFFFF 0xFFFFFFFF 2 1001 1 1001 59 /end IF_DATA /end MEASUREMENT
/begin MEASUREMENT ES900.ES910.CAN1.CAN1.MEAS_ETAS_InternalVars.CriticalDisconnection "" FLOAT64_IEEE LINEAR_FUNCTION_M1_T0_U2 1 100 0 1 /begin IF_DATA E_TARGET KP_BLOB 0xFFFFFFFF 0xFFFFFFFF 2 1001 1 1001 60 /end IF_DATA /end MEASUREMENT
/begin MEASUREMENT ES900.ES910.CAN1.CAN1.MEAS_ETAS_InternalVars.Relay_Error "" FLOAT64_IEEE LINEAR_FUNCTION_M1_T0_U2 1 100 0 1 /begin IF_DATA E_TARGET KP_BLOB 0xFFFFFFFF 0xFFFFFFFF 2 1001 1 1001 61 /end IF_DATA /end MEASUREMENT
/begin MEASUREMENT ES900.ES910.CAN1.CAN1.MEAS_ETAS_InternalVars.Car_OK "" FLOAT64_IEEE LINEAR_FUNCTION_M1_T0_U2 1 100 0 1 /begin IF_DATA E_TARGET KP_BLOB 0xFFFFFFFF 0xFFFFFFFF 2 1001 1 1001 62 /end IF_DATA /end MEASUREMENT
/begin MEASUREMENT ES900.ES910.CAN1.CAN1.MEAS_ETAS_InternalVars.Power "" FLOAT64_IEEE LINEAR_FUNCTION_M1_T0_U12 1 100 -327.68 327.67 /begin IF_DATA E_TARGET KP_BLOB 0xFFFFFFFF 0xFFFFFFFF 2 1001 1 1001 63 /end IF_DATA /end MEASUREMENT
/begin MEASUREMENT ES900.ES910.CAN1.CAN1.MEAS_ETAS_InternalVars.Torque_OK "" FLOAT64_IEEE LINEAR_FUNCTION_M1_T0_U2 1 100 0 1 /begin IF_DATA E_TARGET KP_BLOB 0xFFFFFFFF 0xFFFFFFFF 2 1001 1 1001 64 /end IF_DATA /end MEASUREMENT
/begin MEASUREMENT ES900.ES910.CAN1.CAN1.MEAS_ETAS_InternalVars.Sensorics_Mode "" FLOAT64_IEEE LINEAR_FUNCTION_M1_T0_U1 1 100 0 7 /begin IF_DATA E_TARGET KP_BLOB 0xFFFFFFFF 0xFFFFFFFF 2 1001 1 1001 65 /end IF_DATA /end MEASUREMENT
/begin MEASUREMENT ES900.ES910.CAN1.CAN1.MEAS_ETAS_InternalVars.Critical_Signal_Disconnection "" FLOAT64_IEEE LINEAR_FUNCTION_M1_T0_U2 1 100 0 1 /begin IF_DATA E_TARGET KP_BLOB 0xFFFFFFFF 0xFFFFFFFF 2 1001 1 1001 66 /end IF_DATA /end MEASUREMENT
/begin MEASUREMENT ES900.ES910.CAN1.CAN1.MEAS_ETAS_InternalVars.Critical_CAN_Disconnection "" FLOAT64_IEEE LINEAR_FUNCTION_M1_T0_U2 1 100 0 1 /begin IF_DATA E_TARGET KP_BLOB 0xFFFFFFFF 0xFFFFFFFF 2 1001 1 1001 67 /end IF_DATA /end MEASUREMENT
/begin MEASUREMENT ES900.ES910.CAN1.CAN1.MEAS_ETAS_InternalVars.APPS_Implausibility "" FLOAT64_IEEE LINEAR_FUNCTION_M1_T0_U2 1 100 0 1 /begin IF_DATA E_TARGET KP_BLOB 0xFFFFFFFF 0xFFFFFFFF 2 1001 1 1001 68 /end IF_DATA /end MEASUREMENT
/begin MEASUREMENT ES900.ES910.CAN1.CAN1.AP_ETAS_Synchronism.Sync_CAN1 "" FLOAT64_IEEE LINEAR_FUNCTION_M1_T0_U1 1 100 0 255 /begin IF_DATA E_TARGET KP_BLOB 0xFFFFFFFF 0xFFFFFFFF 2 1001 1 1001 70 /end IF_DATA /end MEASUREMENT
/begin MEASUREMENT ES900.ES910.CAN2.Presence.PresenceGroup.PresenceFlag "" FLOAT64_IEEE LINEAR_FUNCTION_M1_T0_U1 1 100 0 1 /begin IF_DATA E_TARGET KP_BLOB 0xFFFFFFFF 0xFFFFFFFF 2 1001 1 1001 71 /end IF_DATA /end MEASUREMENT
/begin MEASUREMENT ES900.ES910.CAN2.CAN2.MEAS_ETAS_SOC.SOC_High "" FLOAT64_IEEE LINEAR_FUNCTION_M1_T0_U9 1 100 0 655.35 /begin IF_DATA E_TARGET KP_BLOB 0xFFFFFFFF 0xFFFFFFFF 2 1001 1 1001 73 /end IF_DATA /end MEASUREMENT
/begin MEASUREMENT ES900.ES910.CAN2.CAN2.MEAS_ETAS_SOC.SOC_Low "" FLOAT64_IEEE LINEAR_FUNCTION_M1_T0_U9 1 100 0 655.35 /begin IF_DATA E_TARGET KP_BLOB 0xFFFFFFFF 0xFFFFFFFF 2 1001 1 1001 74 /end IF_DATA /end MEASUREMENT
/begin MEASUREMENT ES900.ES910.CAN2.CAN2.MEAS_ETAS_SOC.SOC_Avg "" FLOAT64_IEEE LINEAR_FUNCTION_M1_T0_U9 1 100 0 655.35 /begin IF_DATA E_TARGET KP_BLOB 0xFFFFFFFF 0xFFFFFFFF 2 1001 1 1001 75 /end IF_DATA /end MEASUREMENT
/begin MEASUREMENT ES900.ES910.CAN2.CAN2.AP_ELLIPSE_AUTO.el_Track_Valid "" FLOAT64_IEEE LINEAR_FUNCTION_M1_T0_U2 1 100 0 0 /begin IF_DATA E_TARGET KP_BLOB 0xFFFFFFFF 0xFFFFFFFF 2 1001 1 1001 76 /end IF_DATA /end MEASUREMENT
/begin MEASUREMENT ES900.ES910.CAN2.CAN2.AP_ELLIPSE_AUTO.el_Slip_Valid "" FLOAT64_IEEE LINEAR_FUNCTION_M1_T0_U2 1 100 0 0 /begin IF_DATA E_TARGET KP_BLOB 0xFFFFFFFF 0xFFFFFFFF 2 1001 1 1001 77 /end IF_DATA /end MEASUREMENT
/begin MEASUREMENT ES900.ES910.CAN2.CAN2.AP_ELLIPSE_AUTO.el_Curvature_Valid "" FLOAT64_IEEE LINEAR_FUNCTION_M1_T0_U2 1 100 0 0 /begin IF_DATA E_TARGET KP_BLOB 0xFFFFFFFF 0xFFFFFFFF 2 1001 1 1001 78 /end IF_DATA /end MEASUREMENT
/begin MEASUREMENT ES900.ES910.CAN2.CAN2.AP_ELLIPSE_AUTO.el_SlipAngle "" FLOAT64_IEEE LINEAR_FUNCTION_M1_T0_U13 1 100 0 0 /begin IF_DATA E_TARGET KP_BLOB 0xFFFFFFFF 0xFFFFFFFF 2 1001 1 1001 79 /end IF_DATA /end MEASUREMENT
/begin MEASUREMENT ES900.ES910.CAN2.CAN2.AP_ELLIPSE_AUTO.el_CurvatureRadius "" FLOAT64_IEEE LINEAR_FUNCTION_M1_T0_U14 1 100 0 0 /begin IF_DATA E_TARGET KP_BLOB 0xFFFFFFFF 0xFFFFFFFF 2 1001 1 1001 80 /end IF_DATA /end MEASUREMENT
/begin MEASUREMENT ES900.ES910.CAN2.CAN2.AP_ELLIPSE_AUTO.el_AngleTrack "" FLOAT64_IEEE LINEAR_FUNCTION_M1_T0_U13 1 100 0 0 /begin IF_DATA E_TARGET KP_BLOB 0xFFFFFFFF 0xFFFFFFFF 2 1001 1 1001 81 /end IF_DATA /end MEASUREMENT
/begin MEASUREMENT ES900.ES910.CAN2.CAN2.AP_ELLIPSE_GPS_VEL.el_Vel_GPS_N "" FLOAT64_IEEE LINEAR_FUNCTION_M1_T0_U15 1 100 0 0 /begin IF_DATA E_TARGET KP_BLOB 0xFFFFFFFF 0xFFFFFFFF 2 1001 1 1001 82 /end IF_DATA /end MEASUREMENT
/begin MEASUREMENT ES900.ES910.CAN2.CAN2.AP_ELLIPSE_GPS_VEL.el_Vel_GPS_E "" FLOAT64_IEEE LINEAR_FUNCTION_M1_T0_U15 1 100 0 0 /begin IF_DATA E_TARGET KP_BLOB 0xFFFFFFFF 0xFFFFFFFF 2 1001 1 1001 83 /end IF_DATA /end MEASUREMENT
/begin MEASUREMENT ES900.ES910.CAN2.CAN2.AP_ELLIPSE_GPS_VEL.el_Vel_GPS_D "" FLOAT64_IEEE LINEAR_FUNCTION_M1_T0_U15 1 100 0 0 /begin IF_DATA E_TARGET KP_BLOB 0xFFFFFFFF 0xFFFFFFFF 2 1001 1 1001 84 /end IF_DATA /end MEASUREMENT
/begin MEASUREMENT ES900.ES910.CAN2.CAN2.NM_ETAS_Disconnections.Disconnection_InvR "" FLOAT64_IEEE LINEAR_FUNCTION_M1_T0_U2 1 100 0 1 /begin IF_DATA E_TARGET KP_BLOB 0xFFFFFFFF 0xFFFFFFFF 2 1001 1 1001 86 /end IF_DATA /end MEASUREMENT
/begin MEASUREMENT ES900.ES910.CAN2.CAN2.NM_ETAS_Disconnections.Disconnection_InvL "" FLOAT64_IEEE LINEAR_FUNCTION_M1_T0_U2 1 100 0 1 /begin IF_DATA E_TARGET KP_BLOB 0xFFFFFFFF 0xFFFFFFFF 2 1001 1 1001 87 /end IF_DATA /end MEASUREMENT
/begin MEASUREMENT ES900.ES910.CAN2.CAN2.NM_ETAS_Disconnections.Disconnection_Susp_R_R "" FLOAT64_IEEE LINEAR_FUNCTION_M1_T0_U2 1 100 0 1 /begin IF_DATA E_TARGET KP_BLOB 0xFFFFFFFF 0xFFFFFFFF 2 1001 1 1001 88 /end IF_DATA /end MEASUREMENT
/begin MEASUREMENT ES900.ES910.CAN2.CAN2.NM_ETAS_Disconnections.Disconnection_Susp_R_L "" FLOAT64_IEEE LINEAR_FUNCTION_M1_T0_U2 1 100 0 1 /begin IF_DATA E_TARGET KP_BLOB 0xFFFFFFFF 0xFFFFFFFF 2 1001 1 1001 89 /end IF_DATA /end MEASUREMENT
/begin MEASUREMENT ES900.ES910.CAN2.CAN2.NM_ETAS_Disconnections.Disconnection_Susp_F_R "" FLOAT64_IEEE LINEAR_FUNCTION_M1_T0_U2 1 100 0 1 /begin IF_DATA E_TARGET KP_BLOB 0xFFFFFFFF 0xFFFFFFFF 2 1001 1 1001 90 /end IF_DATA /end MEASUREMENT
/begin MEASUREMENT ES900.ES910.CAN2.CAN2.NM_ETAS_Disconnections.Disconnection_Susp_F_L "" FLOAT64_IEEE LINEAR_FUNCTION_M1_T0_U2 1 100 0 1 /begin IF_DATA E_TARGET KP_BLOB 0xFFFFFFFF 0xFFFFFFFF 2 1001 1 1001 91 /end IF_DATA /end MEASUREMENT
/begin MEASUREMENT ES900.ES910.CAN2.CAN2.NM_ETAS_Disconnections.Disconnection_SteeringSensor "" FLOAT64_IEEE LINEAR_FUNCTION_M1_T0_U2 1 100 0 1 /begin IF_DATA E_TARGET KP_BLOB 0xFFFFFFFF 0xFFFFFFFF 2 1001 1 1001 92 /end IF_DATA /end MEASUREMENT
/begin MEASUREMENT ES900.ES910.CAN2.CAN2.NM_ETAS_Disconnections.Disconnection_Rear "" FLOAT64_IEEE LINEAR_FUNCTION_M1_T0_U2 1 100 0 1 /begin IF_DATA E_TARGET KP_BLOB 0xFFFFFFFF 0xFFFFFFFF 2 1001 1 1001 93 /end IF_DATA /end MEASUREMENT
/begin MEASUREMENT ES900.ES910.CAN2.CAN2.NM_ETAS_Disconnections.Disconnection_Pitot "" FLOAT64_IEEE LINEAR_FUNCTION_M1_T0_U2 1 100 0 1 /begin IF_DATA E_TARGET KP_BLOB 0xFFFFFFFF 0xFFFFFFFF 2 1001 1 1001 94 /end IF_DATA /end MEASUREMENT
/begin MEASUREMENT ES900.ES910.CAN2.CAN2.NM_ETAS_Disconnections.Disconnection_Front "" FLOAT64_IEEE LINEAR_FUNCTION_M1_T0_U2 1 100 0 1 /begin IF_DATA E_TARGET KP_BLOB 0xFFFFFFFF 0xFFFFFFFF 2 1001 1 1001 95 /end IF_DATA /end MEASUREMENT
/begin MEASUREMENT ES900.ES910.CAN2.CAN2.NM_ETAS_Disconnections.Disconnection_Ellipse "" FLOAT64_IEEE LINEAR_FUNCTION_M1_T0_U2 1 100 0 1 /begin IF_DATA E_TARGET KP_BLOB 0xFFFFFFFF 0xFFFFFFFF 2 1001 1 1001 96 /end IF_DATA /end MEASUREMENT
/begin MEASUREMENT ES900.ES910.CAN2.CAN2.NM_ETAS_Disconnections.Disconnection_DashBoard "" FLOAT64_IEEE LINEAR_FUNCTION_M1_T0_U2 1 100 0 1 /begin IF_DATA E_TARGET KP_BLOB 0xFFFFFFFF 0xFFFFFFFF 2 1001 1 1001 97 /end IF_DATA /end MEASUREMENT
/begin MEASUREMENT ES900.ES910.CAN2.CAN2.NM_ETAS_Disconnections.Disconnection_BrakePedal "" FLOAT64_IEEE LINEAR_FUNCTION_M1_T0_U2 1 100 0 1 /begin IF_DATA E_TARGET KP_BLOB 0xFFFFFFFF 0xFFFFFFFF 2 1001 1 1001 98 /end IF_DATA /end MEASUREMENT
/begin MEASUREMENT ES900.ES910.CAN2.CAN2.NM_ETAS_Disconnections.Disconnection_BMS "" FLOAT64_IEEE LINEAR_FUNCTION_M1_T0_U2 1 100 0 1 /begin IF_DATA E_TARGET KP_BLOB 0xFFFFFFFF 0xFFFFFFFF 2 1001 1 1001 99 /end IF_DATA /end MEASUREMENT
/begin MEASUREMENT ES900.ES910.CAN2.CAN2.NM_ETAS_Disconnections.Disconnection_APPS2 "" FLOAT64_IEEE LINEAR_FUNCTION_M1_T0_U2 1 100 0 1 /begin IF_DATA E_TARGET KP_BLOB 0xFFFFFFFF 0xFFFFFFFF 2 1001 1 1001 100 /end IF_DATA /end MEASUREMENT
/begin MEASUREMENT ES900.ES910.CAN2.CAN2.NM_ETAS_Disconnections.Disconnection_APPS1 "" FLOAT64_IEEE LINEAR_FUNCTION_M1_T0_U2 1 100 0 1 /begin IF_DATA E_TARGET KP_BLOB 0xFFFFFFFF 0xFFFFFFFF 2 1001 1 1001 101 /end IF_DATA /end MEASUREMENT
/begin MEASUREMENT ES900.ES910.CAN2.CAN2.MEAS_ETAS_VDC_Values.el_VEL "" FLOAT64_IEEE LINEAR_FUNCTION_M1_T0_U16 1 100 0 65.535 /begin IF_DATA E_TARGET KP_BLOB 0xFFFFFFFF 0xFFFFFFFF 2 1001 1 1001 103 /end IF_DATA /end MEASUREMENT
/begin MEASUREMENT ES900.ES910.CAN2.CAN2.MEAS_ETAS_VDC_Values.SteeringSensor_Value "" FLOAT64_IEEE LINEAR_FUNCTION_M1_T0_U13 1 100 -125 125 /begin IF_DATA E_TARGET KP_BLOB 0xFFFFFFFF 0xFFFFFFFF 2 1001 1 1001 104 /end IF_DATA /end MEASUREMENT
/begin MEASUREMENT ES900.ES910.CAN2.CAN2.MEAS_ETAS_VDC_Values.BrakePedal_Value "" FLOAT64_IEEE LINEAR_FUNCTION_M1_T0_U17 1 100 0 1 /begin IF_DATA E_TARGET KP_BLOB 0xFFFFFFFF 0xFFFFFFFF 2 1001 1 1001 105 /end IF_DATA /end MEASUREMENT
/begin MEASUREMENT ES900.ES910.CAN2.CAN2.MEAS_ETAS_VDC_Values.APPS2_Value "" FLOAT64_IEEE LINEAR_FUNCTION_M1_T0_U17 1 100 0 1 /begin IF_DATA E_TARGET KP_BLOB 0xFFFFFFFF 0xFFFFFFFF 2 1001 1 1001 106 /end IF_DATA /end MEASUREMENT
/begin MEASUREMENT ES900.ES910.CAN2.CAN2.MEAS_ETAS_VDC_Values.APPS1_Value "" FLOAT64_IEEE LINEAR_FUNCTION_M1_T0_U17 1 100 0 1 /begin IF_DATA E_TARGET KP_BLOB 0xFFFFFFFF 0xFFFFFFFF 2 1001 1 1001 107 /end IF_DATA /end MEASUREMENT
/begin MEASUREMENT ES900.ES910.CAN2.CAN2.AP_ETAS_BrakeLight.BrakeLight_Control "" FLOAT64_IEEE LINEAR_FUNCTION_M1_T0_U2 1 100 0 1 /begin IF_DATA E_TARGET KP_BLOB 0xFFFFFFFF 0xFFFFFFFF 2 1001 1 1001 109 /end IF_DATA /end MEASUREMENT
/begin MEASUREMENT ES900.ES910.CAN2.CAN2.MEAS_RECU_SDC.Shutdown_TSMS_TSMP "" FLOAT64_IEEE LINEAR_FUNCTION_M1_T0_U2 1 100 0 0 /begin IF_DATA E_TARGET KP_BLOB 0xFFFFFFFF 0xFFFFFFFF 2 1001 1 1001 110 /end IF_DATA /end MEASUREMENT
/begin MEASUREMENT ES900.ES910.CAN2.CAN2.MEAS_RECU_SDC.Shutdown_HVD "" FLOAT64_IEEE LINEAR_FUNCTION_M1_T0_U2 1 100 0 0 /begin IF_DATA E_TARGET KP_BLOB 0xFFFFFFFF 0xFFFFFFFF 2 1001 1 1001 111 /end IF_DATA /end MEASUREMENT
/begin MEASUREMENT ES900.ES910.CAN2.CAN2.MEAS_RECU_SDC.Shutdown_HVBox "" FLOAT64_IEEE LINEAR_FUNCTION_M1_T0_U2 1 100 0 0 /begin IF_DATA E_TARGET KP_BLOB 0xFFFFFFFF 0xFFFFFFFF 2 1001 1 1001 112 /end IF_DATA /end MEASUREMENT
/begin MEASUREMENT ES900.ES910.CAN2.CAN2.MEAS_RECU_SDC.Shutdown_LeftTS "" FLOAT64_IEEE LINEAR_FUNCTION_M1_T0_U2 1 100 0 0 /begin IF_DATA E_TARGET KP_BLOB 0xFFFFFFFF 0xFFFFFFFF 2 1001 1 1001 113 /end IF_DATA /end MEASUREMENT
/begin MEASUREMENT ES900.ES910.CAN2.CAN2.MEAS_RECU_SDC.Shutdown_RightTS "" FLOAT64_IEEE LINEAR_FUNCTION_M1_T0_U2 1 100 0 0 /begin IF_DATA E_TARGET KP_BLOB 0xFFFFFFFF 0xFFFFFFFF 2 1001 1 1001 114 /end IF_DATA /end MEASUREMENT
/begin MEASUREMENT ES900.ES910.CAN2.CAN2.AP_ELLIPSE_EKF_POS.el_LONGITUDE_EKF "" FLOAT64_IEEE LINEAR_FUNCTION_M1_T0_U18 1 100 0 0 /begin IF_DATA E_TARGET KP_BLOB 0xFFFFFFFF 0xFFFFFFFF 2 1001 1 1001 115 /end IF_DATA /end MEASUREMENT
/begin MEASUREMENT ES900.ES910.CAN2.CAN2.AP_ELLIPSE_EKF_POS.el_LATITUDE_EKF "" FLOAT64_IEEE LINEAR_FUNCTION_M1_T0_U18 1 100 0 0 /begin IF_DATA E_TARGET KP_BLOB 0xFFFFFFFF 0xFFFFFFFF 2 1001 1 1001 116 /end IF_DATA /end MEASUREMENT
/begin MEASUREMENT ES900.ES910.CAN2.CAN2.AP_ELLIPSE_IMU_ACCEL.el_ACCEL_Z "" FLOAT64_IEEE LINEAR_FUNCTION_M1_T0_U19 1 100 0 0 /begin IF_DATA E_TARGET KP_BLOB 0xFFFFFFFF 0xFFFFFFFF 2 1001 1 1001 117 /end IF_DATA /end MEASUREMENT
/begin MEASUREMENT ES900.ES910.CAN2.CAN2.AP_ELLIPSE_IMU_ACCEL.el_ACCEL_Y "" FLOAT64_IEEE LINEAR_FUNCTION_M1_T0_U19 1 100 0 0 /begin IF_DATA E_TARGET KP_BLOB 0xFFFFFFFF 0xFFFFFFFF 2 1001 1 1001 118 /end IF_DATA /end MEASUREMENT
/begin MEASUREMENT ES900.ES910.CAN2.CAN2.AP_ELLIPSE_IMU_ACCEL.el_ACCEL_X "" FLOAT64_IEEE LINEAR_FUNCTION_M1_T0_U19 1 100 0 0 /begin IF_DATA E_TARGET KP_BLOB 0xFFFFFFFF 0xFFFFFFFF 2 1001 1 1001 119 /end IF_DATA /end MEASUREMENT
/begin MEASUREMENT ES900.ES910.CAN2.CAN2.AP_ELLIPSE_EKF_EULER.el_YAW "" FLOAT64_IEEE LINEAR_FUNCTION_M1_T0_U13 1 100 0 0 /begin IF_DATA E_TARGET KP_BLOB 0xFFFFFFFF 0xFFFFFFFF 2 1001 1 1001 120 /end IF_DATA /end MEASUREMENT
/begin MEASUREMENT ES900.ES910.CAN2.CAN2.AP_ELLIPSE_EKF_EULER.el_PITCH "" FLOAT64_IEEE LINEAR_FUNCTION_M1_T0_U13 1 100 0 0 /begin IF_DATA E_TARGET KP_BLOB 0xFFFFFFFF 0xFFFFFFFF 2 1001 1 1001 121 /end IF_DATA /end MEASUREMENT
/begin MEASUREMENT ES900.ES910.CAN2.CAN2.AP_ELLIPSE_EKF_EULER.el_ROLL "" FLOAT64_IEEE LINEAR_FUNCTION_M1_T0_U13 1 100 0 0 /begin IF_DATA E_TARGET KP_BLOB 0xFFFFFFFF 0xFFFFFFFF 2 1001 1 1001 122 /end IF_DATA /end MEASUREMENT
/begin MEASUREMENT ES900.ES910.CAN2.CAN2.AP_ELLIPSE_EKF_VEL.el_Vel_EKF_Z "" FLOAT64_IEEE LINEAR_FUNCTION_M1_T0_U15 1 100 0 0 /begin IF_DATA E_TARGET KP_BLOB 0xFFFFFFFF 0xFFFFFFFF 2 1001 1 1001 123 /end IF_DATA /end MEASUREMENT
/begin MEASUREMENT ES900.ES910.CAN2.CAN2.AP_ELLIPSE_EKF_VEL.el_Vel_EKF_Y "" FLOAT64_IEEE LINEAR_FUNCTION_M1_T0_U15 1 100 0 0 /begin IF_DATA E_TARGET KP_BLOB 0xFFFFFFFF 0xFFFFFFFF 2 1001 1 1001 124 /end IF_DATA /end MEASUREMENT
/begin MEASUREMENT ES900.ES910.CAN2.CAN2.AP_ELLIPSE_EKF_VEL.el_Vel_EKF_X "" FLOAT64_IEEE LINEAR_FUNCTION_M1_T0_U15 1 100 0 0 /begin IF_DATA E_TARGET KP_BLOB 0xFFFFFFFF 0xFFFFFFFF 2 1001 1 1001 125 /end IF_DATA /end MEASUREMENT
/begin MEASUREMENT ES900.ES910.CAN2.CAN2.NM_ELLIPSE_Status.Ellipse_Alive "" FLOAT64_IEEE LINEAR_FUNCTION_M1_T0_U20 1 100 0 0 /begin IF_DATA E_TARGET KP_BLOB 0xFFFFFFFF 0xFFFFFFFF 2 1001 1 1001 126 /end IF_DATA /end MEASUREMENT
/begin MEASUREMENT ES900.ES910.CAN2.CAN2.AP_ELLIPSE_IMU_GYRO.el_GYRO_Z "" FLOAT64_IEEE LINEAR_FUNCTION_M1_T0_U21 1 100 0 0 /begin IF_DATA E_TARGET KP_BLOB 0xFFFFFFFF 0xFFFFFFFF 2 1001 1 1001 127 /end IF_DATA /end MEASUREMENT
/begin MEASUREMENT ES900.ES910.CAN2.CAN2.AP_ELLIPSE_IMU_GYRO.el_GYRO_Y "" FLOAT64_IEEE LINEAR_FUNCTION_M1_T0_U21 1 100 0 0 /begin IF_DATA E_TARGET KP_BLOB 0xFFFFFFFF 0xFFFFFFFF 2 1001 1 1001 128 /end IF_DATA /end MEASUREMENT
/begin MEASUREMENT ES900.ES910.CAN2.CAN2.AP_ELLIPSE_IMU_GYRO.el_GYRO_X "" FLOAT64_IEEE LINEAR_FUNCTION_M1_T0_U21 1 100 0 0 /begin IF_DATA E_TARGET KP_BLOB 0xFFFFFFFF 0xFFFFFFFF 2 1001 1 1001 129 /end IF_DATA /end MEASUREMENT
/begin MEASUREMENT ES900.ES910.CAN2.CAN2.AP_ELLIPSE_VEL_Valid.el_SolutionMode "" FLOAT64_IEEE LINEAR_FUNCTION_M1_T0_U6 1 100 0 0 /begin IF_DATA E_TARGET KP_BLOB 0xFFFFFFFF 0xFFFFFFFF 2 1001 1 1001 130 /end IF_DATA /end MEASUREMENT
/begin MEASUREMENT ES900.ES910.CAN2.CAN2.AP_ELLIPSE_VEL_Valid.el_Vel_GPS_Valid "" FLOAT64_IEEE LINEAR_FUNCTION_M1_T0_U2 1 100 0 0 /begin IF_DATA E_TARGET KP_BLOB 0xFFFFFFFF 0xFFFFFFFF 2 1001 1 1001 131 /end IF_DATA /end MEASUREMENT
/begin MEASUREMENT ES900.ES910.CAN2.CAN2.AP_ELLIPSE_VEL_Valid.el_Vel_EKF_Valid "" FLOAT64_IEEE LINEAR_FUNCTION_M1_T0_U2 1 100 0 0 /begin IF_DATA E_TARGET KP_BLOB 0xFFFFFFFF 0xFFFFFFFF 2 1001 1 1001 132 /end IF_DATA /end MEASUREMENT
/begin MEASUREMENT ES900.ES910.CAN2.CAN2.MEAS_ETAS_Inverter_R_Data.Inv_R_TempMotor "" FLOAT64_IEEE LINEAR_FUNCTION_M1_T0_U5 1 100 -327.68 327.67 /begin IF_DATA E_TARGET KP_BLOB 0xFFFFFFFF 0xFFFFFFFF 2 1001 1 1001 134 /end IF_DATA /end MEASUREMENT
/begin MEASUREMENT ES900.ES910.CAN2.CAN2.MEAS_ETAS_Inverter_R_Data.current_R "" FLOAT64_IEEE LINEAR_FUNCTION_M1_T0_U3 1 100 -327.68 327.67 /begin IF_DATA E_TARGET KP_BLOB 0xFFFFFFFF 0xFFFFFFFF 2 1001 1 1001 135 /end IF_DATA /end MEASUREMENT
/begin MEASUREMENT ES900.ES910.CAN2.CAN2.MEAS_ETAS_Inverter_R_Data.Inv_R_TempIGBT "" FLOAT64_IEEE LINEAR_FUNCTION_M1_T0_U5 1 100 -327.68 327.67 /begin IF_DATA E_TARGET KP_BLOB 0xFFFFFFFF 0xFFFFFFFF 2 1001 1 1001 136 /end IF_DATA /end MEASUREMENT
/begin MEASUREMENT ES900.ES910.CAN2.CAN2.MEAS_ETAS_Inverter_R_Data.RR_Vel_ms_Wheel "" FLOAT64_IEEE LINEAR_FUNCTION_M1_T0_U16 1 100 -327.68 327.67 /begin IF_DATA E_TARGET KP_BLOB 0xFFFFFFFF 0xFFFFFFFF 2 1001 1 1001 137 /end IF_DATA /end MEASUREMENT
/begin MEASUREMENT ES900.ES910.CAN2.CAN2.MEAS_ETAS_Inverter_L_Data.Inv_L_TempMotor "" FLOAT64_IEEE LINEAR_FUNCTION_M1_T0_U5 1 100 -327.68 327.67 /begin IF_DATA E_TARGET KP_BLOB 0xFFFFFFFF 0xFFFFFFFF 2 1001 1 1001 139 /end IF_DATA /end MEASUREMENT
/begin MEASUREMENT ES900.ES910.CAN2.CAN2.MEAS_ETAS_Inverter_L_Data.current_L "" FLOAT64_IEEE LINEAR_FUNCTION_M1_T0_U3 1 100 -327.68 327.67 /begin IF_DATA E_TARGET KP_BLOB 0xFFFFFFFF 0xFFFFFFFF 2 1001 1 1001 140 /end IF_DATA /end MEASUREMENT
/begin MEASUREMENT ES900.ES910.CAN2.CAN2.MEAS_ETAS_Inverter_L_Data.Inv_L_TempIGBT "" FLOAT64_IEEE LINEAR_FUNCTION_M1_T0_U5 1 100 -327.68 327.67 /begin IF_DATA E_TARGET KP_BLOB 0xFFFFFFFF 0xFFFFFFFF 2 1001 1 1001 141 /end IF_DATA /end MEASUREMENT
/begin MEASUREMENT ES900.ES910.CAN2.CAN2.MEAS_ETAS_Inverter_L_Data.RL_Vel_ms_Wheel "" FLOAT64_IEEE LINEAR_FUNCTION_M1_T0_U16 1 100 -327.68 327.67 /begin IF_DATA E_TARGET KP_BLOB 0xFFFFFFFF 0xFFFFFFFF 2 1001 1 1001 142 /end IF_DATA /end MEASUREMENT
/begin MEASUREMENT ES900.ES910.CAN2.CAN2.MEAS_ETAS_VDC_Suspe.SUSP_R_R "" FLOAT64_IEEE LINEAR_FUNCTION_M1_T0_U22 1 100 -327.68 327.67 /begin IF_DATA E_TARGET KP_BLOB 0xFFFFFFFF 0xFFFFFFFF 2 1001 1 1001 144 /end IF_DATA /end MEASUREMENT
/begin MEASUREMENT ES900.ES910.CAN2.CAN2.MEAS_ETAS_VDC_Suspe.SUSP_R_L "" FLOAT64_IEEE LINEAR_FUNCTION_M1_T0_U22 1 100 -327.68 327.67 /begin IF_DATA E_TARGET KP_BLOB 0xFFFFFFFF 0xFFFFFFFF 2 1001 1 1001 145 /end IF_DATA /end MEASUREMENT
/begin MEASUREMENT ES900.ES910.CAN2.CAN2.MEAS_ETAS_VDC_Suspe.SUSP_F_R "" FLOAT64_IEEE LINEAR_FUNCTION_M1_T0_U22 1 100 -327.68 327.67 /begin IF_DATA E_TARGET KP_BLOB 0xFFFFFFFF 0xFFFFFFFF 2 1001 1 1001 146 /end IF_DATA /end MEASUREMENT
/begin MEASUREMENT ES900.ES910.CAN2.CAN2.MEAS_ETAS_VDC_Suspe.SUSP_F_L "" FLOAT64_IEEE LINEAR_FUNCTION_M1_T0_U22 1 100 -327.68 327.67 /begin IF_DATA E_TARGET KP_BLOB 0xFFFFFFFF 0xFFFFFFFF 2 1001 1 1001 147 /end IF_DATA /end MEASUREMENT
/begin MEASUREMENT ES900.ES910.CAN2.CAN2.MEAS_ETAS_VDC_Tq.Throttle_Torque "" FLOAT64_IEEE LINEAR_FUNCTION_M1_T0_U23 1 100 0 655.35 /begin IF_DATA E_TARGET KP_BLOB 0xFFFFFFFF 0xFFFFFFFF 2 1001 1 1001 149 /end IF_DATA /end MEASUREMENT
/begin MEASUREMENT ES900.ES910.CAN2.CAN2.MEAS_ETAS_VDC_Tq.Torque_R "" FLOAT64_IEEE LINEAR_FUNCTION_M1_T0_U23 1 100 -327.68 327.67 /begin IF_DATA E_TARGET KP_BLOB 0xFFFFFFFF 0xFFFFFFFF 2 1001 1 1001 150 /end IF_DATA /end MEASUREMENT
/begin MEASUREMENT ES900.ES910.CAN2.CAN2.MEAS_ETAS_VDC_Tq.Torque_L "" FLOAT64_IEEE LINEAR_FUNCTION_M1_T0_U23 1 100 -327.68 327.67 /begin IF_DATA E_TARGET KP_BLOB 0xFFFFFFFF 0xFFFFFFFF 2 1001 1 1001 151 /end IF_DATA /end MEASUREMENT
/begin MEASUREMENT ES900.ES910.CAN2.CAN2.AP_RECU_Data.Susp_R_R_Bits "" FLOAT64_IEEE LINEAR_FUNCTION_M1_T0_U7 1 100 0 0 /begin IF_DATA E_TARGET KP_BLOB 0xFFFFFFFF 0xFFFFFFFF 2 1001 1 1001 152 /end IF_DATA /end MEASUREMENT
/begin MEASUREMENT ES900.ES910.CAN2.CAN2.AP_RECU_Data.Susp_R_L_Bits "" FLOAT64_IEEE LINEAR_FUNCTION_M1_T0_U7 1 100 0 0 /begin IF_DATA E_TARGET KP_BLOB 0xFFFFFFFF 0xFFFFFFFF 2 1001 1 1001 153 /end IF_DATA /end MEASUREMENT
/begin MEASUREMENT ES900.ES910.CAN2.CAN2.NM_FECU_Keep_Alive.Front_Alive "" FLOAT64_IEEE LINEAR_FUNCTION_M1_T0_U1 1 100 0 0 /begin IF_DATA E_TARGET KP_BLOB 0xFFFFFFFF 0xFFFFFFFF 2 1001 1 1001 154 /end IF_DATA /end MEASUREMENT
/begin MEASUREMENT ES900.ES910.CAN2.CAN2.NM_RECU_Keep_Alive.Rear_Alive "" FLOAT64_IEEE LINEAR_FUNCTION_M1_T0_U1 1 100 0 0 /begin IF_DATA E_TARGET KP_BLOB 0xFFFFFFFF 0xFFFFFFFF 2 1001 1 1001 155 /end IF_DATA /end MEASUREMENT
/begin MEASUREMENT ES900.ES910.CAN2.CAN2.AP_FECU_Data2.Pitot_Bits "" FLOAT64_IEEE LINEAR_FUNCTION_M1_T0_U7 1 100 0 0 /begin IF_DATA E_TARGET KP_BLOB 0xFFFFFFFF 0xFFFFFFFF 2 1001 1 1001 156 /end IF_DATA /end MEASUREMENT
/begin MEASUREMENT ES900.ES910.CAN2.CAN2.AP_FECU_Data2.Susp_F_R_Bits "" FLOAT64_IEEE LINEAR_FUNCTION_M1_T0_U7 1 100 0 0 /begin IF_DATA E_TARGET KP_BLOB 0xFFFFFFFF 0xFFFFFFFF 2 1001 1 1001 157 /end IF_DATA /end MEASUREMENT
/begin MEASUREMENT ES900.ES910.CAN2.CAN2.AP_FECU_Data2.Susp_F_L_Bits "" FLOAT64_IEEE LINEAR_FUNCTION_M1_T0_U7 1 100 0 0 /begin IF_DATA E_TARGET KP_BLOB 0xFFFFFFFF 0xFFFFFFFF 2 1001 1 1001 158 /end IF_DATA /end MEASUREMENT
/begin MEASUREMENT ES900.ES910.CAN2.CAN2.AP_FECU_Data1.SteeringSensor_Bits "" FLOAT64_IEEE LINEAR_FUNCTION_M1_T0_U7 1 100 0 0 /begin IF_DATA E_TARGET KP_BLOB 0xFFFFFFFF 0xFFFFFFFF 2 1001 1 1001 159 /end IF_DATA /end MEASUREMENT
/begin MEASUREMENT ES900.ES910.CAN2.CAN2.AP_FECU_Data1.BrakePedal_Bits "" FLOAT64_IEEE LINEAR_FUNCTION_M1_T0_U7 1 100 0 0 /begin IF_DATA E_TARGET KP_BLOB 0xFFFFFFFF 0xFFFFFFFF 2 1001 1 1001 160 /end IF_DATA /end MEASUREMENT
/begin MEASUREMENT ES900.ES910.CAN2.CAN2.AP_FECU_Data1.APPS2_Bits "" FLOAT64_IEEE LINEAR_FUNCTION_M1_T0_U7 1 100 0 0 /begin IF_DATA E_TARGET KP_BLOB 0xFFFFFFFF 0xFFFFFFFF 2 1001 1 1001 161 /end IF_DATA /end MEASUREMENT
/begin MEASUREMENT ES900.ES910.CAN2.CAN2.AP_FECU_Data1.APPS1_Bits "" FLOAT64_IEEE LINEAR_FUNCTION_M1_T0_U7 1 100 0 0 /begin IF_DATA E_TARGET KP_BLOB 0xFFFFFFFF 0xFFFFFFFF 2 1001 1 1001 162 /end IF_DATA /end MEASUREMENT
/begin MEASUREMENT ES900.ES910.CAN2.CAN2.AP_ETAS_Synchronism.Sync_CAN2 "" FLOAT64_IEEE LINEAR_FUNCTION_M1_T0_U1 1 100 0 255 /begin IF_DATA E_TARGET KP_BLOB 0xFFFFFFFF 0xFFFFFFFF 2 1001 1 1001 164 /end IF_DATA /end MEASUREMENT
/begin CHARACTERISTIC ES900.ES910.CAN1.CAN1.AP_ETAS_DashData.SoC_KF_calibrate "" VALUE 0x0 STANDARD_VALUE_R64 0.0 LINEAR_FUNCTION_M1_T0_U9 0 255 MAX_REFRESH 6 1 /end CHARACTERISTIC
/begin CHARACTERISTIC ES900.ES910.CAN1.CAN1.AP_ETAS_DashData.Speed_calibrate "" VALUE 0x0 STANDARD_VALUE_R64 0.0 LINEAR_FUNCTION_M1_T0_U10 -128 127 MAX_REFRESH 6 1 /end CHARACTERISTIC
/begin CHARACTERISTIC ES900.ES910.CAN1.CAN1.AP_ETAS_DashData.Precharge_Voltage_calibrate "" VALUE 0x0 STANDARD_VALUE_R64 0.0 LINEAR_FUNCTION_M1_T0_U4 0 655.35 MAX_REFRESH 6 1 /end CHARACTERISTIC
/begin CHARACTERISTIC ES900.ES910.CAN1.CAN1.AP_ETAS_DashData.Precharge_Percentage_calibrate "" VALUE 0x0 STANDARD_VALUE_R64 0.0 LINEAR_FUNCTION_M1_T0_U11 0 100 MAX_REFRESH 6 1 /end CHARACTERISTIC
/begin CHARACTERISTIC ES900.ES910.CAN1.CAN1.AP_ETAS_VDCParams.VDC_Max_Tyre_Slip_calibrate "" VALUE 0x0 STANDARD_VALUE_R64 0.0 LINEAR_FUNCTION_M1_T0_U6 0 2.55 MAX_REFRESH 6 1 /end CHARACTERISTIC
/begin CHARACTERISTIC ES900.ES910.CAN1.CAN1.AP_ETAS_Inverter_R_Rx.Inverter_R_RegID_calibrate "" VALUE 0x0 STANDARD_VALUE_R64 0.0 LINEAR_FUNCTION_M1_T0_U1 0 255 MAX_REFRESH 6 1 /end CHARACTERISTIC
/begin CHARACTERISTIC ES900.ES910.CAN1.CAN1.AP_ETAS_Inverter_R_Rx.Inverter_R_b7tob0_calibrate "" VALUE 0x0 STANDARD_VALUE_R64 0.0 LINEAR_FUNCTION_M1_T0_U1 0 255 MAX_REFRESH 6 1 /end CHARACTERISTIC
/begin CHARACTERISTIC ES900.ES910.CAN1.CAN1.AP_ETAS_Inverter_R_Rx.Inverter_R_b15tob8_calibrate "" VALUE 0x0 STANDARD_VALUE_R64 0.0 LINEAR_FUNCTION_M1_T0_U1 0 255 MAX_REFRESH 6 1 /end CHARACTERISTIC
/begin CHARACTERISTIC ES900.ES910.CAN1.CAN1.AP_ETAS_Inverter_L_Rx.Inverter_L_RegID_calibrate "" VALUE 0x0 STANDARD_VALUE_R64 0.0 LINEAR_FUNCTION_M1_T0_U1 0 255 MAX_REFRESH 6 1 /end CHARACTERISTIC
/begin CHARACTERISTIC ES900.ES910.CAN1.CAN1.AP_ETAS_Inverter_L_Rx.Inverter_L_b7tob0_calibrate "" VALUE 0x0 STANDARD_VALUE_R64 0.0 LINEAR_FUNCTION_M1_T0_U1 0 255 MAX_REFRESH 6 1 /end CHARACTERISTIC
/begin CHARACTERISTIC ES900.ES910.CAN1.CAN1.AP_ETAS_Inverter_L_Rx.Inverter_L_b15tob8_calibrate "" VALUE 0x0 STANDARD_VALUE_R64 0.0 LINEAR_FUNCTION_M1_T0_U1 0 255 MAX_REFRESH 6 1 /end CHARACTERISTIC
/begin CHARACTERISTIC ES900.ES910.CAN1.CAN1.AP_ETAS_CarState.Car_State_calibrate "" VALUE 0x0 STANDARD_VALUE_R64 0.0 LINEAR_FUNCTION_M1_T0_U1 0 21 MAX_REFRESH 6 1 /end CHARACTERISTIC
/begin CHARACTERISTIC ES900.ES910.CAN1.CAN1.AP_ETAS_AIRsRequest.AIRs_Request_calibrate "" VALUE 0x0 STANDARD_VALUE_R64 0.0 LINEAR_FUNCTION_M1_T0_U1 0 15 MAX_REFRESH 6 1 /end CHARACTERISTIC
/begin CHARACTERISTIC ES900.ES910.CAN1.CAN1.MEAS_ETAS_InternalVars.InvertersAction_calibrate "" VALUE 0x0 STANDARD_VALUE_R64 0.0 LINEAR_FUNCTION_M1_T0_U6 0 31 MAX_REFRESH 6 1 /end CHARACTERISTIC
/begin CHARACTERISTIC ES900.ES910.CAN1.CAN1.MEAS_ETAS_InternalVars.el_Vel_OK_calibrate "" VALUE 0x0 STANDARD_VALUE_R64 0.0 LINEAR_FUNCTION_M1_T0_U2 0 1 MAX_REFRESH 6 1 /end CHARACTERISTIC
/begin CHARACTERISTIC ES900.ES910.CAN1.CAN1.MEAS_ETAS_InternalVars.TC_Warning_calibrate "" VALUE 0x0 STANDARD_VALUE_R64 0.0 LINEAR_FUNCTION_M1_T0_U2 0 1 MAX_REFRESH 6 1 /end CHARACTERISTIC
/begin CHARACTERISTIC ES900.ES910.CAN1.CAN1.MEAS_ETAS_InternalVars.Regenerative_Enable_calibrate "" VALUE 0x0 STANDARD_VALUE_R64 0.0 LINEAR_FUNCTION_M1_T0_U2 0 1 MAX_REFRESH 6 1 /end CHARACTERISTIC
/begin CHARACTERISTIC ES900.ES910.CAN1.CAN1.MEAS_ETAS_InternalVars.CriticalDisconnection_calibrate "" VALUE 0x0 STANDARD_VALUE_R64 0.0 LINEAR_FUNCTION_M1_T0_U2 0 1 MAX_REFRESH 6 1 /end CHARACTERISTIC
/begin CHARACTERISTIC ES900.ES910.CAN1.CAN1.MEAS_ETAS_InternalVars.Relay_Error_calibrate "" VALUE 0x0 STANDARD_VALUE_R64 0.0 LINEAR_FUNCTION_M1_T0_U2 0 1 MAX_REFRESH 6 1 /end CHARACTERISTIC
/begin CHARACTERISTIC ES900.ES910.CAN1.CAN1.MEAS_ETAS_InternalVars.Car_OK_calibrate "" VALUE 0x0 STANDARD_VALUE_R64 0.0 LINEAR_FUNCTION_M1_T0_U2 0 1 MAX_REFRESH 6 1 /end CHARACTERISTIC
/begin CHARACTERISTIC ES900.ES910.CAN1.CAN1.MEAS_ETAS_InternalVars.Power_calibrate "" VALUE 0x0 STANDARD_VALUE_R64 0.0 LINEAR_FUNCTION_M1_T0_U12 -327.68 327.67 MAX_REFRESH 6 1 /end CHARACTERISTIC
/begin CHARACTERISTIC ES900.ES910.CAN1.CAN1.MEAS_ETAS_InternalVars.Torque_OK_calibrate "" VALUE 0x0 STANDARD_VALUE_R64 0.0 LINEAR_FUNCTION_M1_T0_U2 0 1 MAX_REFRESH 6 1 /end CHARACTERISTIC
/begin CHARACTERISTIC ES900.ES910.CAN1.CAN1.MEAS_ETAS_InternalVars.Sensorics_Mode_calibrate "" VALUE 0x0 STANDARD_VALUE_R64 0.0 LINEAR_FUNCTION_M1_T0_U1 0 7 MAX_REFRESH 6 1 /end CHARACTERISTIC
/begin CHARACTERISTIC ES900.ES910.CAN1.CAN1.MEAS_ETAS_InternalVars.Critical_Signal_Disconnection_calibrate "" VALUE 0x0 STANDARD_VALUE_R64 0.0 LINEAR_FUNCTION_M1_T0_U2 0 1 MAX_REFRESH 6 1 /end CHARACTERISTIC
/begin CHARACTERISTIC ES900.ES910.CAN1.CAN1.MEAS_ETAS_InternalVars.Critical_CAN_Disconnection_calibrate "" VALUE 0x0 STANDARD_VALUE_R64 0.0 LINEAR_FUNCTION_M1_T0_U2 0 1 MAX_REFRESH 6 1 /end CHARACTERISTIC
/begin CHARACTERISTIC ES900.ES910.CAN1.CAN1.MEAS_ETAS_InternalVars.APPS_Implausibility_calibrate "" VALUE 0x0 STANDARD_VALUE_R64 0.0 LINEAR_FUNCTION_M1_T0_U2 0 1 MAX_REFRESH 6 1 /end CHARACTERISTIC
/begin CHARACTERISTIC ES900.ES910.CAN1.CAN1.AP_ETAS_Synchronism.Sync_CAN1_calibrate "" VALUE 0x0 STANDARD_VALUE_R64 0.0 LINEAR_FUNCTION_M1_T0_U1 0 255 MAX_REFRESH 6 1 /end CHARACTERISTIC
/begin CHARACTERISTIC ES900.ES910.CAN2.CAN2.MEAS_ETAS_SOC.SOC_High_calibrate "" VALUE 0x0 STANDARD_VALUE_R64 0.0 LINEAR_FUNCTION_M1_T0_U9 0 655.35 MAX_REFRESH 6 1 /end CHARACTERISTIC
/begin CHARACTERISTIC ES900.ES910.CAN2.CAN2.MEAS_ETAS_SOC.SOC_Low_calibrate "" VALUE 0x0 STANDARD_VALUE_R64 0.0 LINEAR_FUNCTION_M1_T0_U9 0 655.35 MAX_REFRESH 6 1 /end CHARACTERISTIC
/begin CHARACTERISTIC ES900.ES910.CAN2.CAN2.MEAS_ETAS_SOC.SOC_Avg_calibrate "" VALUE 0x0 STANDARD_VALUE_R64 0.0 LINEAR_FUNCTION_M1_T0_U9 0 655.35 MAX_REFRESH 6 1 /end CHARACTERISTIC
/begin CHARACTERISTIC ES900.ES910.CAN2.CAN2.NM_ETAS_Disconnections.Disconnection_InvR_calibrate "" VALUE 0x0 STANDARD_VALUE_R64 0.0 LINEAR_FUNCTION_M1_T0_U2 0 1 MAX_REFRESH 6 1 /end CHARACTERISTIC
/begin CHARACTERISTIC ES900.ES910.CAN2.CAN2.NM_ETAS_Disconnections.Disconnection_InvL_calibrate "" VALUE 0x0 STANDARD_VALUE_R64 0.0 LINEAR_FUNCTION_M1_T0_U2 0 1 MAX_REFRESH 6 1 /end CHARACTERISTIC
/begin CHARACTERISTIC ES900.ES910.CAN2.CAN2.NM_ETAS_Disconnections.Disconnection_Susp_R_R_calibrate "" VALUE 0x0 STANDARD_VALUE_R64 0.0 LINEAR_FUNCTION_M1_T0_U2 0 1 MAX_REFRESH 6 1 /end CHARACTERISTIC
/begin CHARACTERISTIC ES900.ES910.CAN2.CAN2.NM_ETAS_Disconnections.Disconnection_Susp_R_L_calibrate "" VALUE 0x0 STANDARD_VALUE_R64 0.0 LINEAR_FUNCTION_M1_T0_U2 0 1 MAX_REFRESH 6 1 /end CHARACTERISTIC
/begin CHARACTERISTIC ES900.ES910.CAN2.CAN2.NM_ETAS_Disconnections.Disconnection_Susp_F_R_calibrate "" VALUE 0x0 STANDARD_VALUE_R64 0.0 LINEAR_FUNCTION_M1_T0_U2 0 1 MAX_REFRESH 6 1 /end CHARACTERISTIC
/begin CHARACTERISTIC ES900.ES910.CAN2.CAN2.NM_ETAS_Disconnections.Disconnection_Susp_F_L_calibrate "" VALUE 0x0 STANDARD_VALUE_R64 0.0 LINEAR_FUNCTION_M1_T0_U2 0 1 MAX_REFRESH 6 1 /end CHARACTERISTIC
/begin CHARACTERISTIC ES900.ES910.CAN2.CAN2.NM_ETAS_Disconnections.Disconnection_SteeringSensor_calibrate "" VALUE 0x0 STANDARD_VALUE_R64 0.0 LINEAR_FUNCTION_M1_T0_U2 0 1 MAX_REFRESH 6 1 /end CHARACTERISTIC
/begin CHARACTERISTIC ES900.ES910.CAN2.CAN2.NM_ETAS_Disconnections.Disconnection_Rear_calibrate "" VALUE 0x0 STANDARD_VALUE_R64 0.0 LINEAR_FUNCTION_M1_T0_U2 0 1 MAX_REFRESH 6 1 /end CHARACTERISTIC
/begin CHARACTERISTIC ES900.ES910.CAN2.CAN2.NM_ETAS_Disconnections.Disconnection_Pitot_calibrate "" VALUE 0x0 STANDARD_VALUE_R64 0.0 LINEAR_FUNCTION_M1_T0_U2 0 1 MAX_REFRESH 6 1 /end CHARACTERISTIC
/begin CHARACTERISTIC ES900.ES910.CAN2.CAN2.NM_ETAS_Disconnections.Disconnection_Front_calibrate "" VALUE 0x0 STANDARD_VALUE_R64 0.0 LINEAR_FUNCTION_M1_T0_U2 0 1 MAX_REFRESH 6 1 /end CHARACTERISTIC
/begin CHARACTERISTIC ES900.ES910.CAN2.CAN2.NM_ETAS_Disconnections.Disconnection_Ellipse_calibrate "" VALUE 0x0 STANDARD_VALUE_R64 0.0 LINEAR_FUNCTION_M1_T0_U2 0 1 MAX_REFRESH 6 1 /end CHARACTERISTIC
/begin CHARACTERISTIC ES900.ES910.CAN2.CAN2.NM_ETAS_Disconnections.Disconnection_DashBoard_calibrate "" VALUE 0x0 STANDARD_VALUE_R64 0.0 LINEAR_FUNCTION_M1_T0_U2 0 1 MAX_REFRESH 6 1 /end CHARACTERISTIC
/begin CHARACTERISTIC ES900.ES910.CAN2.CAN2.NM_ETAS_Disconnections.Disconnection_BrakePedal_calibrate "" VALUE 0x0 STANDARD_VALUE_R64 0.0 LINEAR_FUNCTION_M1_T0_U2 0 1 MAX_REFRESH 6 1 /end CHARACTERISTIC
/begin CHARACTERISTIC ES900.ES910.CAN2.CAN2.NM_ETAS_Disconnections.Disconnection_BMS_calibrate "" VALUE 0x0 STANDARD_VALUE_R64 0.0 LINEAR_FUNCTION_M1_T0_U2 0 1 MAX_REFRESH 6 1 /end CHARACTERISTIC
/begin CHARACTERISTIC ES900.ES910.CAN2.CAN2.NM_ETAS_Disconnections.Disconnection_APPS2_calibrate "" VALUE 0x0 STANDARD_VALUE_R64 0.0 LINEAR_FUNCTION_M1_T0_U2 0 1 MAX_REFRESH 6 1 /end CHARACTERISTIC
/begin CHARACTERISTIC ES900.ES910.CAN2.CAN2.NM_ETAS_Disconnections.Disconnection_APPS1_calibrate "" VALUE 0x0 STANDARD_VALUE_R64 0.0 LINEAR_FUNCTION_M1_T0_U2 0 1 MAX_REFRESH 6 1 /end CHARACTERISTIC
/begin CHARACTERISTIC ES900.ES910.CAN2.CAN2.MEAS_ETAS_VDC_Values.el_VEL_calibrate "" VALUE 0x0 STANDARD_VALUE_R64 0.0 LINEAR_FUNCTION_M1_T0_U16 0 65.535 MAX_REFRESH 6 1 /end CHARACTERISTIC
/begin CHARACTERISTIC ES900.ES910.CAN2.CAN2.MEAS_ETAS_VDC_Values.SteeringSensor_Value_calibrate "" VALUE 0x0 STANDARD_VALUE_R64 0.0 LINEAR_FUNCTION_M1_T0_U13 -125 125 MAX_REFRESH 6 1 /end CHARACTERISTIC
/begin CHARACTERISTIC ES900.ES910.CAN2.CAN2.MEAS_ETAS_VDC_Values.BrakePedal_Value_calibrate "" VALUE 0x0 STANDARD_VALUE_R64 0.0 LINEAR_FUNCTION_M1_T0_U17 0 1 MAX_REFRESH 6 1 /end CHARACTERISTIC
/begin CHARACTERISTIC ES900.ES910.CAN2.CAN2.MEAS_ETAS_VDC_Values.APPS2_Value_calibrate "" VALUE 0x0 STANDARD_VALUE_R64 0.0 LINEAR_FUNCTION_M1_T0_U17 0 1 MAX_REFRESH 6 1 /end CHARACTERISTIC
/begin CHARACTERISTIC ES900.ES910.CAN2.CAN2.MEAS_ETAS_VDC_Values.APPS1_Value_calibrate "" VALUE 0x0 STANDARD_VALUE_R64 0.0 LINEAR_FUNCTION_M1_T0_U17 0 1 MAX_REFRESH 6 1 /end CHARACTERISTIC
/begin CHARACTERISTIC ES900.ES910.CAN2.CAN2.AP_ETAS_BrakeLight.BrakeLight_Control_calibrate "" VALUE 0x0 STANDARD_VALUE_R64 0.0 LINEAR_FUNCTION_M1_T0_U2 0 1 MAX_REFRESH 6 1 /end CHARACTERISTIC
/begin CHARACTERISTIC ES900.ES910.CAN2.CAN2.MEAS_ETAS_Inverter_R_Data.Inv_R_TempMotor_calibrate "" VALUE 0x0 STANDARD_VALUE_R64 0.0 LINEAR_FUNCTION_M1_T0_U5 -327.68 327.67 MAX_REFRESH 6 1 /end CHARACTERISTIC
/begin CHARACTERISTIC ES900.ES910.CAN2.CAN2.MEAS_ETAS_Inverter_R_Data.current_R_calibrate "" VALUE 0x0 STANDARD_VALUE_R64 0.0 LINEAR_FUNCTION_M1_T0_U3 -327.68 327.67 MAX_REFRESH 6 1 /end CHARACTERISTIC
/begin CHARACTERISTIC ES900.ES910.CAN2.CAN2.MEAS_ETAS_Inverter_R_Data.Inv_R_TempIGBT_calibrate "" VALUE 0x0 STANDARD_VALUE_R64 0.0 LINEAR_FUNCTION_M1_T0_U5 -327.68 327.67 MAX_REFRESH 6 1 /end CHARACTERISTIC
/begin CHARACTERISTIC ES900.ES910.CAN2.CAN2.MEAS_ETAS_Inverter_R_Data.RR_Vel_ms_Wheel_calibrate "" VALUE 0x0 STANDARD_VALUE_R64 0.0 LINEAR_FUNCTION_M1_T0_U16 -327.68 327.67 MAX_REFRESH 6 1 /end CHARACTERISTIC
/begin CHARACTERISTIC ES900.ES910.CAN2.CAN2.MEAS_ETAS_Inverter_L_Data.Inv_L_TempMotor_calibrate "" VALUE 0x0 STANDARD_VALUE_R64 0.0 LINEAR_FUNCTION_M1_T0_U5 -327.68 327.67 MAX_REFRESH 6 1 /end CHARACTERISTIC
/begin CHARACTERISTIC ES900.ES910.CAN2.CAN2.MEAS_ETAS_Inverter_L_Data.current_L_calibrate "" VALUE 0x0 STANDARD_VALUE_R64 0.0 LINEAR_FUNCTION_M1_T0_U3 -327.68 327.67 MAX_REFRESH 6 1 /end CHARACTERISTIC
/begin CHARACTERISTIC ES900.ES910.CAN2.CAN2.MEAS_ETAS_Inverter_L_Data.Inv_L_TempIGBT_calibrate "" VALUE 0x0 STANDARD_VALUE_R64 0.0 LINEAR_FUNCTION_M1_T0_U5 -327.68 327.67 MAX_REFRESH 6 1 /end CHARACTERISTIC
/begin CHARACTERISTIC ES900.ES910.CAN2.CAN2.MEAS_ETAS_Inverter_L_Data.RL_Vel_ms_Wheel_calibrate "" VALUE 0x0 STANDARD_VALUE_R64 0.0 LINEAR_FUNCTION_M1_T0_U16 -327.68 327.67 MAX_REFRESH 6 1 /end CHARACTERISTIC
/begin CHARACTERISTIC ES900.ES910.CAN2.CAN2.MEAS_ETAS_VDC_Suspe.SUSP_R_R_calibrate "" VALUE 0x0 STANDARD_VALUE_R64 0.0 LINEAR_FUNCTION_M1_T0_U22 -327.68 327.67 MAX_REFRESH 6 1 /end CHARACTERISTIC
/begin CHARACTERISTIC ES900.ES910.CAN2.CAN2.MEAS_ETAS_VDC_Suspe.SUSP_R_L_calibrate "" VALUE 0x0 STANDARD_VALUE_R64 0.0 LINEAR_FUNCTION_M1_T0_U22 -327.68 327.67 MAX_REFRESH 6 1 /end CHARACTERISTIC
/begin CHARACTERISTIC ES900.ES910.CAN2.CAN2.MEAS_ETAS_VDC_Suspe.SUSP_F_R_calibrate "" VALUE 0x0 STANDARD_VALUE_R64 0.0 LINEAR_FUNCTION_M1_T0_U22 -327.68 327.67 MAX_REFRESH 6 1 /end CHARACTERISTIC
/begin CHARACTERISTIC ES900.ES910.CAN2.CAN2.MEAS_ETAS_VDC_Suspe.SUSP_F_L_calibrate "" VALUE 0x0 STANDARD_VALUE_R64 0.0 LINEAR_FUNCTION_M1_T0_U22 -327.68 327.67 MAX_REFRESH 6 1 /end CHARACTERISTIC
/begin CHARACTERISTIC ES900.ES910.CAN2.CAN2.MEAS_ETAS_VDC_Tq.Throttle_Torque_calibrate "" VALUE 0x0 STANDARD_VALUE_R64 0.0 LINEAR_FUNCTION_M1_T0_U23 0 655.35 MAX_REFRESH 6 1 /end CHARACTERISTIC
/begin CHARACTERISTIC ES900.ES910.CAN2.CAN2.MEAS_ETAS_VDC_Tq.Torque_R_calibrate "" VALUE 0x0 STANDARD_VALUE_R64 0.0 LINEAR_FUNCTION_M1_T0_U23 -327.68 327.67 MAX_REFRESH 6 1 /end CHARACTERISTIC
/begin CHARACTERISTIC ES900.ES910.CAN2.CAN2.MEAS_ETAS_VDC_Tq.Torque_L_calibrate "" VALUE 0x0 STANDARD_VALUE_R64 0.0 LINEAR_FUNCTION_M1_T0_U23 -327.68 327.67 MAX_REFRESH 6 1 /end CHARACTERISTIC
/begin CHARACTERISTIC ES900.ES910.CAN2.CAN2.AP_ETAS_Synchronism.Sync_CAN2_calibrate "" VALUE 0x0 STANDARD_VALUE_R64 0.0 LINEAR_FUNCTION_M1_T0_U1 0 255 MAX_REFRESH 6 1 /end CHARACTERISTIC
/begin COMPU_METHOD LINEAR_FUNCTION_M1_T0_U1 "" RAT_FUNC "%8.4" "" COEFFS 0 1 0 0 0 1 /end COMPU_METHOD
/begin COMPU_METHOD LINEAR_FUNCTION_M1_T0_U2 "" RAT_FUNC "%8.4" "Bit" COEFFS 0 1 0 0 0 1 /end COMPU_METHOD
/begin COMPU_METHOD LINEAR_FUNCTION_M1_T0_U3 "" RAT_FUNC "%8.4" "A" COEFFS 0 1 0 0 0 1 /end COMPU_METHOD
/begin COMPU_METHOD LINEAR_FUNCTION_M1_T0_U4 "" RAT_FUNC "%8.4" "V" COEFFS 0 1 0 0 0 1 /end COMPU_METHOD
/begin COMPU_METHOD LINEAR_FUNCTION_M1_T0_U5 "" RAT_FUNC "%8.4" "ºC" COEFFS 0 1 0 0 0 1 /end COMPU_METHOD
/begin COMPU_METHOD LINEAR_FUNCTION_M1_T0_U6 "" RAT_FUNC "%8.4" "-" COEFFS 0 1 0 0 0 1 /end COMPU_METHOD
/begin COMPU_METHOD LINEAR_FUNCTION_M1_T0_U7 "" RAT_FUNC "%8.4" "Bits" COEFFS 0 1 0 0 0 1 /end COMPU_METHOD
/begin COMPU_METHOD LINEAR_FUNCTION_M1_T0_U8 "" RAT_FUNC "%8.4" "RPM" COEFFS 0 1 0 0 0 1 /end COMPU_METHOD
/begin COMPU_METHOD LINEAR_FUNCTION_M1_T0_U9 "" RAT_FUNC "%8.4" "%" COEFFS 0 1 0 0 0 1 /end COMPU_METHOD
/begin COMPU_METHOD LINEAR_FUNCTION_M1_T0_U10 "" RAT_FUNC "%8.4" "km/h" COEFFS 0 1 0 0 0 1 /end COMPU_METHOD
/begin COMPU_METHOD LINEAR_FUNCTION_M1_T0_U11 "" RAT_FUNC "%8.4" "100%" COEFFS 0 1 0 0 0 1 /end COMPU_METHOD
/begin COMPU_METHOD LINEAR_FUNCTION_M1_T0_U12 "" RAT_FUNC "%8.4" "kW" COEFFS 0 1 0 0 0 1 /end COMPU_METHOD
/begin COMPU_METHOD LINEAR_FUNCTION_M1_T0_U13 "" RAT_FUNC "%8.4" "º" COEFFS 0 1 0 0 0 1 /end COMPU_METHOD
/begin COMPU_METHOD LINEAR_FUNCTION_M1_T0_U14 "" RAT_FUNC "%8.4" "m" COEFFS 0 1 0 0 0 1 /end COMPU_METHOD
/begin COMPU_METHOD LINEAR_FUNCTION_M1_T0_U15 "" RAT_FUNC "%8.4" "m.s-1" COEFFS 0 1 0 0 0 1 /end COMPU_METHOD
/begin COMPU_METHOD LINEAR_FUNCTION_M1_T0_U16 "" RAT_FUNC "%8.4" "m/s" COEFFS 0 1 0 0 0 1 /end COMPU_METHOD
/begin COMPU_METHOD LINEAR_FUNCTION_M1_T0_U17 "" RAT_FUNC "%8.4" "1%" COEFFS 0 1 0 0 0 1 /end COMPU_METHOD
/begin COMPU_METHOD LINEAR_FUNCTION_M1_T0_U18 "" RAT_FUNC "%8.4" "°" COEFFS 0 1 0 0 0 1 /end COMPU_METHOD
/begin COMPU_METHOD LINEAR_FUNCTION_M1_T0_U19 "" RAT_FUNC "%8.4" "m.s-2" COEFFS 0 1 0 0 0 1 /end COMPU_METHOD
/begin COMPU_METHOD LINEAR_FUNCTION_M1_T0_U20 "" RAT_FUNC "%8.4" "s" COEFFS 0 1 0 0 0 1 /end COMPU_METHOD
/begin COMPU_METHOD LINEAR_FUNCTION_M1_T0_U21 "" RAT_FUNC "%8.4" "º.s-1" COEFFS 0 1 0 0 0 1 /end COMPU_METHOD
/begin COMPU_METHOD LINEAR_FUNCTION_M1_T0_U22 "" RAT_FUNC "%8.4" "N" COEFFS 0 1 0 0 0 1 /end COMPU_METHOD
/begin COMPU_METHOD LINEAR_FUNCTION_M1_T0_U23 "" RAT_FUNC "%8.4" "Nm" COEFFS 0 1 0 0 0 1 /end COMPU_METHOD
/begin RECORD_LAYOUT STANDARD_VALUE_R64 FNC_VALUES 1 FLOAT64_IEEE COLUMN_DIR DIRECT /end RECORD_LAYOUT
/end MODULE
/end PROJECT
/* EOF signals.a2l */
