ASAP2_VERSION
/begin PROJECT "Generated by ETAS from INTECRIO integration project"
/begin HEADER "" VERSION "" PROJECT_NO Y /end HEADER
/begin MODULE Inverters_Action "Generated by ETAS from INTECRIO integration project"
/begin MOD_PAR "" VERSION "" ADDR_EPK 0x0 EPK "" SUPPLIER "ETAS GmbH" CUSTOMER "" CUSTOMER_NO "" USER "" PHONE_NO "" ECU "NO_ECU" CPU_TYPE "MPC750" NO_OF_INTERFACES 1 /end MOD_PAR
/begin MOD_COMMON "Common definitions" BYTE_ORDER MSB_FIRST ALIGNMENT_BYTE 1 ALIGNMENT_WORD 2 ALIGNMENT_LONG 4 ALIGNMENT_FLOAT32_IEEE 4 ALIGNMENT_FLOAT64_IEEE 8 /end MOD_COMMON
/begin MEASUREMENT Inverters_Action_B.Merge "" UBYTE Inverters_Action_CM_boolean 0 0 0 1 ECU_ADDRESS 0x0 DISPLAY_IDENTIFIER Inverters_Action.Merge.Merge /end MEASUREMENT
/begin COMPU_METHOD Inverters_Action_CM_boolean "Q = V" RAT_FUNC "%9.6" "NO_PHYSICAL_QTY" COEFFS 0.0 1.0 0.0 0.0 0.0 1.0 /end COMPU_METHOD
/begin MEASUREMENT Inverters_Action_B.Merge2 "" UBYTE Inverters_Action_CM_uint8 0 0 0.0 255.0 ECU_ADDRESS 0x0 DISPLAY_IDENTIFIER Inverters_Action.Subsystem9.Merge2.Merge2 /end MEASUREMENT
/begin COMPU_METHOD Inverters_Action_CM_uint8 "Q = V" RAT_FUNC "%9.6" "NO_PHYSICAL_QTY" COEFFS 0.0 1.0 0.0 0.0 0.0 1.0 /end COMPU_METHOD
/begin MEASUREMENT Inverters_Action_B.Merge2_p "" UBYTE Inverters_Action_CM_uint8 0 0 0.0 255.0 ECU_ADDRESS 0x0 DISPLAY_IDENTIFIER Inverters_Action.Subsystem10.Merge2.Merge2_p /end MEASUREMENT
/begin MEASUREMENT Inverters_Action_B.subscribed "" UBYTE Inverters_Action_CM_boolean 0 0 0 1 ECU_ADDRESS 0x0 DISPLAY_IDENTIFIER Inverters_Action.Subsystem9.Unsubscribe__Subscribe.subscribed_.subscribed /end MEASUREMENT
/begin MEASUREMENT Inverters_Action_B.subscribed_b "" UBYTE Inverters_Action_CM_boolean 0 0 0 1 ECU_ADDRESS 0x0 DISPLAY_IDENTIFIER Inverters_Action.Subsystem10.Unsubscribe__Subscribe.subscribed_.subscribed_b /end MEASUREMENT
/begin MEASUREMENT Inverters_Action_DW.EnumerationCounter "" FLOAT64_IEEE Inverters_Action_CM_double 0 0 -1.7e+308 1.7e+308 ECU_ADDRESS 0x0 DISPLAY_IDENTIFIER Inverters_Action.Subsystem10.Data_Store_Memory2.EnumerationCounter /end MEASUREMENT
/begin COMPU_METHOD Inverters_Action_CM_double "Q = V" RAT_FUNC "%9.6" "NO_PHYSICAL_QTY" COEFFS 0.0 1.0 0.0 0.0 0.0 1.0 /end COMPU_METHOD
/begin MEASUREMENT Inverters_Action_DW.EnumerationCounter_m "" FLOAT64_IEEE Inverters_Action_CM_double 0 0 -1.7e+308 1.7e+308 ECU_ADDRESS 0x0 DISPLAY_IDENTIFIER Inverters_Action.Subsystem9.Data_Store_Memory2.EnumerationCounter_m /end MEASUREMENT
/begin MEASUREMENT Inverters_Action_DW.LastAction "" FLOAT64_IEEE Inverters_Action_CM_double 0 0 -1.7e+308 1.7e+308 ECU_ADDRESS 0x0 DISPLAY_IDENTIFIER Inverters_Action.Subsystem10.Data_Store_Memory1.LastAction /end MEASUREMENT
/begin MEASUREMENT Inverters_Action_DW.LastAction_k "" FLOAT64_IEEE Inverters_Action_CM_double 0 0 -1.7e+308 1.7e+308 ECU_ADDRESS 0x0 DISPLAY_IDENTIFIER Inverters_Action.Subsystem9.Data_Store_Memory1.LastAction_k /end MEASUREMENT
/begin CHARACTERISTIC Inverters_Action_P.Constant_Value "" VALUE 0x0 SCALAR_UBYTE 255.0 Inverters_Action_CM_uint8 0.0 255.0 DISPLAY_IDENTIFIER Inverters_Action.Subsystem10.Unsubscribe__Subscribe.Constant.Value /end CHARACTERISTIC
/begin RECORD_LAYOUT SCALAR_UBYTE FNC_VALUES 1 UBYTE COLUMN_DIR DIRECT /end RECORD_LAYOUT
/begin CHARACTERISTIC Inverters_Action_P.Constant_Value_m "" VALUE 0x0 SCALAR_UBYTE 255.0 Inverters_Action_CM_uint8 0.0 255.0 DISPLAY_IDENTIFIER Inverters_Action.Subsystem9.Unsubscribe__Subscribe.Constant.Value /end CHARACTERISTIC
/begin CHARACTERISTIC Inverters_Action_P.DataStoreMemory1_InitialValue "" VALUE 0x0 SCALAR_FLOAT64_IEEE 3.5e+305 Inverters_Action_CM_double -1.7e+308 1.7e+308 DISPLAY_IDENTIFIER Inverters_Action.Subsystem10.Data_Store_Memory1.InitialValue /end CHARACTERISTIC
/begin RECORD_LAYOUT SCALAR_FLOAT64_IEEE FNC_VALUES 1 FLOAT64_IEEE COLUMN_DIR DIRECT /end RECORD_LAYOUT
/begin CHARACTERISTIC Inverters_Action_P.DataStoreMemory1_InitialValue_m "" VALUE 0x0 SCALAR_FLOAT64_IEEE 3.5e+305 Inverters_Action_CM_double -1.7e+308 1.7e+308 DISPLAY_IDENTIFIER Inverters_Action.Subsystem9.Data_Store_Memory1.InitialValue /end CHARACTERISTIC
/begin CHARACTERISTIC Inverters_Action_P.DataStoreMemory2_InitialValue "" VALUE 0x0 SCALAR_FLOAT64_IEEE 3.5e+305 Inverters_Action_CM_double -1.7e+308 1.7e+308 DISPLAY_IDENTIFIER Inverters_Action.Subsystem10.Data_Store_Memory2.InitialValue /end CHARACTERISTIC
/begin CHARACTERISTIC Inverters_Action_P.DataStoreMemory2_InitialValue_c "" VALUE 0x0 SCALAR_FLOAT64_IEEE 3.5e+305 Inverters_Action_CM_double -1.7e+308 1.7e+308 DISPLAY_IDENTIFIER Inverters_Action.Subsystem9.Data_Store_Memory2.InitialValue /end CHARACTERISTIC
/begin CHARACTERISTIC Inverters_Action_P.Delay_DelayLength "" VALUE 0x0 SCALAR_ULONG 4294967295.0 Inverters_Action_CM_uint32 0.0 4294967295.0 DISPLAY_IDENTIFIER Inverters_Action.Subsystem10.edge_detection.Delay.DelayLength /end CHARACTERISTIC
/begin RECORD_LAYOUT SCALAR_ULONG FNC_VALUES 1 ULONG COLUMN_DIR DIRECT /end RECORD_LAYOUT
/begin COMPU_METHOD Inverters_Action_CM_uint32 "Q = V" RAT_FUNC "%9.6" "NO_PHYSICAL_QTY" COEFFS 0.0 1.0 0.0 0.0 0.0 1.0 /end COMPU_METHOD
/begin CHARACTERISTIC Inverters_Action_P.Delay_DelayLength_h "" VALUE 0x0 SCALAR_ULONG 4294967295.0 Inverters_Action_CM_uint32 0.0 4294967295.0 DISPLAY_IDENTIFIER Inverters_Action.Subsystem9.edge_detection.Delay.DelayLength /end CHARACTERISTIC
/begin CHARACTERISTIC Inverters_Action_P.Delay_InitialCondition "" VALUE 0x0 SCALAR_FLOAT64_IEEE 3.5e+305 Inverters_Action_CM_double -1.7e+308 1.7e+308 DISPLAY_IDENTIFIER Inverters_Action.Subsystem10.edge_detection.Delay.InitialCondition /end CHARACTERISTIC
/begin CHARACTERISTIC Inverters_Action_P.Delay_InitialCondition_o "" VALUE 0x0 SCALAR_FLOAT64_IEEE 3.5e+305 Inverters_Action_CM_double -1.7e+308 1.7e+308 DISPLAY_IDENTIFIER Inverters_Action.Subsystem9.edge_detection.Delay.InitialCondition /end CHARACTERISTIC
/begin CHARACTERISTIC Inverters_Action_P.Merge_InitialOutput "" VALUE 0x0 SCALAR_UBYTE 1.0 Inverters_Action_CM_boolean 0 1 DISPLAY_IDENTIFIER Inverters_Action.Merge.InitialOutput /end CHARACTERISTIC
/begin CHARACTERISTIC Inverters_Action_P.TimeInterval_Value "" VALUE 0x0 SCALAR_UBYTE 255.0 Inverters_Action_CM_uint8 0.0 255.0 DISPLAY_IDENTIFIER Inverters_Action.Subsystem10.Unsubscribe__Subscribe.Subscribe.Time_Interval.Value /end CHARACTERISTIC
/begin CHARACTERISTIC Inverters_Action_P.TimeInterval_Value_d "" VALUE 0x0 SCALAR_UBYTE 255.0 Inverters_Action_CM_uint8 0.0 255.0 DISPLAY_IDENTIFIER Inverters_Action.Subsystem9.Unsubscribe__Subscribe.Subscribe.Time_Interval.Value /end CHARACTERISTIC
/begin CHARACTERISTIC Inverters_Action_P._Value "" VALUE 0x0 SCALAR_UBYTE 1.0 Inverters_Action_CM_boolean 0 1 DISPLAY_IDENTIFIER Inverters_Action.Subsystem10.Unsubscribe__Subscribe.Subscribe._.Value /end CHARACTERISTIC
/begin CHARACTERISTIC Inverters_Action_P.subscribed_InitialOutput "" VALUE 0x0 SCALAR_UBYTE 1.0 Inverters_Action_CM_boolean 0 1 DISPLAY_IDENTIFIER Inverters_Action.Subsystem10.Unsubscribe__Subscribe.subscribed_.InitialOutput /end CHARACTERISTIC
/begin CHARACTERISTIC Inverters_Action_P.subscribed_InitialOutput_k "" VALUE 0x0 SCALAR_UBYTE 1.0 Inverters_Action_CM_boolean 0 1 DISPLAY_IDENTIFIER Inverters_Action.Subsystem9.Unsubscribe__Subscribe.subscribed_.InitialOutput /end CHARACTERISTIC
/begin CHARACTERISTIC Inverters_Action_P.u_Value "" VALUE 0x0 SCALAR_UBYTE 1.0 Inverters_Action_CM_boolean 0 1 DISPLAY_IDENTIFIER Inverters_Action.Subsystem9.Unsubscribe__Subscribe.Subscribe.1.Value /end CHARACTERISTIC
/begin MEASUREMENT Inverters_Action_U.InvertersAction "" FLOAT64_IEEE Inverters_Action_CM_double 0 0 -1.7e+308 1.7e+308 ECU_ADDRESS 0x0 DISPLAY_IDENTIFIER Inverters_Action.InvertersAction /end MEASUREMENT
/begin MEASUREMENT Inverters_Action_U.current_L "" FLOAT64_IEEE Inverters_Action_CM_double 0 0 -1.7e+308 1.7e+308 ECU_ADDRESS 0x0 DISPLAY_IDENTIFIER Inverters_Action.current_L /end MEASUREMENT
/begin MEASUREMENT Inverters_Action_U.current_R "" FLOAT64_IEEE Inverters_Action_CM_double 0 0 -1.7e+308 1.7e+308 ECU_ADDRESS 0x0 DISPLAY_IDENTIFIER Inverters_Action.current_R /end MEASUREMENT
/begin MEASUREMENT Inverters_Action_Y.Inverter_L_RegID "" UBYTE Inverters_Action_CM_uint8 0 0 0.0 255.0 ECU_ADDRESS 0x0 DISPLAY_IDENTIFIER Inverters_Action.Inverter_L_RegID /end MEASUREMENT
/begin MEASUREMENT Inverters_Action_Y.Inverter_L_b15tob8 "" UBYTE Inverters_Action_CM_uint8 0 0 0.0 255.0 ECU_ADDRESS 0x0 DISPLAY_IDENTIFIER Inverters_Action.Inverter_L_b15tob8 /end MEASUREMENT
/begin MEASUREMENT Inverters_Action_Y.Inverter_L_b7tob0 "" UBYTE Inverters_Action_CM_uint8 0 0 0.0 255.0 ECU_ADDRESS 0x0 DISPLAY_IDENTIFIER Inverters_Action.Inverter_L_b7tob0 /end MEASUREMENT
/begin MEASUREMENT Inverters_Action_Y.Inverter_R_RegID "" UBYTE Inverters_Action_CM_uint8 0 0 0.0 255.0 ECU_ADDRESS 0x0 DISPLAY_IDENTIFIER Inverters_Action.Inverter_R_RegID /end MEASUREMENT
/begin MEASUREMENT Inverters_Action_Y.Inverter_R_b15tob8 "" UBYTE Inverters_Action_CM_uint8 0 0 0.0 255.0 ECU_ADDRESS 0x0 DISPLAY_IDENTIFIER Inverters_Action.Inverter_R_b15tob8 /end MEASUREMENT
/begin MEASUREMENT Inverters_Action_Y.Inverter_R_b7tob0 "" UBYTE Inverters_Action_CM_uint8 0 0 0.0 255.0 ECU_ADDRESS 0x0 DISPLAY_IDENTIFIER Inverters_Action.Inverter_R_b7tob0 /end MEASUREMENT
/begin MEASUREMENT Inverters_Action_Y.InvertersSubscribed "" UBYTE Inverters_Action_CM_boolean 0 0 0 1 ECU_ADDRESS 0x0 DISPLAY_IDENTIFIER Inverters_Action.InvertersSubscribed /end MEASUREMENT
/end MODULE
/* Inverters_Action */
/end PROJECT
