ASAP2_VERSION
/begin PROJECT "Generated by ETAS from INTECRIO integration project"
/begin HEADER "" VERSION "" PROJECT_NO Y /end HEADER
/begin MODULE Inverters_Action "Generated by ETAS from INTECRIO integration project"
/begin MOD_PAR "" VERSION "" ADDR_EPK 0x0 EPK "" SUPPLIER "ETAS GmbH" CUSTOMER "" CUSTOMER_NO "" USER "" PHONE_NO "" ECU "NO_ECU" CPU_TYPE "MPC750" NO_OF_INTERFACES 1 /end MOD_PAR
/begin MOD_COMMON "Common definitions" BYTE_ORDER MSB_FIRST ALIGNMENT_BYTE 1 ALIGNMENT_WORD 2 ALIGNMENT_LONG 4 ALIGNMENT_FLOAT32_IEEE 4 ALIGNMENT_FLOAT64_IEEE 8 /end MOD_COMMON
/begin MEASUREMENT Inverters_Action_B.Merge "" UBYTE Inverters_Action_CM_boolean 0 0 0 1 ECU_ADDRESS 0x0 DISPLAY_IDENTIFIER Inverters_Action.Merge.Merge /end MEASUREMENT
/begin COMPU_METHOD Inverters_Action_CM_boolean "Q = V" RAT_FUNC "%9.6" "NO_PHYSICAL_QTY" COEFFS 0.0 1.0 0.0 0.0 0.0 1.0 /end COMPU_METHOD
/begin MEASUREMENT Inverters_Action_B.Merge2 "" UBYTE Inverters_Action_CM_uint8 0 0 0.0 255.0 ECU_ADDRESS 0x0 DISPLAY_IDENTIFIER Inverters_Action.Blost_e_Left.Merge2.Merge2 /end MEASUREMENT
/begin COMPU_METHOD Inverters_Action_CM_uint8 "Q = V" RAT_FUNC "%9.6" "NO_PHYSICAL_QTY" COEFFS 0.0 1.0 0.0 0.0 0.0 1.0 /end COMPU_METHOD
/begin MEASUREMENT Inverters_Action_B.Merge2_p "" UBYTE Inverters_Action_CM_uint8 0 0 0.0 255.0 ECU_ADDRESS 0x0 DISPLAY_IDENTIFIER Inverters_Action.Blost_e_Right.Merge2.Merge2_p /end MEASUREMENT
/begin MEASUREMENT Inverters_Action_B.NOR "" UBYTE Inverters_Action_CM_boolean 0 0 0 1 ECU_ADDRESS 0x0 DISPLAY_IDENTIFIER Inverters_Action.Forced_Forward_Direction_accel.NOR.NOR /end MEASUREMENT
/begin MEASUREMENT Inverters_Action_B.subscribed "" UBYTE Inverters_Action_CM_boolean 0 0 0 1 ECU_ADDRESS 0x0 DISPLAY_IDENTIFIER Inverters_Action.Blost_e_Right.Unsubscribe__Subscribe.subscribed_.subscribed /end MEASUREMENT
/begin MEASUREMENT Inverters_Action_B.subscribed_k "" UBYTE Inverters_Action_CM_boolean 0 0 0 1 ECU_ADDRESS 0x0 DISPLAY_IDENTIFIER Inverters_Action.Blost_e_Left.Unsubscribe__Subscribe.subscribed_.subscribed_k /end MEASUREMENT
/begin MEASUREMENT Inverters_Action_ConstB.TorqueCommand.Divide "" FLOAT64_IEEE Inverters_Action_CM_double 0 0 -1.7e+308 1.7e+308 ECU_ADDRESS 0x0 DISPLAY_IDENTIFIER Inverters_Action.Blost_e_Left.Torque_Command.Divide.Divide /end MEASUREMENT
/begin COMPU_METHOD Inverters_Action_CM_double "Q = V" RAT_FUNC "%9.6" "NO_PHYSICAL_QTY" COEFFS 0.0 1.0 0.0 0.0 0.0 1.0 /end COMPU_METHOD
/begin MEASUREMENT Inverters_Action_ConstB.TorqueCommand0.BitwiseOperator1 "" UWORD Inverters_Action_CM_uint16 0 0 0.0 65535.0 ECU_ADDRESS 0x0 DISPLAY_IDENTIFIER Inverters_Action.Blost_e_Left.Torque_Command_0.Subsystem.Bitwise_Operator1.BitwiseOperator1 /end MEASUREMENT
/begin COMPU_METHOD Inverters_Action_CM_uint16 "Q = V" RAT_FUNC "%9.6" "NO_PHYSICAL_QTY" COEFFS 0.0 1.0 0.0 0.0 0.0 1.0 /end COMPU_METHOD
/begin MEASUREMENT Inverters_Action_ConstB.TorqueCommand0.Current0to65535 "" UWORD Inverters_Action_CM_uint16 0 0 0.0 65535.0 ECU_ADDRESS 0x0 DISPLAY_IDENTIFIER Inverters_Action.Blost_e_Left.Torque_Command_0.Product.Current_0_to_65535 /end MEASUREMENT
/begin MEASUREMENT Inverters_Action_ConstB.TorqueCommand0.Divide "" FLOAT64_IEEE Inverters_Action_CM_double 0 0 -1.7e+308 1.7e+308 ECU_ADDRESS 0x0 DISPLAY_IDENTIFIER Inverters_Action.Blost_e_Left.Torque_Command_0.Divide.Divide /end MEASUREMENT
/begin MEASUREMENT Inverters_Action_ConstB.TorqueCommand0.ShiftArithmetic "" UWORD Inverters_Action_CM_uint16 0 0 0.0 65535.0 ECU_ADDRESS 0x0 DISPLAY_IDENTIFIER Inverters_Action.Blost_e_Left.Torque_Command_0.Subsystem.Shift_Arithmetic.ShiftArithmetic /end MEASUREMENT
/begin MEASUREMENT Inverters_Action_ConstB.TorqueCommand0.b7tob0 "" UWORD Inverters_Action_CM_uint16 0 0 0.0 65535.0 ECU_ADDRESS 0x0 DISPLAY_IDENTIFIER Inverters_Action.Blost_e_Left.Torque_Command_0.Subsystem.Bitwise_Operator.b7_to_b0 /end MEASUREMENT
/begin MEASUREMENT Inverters_Action_ConstB.TorqueCommand0_a.BitwiseOperator1 "" UWORD Inverters_Action_CM_uint16 0 0 0.0 65535.0 ECU_ADDRESS 0x0 DISPLAY_IDENTIFIER Inverters_Action.Blost_e_Right.Torque_Command_0.Subsystem.Bitwise_Operator1.BitwiseOperator1 /end MEASUREMENT
/begin MEASUREMENT Inverters_Action_ConstB.TorqueCommand0_a.Current0to65535 "" UWORD Inverters_Action_CM_uint16 0 0 0.0 65535.0 ECU_ADDRESS 0x0 DISPLAY_IDENTIFIER Inverters_Action.Blost_e_Right.Torque_Command_0.Product.Current_0_to_65535 /end MEASUREMENT
/begin MEASUREMENT Inverters_Action_ConstB.TorqueCommand0_a.Divide "" FLOAT64_IEEE Inverters_Action_CM_double 0 0 -1.7e+308 1.7e+308 ECU_ADDRESS 0x0 DISPLAY_IDENTIFIER Inverters_Action.Blost_e_Right.Torque_Command_0.Divide.Divide /end MEASUREMENT
/begin MEASUREMENT Inverters_Action_ConstB.TorqueCommand0_a.ShiftArithmetic "" UWORD Inverters_Action_CM_uint16 0 0 0.0 65535.0 ECU_ADDRESS 0x0 DISPLAY_IDENTIFIER Inverters_Action.Blost_e_Right.Torque_Command_0.Subsystem.Shift_Arithmetic.ShiftArithmetic /end MEASUREMENT
/begin MEASUREMENT Inverters_Action_ConstB.TorqueCommand0_a.b7tob0 "" UWORD Inverters_Action_CM_uint16 0 0 0.0 65535.0 ECU_ADDRESS 0x0 DISPLAY_IDENTIFIER Inverters_Action.Blost_e_Right.Torque_Command_0.Subsystem.Bitwise_Operator.b7_to_b0 /end MEASUREMENT
/begin MEASUREMENT Inverters_Action_ConstB.TorqueCommand_k.Divide "" FLOAT64_IEEE Inverters_Action_CM_double 0 0 -1.7e+308 1.7e+308 ECU_ADDRESS 0x0 DISPLAY_IDENTIFIER Inverters_Action.Blost_e_Right.Torque_Command.Divide.Divide /end MEASUREMENT
/begin MEASUREMENT Inverters_Action_DW.EnumerationCounter "" FLOAT64_IEEE Inverters_Action_CM_double 0 0 -1.7e+308 1.7e+308 ECU_ADDRESS 0x0 DISPLAY_IDENTIFIER Inverters_Action.Blost_e_Left.Data_Store_Memory2.EnumerationCounter /end MEASUREMENT
/begin MEASUREMENT Inverters_Action_DW.EnumerationCounter_g "" FLOAT64_IEEE Inverters_Action_CM_double 0 0 -1.7e+308 1.7e+308 ECU_ADDRESS 0x0 DISPLAY_IDENTIFIER Inverters_Action.Blost_e_Right.Data_Store_Memory2.EnumerationCounter_g /end MEASUREMENT
/begin MEASUREMENT Inverters_Action_DW.LastAction "" FLOAT64_IEEE Inverters_Action_CM_double 0 0 -1.7e+308 1.7e+308 ECU_ADDRESS 0x0 DISPLAY_IDENTIFIER Inverters_Action.Blost_e_Left.Data_Store_Memory1.LastAction /end MEASUREMENT
/begin MEASUREMENT Inverters_Action_DW.LastAction_l "" FLOAT64_IEEE Inverters_Action_CM_double 0 0 -1.7e+308 1.7e+308 ECU_ADDRESS 0x0 DISPLAY_IDENTIFIER Inverters_Action.Blost_e_Right.Data_Store_Memory1.LastAction_l /end MEASUREMENT
/begin MEASUREMENT Inverters_Action_U.Car_State "" FLOAT64_IEEE Inverters_Action_CM_double 0 0 -1.7e+308 1.7e+308 ECU_ADDRESS 0x0 DISPLAY_IDENTIFIER Inverters_Action.Car_State /end MEASUREMENT
/begin MEASUREMENT Inverters_Action_U.InvertersAction "" FLOAT64_IEEE Inverters_Action_CM_double 0 0 -1.7e+308 1.7e+308 ECU_ADDRESS 0x0 DISPLAY_IDENTIFIER Inverters_Action.InvertersAction /end MEASUREMENT
/begin MEASUREMENT Inverters_Action_U.RL_rads_Motor "" FLOAT64_IEEE Inverters_Action_CM_double 0 0 -1.7e+308 1.7e+308 ECU_ADDRESS 0x0 DISPLAY_IDENTIFIER Inverters_Action.RL_rads_Motor /end MEASUREMENT
/begin MEASUREMENT Inverters_Action_U.RacingMode "" FLOAT64_IEEE Inverters_Action_CM_double 0 0 -1.7e+308 1.7e+308 ECU_ADDRESS 0x0 DISPLAY_IDENTIFIER Inverters_Action.RacingMode /end MEASUREMENT
/begin MEASUREMENT Inverters_Action_U.current_L "" FLOAT64_IEEE Inverters_Action_CM_double 0 0 -1.7e+308 1.7e+308 ECU_ADDRESS 0x0 DISPLAY_IDENTIFIER Inverters_Action.current_L /end MEASUREMENT
/begin MEASUREMENT Inverters_Action_U.current_R "" FLOAT64_IEEE Inverters_Action_CM_double 0 0 -1.7e+308 1.7e+308 ECU_ADDRESS 0x0 DISPLAY_IDENTIFIER Inverters_Action.current_R /end MEASUREMENT
/begin MEASUREMENT Inverters_Action_Y.Inverter_L_RegID "" UBYTE Inverters_Action_CM_uint8 0 0 0.0 255.0 ECU_ADDRESS 0x0 DISPLAY_IDENTIFIER Inverters_Action.Inverter_L_RegID /end MEASUREMENT
/begin MEASUREMENT Inverters_Action_Y.Inverter_L_b15tob8 "" UBYTE Inverters_Action_CM_uint8 0 0 0.0 255.0 ECU_ADDRESS 0x0 DISPLAY_IDENTIFIER Inverters_Action.Inverter_L_b15tob8 /end MEASUREMENT
/begin MEASUREMENT Inverters_Action_Y.Inverter_L_b7tob0 "" UBYTE Inverters_Action_CM_uint8 0 0 0.0 255.0 ECU_ADDRESS 0x0 DISPLAY_IDENTIFIER Inverters_Action.Inverter_L_b7tob0 /end MEASUREMENT
/begin MEASUREMENT Inverters_Action_Y.Inverter_R_RegID "" UBYTE Inverters_Action_CM_uint8 0 0 0.0 255.0 ECU_ADDRESS 0x0 DISPLAY_IDENTIFIER Inverters_Action.Inverter_R_RegID /end MEASUREMENT
/begin MEASUREMENT Inverters_Action_Y.Inverter_R_b15tob8 "" UBYTE Inverters_Action_CM_uint8 0 0 0.0 255.0 ECU_ADDRESS 0x0 DISPLAY_IDENTIFIER Inverters_Action.Inverter_R_b15tob8 /end MEASUREMENT
/begin MEASUREMENT Inverters_Action_Y.Inverter_R_b7tob0 "" UBYTE Inverters_Action_CM_uint8 0 0 0.0 255.0 ECU_ADDRESS 0x0 DISPLAY_IDENTIFIER Inverters_Action.Inverter_R_b7tob0 /end MEASUREMENT
/begin MEASUREMENT Inverters_Action_Y.InvertersSubscribed "" UBYTE Inverters_Action_CM_boolean 0 0 0 1 ECU_ADDRESS 0x0 DISPLAY_IDENTIFIER Inverters_Action.InvertersSubscribed /end MEASUREMENT
/end MODULE
/* Inverters_Action */
/end PROJECT
