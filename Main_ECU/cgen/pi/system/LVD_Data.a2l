ASAP2_VERSION
/begin PROJECT "Generated by ETAS from INTECRIO integration project"
/begin HEADER "" VERSION "" PROJECT_NO Y /end HEADER
/begin MODULE LVD_Data "Generated by ETAS from INTECRIO integration project"
/begin MOD_PAR "" VERSION "" ADDR_EPK 0x0 EPK "" SUPPLIER "ETAS GmbH" CUSTOMER "" CUSTOMER_NO "" USER "" PHONE_NO "" ECU "NO_ECU" CPU_TYPE "MPC750" NO_OF_INTERFACES 1 /end MOD_PAR
/begin MOD_COMMON "Common definitions" BYTE_ORDER MSB_FIRST ALIGNMENT_BYTE 1 ALIGNMENT_WORD 2 ALIGNMENT_LONG 4 ALIGNMENT_FLOAT32_IEEE 4 ALIGNMENT_FLOAT64_IEEE 8 /end MOD_COMMON
/begin MEASUREMENT LVD_Data_DW.Previous_IN "" FLOAT64_IEEE LVD_Data_CM_double 0 0 -1.7e+308 1.7e+308 ECU_ADDRESS 0x0 DISPLAY_IDENTIFIER LVD_Data.Low_Pass.Data_Store_Memory.Previous_IN /end MEASUREMENT
/begin COMPU_METHOD LVD_Data_CM_double "Q = V" /* ConversionType */ RAT_FUNC /* Format */ "%9.6" /* Unit */ "NO_PHYSICAL_QTY" COEFFS 0.0 1.0 0.0 0.0 0.0 1.0 /end COMPU_METHOD
/begin MEASUREMENT LVD_Data_DW.Previous_OUT "" FLOAT64_IEEE LVD_Data_CM_double 0 0 -1.7e+308 1.7e+308 ECU_ADDRESS 0x0 DISPLAY_IDENTIFIER LVD_Data.Low_Pass.Data_Store_Memory1.Previous_OUT /end MEASUREMENT
/begin CHARACTERISTIC LVD_Data_P.DataStoreMemory1_InitialValue "" VALUE 0x0 SCALAR_FLOAT64_IEEE 3.5e+305 LVD_Data_CM_double -1.7e+308 1.7e+308 DISPLAY_IDENTIFIER LVD_Data.Low_Pass.Data_Store_Memory1.InitialValue /end CHARACTERISTIC
/begin RECORD_LAYOUT SCALAR_FLOAT64_IEEE FNC_VALUES 1 FLOAT64_IEEE COLUMN_DIR DIRECT /end RECORD_LAYOUT
/begin CHARACTERISTIC LVD_Data_P.DataStoreMemory_InitialValue "" VALUE 0x0 SCALAR_FLOAT64_IEEE 3.5e+305 LVD_Data_CM_double -1.7e+308 1.7e+308 DISPLAY_IDENTIFIER LVD_Data.Low_Pass.Data_Store_Memory.InitialValue /end CHARACTERISTIC
/begin CHARACTERISTIC LVD_Data_P.MaxBits2_Value "" VALUE 0x0 SCALAR_FLOAT64_IEEE 3.5e+305 LVD_Data_CM_double -1.7e+308 1.7e+308 DISPLAY_IDENTIFIER LVD_Data.MaxBits2.Value /end CHARACTERISTIC
/begin CHARACTERISTIC LVD_Data_P.MaxBits_Value "" VALUE 0x0 SCALAR_FLOAT64_IEEE 3.5e+305 LVD_Data_CM_double -1.7e+308 1.7e+308 DISPLAY_IDENTIFIER LVD_Data.MaxBits.Value /end CHARACTERISTIC
/begin CHARACTERISTIC LVD_Data_P.Vmax_Value "" VALUE 0x0 SCALAR_FLOAT64_IEEE 3.5e+305 LVD_Data_CM_double -1.7e+308 1.7e+308 DISPLAY_IDENTIFIER LVD_Data.Vmax.Value /end CHARACTERISTIC
/begin CHARACTERISTIC LVD_Data_P.Vmin_Value "" VALUE 0x0 SCALAR_FLOAT64_IEEE 3.5e+305 LVD_Data_CM_double -1.7e+308 1.7e+308 DISPLAY_IDENTIFIER LVD_Data.Vmin.Value /end CHARACTERISTIC
/begin CHARACTERISTIC LVD_Data_P.ct_Value "" VALUE 0x0 SCALAR_FLOAT64_IEEE 3.5e+305 LVD_Data_CM_double -1.7e+308 1.7e+308 DISPLAY_IDENTIFIER LVD_Data.Low_Pass.ct.Value /end CHARACTERISTIC
/begin CHARACTERISTIC LVD_Data_P.exptcycletau1_Value "" VALUE 0x0 SCALAR_FLOAT64_IEEE 3.5e+305 LVD_Data_CM_double -1.7e+308 1.7e+308 DISPLAY_IDENTIFIER LVD_Data.Low_Pass.exp__tcycle__tau_1.Value /end CHARACTERISTIC
/begin MEASUREMENT LVD_Data_U.LVBattery_Voltage_Bits "" FLOAT64_IEEE LVD_Data_CM_double 0 0 -1.7e+308 1.7e+308 ECU_ADDRESS 0x0 DISPLAY_IDENTIFIER LVD_Data.LVBattery_Voltage_Bits /end MEASUREMENT
/begin MEASUREMENT LVD_Data_Y.LVbattery_Voltage "" FLOAT64_IEEE LVD_Data_CM_double 0 0 -1.7e+308 1.7e+308 ECU_ADDRESS 0x0 DISPLAY_IDENTIFIER LVD_Data.LVbattery_Voltage /end MEASUREMENT
/end MODULE
/* LVD_Data */
/end PROJECT
