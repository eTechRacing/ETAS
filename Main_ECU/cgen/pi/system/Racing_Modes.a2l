ASAP2_VERSION
/begin PROJECT "Generated by ETAS from INTECRIO integration project"
/begin HEADER "" VERSION "" PROJECT_NO Y /end HEADER
/begin MODULE Racing_Modes "Generated by ETAS from INTECRIO integration project"
/begin MOD_PAR "" VERSION "" ADDR_EPK 0x0 EPK "" SUPPLIER "ETAS GmbH" CUSTOMER "" CUSTOMER_NO "" USER "" PHONE_NO "" ECU "NO_ECU" CPU_TYPE "MPC750" NO_OF_INTERFACES 1 /end MOD_PAR
/begin MOD_COMMON "Common definitions" BYTE_ORDER MSB_FIRST ALIGNMENT_BYTE 1 ALIGNMENT_WORD 2 ALIGNMENT_LONG 4 ALIGNMENT_FLOAT32_IEEE 4 ALIGNMENT_FLOAT64_IEEE 8 /end MOD_COMMON
/begin MEASUREMENT Racing_Modes_B.Gain "" FLOAT64_IEEE Racing_Modes_CM_double 0 0 -1.7e+308 1.7e+308 ECU_ADDRESS 0x0 DISPLAY_IDENTIFIER Racing_Modes.Custom_Dash__11_.Max_tyre_slip.Gain.Gain /end MEASUREMENT
/begin COMPU_METHOD Racing_Modes_CM_double "Q = V" RAT_FUNC "%9.6" "NO_PHYSICAL_QTY" COEFFS 0.0 1.0 0.0 0.0 0.0 1.0 /end COMPU_METHOD
/begin MEASUREMENT Racing_Modes_B.Merge "" FLOAT64_IEEE Racing_Modes_CM_double 0 0 -1.7e+308 1.7e+308 ECU_ADDRESS 0x0 DISPLAY_IDENTIFIER Racing_Modes.Merge.Merge /end MEASUREMENT
/begin MEASUREMENT Racing_Modes_U.CustomMode_Data "" FLOAT64_IEEE Racing_Modes_CM_double 0 0 -1.7e+308 1.7e+308 ECU_ADDRESS 0x0 DISPLAY_IDENTIFIER Racing_Modes.CustomMode_Data /end MEASUREMENT
/begin MEASUREMENT Racing_Modes_U.CustomMode_Identifier "" FLOAT64_IEEE Racing_Modes_CM_double 0 0 -1.7e+308 1.7e+308 ECU_ADDRESS 0x0 DISPLAY_IDENTIFIER Racing_Modes.CustomMode_Identifier /end MEASUREMENT
/begin MEASUREMENT Racing_Modes_U.RacingMode "" UBYTE Racing_Modes_CM_uint8 0 0 0.0 255.0 ECU_ADDRESS 0x0 DISPLAY_IDENTIFIER Racing_Modes.RacingMode /end MEASUREMENT
/begin COMPU_METHOD Racing_Modes_CM_uint8 "Q = V" RAT_FUNC "%9.6" "NO_PHYSICAL_QTY" COEFFS 0.0 1.0 0.0 0.0 0.0 1.0 /end COMPU_METHOD
/begin MEASUREMENT Racing_Modes_Y.VDC_Max_Tyre_Slip "" FLOAT64_IEEE Racing_Modes_CM_double 0 0 -1.7e+308 1.7e+308 ECU_ADDRESS 0x0 DISPLAY_IDENTIFIER Racing_Modes.VDC_Max_Tyre_Slip /end MEASUREMENT
/begin MEASUREMENT Racing_Modes_Y.Workshop_Mode_Enable "" UBYTE Racing_Modes_CM_boolean 0 0 0 1 ECU_ADDRESS 0x0 DISPLAY_IDENTIFIER Racing_Modes.Workshop_Mode_Enable /end MEASUREMENT
/begin COMPU_METHOD Racing_Modes_CM_boolean "Q = V" RAT_FUNC "%9.6" "NO_PHYSICAL_QTY" COEFFS 0.0 1.0 0.0 0.0 0.0 1.0 /end COMPU_METHOD
/end MODULE
/* Racing_Modes */
/end PROJECT
