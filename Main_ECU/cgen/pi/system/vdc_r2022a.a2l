ASAP2_VERSION
/begin PROJECT "Generated by ETAS from INTECRIO integration project"
/begin HEADER "" VERSION "" PROJECT_NO Y /end HEADER
/begin MODULE vdc_r2022a "Generated by ETAS from INTECRIO integration project"
/begin MOD_PAR "" VERSION "" ADDR_EPK 0x0 EPK "" SUPPLIER "ETAS GmbH" CUSTOMER "" CUSTOMER_NO "" USER "" PHONE_NO "" ECU "NO_ECU" CPU_TYPE "MPC750" NO_OF_INTERFACES 1 /end MOD_PAR
/begin MOD_COMMON "Common definitions" BYTE_ORDER MSB_FIRST ALIGNMENT_BYTE 1 ALIGNMENT_WORD 2 ALIGNMENT_LONG 4 ALIGNMENT_FLOAT32_IEEE 4 ALIGNMENT_FLOAT64_IEEE 8 /end MOD_COMMON
/begin MEASUREMENT vdc_r2022a_B.Merge1 "" FLOAT64_IEEE vdc_r2022a_CM_double 0 0 -1.7e+308 1.7e+308 ECU_ADDRESS 0x0 DISPLAY_IDENTIFIER vdc_r2022a.Merge1.Merge1 /end MEASUREMENT
/begin COMPU_METHOD vdc_r2022a_CM_double "Q = V" /* ConversionType */ RAT_FUNC /* Format */ "%9.6" /* Unit */ "NO_PHYSICAL_QTY" COEFFS 0.0 1.0 0.0 0.0 0.0 1.0 /end COMPU_METHOD
/begin MEASUREMENT vdc_r2022a_B.Merge2 "" FLOAT64_IEEE vdc_r2022a_CM_double 0 0 -1.7e+308 1.7e+308 ECU_ADDRESS 0x0 DISPLAY_IDENTIFIER vdc_r2022a.Merge2.Merge2 /end MEASUREMENT
/begin MEASUREMENT vdc_r2022a_B.Merge3 "" UBYTE vdc_r2022a_CM_boolean 0 0 0 1 ECU_ADDRESS 0x0 DISPLAY_IDENTIFIER vdc_r2022a.Merge3.Merge3 /end MEASUREMENT
/begin COMPU_METHOD vdc_r2022a_CM_boolean "Q = V" /* ConversionType */ RAT_FUNC /* Format */ "%9.6" /* Unit */ "NO_PHYSICAL_QTY" COEFFS 0.0 1.0 0.0 0.0 0.0 1.0 /end COMPU_METHOD
/begin MEASUREMENT vdc_r2022a_DW.A "" FLOAT64_IEEE vdc_r2022a_CM_double 0 0 -1.7e+308 1.7e+308 ECU_ADDRESS 0x0 DISPLAY_IDENTIFIER vdc_r2022a.Accumulator_Power.PowerLimitDetection.Data_Store_Memory10.A /end MEASUREMENT
/begin MEASUREMENT vdc_r2022a_DW.ERROR_Counter "" FLOAT64_IEEE vdc_r2022a_CM_double 0 0 -1.7e+308 1.7e+308 ECU_ADDRESS 0x0 DISPLAY_IDENTIFIER vdc_r2022a.SAFETY_BLOCK.APPS_IMPLAUSIBILITY.Data_Store_Memory1.ERROR_Counter /end MEASUREMENT
/begin MEASUREMENT vdc_r2022a_U.APPS1_Value "" FLOAT64_IEEE vdc_r2022a_CM_double 0 0 -1.7e+308 1.7e+308 ECU_ADDRESS 0x0 DISPLAY_IDENTIFIER vdc_r2022a.APPS1_Value /end MEASUREMENT
/begin MEASUREMENT vdc_r2022a_U.APPS2_Value "" FLOAT64_IEEE vdc_r2022a_CM_double 0 0 -1.7e+308 1.7e+308 ECU_ADDRESS 0x0 DISPLAY_IDENTIFIER vdc_r2022a.APPS2_Value /end MEASUREMENT
/begin MEASUREMENT vdc_r2022a_U.Accumulator_Current "" FLOAT64_IEEE vdc_r2022a_CM_double 0 0 -1.7e+308 1.7e+308 ECU_ADDRESS 0x0 DISPLAY_IDENTIFIER vdc_r2022a.Accumulator_Current /end MEASUREMENT
/begin MEASUREMENT vdc_r2022a_U.Accumulator_Voltage "" FLOAT64_IEEE vdc_r2022a_CM_double 0 0 -1.7e+308 1.7e+308 ECU_ADDRESS 0x0 DISPLAY_IDENTIFIER vdc_r2022a.Accumulator_Voltage /end MEASUREMENT
/begin MEASUREMENT vdc_r2022a_U.BrakeSensor_Value "" FLOAT64_IEEE vdc_r2022a_CM_double 0 0 -1.7e+308 1.7e+308 ECU_ADDRESS 0x0 DISPLAY_IDENTIFIER vdc_r2022a.BrakeSensor_Value /end MEASUREMENT
/begin MEASUREMENT vdc_r2022a_U.Car_State "" FLOAT64_IEEE vdc_r2022a_CM_double 0 0 -1.7e+308 1.7e+308 ECU_ADDRESS 0x0 DISPLAY_IDENTIFIER vdc_r2022a.Car_State /end MEASUREMENT
/begin MEASUREMENT vdc_r2022a_U.CriticalDisconnection "" UBYTE vdc_r2022a_CM_boolean 0 0 0 1 ECU_ADDRESS 0x0 DISPLAY_IDENTIFIER vdc_r2022a.CriticalDisconnection /end MEASUREMENT
/begin MEASUREMENT vdc_r2022a_U.RL_Vel_ms_Wheel "" FLOAT64_IEEE vdc_r2022a_CM_double 0 0 -1.7e+308 1.7e+308 ECU_ADDRESS 0x0 DISPLAY_IDENTIFIER vdc_r2022a.RL_Vel_ms_Wheel /end MEASUREMENT
/begin MEASUREMENT vdc_r2022a_U.RL_rads_Motor "" FLOAT64_IEEE vdc_r2022a_CM_double 0 0 -1.7e+308 1.7e+308 ECU_ADDRESS 0x0 DISPLAY_IDENTIFIER vdc_r2022a.RL_rads_Motor /end MEASUREMENT
/begin MEASUREMENT vdc_r2022a_U.RR_Vel_ms_Wheel "" FLOAT64_IEEE vdc_r2022a_CM_double 0 0 -1.7e+308 1.7e+308 ECU_ADDRESS 0x0 DISPLAY_IDENTIFIER vdc_r2022a.RR_Vel_ms_Wheel /end MEASUREMENT
/begin MEASUREMENT vdc_r2022a_U.RR_rads_Motor "" FLOAT64_IEEE vdc_r2022a_CM_double 0 0 -1.7e+308 1.7e+308 ECU_ADDRESS 0x0 DISPLAY_IDENTIFIER vdc_r2022a.RR_rads_Motor /end MEASUREMENT
/begin MEASUREMENT vdc_r2022a_U.Shutdown_PackageIntck "" UBYTE vdc_r2022a_CM_boolean 0 0 0 1 ECU_ADDRESS 0x0 DISPLAY_IDENTIFIER vdc_r2022a.Shutdown_PackageIntck /end MEASUREMENT
/begin MEASUREMENT vdc_r2022a_U.SteeringSensor_Value "" FLOAT64_IEEE vdc_r2022a_CM_double 0 0 -1.7e+308 1.7e+308 ECU_ADDRESS 0x0 DISPLAY_IDENTIFIER vdc_r2022a.SteeringSensor_Value /end MEASUREMENT
/begin MEASUREMENT vdc_r2022a_U.Susp_F_L "" FLOAT64_IEEE vdc_r2022a_CM_double 0 0 -1.7e+308 1.7e+308 ECU_ADDRESS 0x0 DISPLAY_IDENTIFIER vdc_r2022a.Susp_F_L /end MEASUREMENT
/begin MEASUREMENT vdc_r2022a_U.Susp_F_R "" FLOAT64_IEEE vdc_r2022a_CM_double 0 0 -1.7e+308 1.7e+308 ECU_ADDRESS 0x0 DISPLAY_IDENTIFIER vdc_r2022a.Susp_F_R /end MEASUREMENT
/begin MEASUREMENT vdc_r2022a_U.Susp_R_L "" FLOAT64_IEEE vdc_r2022a_CM_double 0 0 -1.7e+308 1.7e+308 ECU_ADDRESS 0x0 DISPLAY_IDENTIFIER vdc_r2022a.Susp_R_L /end MEASUREMENT
/begin MEASUREMENT vdc_r2022a_U.Susp_R_R "" FLOAT64_IEEE vdc_r2022a_CM_double 0 0 -1.7e+308 1.7e+308 ECU_ADDRESS 0x0 DISPLAY_IDENTIFIER vdc_r2022a.Susp_R_R /end MEASUREMENT
/begin MEASUREMENT vdc_r2022a_U.TV_Mode "" FLOAT64_IEEE vdc_r2022a_CM_double 0 0 -1.7e+308 1.7e+308 ECU_ADDRESS 0x0 DISPLAY_IDENTIFIER vdc_r2022a.TV_Mode /end MEASUREMENT
/begin MEASUREMENT vdc_r2022a_U.TorqueEnable "" UBYTE vdc_r2022a_CM_boolean 0 0 0 1 ECU_ADDRESS 0x0 DISPLAY_IDENTIFIER vdc_r2022a.TorqueEnable /end MEASUREMENT
/begin MEASUREMENT vdc_r2022a_U.VDC_Max_tire_slip "" FLOAT64_IEEE vdc_r2022a_CM_double 0 0 -1.7e+308 1.7e+308 ECU_ADDRESS 0x0 DISPLAY_IDENTIFIER vdc_r2022a.VDC_Max_tire_slip /end MEASUREMENT
/begin MEASUREMENT vdc_r2022a_U.Workshop_Mode_Enable "" FLOAT64_IEEE vdc_r2022a_CM_double 0 0 -1.7e+308 1.7e+308 ECU_ADDRESS 0x0 DISPLAY_IDENTIFIER vdc_r2022a.Workshop_Mode_Enable /end MEASUREMENT
/begin MEASUREMENT vdc_r2022a_U.el_ACCEL_X "" FLOAT64_IEEE vdc_r2022a_CM_double 0 0 -1.7e+308 1.7e+308 ECU_ADDRESS 0x0 DISPLAY_IDENTIFIER vdc_r2022a.el_ACCEL_X /end MEASUREMENT
/begin MEASUREMENT vdc_r2022a_U.el_ACCEL_Y "" FLOAT64_IEEE vdc_r2022a_CM_double 0 0 -1.7e+308 1.7e+308 ECU_ADDRESS 0x0 DISPLAY_IDENTIFIER vdc_r2022a.el_ACCEL_Y /end MEASUREMENT
/begin MEASUREMENT vdc_r2022a_U.el_ACCEL_Z "" FLOAT64_IEEE vdc_r2022a_CM_double 0 0 -1.7e+308 1.7e+308 ECU_ADDRESS 0x0 DISPLAY_IDENTIFIER vdc_r2022a.el_ACCEL_Z /end MEASUREMENT
/begin MEASUREMENT vdc_r2022a_U.el_GYRO_X "" FLOAT64_IEEE vdc_r2022a_CM_double 0 0 -1.7e+308 1.7e+308 ECU_ADDRESS 0x0 DISPLAY_IDENTIFIER vdc_r2022a.el_GYRO_X /end MEASUREMENT
/begin MEASUREMENT vdc_r2022a_U.el_GYRO_Y "" FLOAT64_IEEE vdc_r2022a_CM_double 0 0 -1.7e+308 1.7e+308 ECU_ADDRESS 0x0 DISPLAY_IDENTIFIER vdc_r2022a.el_GYRO_Y /end MEASUREMENT
/begin MEASUREMENT vdc_r2022a_U.el_GYRO_Z "" FLOAT64_IEEE vdc_r2022a_CM_double 0 0 -1.7e+308 1.7e+308 ECU_ADDRESS 0x0 DISPLAY_IDENTIFIER vdc_r2022a.el_GYRO_Z /end MEASUREMENT
/begin MEASUREMENT vdc_r2022a_U.el_PITCH "" FLOAT64_IEEE vdc_r2022a_CM_double 0 0 -1.7e+308 1.7e+308 ECU_ADDRESS 0x0 DISPLAY_IDENTIFIER vdc_r2022a.el_PITCH /end MEASUREMENT
/begin MEASUREMENT vdc_r2022a_U.el_ROLL "" FLOAT64_IEEE vdc_r2022a_CM_double 0 0 -1.7e+308 1.7e+308 ECU_ADDRESS 0x0 DISPLAY_IDENTIFIER vdc_r2022a.el_ROLL /end MEASUREMENT
/begin MEASUREMENT vdc_r2022a_U.el_Vel_X "" FLOAT64_IEEE vdc_r2022a_CM_double 0 0 -1.7e+308 1.7e+308 ECU_ADDRESS 0x0 DISPLAY_IDENTIFIER vdc_r2022a.el_Vel_X /end MEASUREMENT
/begin MEASUREMENT vdc_r2022a_U.el_Vel_Y "" FLOAT64_IEEE vdc_r2022a_CM_double 0 0 -1.7e+308 1.7e+308 ECU_ADDRESS 0x0 DISPLAY_IDENTIFIER vdc_r2022a.el_Vel_Y /end MEASUREMENT
/begin MEASUREMENT vdc_r2022a_U.el_Vel_Z "" FLOAT64_IEEE vdc_r2022a_CM_double 0 0 -1.7e+308 1.7e+308 ECU_ADDRESS 0x0 DISPLAY_IDENTIFIER vdc_r2022a.el_Vel_Z /end MEASUREMENT
/begin MEASUREMENT vdc_r2022a_U.el_YAW "" FLOAT64_IEEE vdc_r2022a_CM_double 0 0 -1.7e+308 1.7e+308 ECU_ADDRESS 0x0 DISPLAY_IDENTIFIER vdc_r2022a.el_YAW /end MEASUREMENT
/begin MEASUREMENT vdc_r2022a_Y.APPS_Implausibility "" FLOAT64_IEEE vdc_r2022a_CM_double 0 0 -1.7e+308 1.7e+308 ECU_ADDRESS 0x0 DISPLAY_IDENTIFIER vdc_r2022a.APPS_Implausibility /end MEASUREMENT
/begin MEASUREMENT vdc_r2022a_Y.Power "" FLOAT64_IEEE vdc_r2022a_CM_double 0 0 -1.7e+308 1.7e+308 ECU_ADDRESS 0x0 DISPLAY_IDENTIFIER vdc_r2022a.Power /end MEASUREMENT
/begin MEASUREMENT vdc_r2022a_Y.PowerLimitReached "" FLOAT64_IEEE vdc_r2022a_CM_double 0 0 -1.7e+308 1.7e+308 ECU_ADDRESS 0x0 DISPLAY_IDENTIFIER vdc_r2022a.PowerLimitReached /end MEASUREMENT
/begin MEASUREMENT vdc_r2022a_Y.PowerMean500ms "" FLOAT64_IEEE vdc_r2022a_CM_double 0 0 -1.7e+308 1.7e+308 ECU_ADDRESS 0x0 DISPLAY_IDENTIFIER vdc_r2022a.PowerMean500ms /end MEASUREMENT
/begin MEASUREMENT vdc_r2022a_Y.TC_WARNING "" UBYTE vdc_r2022a_CM_boolean 0 0 0 1 ECU_ADDRESS 0x0 DISPLAY_IDENTIFIER vdc_r2022a.TC_WARNING /end MEASUREMENT
/begin MEASUREMENT vdc_r2022a_Y.Torque_L_out "" FLOAT64_IEEE vdc_r2022a_CM_double 0 0 -1.7e+308 1.7e+308 ECU_ADDRESS 0x0 DISPLAY_IDENTIFIER vdc_r2022a.Torque_L_out /end MEASUREMENT
/begin MEASUREMENT vdc_r2022a_Y.Torque_OK "" FLOAT64_IEEE vdc_r2022a_CM_double 0 0 -1.7e+308 1.7e+308 ECU_ADDRESS 0x0 DISPLAY_IDENTIFIER vdc_r2022a.Torque_OK /end MEASUREMENT
/begin MEASUREMENT vdc_r2022a_Y.Torque_R_out "" FLOAT64_IEEE vdc_r2022a_CM_double 0 0 -1.7e+308 1.7e+308 ECU_ADDRESS 0x0 DISPLAY_IDENTIFIER vdc_r2022a.Torque_R_out /end MEASUREMENT
/end MODULE
/* vdc_r2022a */
/end PROJECT
