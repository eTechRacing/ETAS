ASAP2_VERSION
/begin PROJECT "Generated by ETAS from INTECRIO integration project"
/begin HEADER "" VERSION "" PROJECT_NO Y /end HEADER
/begin MODULE Ellipse "Generated by ETAS from INTECRIO integration project"
/begin MOD_PAR "" VERSION "" ADDR_EPK 0x0 EPK "" SUPPLIER "ETAS GmbH" CUSTOMER "" CUSTOMER_NO "" USER "" PHONE_NO "" ECU "NO_ECU" CPU_TYPE "MPC750" NO_OF_INTERFACES 1 /end MOD_PAR
/begin MOD_COMMON "Common definitions" BYTE_ORDER MSB_FIRST ALIGNMENT_BYTE 1 ALIGNMENT_WORD 2 ALIGNMENT_LONG 4 ALIGNMENT_FLOAT32_IEEE 4 ALIGNMENT_FLOAT64_IEEE 8 /end MOD_COMMON
/begin MEASUREMENT Ellipse_B.Merge "" FLOAT64_IEEE Ellipse_CM_double 0 0 -1.7e+308 1.7e+308 ECU_ADDRESS 0x0 DISPLAY_IDENTIFIER Ellipse.Merge.Merge /end MEASUREMENT
/begin COMPU_METHOD Ellipse_CM_double "Q = V" /* ConversionType */ RAT_FUNC /* Format */ "%9.6" /* Unit */ "NO_PHYSICAL_QTY" COEFFS 0.0 1.0 0.0 0.0 0.0 1.0 /end COMPU_METHOD
/begin MEASUREMENT Ellipse_U.el_AngleTrack "" FLOAT64_IEEE Ellipse_CM_double 0 0 -1.7e+308 1.7e+308 ECU_ADDRESS 0x0 DISPLAY_IDENTIFIER Ellipse.el_AngleTrack /end MEASUREMENT
/begin MEASUREMENT Ellipse_U.el_CurvatureRadius "" FLOAT64_IEEE Ellipse_CM_double 0 0 -1.7e+308 1.7e+308 ECU_ADDRESS 0x0 DISPLAY_IDENTIFIER Ellipse.el_CurvatureRadius /end MEASUREMENT
/begin MEASUREMENT Ellipse_U.el_Curvature_Valid "" FLOAT64_IEEE Ellipse_CM_double 0 0 -1.7e+308 1.7e+308 ECU_ADDRESS 0x0 DISPLAY_IDENTIFIER Ellipse.el_Curvature_Valid /end MEASUREMENT
/begin MEASUREMENT Ellipse_U.el_LATITUDE_EKF "" FLOAT64_IEEE Ellipse_CM_double 0 0 -1.7e+308 1.7e+308 ECU_ADDRESS 0x0 DISPLAY_IDENTIFIER Ellipse.el_LATITUDE_EKF /end MEASUREMENT
/begin MEASUREMENT Ellipse_U.el_LONGITUDE_EKF "" FLOAT64_IEEE Ellipse_CM_double 0 0 -1.7e+308 1.7e+308 ECU_ADDRESS 0x0 DISPLAY_IDENTIFIER Ellipse.el_LONGITUDE_EKF /end MEASUREMENT
/begin MEASUREMENT Ellipse_U.el_SlipAngle "" FLOAT64_IEEE Ellipse_CM_double 0 0 -1.7e+308 1.7e+308 ECU_ADDRESS 0x0 DISPLAY_IDENTIFIER Ellipse.el_SlipAngle /end MEASUREMENT
/begin MEASUREMENT Ellipse_U.el_Slip_Valid "" FLOAT64_IEEE Ellipse_CM_double 0 0 -1.7e+308 1.7e+308 ECU_ADDRESS 0x0 DISPLAY_IDENTIFIER Ellipse.el_Slip_Valid /end MEASUREMENT
/begin MEASUREMENT Ellipse_U.el_SolutionMode "" FLOAT64_IEEE Ellipse_CM_double 0 0 -1.7e+308 1.7e+308 ECU_ADDRESS 0x0 DISPLAY_IDENTIFIER Ellipse.el_SolutionMode /end MEASUREMENT
/begin MEASUREMENT Ellipse_U.el_Vel_EKF_Valid "" FLOAT64_IEEE Ellipse_CM_double 0 0 -1.7e+308 1.7e+308 ECU_ADDRESS 0x0 DISPLAY_IDENTIFIER Ellipse.el_Vel_EKF_Valid /end MEASUREMENT
/begin MEASUREMENT Ellipse_U.el_Vel_EKF_X "" FLOAT64_IEEE Ellipse_CM_double 0 0 -1.7e+308 1.7e+308 ECU_ADDRESS 0x0 DISPLAY_IDENTIFIER Ellipse.el_Vel_EKF_X /end MEASUREMENT
/begin MEASUREMENT Ellipse_U.el_Vel_EKF_Y "" FLOAT64_IEEE Ellipse_CM_double 0 0 -1.7e+308 1.7e+308 ECU_ADDRESS 0x0 DISPLAY_IDENTIFIER Ellipse.el_Vel_EKF_Y /end MEASUREMENT
/begin MEASUREMENT Ellipse_U.el_Vel_EKF_Z "" FLOAT64_IEEE Ellipse_CM_double 0 0 -1.7e+308 1.7e+308 ECU_ADDRESS 0x0 DISPLAY_IDENTIFIER Ellipse.el_Vel_EKF_Z /end MEASUREMENT
/begin MEASUREMENT Ellipse_U.el_Vel_GPS_D "" FLOAT64_IEEE Ellipse_CM_double 0 0 -1.7e+308 1.7e+308 ECU_ADDRESS 0x0 DISPLAY_IDENTIFIER Ellipse.el_Vel_GPS_D /end MEASUREMENT
/begin MEASUREMENT Ellipse_U.el_Vel_GPS_E "" FLOAT64_IEEE Ellipse_CM_double 0 0 -1.7e+308 1.7e+308 ECU_ADDRESS 0x0 DISPLAY_IDENTIFIER Ellipse.el_Vel_GPS_E /end MEASUREMENT
/begin MEASUREMENT Ellipse_U.el_Vel_GPS_N "" FLOAT64_IEEE Ellipse_CM_double 0 0 -1.7e+308 1.7e+308 ECU_ADDRESS 0x0 DISPLAY_IDENTIFIER Ellipse.el_Vel_GPS_N /end MEASUREMENT
/begin MEASUREMENT Ellipse_U.el_Vel_GPS_Valid "" FLOAT64_IEEE Ellipse_CM_double 0 0 -1.7e+308 1.7e+308 ECU_ADDRESS 0x0 DISPLAY_IDENTIFIER Ellipse.el_Vel_GPS_Valid /end MEASUREMENT
/begin MEASUREMENT Ellipse_Y.el_VEL "" FLOAT64_IEEE Ellipse_CM_double 0 0 -1.7e+308 1.7e+308 ECU_ADDRESS 0x0 DISPLAY_IDENTIFIER Ellipse.el_VEL /end MEASUREMENT
/begin MEASUREMENT Ellipse_Y.el_Vel_OK "" FLOAT64_IEEE Ellipse_CM_double 0 0 -1.7e+308 1.7e+308 ECU_ADDRESS 0x0 DISPLAY_IDENTIFIER Ellipse.el_Vel_OK /end MEASUREMENT
/end MODULE
/* Ellipse */
/end PROJECT
