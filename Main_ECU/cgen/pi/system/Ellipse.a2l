ASAP2_VERSION
/begin PROJECT "Generated by ETAS from INTECRIO integration project"
/begin HEADER "" VERSION "" PROJECT_NO Y /end HEADER
/begin MODULE Ellipse "Generated by ETAS from INTECRIO integration project"
/begin MOD_PAR "" VERSION "" ADDR_EPK 0x0 EPK "" SUPPLIER "ETAS GmbH" CUSTOMER "" CUSTOMER_NO "" USER "" PHONE_NO "" ECU "NO_ECU" CPU_TYPE "MPC750" NO_OF_INTERFACES 1 /end MOD_PAR
/begin MOD_COMMON "Common definitions" BYTE_ORDER MSB_FIRST ALIGNMENT_BYTE 1 ALIGNMENT_WORD 2 ALIGNMENT_LONG 4 ALIGNMENT_FLOAT32_IEEE 4 ALIGNMENT_FLOAT64_IEEE 8 /end MOD_COMMON
/begin MEASUREMENT Ellipse_U.ACCEL_X_IMU "" FLOAT64_IEEE Ellipse_CM_double 0 0 -1.7e+308 1.7e+308 ECU_ADDRESS 0x0 DISPLAY_IDENTIFIER Ellipse.ACCEL_X_IMU /end MEASUREMENT
/begin COMPU_METHOD Ellipse_CM_double "Q = V" /* ConversionType */ RAT_FUNC /* Format */ "%9.6" /* Unit */ "NO_PHYSICAL_QTY" COEFFS 0.0 1.0 0.0 0.0 0.0 1.0 /end COMPU_METHOD
/begin MEASUREMENT Ellipse_U.ACCEL_X_MAG "" FLOAT64_IEEE Ellipse_CM_double 0 0 -1.7e+308 1.7e+308 ECU_ADDRESS 0x0 DISPLAY_IDENTIFIER Ellipse.ACCEL_X_MAG /end MEASUREMENT
/begin MEASUREMENT Ellipse_U.ACCEL_Y_IMU "" FLOAT64_IEEE Ellipse_CM_double 0 0 -1.7e+308 1.7e+308 ECU_ADDRESS 0x0 DISPLAY_IDENTIFIER Ellipse.ACCEL_Y_IMU /end MEASUREMENT
/begin MEASUREMENT Ellipse_U.ACCEL_Y_MAG "" FLOAT64_IEEE Ellipse_CM_double 0 0 -1.7e+308 1.7e+308 ECU_ADDRESS 0x0 DISPLAY_IDENTIFIER Ellipse.ACCEL_Y_MAG /end MEASUREMENT
/begin MEASUREMENT Ellipse_U.ACCEL_Z_IMU "" FLOAT64_IEEE Ellipse_CM_double 0 0 -1.7e+308 1.7e+308 ECU_ADDRESS 0x0 DISPLAY_IDENTIFIER Ellipse.ACCEL_Z_IMU /end MEASUREMENT
/begin MEASUREMENT Ellipse_U.ACCEL_Z_MAG "" FLOAT64_IEEE Ellipse_CM_double 0 0 -1.7e+308 1.7e+308 ECU_ADDRESS 0x0 DISPLAY_IDENTIFIER Ellipse.ACCEL_Z_MAG /end MEASUREMENT
/begin MEASUREMENT Ellipse_U.ANGLE_SLIP "" FLOAT64_IEEE Ellipse_CM_double 0 0 -1.7e+308 1.7e+308 ECU_ADDRESS 0x0 DISPLAY_IDENTIFIER Ellipse.ANGLE_SLIP /end MEASUREMENT
/begin MEASUREMENT Ellipse_U.ANGLE_TRACK "" FLOAT64_IEEE Ellipse_CM_double 0 0 -1.7e+308 1.7e+308 ECU_ADDRESS 0x0 DISPLAY_IDENTIFIER Ellipse.ANGLE_TRACK /end MEASUREMENT
/begin MEASUREMENT Ellipse_U.AUTO_STATUS "" FLOAT64_IEEE Ellipse_CM_double 0 0 -1.7e+308 1.7e+308 ECU_ADDRESS 0x0 DISPLAY_IDENTIFIER Ellipse.AUTO_STATUS /end MEASUREMENT
/begin MEASUREMENT Ellipse_U.CLOCK "" FLOAT64_IEEE Ellipse_CM_double 0 0 -1.7e+308 1.7e+308 ECU_ADDRESS 0x0 DISPLAY_IDENTIFIER Ellipse.CLOCK /end MEASUREMENT
/begin MEASUREMENT Ellipse_U.CURVATURE_RADIUS "" FLOAT64_IEEE Ellipse_CM_double 0 0 -1.7e+308 1.7e+308 ECU_ADDRESS 0x0 DISPLAY_IDENTIFIER Ellipse.CURVATURE_RADIUS /end MEASUREMENT
/begin MEASUREMENT Ellipse_U.GENERAL "" FLOAT64_IEEE Ellipse_CM_double 0 0 -1.7e+308 1.7e+308 ECU_ADDRESS 0x0 DISPLAY_IDENTIFIER Ellipse.GENERAL /end MEASUREMENT
/begin MEASUREMENT Ellipse_U.GYRO_X "" FLOAT64_IEEE Ellipse_CM_double 0 0 -1.7e+308 1.7e+308 ECU_ADDRESS 0x0 DISPLAY_IDENTIFIER Ellipse.GYRO_X /end MEASUREMENT
/begin MEASUREMENT Ellipse_U.GYRO_Y "" FLOAT64_IEEE Ellipse_CM_double 0 0 -1.7e+308 1.7e+308 ECU_ADDRESS 0x0 DISPLAY_IDENTIFIER Ellipse.GYRO_Y /end MEASUREMENT
/begin MEASUREMENT Ellipse_U.GYRO_Z "" FLOAT64_IEEE Ellipse_CM_double 0 0 -1.7e+308 1.7e+308 ECU_ADDRESS 0x0 DISPLAY_IDENTIFIER Ellipse.GYRO_Z /end MEASUREMENT
/begin MEASUREMENT Ellipse_U.LATITUDE_EKF "" FLOAT64_IEEE Ellipse_CM_double 0 0 -1.7e+308 1.7e+308 ECU_ADDRESS 0x0 DISPLAY_IDENTIFIER Ellipse.LATITUDE_EKF /end MEASUREMENT
/begin MEASUREMENT Ellipse_U.LONGITUDE_EKF "" FLOAT64_IEEE Ellipse_CM_double 0 0 -1.7e+308 1.7e+308 ECU_ADDRESS 0x0 DISPLAY_IDENTIFIER Ellipse.LONGITUDE_EKF /end MEASUREMENT
/begin MEASUREMENT Ellipse_U.PITCH "" FLOAT64_IEEE Ellipse_CM_double 0 0 -1.7e+308 1.7e+308 ECU_ADDRESS 0x0 DISPLAY_IDENTIFIER Ellipse.PITCH /end MEASUREMENT
/begin MEASUREMENT Ellipse_U.ROLL "" FLOAT64_IEEE Ellipse_CM_double 0 0 -1.7e+308 1.7e+308 ECU_ADDRESS 0x0 DISPLAY_IDENTIFIER Ellipse.ROLL /end MEASUREMENT
/begin MEASUREMENT Ellipse_U.TIME_STAMP "" FLOAT64_IEEE Ellipse_CM_double 0 0 -1.7e+308 1.7e+308 ECU_ADDRESS 0x0 DISPLAY_IDENTIFIER Ellipse.TIME_STAMP /end MEASUREMENT
/begin MEASUREMENT Ellipse_U.YAW "" FLOAT64_IEEE Ellipse_CM_double 0 0 -1.7e+308 1.7e+308 ECU_ADDRESS 0x0 DISPLAY_IDENTIFIER Ellipse.YAW /end MEASUREMENT
/begin MEASUREMENT Ellipse_U.el_Vel_X "" FLOAT64_IEEE Ellipse_CM_double 0 0 -1.7e+308 1.7e+308 ECU_ADDRESS 0x0 DISPLAY_IDENTIFIER Ellipse.el_Vel_X /end MEASUREMENT
/begin MEASUREMENT Ellipse_U.el_Vel_Y "" FLOAT64_IEEE Ellipse_CM_double 0 0 -1.7e+308 1.7e+308 ECU_ADDRESS 0x0 DISPLAY_IDENTIFIER Ellipse.el_Vel_Y /end MEASUREMENT
/begin MEASUREMENT Ellipse_U.el_Vel_Z "" FLOAT64_IEEE Ellipse_CM_double 0 0 -1.7e+308 1.7e+308 ECU_ADDRESS 0x0 DISPLAY_IDENTIFIER Ellipse.el_Vel_Z /end MEASUREMENT
/begin MEASUREMENT Ellipse_Y.Accel_X_IMU_Tx "" FLOAT64_IEEE Ellipse_CM_double 0 0 -1.7e+308 1.7e+308 ECU_ADDRESS 0x0 DISPLAY_IDENTIFIER Ellipse.Accel_X_IMU_Tx /end MEASUREMENT
/begin MEASUREMENT Ellipse_Y.Accel_X_Mag_Tx "" FLOAT64_IEEE Ellipse_CM_double 0 0 -1.7e+308 1.7e+308 ECU_ADDRESS 0x0 DISPLAY_IDENTIFIER Ellipse.Accel_X_Mag_Tx /end MEASUREMENT
/begin MEASUREMENT Ellipse_Y.Accel_Y_IMU_Tx "" FLOAT64_IEEE Ellipse_CM_double 0 0 -1.7e+308 1.7e+308 ECU_ADDRESS 0x0 DISPLAY_IDENTIFIER Ellipse.Accel_Y_IMU_Tx /end MEASUREMENT
/begin MEASUREMENT Ellipse_Y.Accel_Y_Mag_Tx "" FLOAT64_IEEE Ellipse_CM_double 0 0 -1.7e+308 1.7e+308 ECU_ADDRESS 0x0 DISPLAY_IDENTIFIER Ellipse.Accel_Y_Mag_Tx /end MEASUREMENT
/begin MEASUREMENT Ellipse_Y.Accel_Z_IMU_Tx "" FLOAT64_IEEE Ellipse_CM_double 0 0 -1.7e+308 1.7e+308 ECU_ADDRESS 0x0 DISPLAY_IDENTIFIER Ellipse.Accel_Z_IMU_Tx /end MEASUREMENT
/begin MEASUREMENT Ellipse_Y.Accel_Z_Mag_Tx "" FLOAT64_IEEE Ellipse_CM_double 0 0 -1.7e+308 1.7e+308 ECU_ADDRESS 0x0 DISPLAY_IDENTIFIER Ellipse.Accel_Z_Mag_Tx /end MEASUREMENT
/begin MEASUREMENT Ellipse_Y.Clock_Tx "" FLOAT64_IEEE Ellipse_CM_double 0 0 -1.7e+308 1.7e+308 ECU_ADDRESS 0x0 DISPLAY_IDENTIFIER Ellipse.Clock_Tx /end MEASUREMENT
/begin MEASUREMENT Ellipse_Y.CurvRadius "" FLOAT64_IEEE Ellipse_CM_double 0 0 -1.7e+308 1.7e+308 ECU_ADDRESS 0x0 DISPLAY_IDENTIFIER Ellipse.CurvRadius /end MEASUREMENT
/begin MEASUREMENT Ellipse_Y.General_Tx "" FLOAT64_IEEE Ellipse_CM_double 0 0 -1.7e+308 1.7e+308 ECU_ADDRESS 0x0 DISPLAY_IDENTIFIER Ellipse.General_Tx /end MEASUREMENT
/begin MEASUREMENT Ellipse_Y.Gyro_X_Tx "" FLOAT64_IEEE Ellipse_CM_double 0 0 -1.7e+308 1.7e+308 ECU_ADDRESS 0x0 DISPLAY_IDENTIFIER Ellipse.Gyro_X_Tx /end MEASUREMENT
/begin MEASUREMENT Ellipse_Y.Gyro_Y_Tx "" FLOAT64_IEEE Ellipse_CM_double 0 0 -1.7e+308 1.7e+308 ECU_ADDRESS 0x0 DISPLAY_IDENTIFIER Ellipse.Gyro_Y_Tx /end MEASUREMENT
/begin MEASUREMENT Ellipse_Y.Gyro_Z_Tx "" FLOAT64_IEEE Ellipse_CM_double 0 0 -1.7e+308 1.7e+308 ECU_ADDRESS 0x0 DISPLAY_IDENTIFIER Ellipse.Gyro_Z_Tx /end MEASUREMENT
/begin MEASUREMENT Ellipse_Y.Lat_EKF "" FLOAT64_IEEE Ellipse_CM_double 0 0 -1.7e+308 1.7e+308 ECU_ADDRESS 0x0 DISPLAY_IDENTIFIER Ellipse.Lat_EKF /end MEASUREMENT
/begin MEASUREMENT Ellipse_Y.Long_EKF "" FLOAT64_IEEE Ellipse_CM_double 0 0 -1.7e+308 1.7e+308 ECU_ADDRESS 0x0 DISPLAY_IDENTIFIER Ellipse.Long_EKF /end MEASUREMENT
/begin MEASUREMENT Ellipse_Y.Pitch_Tx "" FLOAT64_IEEE Ellipse_CM_double 0 0 -1.7e+308 1.7e+308 ECU_ADDRESS 0x0 DISPLAY_IDENTIFIER Ellipse.Pitch_Tx /end MEASUREMENT
/begin MEASUREMENT Ellipse_Y.Roll_Tx "" FLOAT64_IEEE Ellipse_CM_double 0 0 -1.7e+308 1.7e+308 ECU_ADDRESS 0x0 DISPLAY_IDENTIFIER Ellipse.Roll_Tx /end MEASUREMENT
/begin MEASUREMENT Ellipse_Y.SlipAngle "" FLOAT64_IEEE Ellipse_CM_double 0 0 -1.7e+308 1.7e+308 ECU_ADDRESS 0x0 DISPLAY_IDENTIFIER Ellipse.SlipAngle /end MEASUREMENT
/begin MEASUREMENT Ellipse_Y.Status_Auto "" FLOAT64_IEEE Ellipse_CM_double 0 0 -1.7e+308 1.7e+308 ECU_ADDRESS 0x0 DISPLAY_IDENTIFIER Ellipse.Status_Auto /end MEASUREMENT
/begin MEASUREMENT Ellipse_Y.Time "" FLOAT64_IEEE Ellipse_CM_double 0 0 -1.7e+308 1.7e+308 ECU_ADDRESS 0x0 DISPLAY_IDENTIFIER Ellipse.Time /end MEASUREMENT
/begin MEASUREMENT Ellipse_Y.TrackAngle "" FLOAT64_IEEE Ellipse_CM_double 0 0 -1.7e+308 1.7e+308 ECU_ADDRESS 0x0 DISPLAY_IDENTIFIER Ellipse.TrackAngle /end MEASUREMENT
/begin MEASUREMENT Ellipse_Y.Vel_X "" FLOAT64_IEEE Ellipse_CM_double 0 0 -1.7e+308 1.7e+308 ECU_ADDRESS 0x0 DISPLAY_IDENTIFIER Ellipse.Vel_X /end MEASUREMENT
/begin MEASUREMENT Ellipse_Y.Vel_Y "" FLOAT64_IEEE Ellipse_CM_double 0 0 -1.7e+308 1.7e+308 ECU_ADDRESS 0x0 DISPLAY_IDENTIFIER Ellipse.Vel_Y /end MEASUREMENT
/begin MEASUREMENT Ellipse_Y.Vel_Z "" FLOAT64_IEEE Ellipse_CM_double 0 0 -1.7e+308 1.7e+308 ECU_ADDRESS 0x0 DISPLAY_IDENTIFIER Ellipse.Vel_Z /end MEASUREMENT
/begin MEASUREMENT Ellipse_Y.Yaw_Tx "" FLOAT64_IEEE Ellipse_CM_double 0 0 -1.7e+308 1.7e+308 ECU_ADDRESS 0x0 DISPLAY_IDENTIFIER Ellipse.Yaw_Tx /end MEASUREMENT
/end MODULE
/* Ellipse */
/end PROJECT
