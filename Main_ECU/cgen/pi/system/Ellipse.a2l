ASAP2_VERSION
/begin PROJECT "Generated by ETAS from INTECRIO integration project"
/begin HEADER "" VERSION "" PROJECT_NO Y /end HEADER
/begin MODULE Ellipse "Generated by ETAS from INTECRIO integration project"
/begin MOD_PAR "" VERSION "" ADDR_EPK 0x0 EPK "" SUPPLIER "ETAS GmbH" CUSTOMER "" CUSTOMER_NO "" USER "" PHONE_NO "" ECU "NO_ECU" CPU_TYPE "MPC750" NO_OF_INTERFACES 1 /end MOD_PAR
/begin MOD_COMMON "Common definitions" BYTE_ORDER MSB_FIRST ALIGNMENT_BYTE 1 ALIGNMENT_WORD 2 ALIGNMENT_LONG 4 ALIGNMENT_FLOAT32_IEEE 4 ALIGNMENT_FLOAT64_IEEE 8 /end MOD_COMMON
/begin MEASUREMENT Ellipse_U.el_AUTO_STATUS "" FLOAT64_IEEE Ellipse_CM_double 0 0 -1.7e+308 1.7e+308 ECU_ADDRESS 0x0 DISPLAY_IDENTIFIER Ellipse.el_AUTO_STATUS /end MEASUREMENT
/begin COMPU_METHOD Ellipse_CM_double "Q = V" /* ConversionType */ RAT_FUNC /* Format */ "%9.6" /* Unit */ "NO_PHYSICAL_QTY" COEFFS 0.0 1.0 0.0 0.0 0.0 1.0 /end COMPU_METHOD
/begin MEASUREMENT Ellipse_U.el_AngleTrack "" FLOAT64_IEEE Ellipse_CM_double 0 0 -1.7e+308 1.7e+308 ECU_ADDRESS 0x0 DISPLAY_IDENTIFIER Ellipse.el_AngleTrack /end MEASUREMENT
/begin MEASUREMENT Ellipse_U.el_CLOCK "" FLOAT64_IEEE Ellipse_CM_double 0 0 -1.7e+308 1.7e+308 ECU_ADDRESS 0x0 DISPLAY_IDENTIFIER Ellipse.el_CLOCK /end MEASUREMENT
/begin MEASUREMENT Ellipse_U.el_CurvatureRadius "" FLOAT64_IEEE Ellipse_CM_double 0 0 -1.7e+308 1.7e+308 ECU_ADDRESS 0x0 DISPLAY_IDENTIFIER Ellipse.el_CurvatureRadius /end MEASUREMENT
/begin MEASUREMENT Ellipse_U.el_GENERAL "" FLOAT64_IEEE Ellipse_CM_double 0 0 -1.7e+308 1.7e+308 ECU_ADDRESS 0x0 DISPLAY_IDENTIFIER Ellipse.el_GENERAL /end MEASUREMENT
/begin MEASUREMENT Ellipse_U.el_LATITUDE_EKF "" FLOAT64_IEEE Ellipse_CM_double 0 0 -1.7e+308 1.7e+308 ECU_ADDRESS 0x0 DISPLAY_IDENTIFIER Ellipse.el_LATITUDE_EKF /end MEASUREMENT
/begin MEASUREMENT Ellipse_U.el_LONGITUDE_EKF "" FLOAT64_IEEE Ellipse_CM_double 0 0 -1.7e+308 1.7e+308 ECU_ADDRESS 0x0 DISPLAY_IDENTIFIER Ellipse.el_LONGITUDE_EKF /end MEASUREMENT
/begin MEASUREMENT Ellipse_U.el_SlipAngle "" FLOAT64_IEEE Ellipse_CM_double 0 0 -1.7e+308 1.7e+308 ECU_ADDRESS 0x0 DISPLAY_IDENTIFIER Ellipse.el_SlipAngle /end MEASUREMENT
/begin MEASUREMENT Ellipse_Y.Clock_Tx "" FLOAT64_IEEE Ellipse_CM_double 0 0 -1.7e+308 1.7e+308 ECU_ADDRESS 0x0 DISPLAY_IDENTIFIER Ellipse.Clock_Tx /end MEASUREMENT
/begin MEASUREMENT Ellipse_Y.CurvRadius "" FLOAT64_IEEE Ellipse_CM_double 0 0 -1.7e+308 1.7e+308 ECU_ADDRESS 0x0 DISPLAY_IDENTIFIER Ellipse.CurvRadius /end MEASUREMENT
/begin MEASUREMENT Ellipse_Y.General_Tx "" FLOAT64_IEEE Ellipse_CM_double 0 0 -1.7e+308 1.7e+308 ECU_ADDRESS 0x0 DISPLAY_IDENTIFIER Ellipse.General_Tx /end MEASUREMENT
/begin MEASUREMENT Ellipse_Y.Lat_EKF "" FLOAT64_IEEE Ellipse_CM_double 0 0 -1.7e+308 1.7e+308 ECU_ADDRESS 0x0 DISPLAY_IDENTIFIER Ellipse.Lat_EKF /end MEASUREMENT
/begin MEASUREMENT Ellipse_Y.Long_EKF "" FLOAT64_IEEE Ellipse_CM_double 0 0 -1.7e+308 1.7e+308 ECU_ADDRESS 0x0 DISPLAY_IDENTIFIER Ellipse.Long_EKF /end MEASUREMENT
/begin MEASUREMENT Ellipse_Y.SlipAngle "" FLOAT64_IEEE Ellipse_CM_double 0 0 -1.7e+308 1.7e+308 ECU_ADDRESS 0x0 DISPLAY_IDENTIFIER Ellipse.SlipAngle /end MEASUREMENT
/begin MEASUREMENT Ellipse_Y.Status_Auto "" FLOAT64_IEEE Ellipse_CM_double 0 0 -1.7e+308 1.7e+308 ECU_ADDRESS 0x0 DISPLAY_IDENTIFIER Ellipse.Status_Auto /end MEASUREMENT
/begin MEASUREMENT Ellipse_Y.TrackAngle "" FLOAT64_IEEE Ellipse_CM_double 0 0 -1.7e+308 1.7e+308 ECU_ADDRESS 0x0 DISPLAY_IDENTIFIER Ellipse.TrackAngle /end MEASUREMENT
/end MODULE
/* Ellipse */
/end PROJECT
