ASAP2_VERSION
/begin PROJECT "Generated by ETAS from INTECRIO integration project"
/begin HEADER "" VERSION "" PROJECT_NO Y /end HEADER
/begin MODULE VDC_Winter_Testing "Generated by ETAS from INTECRIO integration project"
/begin MOD_PAR "" VERSION "" ADDR_EPK 0x0 EPK "" SUPPLIER "ETAS GmbH" CUSTOMER "" CUSTOMER_NO "" USER "" PHONE_NO "" ECU "NO_ECU" CPU_TYPE "MPC750" NO_OF_INTERFACES 1 /end MOD_PAR
/begin MOD_COMMON "Common definitions" BYTE_ORDER MSB_FIRST ALIGNMENT_BYTE 1 ALIGNMENT_WORD 2 ALIGNMENT_LONG 4 ALIGNMENT_FLOAT32_IEEE 4 ALIGNMENT_FLOAT64_IEEE 8 /end MOD_COMMON
/begin MEASUREMENT VDC_Winter_Testing_DW.ERROR_Counter "" FLOAT64_IEEE VDC_Winter_Testing_CM_double 0 0 -1.7e+308 1.7e+308 ECU_ADDRESS 0x0 DISPLAY_IDENTIFIER VDC_Winter_Testing.SAFETY_BLOCK.APPS_IMPLAUSIBILITY.Data_Store_Memory1.ERROR_Counter /end MEASUREMENT
/begin COMPU_METHOD VDC_Winter_Testing_CM_double "Q = V" /* ConversionType */ RAT_FUNC /* Format */ "%9.6" /* Unit */ "NO_PHYSICAL_QTY" COEFFS 0.0 1.0 0.0 0.0 0.0 1.0 /end COMPU_METHOD
/begin MEASUREMENT VDC_Winter_Testing_U.APPS1_Value "" FLOAT64_IEEE VDC_Winter_Testing_CM_double 0 0 -1.7e+308 1.7e+308 ECU_ADDRESS 0x0 DISPLAY_IDENTIFIER VDC_Winter_Testing.APPS1_Value /end MEASUREMENT
/begin MEASUREMENT VDC_Winter_Testing_U.APPS2_Value "" FLOAT64_IEEE VDC_Winter_Testing_CM_double 0 0 -1.7e+308 1.7e+308 ECU_ADDRESS 0x0 DISPLAY_IDENTIFIER VDC_Winter_Testing.APPS2_Value /end MEASUREMENT
/begin MEASUREMENT VDC_Winter_Testing_U.Accumulator_Voltage "" FLOAT64_IEEE VDC_Winter_Testing_CM_double 0 0 -1.7e+308 1.7e+308 ECU_ADDRESS 0x0 DISPLAY_IDENTIFIER VDC_Winter_Testing.Accumulator_Voltage /end MEASUREMENT
/begin MEASUREMENT VDC_Winter_Testing_U.BrakePedal_Value "" FLOAT64_IEEE VDC_Winter_Testing_CM_double 0 0 -1.7e+308 1.7e+308 ECU_ADDRESS 0x0 DISPLAY_IDENTIFIER VDC_Winter_Testing.BrakePedal_Value /end MEASUREMENT
/begin MEASUREMENT VDC_Winter_Testing_U.Car_State "" FLOAT64_IEEE VDC_Winter_Testing_CM_double 0 0 -1.7e+308 1.7e+308 ECU_ADDRESS 0x0 DISPLAY_IDENTIFIER VDC_Winter_Testing.Car_State /end MEASUREMENT
/begin MEASUREMENT VDC_Winter_Testing_U.CriticalDisconnection "" UBYTE VDC_Winter_Testing_CM_boolean 0 0 0 1 ECU_ADDRESS 0x0 DISPLAY_IDENTIFIER VDC_Winter_Testing.CriticalDisconnection /end MEASUREMENT
/begin COMPU_METHOD VDC_Winter_Testing_CM_boolean "Q = V" /* ConversionType */ RAT_FUNC /* Format */ "%9.6" /* Unit */ "NO_PHYSICAL_QTY" COEFFS 0.0 1.0 0.0 0.0 0.0 1.0 /end COMPU_METHOD
/begin MEASUREMENT VDC_Winter_Testing_U.Disconnection_Mode "" FLOAT64_IEEE VDC_Winter_Testing_CM_double 0 0 -1.7e+308 1.7e+308 ECU_ADDRESS 0x0 DISPLAY_IDENTIFIER VDC_Winter_Testing.Disconnection_Mode /end MEASUREMENT
/begin MEASUREMENT VDC_Winter_Testing_U.RL_Vel_ms_Wheel "" FLOAT64_IEEE VDC_Winter_Testing_CM_double 0 0 -1.7e+308 1.7e+308 ECU_ADDRESS 0x0 DISPLAY_IDENTIFIER VDC_Winter_Testing.RL_Vel_ms_Wheel /end MEASUREMENT
/begin MEASUREMENT VDC_Winter_Testing_U.RL_rads_Motor "" FLOAT64_IEEE VDC_Winter_Testing_CM_double 0 0 -1.7e+308 1.7e+308 ECU_ADDRESS 0x0 DISPLAY_IDENTIFIER VDC_Winter_Testing.RL_rads_Motor /end MEASUREMENT
/begin MEASUREMENT VDC_Winter_Testing_U.RR_Vel_ms_Wheel "" FLOAT64_IEEE VDC_Winter_Testing_CM_double 0 0 -1.7e+308 1.7e+308 ECU_ADDRESS 0x0 DISPLAY_IDENTIFIER VDC_Winter_Testing.RR_Vel_ms_Wheel /end MEASUREMENT
/begin MEASUREMENT VDC_Winter_Testing_U.RR_rads_Motor "" FLOAT64_IEEE VDC_Winter_Testing_CM_double 0 0 -1.7e+308 1.7e+308 ECU_ADDRESS 0x0 DISPLAY_IDENTIFIER VDC_Winter_Testing.RR_rads_Motor /end MEASUREMENT
/begin MEASUREMENT VDC_Winter_Testing_U.RacingMode "" FLOAT64_IEEE VDC_Winter_Testing_CM_double 0 0 -1.7e+308 1.7e+308 ECU_ADDRESS 0x0 DISPLAY_IDENTIFIER VDC_Winter_Testing.RacingMode /end MEASUREMENT
/begin MEASUREMENT VDC_Winter_Testing_U.Shutdown_PackageIntck "" UBYTE VDC_Winter_Testing_CM_boolean 0 0 0 1 ECU_ADDRESS 0x0 DISPLAY_IDENTIFIER VDC_Winter_Testing.Shutdown_PackageIntck /end MEASUREMENT
/begin MEASUREMENT VDC_Winter_Testing_U.SteeringSensor_Value "" FLOAT64_IEEE VDC_Winter_Testing_CM_double 0 0 -1.7e+308 1.7e+308 ECU_ADDRESS 0x0 DISPLAY_IDENTIFIER VDC_Winter_Testing.SteeringSensor_Value /end MEASUREMENT
/begin MEASUREMENT VDC_Winter_Testing_U.Susp_F_L "" FLOAT64_IEEE VDC_Winter_Testing_CM_double 0 0 -1.7e+308 1.7e+308 ECU_ADDRESS 0x0 DISPLAY_IDENTIFIER VDC_Winter_Testing.Susp_F_L /end MEASUREMENT
/begin MEASUREMENT VDC_Winter_Testing_U.Susp_F_R "" FLOAT64_IEEE VDC_Winter_Testing_CM_double 0 0 -1.7e+308 1.7e+308 ECU_ADDRESS 0x0 DISPLAY_IDENTIFIER VDC_Winter_Testing.Susp_F_R /end MEASUREMENT
/begin MEASUREMENT VDC_Winter_Testing_U.Susp_R_L "" FLOAT64_IEEE VDC_Winter_Testing_CM_double 0 0 -1.7e+308 1.7e+308 ECU_ADDRESS 0x0 DISPLAY_IDENTIFIER VDC_Winter_Testing.Susp_R_L /end MEASUREMENT
/begin MEASUREMENT VDC_Winter_Testing_U.Susp_R_R "" FLOAT64_IEEE VDC_Winter_Testing_CM_double 0 0 -1.7e+308 1.7e+308 ECU_ADDRESS 0x0 DISPLAY_IDENTIFIER VDC_Winter_Testing.Susp_R_R /end MEASUREMENT
/begin MEASUREMENT VDC_Winter_Testing_U.TorqueEnable "" UBYTE VDC_Winter_Testing_CM_boolean 0 0 0 1 ECU_ADDRESS 0x0 DISPLAY_IDENTIFIER VDC_Winter_Testing.TorqueEnable /end MEASUREMENT
/begin MEASUREMENT VDC_Winter_Testing_U.el_ACCEL_X "" FLOAT64_IEEE VDC_Winter_Testing_CM_double 0 0 -1.7e+308 1.7e+308 ECU_ADDRESS 0x0 DISPLAY_IDENTIFIER VDC_Winter_Testing.el_ACCEL_X /end MEASUREMENT
/begin MEASUREMENT VDC_Winter_Testing_U.el_ACCEL_Y "" FLOAT64_IEEE VDC_Winter_Testing_CM_double 0 0 -1.7e+308 1.7e+308 ECU_ADDRESS 0x0 DISPLAY_IDENTIFIER VDC_Winter_Testing.el_ACCEL_Y /end MEASUREMENT
/begin MEASUREMENT VDC_Winter_Testing_U.el_ACCEL_Z "" FLOAT64_IEEE VDC_Winter_Testing_CM_double 0 0 -1.7e+308 1.7e+308 ECU_ADDRESS 0x0 DISPLAY_IDENTIFIER VDC_Winter_Testing.el_ACCEL_Z /end MEASUREMENT
/begin MEASUREMENT VDC_Winter_Testing_U.el_GYRO_X "" FLOAT64_IEEE VDC_Winter_Testing_CM_double 0 0 -1.7e+308 1.7e+308 ECU_ADDRESS 0x0 DISPLAY_IDENTIFIER VDC_Winter_Testing.el_GYRO_X /end MEASUREMENT
/begin MEASUREMENT VDC_Winter_Testing_U.el_GYRO_Y "" FLOAT64_IEEE VDC_Winter_Testing_CM_double 0 0 -1.7e+308 1.7e+308 ECU_ADDRESS 0x0 DISPLAY_IDENTIFIER VDC_Winter_Testing.el_GYRO_Y /end MEASUREMENT
/begin MEASUREMENT VDC_Winter_Testing_U.el_GYRO_Z "" FLOAT64_IEEE VDC_Winter_Testing_CM_double 0 0 -1.7e+308 1.7e+308 ECU_ADDRESS 0x0 DISPLAY_IDENTIFIER VDC_Winter_Testing.el_GYRO_Z /end MEASUREMENT
/begin MEASUREMENT VDC_Winter_Testing_U.el_PITCH "" FLOAT64_IEEE VDC_Winter_Testing_CM_double 0 0 -1.7e+308 1.7e+308 ECU_ADDRESS 0x0 DISPLAY_IDENTIFIER VDC_Winter_Testing.el_PITCH /end MEASUREMENT
/begin MEASUREMENT VDC_Winter_Testing_U.el_ROLL "" FLOAT64_IEEE VDC_Winter_Testing_CM_double 0 0 -1.7e+308 1.7e+308 ECU_ADDRESS 0x0 DISPLAY_IDENTIFIER VDC_Winter_Testing.el_ROLL /end MEASUREMENT
/begin MEASUREMENT VDC_Winter_Testing_U.el_VEL "" FLOAT64_IEEE VDC_Winter_Testing_CM_double 0 0 -1.7e+308 1.7e+308 ECU_ADDRESS 0x0 DISPLAY_IDENTIFIER VDC_Winter_Testing.el_VEL /end MEASUREMENT
/begin MEASUREMENT VDC_Winter_Testing_U.el_YAW "" FLOAT64_IEEE VDC_Winter_Testing_CM_double 0 0 -1.7e+308 1.7e+308 ECU_ADDRESS 0x0 DISPLAY_IDENTIFIER VDC_Winter_Testing.el_YAW /end MEASUREMENT
/begin MEASUREMENT VDC_Winter_Testing_Y.APPS_Implausibility "" FLOAT64_IEEE VDC_Winter_Testing_CM_double 0 0 -1.7e+308 1.7e+308 ECU_ADDRESS 0x0 DISPLAY_IDENTIFIER VDC_Winter_Testing.APPS_Implausibility /end MEASUREMENT
/begin MEASUREMENT VDC_Winter_Testing_Y.BrakeLight_Control "" FLOAT64_IEEE VDC_Winter_Testing_CM_double 0 0 -1.7e+308 1.7e+308 ECU_ADDRESS 0x0 DISPLAY_IDENTIFIER VDC_Winter_Testing.BrakeLight_Control /end MEASUREMENT
/begin MEASUREMENT VDC_Winter_Testing_Y.Torque_L "" FLOAT64_IEEE VDC_Winter_Testing_CM_double 0 0 -1.7e+308 1.7e+308 ECU_ADDRESS 0x0 DISPLAY_IDENTIFIER VDC_Winter_Testing.Torque_L /end MEASUREMENT
/begin MEASUREMENT VDC_Winter_Testing_Y.Torque_OK "" FLOAT64_IEEE VDC_Winter_Testing_CM_double 0 0 -1.7e+308 1.7e+308 ECU_ADDRESS 0x0 DISPLAY_IDENTIFIER VDC_Winter_Testing.Torque_OK /end MEASUREMENT
/begin MEASUREMENT VDC_Winter_Testing_Y.Torque_R "" FLOAT64_IEEE VDC_Winter_Testing_CM_double 0 0 -1.7e+308 1.7e+308 ECU_ADDRESS 0x0 DISPLAY_IDENTIFIER VDC_Winter_Testing.Torque_R /end MEASUREMENT
/begin MEASUREMENT VDC_Winter_Testing_Y.VDC_Max_Tyre_Slip "" FLOAT64_IEEE VDC_Winter_Testing_CM_double 0 0 -1.7e+308 1.7e+308 ECU_ADDRESS 0x0 DISPLAY_IDENTIFIER VDC_Winter_Testing.VDC_Max_Tyre_Slip /end MEASUREMENT
/end MODULE
/* VDC_Winter_Testing */
/end PROJECT
