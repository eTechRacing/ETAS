ASAP2_VERSION
/begin PROJECT "Generated by ETAS from INTECRIO integration project"
/begin HEADER "" VERSION "" PROJECT_NO Y /end HEADER
/begin MODULE VDC "Generated by ETAS from INTECRIO integration project"
/begin MOD_PAR "" VERSION "" ADDR_EPK 0x0 EPK "" SUPPLIER "ETAS GmbH" CUSTOMER "" CUSTOMER_NO "" USER "" PHONE_NO "" ECU "NO_ECU" CPU_TYPE "MPC750" NO_OF_INTERFACES 1 /end MOD_PAR
/begin MOD_COMMON "Common definitions" BYTE_ORDER MSB_FIRST ALIGNMENT_BYTE 1 ALIGNMENT_WORD 2 ALIGNMENT_LONG 4 ALIGNMENT_FLOAT32_IEEE 4 ALIGNMENT_FLOAT64_IEEE 8 /end MOD_COMMON
/begin MEASUREMENT VDC_B.Merge1 "" FLOAT64_IEEE VDC_CM_double 0 0 -1.7e+308 1.7e+308 ECU_ADDRESS 0x0 DISPLAY_IDENTIFIER VDC.Merge1.Merge1 /end MEASUREMENT
/begin COMPU_METHOD VDC_CM_double "Q = V" /* ConversionType */ RAT_FUNC /* Format */ "%9.6" /* Unit */ "NO_PHYSICAL_QTY" COEFFS 0.0 1.0 0.0 0.0 0.0 1.0 /end COMPU_METHOD
/begin MEASUREMENT VDC_B.Merge2 "" FLOAT64_IEEE VDC_CM_double 0 0 -1.7e+308 1.7e+308 ECU_ADDRESS 0x0 DISPLAY_IDENTIFIER VDC.Merge2.Merge2 /end MEASUREMENT
/begin MEASUREMENT VDC_B.Merge3 "" FLOAT64_IEEE VDC_CM_double 0 0 -1.7e+308 1.7e+308 ECU_ADDRESS 0x0 DISPLAY_IDENTIFIER VDC.Merge3.Merge3 /end MEASUREMENT
/begin MEASUREMENT VDC_B.Merge4 "" FLOAT64_IEEE VDC_CM_double 0 0 -1.7e+308 1.7e+308 ECU_ADDRESS 0x0 DISPLAY_IDENTIFIER VDC.Merge4.Merge4 /end MEASUREMENT
/begin MEASUREMENT VDC_B.Merge6 "" FLOAT64_IEEE VDC_CM_double 0 0 -1.7e+308 1.7e+308 ECU_ADDRESS 0x0 DISPLAY_IDENTIFIER VDC.Merge6.Merge6 /end MEASUREMENT
/begin MEASUREMENT VDC_B.TC_Warning "" FLOAT64_IEEE VDC_CM_double 0 0 -1.7e+308 1.7e+308 ECU_ADDRESS 0x0 DISPLAY_IDENTIFIER VDC.ACCELERATION.RIGIDAXLE_WITH_TC.Rigid_Axle_with_TC_2024.TC_Warning /end MEASUREMENT
/begin MEASUREMENT VDC_B.TC_Warning_l "" FLOAT64_IEEE VDC_CM_double 0 0 -1.7e+308 1.7e+308 ECU_ADDRESS 0x0 DISPLAY_IDENTIFIER VDC.SKIDPAD.TC_TV.Rigid_Axle_with_TC_2024.TC_Warning /end MEASUREMENT
/begin MEASUREMENT VDC_B.sf_MATLABFunction.Torque_L_Nm "" FLOAT64_IEEE VDC_CM_double 0 0 -1.7e+308 1.7e+308 ECU_ADDRESS 0x0 DISPLAY_IDENTIFIER VDC.SKIDPAD.TC_TV.MATLAB_Function.Torque_L_Nm /end MEASUREMENT
/begin MEASUREMENT VDC_B.sf_MATLABFunction.Torque_R_Nm "" FLOAT64_IEEE VDC_CM_double 0 0 -1.7e+308 1.7e+308 ECU_ADDRESS 0x0 DISPLAY_IDENTIFIER VDC.SKIDPAD.TC_TV.MATLAB_Function.Torque_R_Nm /end MEASUREMENT
/begin MEASUREMENT VDC_B.sf_MATLABFunction_a.Torque_L_Nm "" FLOAT64_IEEE VDC_CM_double 0 0 -1.7e+308 1.7e+308 ECU_ADDRESS 0x0 DISPLAY_IDENTIFIER VDC.SKIDPAD.TV_with_TC_OFF.MATLAB_Function.Torque_L_Nm /end MEASUREMENT
/begin MEASUREMENT VDC_B.sf_MATLABFunction_a.Torque_R_Nm "" FLOAT64_IEEE VDC_CM_double 0 0 -1.7e+308 1.7e+308 ECU_ADDRESS 0x0 DISPLAY_IDENTIFIER VDC.SKIDPAD.TV_with_TC_OFF.MATLAB_Function.Torque_R_Nm /end MEASUREMENT
/begin MEASUREMENT VDC_B.sf_RigidAxlewithTC2024_c.Motor_Torque_RL "" FLOAT64_IEEE VDC_CM_double 0 0 -1.7e+308 1.7e+308 ECU_ADDRESS 0x0 DISPLAY_IDENTIFIER VDC.ENDURANCE.RIGIDAXLE_WITH_TC.Rigid_Axle_with_TC_2024.Motor_Torque_RL /end MEASUREMENT
/begin MEASUREMENT VDC_B.sf_RigidAxlewithTC2024_c.Motor_Torque_RR "" FLOAT64_IEEE VDC_CM_double 0 0 -1.7e+308 1.7e+308 ECU_ADDRESS 0x0 DISPLAY_IDENTIFIER VDC.ENDURANCE.RIGIDAXLE_WITH_TC.Rigid_Axle_with_TC_2024.Motor_Torque_RR /end MEASUREMENT
/begin MEASUREMENT VDC_B.sf_RigidAxlewithTC2024_c.TC_Warning "" FLOAT64_IEEE VDC_CM_double 0 0 -1.7e+308 1.7e+308 ECU_ADDRESS 0x0 DISPLAY_IDENTIFIER VDC.ENDURANCE.RIGIDAXLE_WITH_TC.Rigid_Axle_with_TC_2024.TC_Warning /end MEASUREMENT
/begin MEASUREMENT VDC_B.sf_RigidAxlewithTC2024_p2.Motor_Torque_RL "" FLOAT64_IEEE VDC_CM_double 0 0 -1.7e+308 1.7e+308 ECU_ADDRESS 0x0 DISPLAY_IDENTIFIER VDC.AUTOX1.RIGIDAXLE_WITH_TC.Rigid_Axle_with_TC_2024.Motor_Torque_RL /end MEASUREMENT
/begin MEASUREMENT VDC_B.sf_RigidAxlewithTC2024_p2.Motor_Torque_RR "" FLOAT64_IEEE VDC_CM_double 0 0 -1.7e+308 1.7e+308 ECU_ADDRESS 0x0 DISPLAY_IDENTIFIER VDC.AUTOX1.RIGIDAXLE_WITH_TC.Rigid_Axle_with_TC_2024.Motor_Torque_RR /end MEASUREMENT
/begin MEASUREMENT VDC_B.sf_RigidAxlewithTC2024_p2.TC_Warning "" FLOAT64_IEEE VDC_CM_double 0 0 -1.7e+308 1.7e+308 ECU_ADDRESS 0x0 DISPLAY_IDENTIFIER VDC.AUTOX1.RIGIDAXLE_WITH_TC.Rigid_Axle_with_TC_2024.TC_Warning /end MEASUREMENT
/begin MEASUREMENT VDC_B.sf_Torquedemandedbythedriver_a.Throttle_Torque "" FLOAT64_IEEE VDC_CM_double 0 0 -1.7e+308 1.7e+308 ECU_ADDRESS 0x0 DISPLAY_IDENTIFIER VDC.AUTOX1.Torque_demanded_by_the_driver.Throttle_Torque /end MEASUREMENT
/begin MEASUREMENT VDC_B.sf_Torquedemandedbythedriver_k.Throttle_Torque "" FLOAT64_IEEE VDC_CM_double 0 0 -1.7e+308 1.7e+308 ECU_ADDRESS 0x0 DISPLAY_IDENTIFIER VDC.ACCELERATION.Torque_demanded_by_the_driver.Throttle_Torque /end MEASUREMENT
/begin MEASUREMENT VDC_B.sf_Torquedemandedbythedriver_m.Throttle_Torque "" FLOAT64_IEEE VDC_CM_double 0 0 -1.7e+308 1.7e+308 ECU_ADDRESS 0x0 DISPLAY_IDENTIFIER VDC.SKIDPAD.Torque_demanded_by_the_driver.Throttle_Torque /end MEASUREMENT
/begin MEASUREMENT VDC_B.state "" FLOAT64_IEEE VDC_CM_double 0 0 -1.7e+308 1.7e+308 ECU_ADDRESS 0x0 DISPLAY_IDENTIFIER VDC.ENDURANCE.Torque.state.state /end MEASUREMENT
/begin MEASUREMENT VDC_DW.ERROR_Counter "" FLOAT64_IEEE VDC_CM_double 0 0 -1.7e+308 1.7e+308 ECU_ADDRESS 0x0 DISPLAY_IDENTIFIER VDC.SAFETY_BLOCK.APPS_IMPLAUSIBILITY.Data_Store_Memory1.ERROR_Counter /end MEASUREMENT
/begin MEASUREMENT VDC_U.APPS1_Value "" FLOAT64_IEEE VDC_CM_double 0 0 -1.7e+308 1.7e+308 ECU_ADDRESS 0x0 DISPLAY_IDENTIFIER VDC.APPS1_Value /end MEASUREMENT
/begin MEASUREMENT VDC_U.APPS2_Value "" FLOAT64_IEEE VDC_CM_double 0 0 -1.7e+308 1.7e+308 ECU_ADDRESS 0x0 DISPLAY_IDENTIFIER VDC.APPS2_Value /end MEASUREMENT
/begin MEASUREMENT VDC_U.Accumulator_Voltage "" FLOAT64_IEEE VDC_CM_double 0 0 -1.7e+308 1.7e+308 ECU_ADDRESS 0x0 DISPLAY_IDENTIFIER VDC.Accumulator_Voltage /end MEASUREMENT
/begin MEASUREMENT VDC_U.BrakePedal_Value "" FLOAT64_IEEE VDC_CM_double 0 0 -1.7e+308 1.7e+308 ECU_ADDRESS 0x0 DISPLAY_IDENTIFIER VDC.BrakePedal_Value /end MEASUREMENT
/begin MEASUREMENT VDC_U.Car_State "" FLOAT64_IEEE VDC_CM_double 0 0 -1.7e+308 1.7e+308 ECU_ADDRESS 0x0 DISPLAY_IDENTIFIER VDC.Car_State /end MEASUREMENT
/begin MEASUREMENT VDC_U.CriticalDisconnection "" UBYTE VDC_CM_boolean 0 0 0 1 ECU_ADDRESS 0x0 DISPLAY_IDENTIFIER VDC.CriticalDisconnection /end MEASUREMENT
/begin COMPU_METHOD VDC_CM_boolean "Q = V" /* ConversionType */ RAT_FUNC /* Format */ "%9.6" /* Unit */ "NO_PHYSICAL_QTY" COEFFS 0.0 1.0 0.0 0.0 0.0 1.0 /end COMPU_METHOD
/begin MEASUREMENT VDC_U.Disconnection_Mode "" FLOAT64_IEEE VDC_CM_double 0 0 -1.7e+308 1.7e+308 ECU_ADDRESS 0x0 DISPLAY_IDENTIFIER VDC.Disconnection_Mode /end MEASUREMENT
/begin MEASUREMENT VDC_U.RL_Vel_ms_Wheel "" FLOAT64_IEEE VDC_CM_double 0 0 -1.7e+308 1.7e+308 ECU_ADDRESS 0x0 DISPLAY_IDENTIFIER VDC.RL_Vel_ms_Wheel /end MEASUREMENT
/begin MEASUREMENT VDC_U.RL_rads_Motor "" FLOAT64_IEEE VDC_CM_double 0 0 -1.7e+308 1.7e+308 ECU_ADDRESS 0x0 DISPLAY_IDENTIFIER VDC.RL_rads_Motor /end MEASUREMENT
/begin MEASUREMENT VDC_U.RR_Vel_ms_Wheel "" FLOAT64_IEEE VDC_CM_double 0 0 -1.7e+308 1.7e+308 ECU_ADDRESS 0x0 DISPLAY_IDENTIFIER VDC.RR_Vel_ms_Wheel /end MEASUREMENT
/begin MEASUREMENT VDC_U.RR_rads_Motor "" FLOAT64_IEEE VDC_CM_double 0 0 -1.7e+308 1.7e+308 ECU_ADDRESS 0x0 DISPLAY_IDENTIFIER VDC.RR_rads_Motor /end MEASUREMENT
/begin MEASUREMENT VDC_U.RacingMode "" FLOAT64_IEEE VDC_CM_double 0 0 -1.7e+308 1.7e+308 ECU_ADDRESS 0x0 DISPLAY_IDENTIFIER VDC.RacingMode /end MEASUREMENT
/begin MEASUREMENT VDC_U.Shutdown_PackageIntck "" UBYTE VDC_CM_boolean 0 0 0 1 ECU_ADDRESS 0x0 DISPLAY_IDENTIFIER VDC.Shutdown_PackageIntck /end MEASUREMENT
/begin MEASUREMENT VDC_U.SteeringSensor_Value "" FLOAT64_IEEE VDC_CM_double 0 0 -1.7e+308 1.7e+308 ECU_ADDRESS 0x0 DISPLAY_IDENTIFIER VDC.SteeringSensor_Value /end MEASUREMENT
/begin MEASUREMENT VDC_U.Susp_F_L "" FLOAT64_IEEE VDC_CM_double 0 0 -1.7e+308 1.7e+308 ECU_ADDRESS 0x0 DISPLAY_IDENTIFIER VDC.Susp_F_L /end MEASUREMENT
/begin MEASUREMENT VDC_U.Susp_F_R "" FLOAT64_IEEE VDC_CM_double 0 0 -1.7e+308 1.7e+308 ECU_ADDRESS 0x0 DISPLAY_IDENTIFIER VDC.Susp_F_R /end MEASUREMENT
/begin MEASUREMENT VDC_U.Susp_R_L "" FLOAT64_IEEE VDC_CM_double 0 0 -1.7e+308 1.7e+308 ECU_ADDRESS 0x0 DISPLAY_IDENTIFIER VDC.Susp_R_L /end MEASUREMENT
/begin MEASUREMENT VDC_U.Susp_R_R "" FLOAT64_IEEE VDC_CM_double 0 0 -1.7e+308 1.7e+308 ECU_ADDRESS 0x0 DISPLAY_IDENTIFIER VDC.Susp_R_R /end MEASUREMENT
/begin MEASUREMENT VDC_U.TorqueEnable "" UBYTE VDC_CM_boolean 0 0 0 1 ECU_ADDRESS 0x0 DISPLAY_IDENTIFIER VDC.TorqueEnable /end MEASUREMENT
/begin MEASUREMENT VDC_U.el_ACCEL_X "" FLOAT64_IEEE VDC_CM_double 0 0 -1.7e+308 1.7e+308 ECU_ADDRESS 0x0 DISPLAY_IDENTIFIER VDC.el_ACCEL_X /end MEASUREMENT
/begin MEASUREMENT VDC_U.el_ACCEL_Y "" FLOAT64_IEEE VDC_CM_double 0 0 -1.7e+308 1.7e+308 ECU_ADDRESS 0x0 DISPLAY_IDENTIFIER VDC.el_ACCEL_Y /end MEASUREMENT
/begin MEASUREMENT VDC_U.el_ACCEL_Z "" FLOAT64_IEEE VDC_CM_double 0 0 -1.7e+308 1.7e+308 ECU_ADDRESS 0x0 DISPLAY_IDENTIFIER VDC.el_ACCEL_Z /end MEASUREMENT
/begin MEASUREMENT VDC_U.el_GYRO_X "" FLOAT64_IEEE VDC_CM_double 0 0 -1.7e+308 1.7e+308 ECU_ADDRESS 0x0 DISPLAY_IDENTIFIER VDC.el_GYRO_X /end MEASUREMENT
/begin MEASUREMENT VDC_U.el_GYRO_Y "" FLOAT64_IEEE VDC_CM_double 0 0 -1.7e+308 1.7e+308 ECU_ADDRESS 0x0 DISPLAY_IDENTIFIER VDC.el_GYRO_Y /end MEASUREMENT
/begin MEASUREMENT VDC_U.el_GYRO_Z "" FLOAT64_IEEE VDC_CM_double 0 0 -1.7e+308 1.7e+308 ECU_ADDRESS 0x0 DISPLAY_IDENTIFIER VDC.el_GYRO_Z /end MEASUREMENT
/begin MEASUREMENT VDC_U.el_PITCH "" FLOAT64_IEEE VDC_CM_double 0 0 -1.7e+308 1.7e+308 ECU_ADDRESS 0x0 DISPLAY_IDENTIFIER VDC.el_PITCH /end MEASUREMENT
/begin MEASUREMENT VDC_U.el_ROLL "" FLOAT64_IEEE VDC_CM_double 0 0 -1.7e+308 1.7e+308 ECU_ADDRESS 0x0 DISPLAY_IDENTIFIER VDC.el_ROLL /end MEASUREMENT
/begin MEASUREMENT VDC_U.el_VEL "" FLOAT64_IEEE VDC_CM_double 0 0 -1.7e+308 1.7e+308 ECU_ADDRESS 0x0 DISPLAY_IDENTIFIER VDC.el_VEL /end MEASUREMENT
/begin MEASUREMENT VDC_U.el_YAW "" FLOAT64_IEEE VDC_CM_double 0 0 -1.7e+308 1.7e+308 ECU_ADDRESS 0x0 DISPLAY_IDENTIFIER VDC.el_YAW /end MEASUREMENT
/begin MEASUREMENT VDC_Y.APPS_Implausibility "" FLOAT64_IEEE VDC_CM_double 0 0 -1.7e+308 1.7e+308 ECU_ADDRESS 0x0 DISPLAY_IDENTIFIER VDC.APPS_Implausibility /end MEASUREMENT
/begin MEASUREMENT VDC_Y.BrakeLight_Control "" FLOAT64_IEEE VDC_CM_double 0 0 -1.7e+308 1.7e+308 ECU_ADDRESS 0x0 DISPLAY_IDENTIFIER VDC.BrakeLight_Control /end MEASUREMENT
/begin MEASUREMENT VDC_Y.Regenerative_Enable "" FLOAT64_IEEE VDC_CM_double 0 0 -1.7e+308 1.7e+308 ECU_ADDRESS 0x0 DISPLAY_IDENTIFIER VDC.Regenerative_Enable /end MEASUREMENT
/begin MEASUREMENT VDC_Y.Sensorics_Mode "" FLOAT64_IEEE VDC_CM_double 0 0 -1.7e+308 1.7e+308 ECU_ADDRESS 0x0 DISPLAY_IDENTIFIER VDC.Sensorics_Mode /end MEASUREMENT
/begin MEASUREMENT VDC_Y.TC_Warning "" FLOAT64_IEEE VDC_CM_double 0 0 -1.7e+308 1.7e+308 ECU_ADDRESS 0x0 DISPLAY_IDENTIFIER VDC.TC_Warning /end MEASUREMENT
/begin MEASUREMENT VDC_Y.Throttle_Torque "" FLOAT64_IEEE VDC_CM_double 0 0 -1.7e+308 1.7e+308 ECU_ADDRESS 0x0 DISPLAY_IDENTIFIER VDC.Throttle_Torque /end MEASUREMENT
/begin MEASUREMENT VDC_Y.Torque_L "" FLOAT64_IEEE VDC_CM_double 0 0 -1.7e+308 1.7e+308 ECU_ADDRESS 0x0 DISPLAY_IDENTIFIER VDC.Torque_L /end MEASUREMENT
/begin MEASUREMENT VDC_Y.Torque_OK "" FLOAT64_IEEE VDC_CM_double 0 0 -1.7e+308 1.7e+308 ECU_ADDRESS 0x0 DISPLAY_IDENTIFIER VDC.Torque_OK /end MEASUREMENT
/begin MEASUREMENT VDC_Y.Torque_R "" FLOAT64_IEEE VDC_CM_double 0 0 -1.7e+308 1.7e+308 ECU_ADDRESS 0x0 DISPLAY_IDENTIFIER VDC.Torque_R /end MEASUREMENT
/begin MEASUREMENT VDC_Y.VDC_Max_Tyre_Slip "" FLOAT64_IEEE VDC_CM_double 0 0 -1.7e+308 1.7e+308 ECU_ADDRESS 0x0 DISPLAY_IDENTIFIER VDC.VDC_Max_Tyre_Slip /end MEASUREMENT
/end MODULE
/* VDC */
/end PROJECT
