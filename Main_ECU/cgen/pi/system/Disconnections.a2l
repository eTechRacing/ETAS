ASAP2_VERSION
/begin PROJECT "Generated by ETAS from INTECRIO integration project"
/begin HEADER "" VERSION "" PROJECT_NO Y /end HEADER
/begin MODULE Disconnections "Generated by ETAS from INTECRIO integration project"
/begin MOD_PAR "" VERSION "" ADDR_EPK 0x0 EPK "" SUPPLIER "ETAS GmbH" CUSTOMER "" CUSTOMER_NO "" USER "" PHONE_NO "" ECU "NO_ECU" CPU_TYPE "MPC750" NO_OF_INTERFACES 1 /end MOD_PAR
/begin MOD_COMMON "Common definitions" BYTE_ORDER MSB_FIRST ALIGNMENT_BYTE 1 ALIGNMENT_WORD 2 ALIGNMENT_LONG 4 ALIGNMENT_FLOAT32_IEEE 4 ALIGNMENT_FLOAT64_IEEE 8 /end MOD_COMMON
/begin MEASUREMENT Disconnections_B.Merge "" FLOAT64_IEEE Disconnections_CM_double 0 0 -1.7e+308 1.7e+308 ECU_ADDRESS 0x0 DISPLAY_IDENTIFIER Disconnections.ECU_Disconections.LifeCheck_BMS.Merge.Merge /end MEASUREMENT
/begin COMPU_METHOD Disconnections_CM_double "Q = V" RAT_FUNC "%9.6" "NO_PHYSICAL_QTY" COEFFS 0.0 1.0 0.0 0.0 0.0 1.0 /end COMPU_METHOD
/begin MEASUREMENT Disconnections_B.Merge_b "" FLOAT64_IEEE Disconnections_CM_double 0 0 -1.7e+308 1.7e+308 ECU_ADDRESS 0x0 DISPLAY_IDENTIFIER Disconnections.ECU_Disconections.LifeCheck_AccFront.Merge.Merge_b /end MEASUREMENT
/begin MEASUREMENT Disconnections_B.Merge_d "" FLOAT64_IEEE Disconnections_CM_double 0 0 -1.7e+308 1.7e+308 ECU_ADDRESS 0x0 DISPLAY_IDENTIFIER Disconnections.ECU_Disconections.LifeCheck_AccRear.Merge.Merge_d /end MEASUREMENT
/begin MEASUREMENT Disconnections_B.Merge_f "" FLOAT64_IEEE Disconnections_CM_double 0 0 -1.7e+308 1.7e+308 ECU_ADDRESS 0x0 DISPLAY_IDENTIFIER Disconnections.ECU_Disconections.Life_check4.Merge.Merge_f /end MEASUREMENT
/begin MEASUREMENT Disconnections_B.Merge_h "" FLOAT64_IEEE Disconnections_CM_double 0 0 -1.7e+308 1.7e+308 ECU_ADDRESS 0x0 DISPLAY_IDENTIFIER Disconnections.ECU_Disconections.LifeCheck_Dash.Merge.Merge_h /end MEASUREMENT
/begin MEASUREMENT Disconnections_DW.A "" FLOAT64_IEEE Disconnections_CM_double 0 0 -1.7e+308 1.7e+308 ECU_ADDRESS 0x0 DISPLAY_IDENTIFIER Disconnections.Counter.Data_Store_Memory.A /end MEASUREMENT
/begin MEASUREMENT Disconnections_DW.Last_alive "" FLOAT64_IEEE Disconnections_CM_double 0 0 -1.7e+308 1.7e+308 ECU_ADDRESS 0x0 DISPLAY_IDENTIFIER Disconnections.Pedal_Box_Disconnections__Noise_.Life_check3.Data_Store_Memory.Last_alive /end MEASUREMENT
/begin MEASUREMENT Disconnections_DW.Last_alive_a "" FLOAT64_IEEE Disconnections_CM_double 0 0 -1.7e+308 1.7e+308 ECU_ADDRESS 0x0 DISPLAY_IDENTIFIER Disconnections.ECU_Disconections.LifeCheck_AccFront.Data_Store_Memory.Last_alive_a /end MEASUREMENT
/begin MEASUREMENT Disconnections_DW.Last_alive_c "" FLOAT64_IEEE Disconnections_CM_double 0 0 -1.7e+308 1.7e+308 ECU_ADDRESS 0x0 DISPLAY_IDENTIFIER Disconnections.Pedal_Box_Disconnections__Noise_.Life_check2.Data_Store_Memory.Last_alive_c /end MEASUREMENT
/begin MEASUREMENT Disconnections_DW.Last_alive_c0 "" FLOAT64_IEEE Disconnections_CM_double 0 0 -1.7e+308 1.7e+308 ECU_ADDRESS 0x0 DISPLAY_IDENTIFIER Disconnections.ECU_Disconections.LifeCheck_BMS.Data_Store_Memory.Last_alive_c0 /end MEASUREMENT
/begin MEASUREMENT Disconnections_DW.Last_alive_g "" FLOAT64_IEEE Disconnections_CM_double 0 0 -1.7e+308 1.7e+308 ECU_ADDRESS 0x0 DISPLAY_IDENTIFIER Disconnections.Pedal_Box_Disconnections__Noise_.Life_check1.Data_Store_Memory.Last_alive_g /end MEASUREMENT
/begin MEASUREMENT Disconnections_DW.Last_alive_gx "" FLOAT64_IEEE Disconnections_CM_double 0 0 -1.7e+308 1.7e+308 ECU_ADDRESS 0x0 DISPLAY_IDENTIFIER Disconnections.ECU_Disconections.LifeCheck_AccRear.Data_Store_Memory.Last_alive_gx /end MEASUREMENT
/begin MEASUREMENT Disconnections_DW.Last_alive_j "" FLOAT64_IEEE Disconnections_CM_double 0 0 -1.7e+308 1.7e+308 ECU_ADDRESS 0x0 DISPLAY_IDENTIFIER Disconnections.ECU_Disconections.Life_check4.Data_Store_Memory.Last_alive_j /end MEASUREMENT
/begin MEASUREMENT Disconnections_DW.Last_alive_o "" FLOAT64_IEEE Disconnections_CM_double 0 0 -1.7e+308 1.7e+308 ECU_ADDRESS 0x0 DISPLAY_IDENTIFIER Disconnections.ECU_Disconections.LifeCheck_Dash.Data_Store_Memory.Last_alive_o /end MEASUREMENT
/begin MEASUREMENT Disconnections_DW.Tot_Errors "" FLOAT64_IEEE Disconnections_CM_double 0 0 -1.7e+308 1.7e+308 ECU_ADDRESS 0x0 DISPLAY_IDENTIFIER Disconnections.Pedal_Box_Disconnections__Noise_.Life_check3.Data_Store_Memory1.Tot_Errors /end MEASUREMENT
/begin MEASUREMENT Disconnections_DW.Tot_Errors_j "" FLOAT64_IEEE Disconnections_CM_double 0 0 -1.7e+308 1.7e+308 ECU_ADDRESS 0x0 DISPLAY_IDENTIFIER Disconnections.Pedal_Box_Disconnections__Noise_.Life_check2.Data_Store_Memory1.Tot_Errors_j /end MEASUREMENT
/begin MEASUREMENT Disconnections_DW.Tot_Errors_k "" FLOAT64_IEEE Disconnections_CM_double 0 0 -1.7e+308 1.7e+308 ECU_ADDRESS 0x0 DISPLAY_IDENTIFIER Disconnections.Pedal_Box_Disconnections__Noise_.Life_check1.Data_Store_Memory1.Tot_Errors_k /end MEASUREMENT
/begin MEASUREMENT Disconnections_U.APPS1_Bits "" FLOAT64_IEEE Disconnections_CM_double 0 0 -1.7e+308 1.7e+308 ECU_ADDRESS 0x0 DISPLAY_IDENTIFIER Disconnections.APPS1_Bits /end MEASUREMENT
/begin MEASUREMENT Disconnections_U.APPS2_Bits "" FLOAT64_IEEE Disconnections_CM_double 0 0 -1.7e+308 1.7e+308 ECU_ADDRESS 0x0 DISPLAY_IDENTIFIER Disconnections.APPS2_Bits /end MEASUREMENT
/begin MEASUREMENT Disconnections_U.BMS_Alive "" FLOAT64_IEEE Disconnections_CM_double 0 0 -1.7e+308 1.7e+308 ECU_ADDRESS 0x0 DISPLAY_IDENTIFIER Disconnections.BMS_Alive /end MEASUREMENT
/begin MEASUREMENT Disconnections_U.BrakeSensor_Bits "" FLOAT64_IEEE Disconnections_CM_double 0 0 -1.7e+308 1.7e+308 ECU_ADDRESS 0x0 DISPLAY_IDENTIFIER Disconnections.BrakeSensor_Bits /end MEASUREMENT
/begin MEASUREMENT Disconnections_U.Dash_Alive "" FLOAT64_IEEE Disconnections_CM_double 0 0 -1.7e+308 1.7e+308 ECU_ADDRESS 0x0 DISPLAY_IDENTIFIER Disconnections.Dash_Alive /end MEASUREMENT
/begin MEASUREMENT Disconnections_U.Ellipse_Alive "" FLOAT64_IEEE Disconnections_CM_double 0 0 -1.7e+308 1.7e+308 ECU_ADDRESS 0x0 DISPLAY_IDENTIFIER Disconnections.Ellipse_Alive /end MEASUREMENT
/begin MEASUREMENT Disconnections_U.Front_Alive "" FLOAT64_IEEE Disconnections_CM_double 0 0 -1.7e+308 1.7e+308 ECU_ADDRESS 0x0 DISPLAY_IDENTIFIER Disconnections.Front_Alive /end MEASUREMENT
/begin MEASUREMENT Disconnections_U.Rear_Alive "" FLOAT64_IEEE Disconnections_CM_double 0 0 -1.7e+308 1.7e+308 ECU_ADDRESS 0x0 DISPLAY_IDENTIFIER Disconnections.Rear_Alive /end MEASUREMENT
/begin MEASUREMENT Disconnections_U.SteeringSensor_Bits "" FLOAT64_IEEE Disconnections_CM_double 0 0 -1.7e+308 1.7e+308 ECU_ADDRESS 0x0 DISPLAY_IDENTIFIER Disconnections.SteeringSensor_Bits /end MEASUREMENT
/begin MEASUREMENT Disconnections_U.Susp_F_L_Bits "" FLOAT64_IEEE Disconnections_CM_double 0 0 -1.7e+308 1.7e+308 ECU_ADDRESS 0x0 DISPLAY_IDENTIFIER Disconnections.Susp_F_L_Bits /end MEASUREMENT
/begin MEASUREMENT Disconnections_U.Susp_F_R_Bits "" FLOAT64_IEEE Disconnections_CM_double 0 0 -1.7e+308 1.7e+308 ECU_ADDRESS 0x0 DISPLAY_IDENTIFIER Disconnections.Susp_F_R_Bits /end MEASUREMENT
/begin MEASUREMENT Disconnections_U.Susp_R_L_Bits "" FLOAT64_IEEE Disconnections_CM_double 0 0 -1.7e+308 1.7e+308 ECU_ADDRESS 0x0 DISPLAY_IDENTIFIER Disconnections.Susp_R_L_Bits /end MEASUREMENT
/begin MEASUREMENT Disconnections_U.Susp_R_R_Bits "" FLOAT64_IEEE Disconnections_CM_double 0 0 -1.7e+308 1.7e+308 ECU_ADDRESS 0x0 DISPLAY_IDENTIFIER Disconnections.Susp_R_R_Bits /end MEASUREMENT
/begin MEASUREMENT Disconnections_Y.CounterOut "" FLOAT64_IEEE Disconnections_CM_double 0 0 -1.7e+308 1.7e+308 ECU_ADDRESS 0x0 DISPLAY_IDENTIFIER Disconnections.CounterOut /end MEASUREMENT
/begin MEASUREMENT Disconnections_Y.CriticalDisconnection "" UBYTE Disconnections_CM_boolean 0 0 0 1 ECU_ADDRESS 0x0 DISPLAY_IDENTIFIER Disconnections.CriticalDisconnection /end MEASUREMENT
/begin COMPU_METHOD Disconnections_CM_boolean "Q = V" RAT_FUNC "%9.6" "NO_PHYSICAL_QTY" COEFFS 0.0 1.0 0.0 0.0 0.0 1.0 /end COMPU_METHOD
/begin MEASUREMENT Disconnections_Y.Critical_CAN_Disconnection "" UBYTE Disconnections_CM_boolean 0 0 0 1 ECU_ADDRESS 0x0 DISPLAY_IDENTIFIER Disconnections.Critical_CAN_Disconnection /end MEASUREMENT
/begin MEASUREMENT Disconnections_Y.Critical_Signal_Disconnection "" UBYTE Disconnections_CM_boolean 0 0 0 1 ECU_ADDRESS 0x0 DISPLAY_IDENTIFIER Disconnections.Critical_Signal_Disconnection /end MEASUREMENT
/begin MEASUREMENT Disconnections_Y.Disconnection_APPS1 "" FLOAT64_IEEE Disconnections_CM_double 0 0 -1.7e+308 1.7e+308 ECU_ADDRESS 0x0 DISPLAY_IDENTIFIER Disconnections.Disconnection_APPS1 /end MEASUREMENT
/begin MEASUREMENT Disconnections_Y.Disconnection_APPS2 "" FLOAT64_IEEE Disconnections_CM_double 0 0 -1.7e+308 1.7e+308 ECU_ADDRESS 0x0 DISPLAY_IDENTIFIER Disconnections.Disconnection_APPS2 /end MEASUREMENT
/begin MEASUREMENT Disconnections_Y.Disconnection_BMS "" FLOAT64_IEEE Disconnections_CM_double 0 0 -1.7e+308 1.7e+308 ECU_ADDRESS 0x0 DISPLAY_IDENTIFIER Disconnections.Disconnection_BMS /end MEASUREMENT
/begin MEASUREMENT Disconnections_Y.Disconnection_Brake_Sensor "" FLOAT64_IEEE Disconnections_CM_double 0 0 -1.7e+308 1.7e+308 ECU_ADDRESS 0x0 DISPLAY_IDENTIFIER Disconnections.Disconnection_Brake_Sensor /end MEASUREMENT
/begin MEASUREMENT Disconnections_Y.Disconnection_DashBoard "" FLOAT64_IEEE Disconnections_CM_double 0 0 -1.7e+308 1.7e+308 ECU_ADDRESS 0x0 DISPLAY_IDENTIFIER Disconnections.Disconnection_DashBoard /end MEASUREMENT
/begin MEASUREMENT Disconnections_Y.Disconnection_Ellipse "" FLOAT64_IEEE Disconnections_CM_double 0 0 -1.7e+308 1.7e+308 ECU_ADDRESS 0x0 DISPLAY_IDENTIFIER Disconnections.Disconnection_Ellipse /end MEASUREMENT
/begin MEASUREMENT Disconnections_Y.Disconnection_Front "" FLOAT64_IEEE Disconnections_CM_double 0 0 -1.7e+308 1.7e+308 ECU_ADDRESS 0x0 DISPLAY_IDENTIFIER Disconnections.Disconnection_Front /end MEASUREMENT
/begin MEASUREMENT Disconnections_Y.Disconnection_Rear "" FLOAT64_IEEE Disconnections_CM_double 0 0 -1.7e+308 1.7e+308 ECU_ADDRESS 0x0 DISPLAY_IDENTIFIER Disconnections.Disconnection_Rear /end MEASUREMENT
/begin MEASUREMENT Disconnections_Y.Disconnection_SteeringSensor "" UBYTE Disconnections_CM_uint8 0 0 0.0 255.0 ECU_ADDRESS 0x0 DISPLAY_IDENTIFIER Disconnections.Disconnection_SteeringSensor /end MEASUREMENT
/begin COMPU_METHOD Disconnections_CM_uint8 "Q = V" RAT_FUNC "%9.6" "NO_PHYSICAL_QTY" COEFFS 0.0 1.0 0.0 0.0 0.0 1.0 /end COMPU_METHOD
/begin MEASUREMENT Disconnections_Y.Disconnection_Susp_F_L "" UBYTE Disconnections_CM_uint8 0 0 0.0 255.0 ECU_ADDRESS 0x0 DISPLAY_IDENTIFIER Disconnections.Disconnection_Susp_F_L /end MEASUREMENT
/begin MEASUREMENT Disconnections_Y.Disconnection_Susp_F_R "" UBYTE Disconnections_CM_uint8 0 0 0.0 255.0 ECU_ADDRESS 0x0 DISPLAY_IDENTIFIER Disconnections.Disconnection_Susp_F_R /end MEASUREMENT
/begin MEASUREMENT Disconnections_Y.Disconnection_Susp_R_L "" UBYTE Disconnections_CM_uint8 0 0 0.0 255.0 ECU_ADDRESS 0x0 DISPLAY_IDENTIFIER Disconnections.Disconnection_Susp_R_L /end MEASUREMENT
/begin MEASUREMENT Disconnections_Y.Disconnection_Susp_R_R "" UBYTE Disconnections_CM_uint8 0 0 0.0 255.0 ECU_ADDRESS 0x0 DISPLAY_IDENTIFIER Disconnections.Disconnection_Susp_R_R /end MEASUREMENT
/begin MEASUREMENT Disconnections_Y.TV_mode "" FLOAT64_IEEE Disconnections_CM_double 0 0 -1.7e+308 1.7e+308 ECU_ADDRESS 0x0 DISPLAY_IDENTIFIER Disconnections.TV_mode /end MEASUREMENT
/end MODULE
/* Disconnections */
/end PROJECT
