ASAP2_VERSION
/begin PROJECT "Generated by ETAS from INTECRIO integration project"
/begin HEADER "" VERSION "" PROJECT_NO Y /end HEADER
/begin MODULE Disconnections "Generated by ETAS from INTECRIO integration project"
/begin MOD_PAR "" VERSION "" ADDR_EPK 0x0 EPK "" SUPPLIER "ETAS GmbH" CUSTOMER "" CUSTOMER_NO "" USER "" PHONE_NO "" ECU "NO_ECU" CPU_TYPE "MPC750" NO_OF_INTERFACES 1 /end MOD_PAR
/begin MOD_COMMON "Common definitions" BYTE_ORDER MSB_FIRST ALIGNMENT_BYTE 1 ALIGNMENT_WORD 2 ALIGNMENT_LONG 4 ALIGNMENT_FLOAT32_IEEE 4 ALIGNMENT_FLOAT64_IEEE 8 /end MOD_COMMON
/begin MEASUREMENT Disconnections_B.Merge "" FLOAT64_IEEE Disconnections_CM_double 0 0 -1.7e+308 1.7e+308 ECU_ADDRESS 0x0 DISPLAY_IDENTIFIER Disconnections.ECU_Disconections.LifeCheck_BMS.Merge.Merge /end MEASUREMENT
/begin COMPU_METHOD Disconnections_CM_double "Q = V" RAT_FUNC "%9.6" "NO_PHYSICAL_QTY" COEFFS 0.0 1.0 0.0 0.0 0.0 1.0 /end COMPU_METHOD
/begin MEASUREMENT Disconnections_B.Merge_b "" FLOAT64_IEEE Disconnections_CM_double 0 0 -1.7e+308 1.7e+308 ECU_ADDRESS 0x0 DISPLAY_IDENTIFIER Disconnections.ECU_Disconections.LifeCheck_AccFront.Merge.Merge_b /end MEASUREMENT
/begin MEASUREMENT Disconnections_B.Merge_d "" FLOAT64_IEEE Disconnections_CM_double 0 0 -1.7e+308 1.7e+308 ECU_ADDRESS 0x0 DISPLAY_IDENTIFIER Disconnections.ECU_Disconections.LifeCheck_AccRear.Merge.Merge_d /end MEASUREMENT
/begin MEASUREMENT Disconnections_B.Merge_f "" FLOAT64_IEEE Disconnections_CM_double 0 0 -1.7e+308 1.7e+308 ECU_ADDRESS 0x0 DISPLAY_IDENTIFIER Disconnections.ECU_Disconections.Life_check4.Merge.Merge_f /end MEASUREMENT
/begin MEASUREMENT Disconnections_B.Merge_h "" FLOAT64_IEEE Disconnections_CM_double 0 0 -1.7e+308 1.7e+308 ECU_ADDRESS 0x0 DISPLAY_IDENTIFIER Disconnections.ECU_Disconections.LifeCheck_Dash.Merge.Merge_h /end MEASUREMENT
/begin MEASUREMENT Disconnections_B.Merge_he "" FLOAT64_IEEE Disconnections_CM_double 0 0 -1.7e+308 1.7e+308 ECU_ADDRESS 0x0 DISPLAY_IDENTIFIER Disconnections.ECU_Disconections.LifeCheck_ADCAN.Merge.Merge_he /end MEASUREMENT
/begin MEASUREMENT Disconnections_B.Merge_j "" FLOAT64_IEEE Disconnections_CM_double 0 0 -1.7e+308 1.7e+308 ECU_ADDRESS 0x0 DISPLAY_IDENTIFIER Disconnections.ECU_Disconections.LifeCheck_Shutdown.Merge.Merge_j /end MEASUREMENT
/begin MEASUREMENT Disconnections_DW.A "" FLOAT64_IEEE Disconnections_CM_double 0 0 -1.7e+308 1.7e+308 ECU_ADDRESS 0x0 DISPLAY_IDENTIFIER Disconnections.Counter.Data_Store_Memory.A /end MEASUREMENT
/begin MEASUREMENT Disconnections_DW.Last_alive "" FLOAT64_IEEE Disconnections_CM_double 0 0 -1.7e+308 1.7e+308 ECU_ADDRESS 0x0 DISPLAY_IDENTIFIER Disconnections.Pedal_Box_Disconnections__Noise_.Life_check3.Data_Store_Memory.Last_alive /end MEASUREMENT
/begin MEASUREMENT Disconnections_DW.Last_alive_a "" FLOAT64_IEEE Disconnections_CM_double 0 0 -1.7e+308 1.7e+308 ECU_ADDRESS 0x0 DISPLAY_IDENTIFIER Disconnections.ECU_Disconections.LifeCheck_AccFront.Data_Store_Memory.Last_alive_a /end MEASUREMENT
/begin MEASUREMENT Disconnections_DW.Last_alive_ar "" FLOAT64_IEEE Disconnections_CM_double 0 0 -1.7e+308 1.7e+308 ECU_ADDRESS 0x0 DISPLAY_IDENTIFIER Disconnections.ECU_Disconections.LifeCheck_ADCAN.Data_Store_Memory.Last_alive_ar /end MEASUREMENT
/begin MEASUREMENT Disconnections_DW.Last_alive_c "" FLOAT64_IEEE Disconnections_CM_double 0 0 -1.7e+308 1.7e+308 ECU_ADDRESS 0x0 DISPLAY_IDENTIFIER Disconnections.Pedal_Box_Disconnections__Noise_.Life_check2.Data_Store_Memory.Last_alive_c /end MEASUREMENT
/begin MEASUREMENT Disconnections_DW.Last_alive_c0 "" FLOAT64_IEEE Disconnections_CM_double 0 0 -1.7e+308 1.7e+308 ECU_ADDRESS 0x0 DISPLAY_IDENTIFIER Disconnections.ECU_Disconections.LifeCheck_BMS.Data_Store_Memory.Last_alive_c0 /end MEASUREMENT
/begin MEASUREMENT Disconnections_DW.Last_alive_g "" FLOAT64_IEEE Disconnections_CM_double 0 0 -1.7e+308 1.7e+308 ECU_ADDRESS 0x0 DISPLAY_IDENTIFIER Disconnections.Pedal_Box_Disconnections__Noise_.Life_check1.Data_Store_Memory.Last_alive_g /end MEASUREMENT
/begin MEASUREMENT Disconnections_DW.Last_alive_gx "" FLOAT64_IEEE Disconnections_CM_double 0 0 -1.7e+308 1.7e+308 ECU_ADDRESS 0x0 DISPLAY_IDENTIFIER Disconnections.ECU_Disconections.LifeCheck_AccRear.Data_Store_Memory.Last_alive_gx /end MEASUREMENT
/begin MEASUREMENT Disconnections_DW.Last_alive_j "" FLOAT64_IEEE Disconnections_CM_double 0 0 -1.7e+308 1.7e+308 ECU_ADDRESS 0x0 DISPLAY_IDENTIFIER Disconnections.ECU_Disconections.LifeCheck_Shutdown.Data_Store_Memory.Last_alive_j /end MEASUREMENT
/begin MEASUREMENT Disconnections_DW.Last_alive_je "" FLOAT64_IEEE Disconnections_CM_double 0 0 -1.7e+308 1.7e+308 ECU_ADDRESS 0x0 DISPLAY_IDENTIFIER Disconnections.ECU_Disconections.Life_check4.Data_Store_Memory.Last_alive_je /end MEASUREMENT
/begin MEASUREMENT Disconnections_DW.Last_alive_l "" FLOAT64_IEEE Disconnections_CM_double 0 0 -1.7e+308 1.7e+308 ECU_ADDRESS 0x0 DISPLAY_IDENTIFIER Disconnections.Gyro_Disconnections__Noise_.Life_check6.Data_Store_Memory.Last_alive_l /end MEASUREMENT
/begin MEASUREMENT Disconnections_DW.Last_alive_m "" FLOAT64_IEEE Disconnections_CM_double 0 0 -1.7e+308 1.7e+308 ECU_ADDRESS 0x0 DISPLAY_IDENTIFIER Disconnections.Gyro_Disconnections__Noise_.Life_check8.Data_Store_Memory.Last_alive_m /end MEASUREMENT
/begin MEASUREMENT Disconnections_DW.Last_alive_o "" FLOAT64_IEEE Disconnections_CM_double 0 0 -1.7e+308 1.7e+308 ECU_ADDRESS 0x0 DISPLAY_IDENTIFIER Disconnections.ECU_Disconections.LifeCheck_Dash.Data_Store_Memory.Last_alive_o /end MEASUREMENT
/begin MEASUREMENT Disconnections_DW.Tot_Errors "" FLOAT64_IEEE Disconnections_CM_double 0 0 -1.7e+308 1.7e+308 ECU_ADDRESS 0x0 DISPLAY_IDENTIFIER Disconnections.Pedal_Box_Disconnections__Noise_.Life_check3.Data_Store_Memory1.Tot_Errors /end MEASUREMENT
/begin MEASUREMENT Disconnections_DW.Tot_Errors_h "" FLOAT64_IEEE Disconnections_CM_double 0 0 -1.7e+308 1.7e+308 ECU_ADDRESS 0x0 DISPLAY_IDENTIFIER Disconnections.Gyro_Disconnections__Noise_.Life_check6.Data_Store_Memory1.Tot_Errors_h /end MEASUREMENT
/begin MEASUREMENT Disconnections_DW.Tot_Errors_j "" FLOAT64_IEEE Disconnections_CM_double 0 0 -1.7e+308 1.7e+308 ECU_ADDRESS 0x0 DISPLAY_IDENTIFIER Disconnections.Pedal_Box_Disconnections__Noise_.Life_check2.Data_Store_Memory1.Tot_Errors_j /end MEASUREMENT
/begin MEASUREMENT Disconnections_DW.Tot_Errors_k "" FLOAT64_IEEE Disconnections_CM_double 0 0 -1.7e+308 1.7e+308 ECU_ADDRESS 0x0 DISPLAY_IDENTIFIER Disconnections.Pedal_Box_Disconnections__Noise_.Life_check1.Data_Store_Memory1.Tot_Errors_k /end MEASUREMENT
/begin MEASUREMENT Disconnections_DW.Tot_Errors_m "" FLOAT64_IEEE Disconnections_CM_double 0 0 -1.7e+308 1.7e+308 ECU_ADDRESS 0x0 DISPLAY_IDENTIFIER Disconnections.Gyro_Disconnections__Noise_.Life_check8.Data_Store_Memory1.Tot_Errors_m /end MEASUREMENT
/begin CHARACTERISTIC Disconnections_P.Constant_Value "" VALUE 0x0 SCALAR_FLOAT64_IEEE 3.5e+305 Disconnections_CM_double -1.7e+308 1.7e+308 DISPLAY_IDENTIFIER Disconnections.Subsystem.VDC_2018_Complete.Constant.Value /end CHARACTERISTIC
/begin RECORD_LAYOUT SCALAR_FLOAT64_IEEE FNC_VALUES 1 FLOAT64_IEEE COLUMN_DIR DIRECT /end RECORD_LAYOUT
/begin CHARACTERISTIC Disconnections_P.Constant_Value_c "" VALUE 0x0 SCALAR_FLOAT64_IEEE 3.5e+305 Disconnections_CM_double -1.7e+308 1.7e+308 DISPLAY_IDENTIFIER Disconnections.Counter.Constant.Value /end CHARACTERISTIC
/begin CHARACTERISTIC Disconnections_P.Constant_Value_d "" VALUE 0x0 SCALAR_FLOAT64_IEEE 3.5e+305 Disconnections_CM_double -1.7e+308 1.7e+308 DISPLAY_IDENTIFIER Disconnections.Signal_Disconnections.Compare_To_Zero2.Constant.Value /end CHARACTERISTIC
/begin CHARACTERISTIC Disconnections_P.Constant_Value_e "" VALUE 0x0 SCALAR_FLOAT64_IEEE 3.5e+305 Disconnections_CM_double -1.7e+308 1.7e+308 DISPLAY_IDENTIFIER Disconnections.Subsystem.Rigid_Axle.Constant.Value /end CHARACTERISTIC
/begin CHARACTERISTIC Disconnections_P.Constant_Value_h "" VALUE 0x0 SCALAR_FLOAT64_IEEE 3.5e+305 Disconnections_CM_double -1.7e+308 1.7e+308 DISPLAY_IDENTIFIER Disconnections.Subsystem.VDC_without_Longitudinal.Constant.Value /end CHARACTERISTIC
/begin CHARACTERISTIC Disconnections_P.Constant_Value_i "" VALUE 0x0 SCALAR_FLOAT64_IEEE 3.5e+305 Disconnections_CM_double -1.7e+308 1.7e+308 DISPLAY_IDENTIFIER Disconnections.Constant.Value /end CHARACTERISTIC
/begin CHARACTERISTIC Disconnections_P.Constant_Value_ic "" VALUE 0x0 SCALAR_FLOAT64_IEEE 3.5e+305 Disconnections_CM_double -1.7e+308 1.7e+308 DISPLAY_IDENTIFIER Disconnections.Signal_Disconnections.Compare_To_Zero.Constant.Value /end CHARACTERISTIC
/begin CHARACTERISTIC Disconnections_P.Constant_Value_j "" VALUE 0x0 SCALAR_FLOAT64_IEEE 3.5e+305 Disconnections_CM_double -1.7e+308 1.7e+308 DISPLAY_IDENTIFIER Disconnections.Signal_Disconnections.Compare_To_Zero3.Constant.Value /end CHARACTERISTIC
/begin CHARACTERISTIC Disconnections_P.Constant_Value_l "" VALUE 0x0 SCALAR_FLOAT64_IEEE 3.5e+305 Disconnections_CM_double -1.7e+308 1.7e+308 DISPLAY_IDENTIFIER Disconnections.Signal_Disconnections.Compare_To_Zero1.Constant.Value /end CHARACTERISTIC
/begin CHARACTERISTIC Disconnections_P.Constant_Value_m "" VALUE 0x0 SCALAR_FLOAT64_IEEE 3.5e+305 Disconnections_CM_double -1.7e+308 1.7e+308 DISPLAY_IDENTIFIER Disconnections.Subsystem.Steering_TV_2017_without_TC.Constant.Value /end CHARACTERISTIC
/begin CHARACTERISTIC Disconnections_P.Constant_Value_o "" VALUE 0x0 SCALAR_FLOAT64_IEEE 3.5e+305 Disconnections_CM_double -1.7e+308 1.7e+308 DISPLAY_IDENTIFIER Disconnections.Signal_Disconnections.Compare_To_Zero4.Constant.Value /end CHARACTERISTIC
/begin CHARACTERISTIC Disconnections_P.DataStoreMemory1_InitialValue "" VALUE 0x0 SCALAR_FLOAT64_IEEE 3.5e+305 Disconnections_CM_double -1.7e+308 1.7e+308 DISPLAY_IDENTIFIER Disconnections.Pedal_Box_Disconnections__Noise_.Life_check3.Data_Store_Memory1.InitialValue /end CHARACTERISTIC
/begin CHARACTERISTIC Disconnections_P.DataStoreMemory1_InitialValue_b "" VALUE 0x0 SCALAR_FLOAT64_IEEE 3.5e+305 Disconnections_CM_double -1.7e+308 1.7e+308 DISPLAY_IDENTIFIER Disconnections.Pedal_Box_Disconnections__Noise_.Life_check1.Data_Store_Memory1.InitialValue /end CHARACTERISTIC
/begin CHARACTERISTIC Disconnections_P.DataStoreMemory1_InitialValue_c "" VALUE 0x0 SCALAR_FLOAT64_IEEE 3.5e+305 Disconnections_CM_double -1.7e+308 1.7e+308 DISPLAY_IDENTIFIER Disconnections.Gyro_Disconnections__Noise_.Life_check8.Data_Store_Memory1.InitialValue /end CHARACTERISTIC
/begin CHARACTERISTIC Disconnections_P.DataStoreMemory1_InitialValue_d "" VALUE 0x0 SCALAR_FLOAT64_IEEE 3.5e+305 Disconnections_CM_double -1.7e+308 1.7e+308 DISPLAY_IDENTIFIER Disconnections.Pedal_Box_Disconnections__Noise_.Life_check2.Data_Store_Memory1.InitialValue /end CHARACTERISTIC
/begin CHARACTERISTIC Disconnections_P.DataStoreMemory1_InitialValue_m "" VALUE 0x0 SCALAR_FLOAT64_IEEE 3.5e+305 Disconnections_CM_double -1.7e+308 1.7e+308 DISPLAY_IDENTIFIER Disconnections.Gyro_Disconnections__Noise_.Life_check6.Data_Store_Memory1.InitialValue /end CHARACTERISTIC
/begin CHARACTERISTIC Disconnections_P.DataStoreMemory_InitialValue "" VALUE 0x0 SCALAR_FLOAT64_IEEE 3.5e+305 Disconnections_CM_double -1.7e+308 1.7e+308 DISPLAY_IDENTIFIER Disconnections.ECU_Disconections.LifeCheck_BMS.Data_Store_Memory.InitialValue /end CHARACTERISTIC
/begin CHARACTERISTIC Disconnections_P.DataStoreMemory_InitialValue_b "" VALUE 0x0 SCALAR_FLOAT64_IEEE 3.5e+305 Disconnections_CM_double -1.7e+308 1.7e+308 DISPLAY_IDENTIFIER Disconnections.ECU_Disconections.LifeCheck_ADCAN.Data_Store_Memory.InitialValue /end CHARACTERISTIC
/begin CHARACTERISTIC Disconnections_P.DataStoreMemory_InitialValue_ba "" VALUE 0x0 SCALAR_FLOAT64_IEEE 3.5e+305 Disconnections_CM_double -1.7e+308 1.7e+308 DISPLAY_IDENTIFIER Disconnections.Gyro_Disconnections__Noise_.Life_check8.Data_Store_Memory.InitialValue /end CHARACTERISTIC
/begin CHARACTERISTIC Disconnections_P.DataStoreMemory_InitialValue_c "" VALUE 0x0 SCALAR_FLOAT64_IEEE 3.5e+305 Disconnections_CM_double -1.7e+308 1.7e+308 DISPLAY_IDENTIFIER Disconnections.Pedal_Box_Disconnections__Noise_.Life_check3.Data_Store_Memory.InitialValue /end CHARACTERISTIC
/begin CHARACTERISTIC Disconnections_P.DataStoreMemory_InitialValue_d "" VALUE 0x0 SCALAR_FLOAT64_IEEE 3.5e+305 Disconnections_CM_double -1.7e+308 1.7e+308 DISPLAY_IDENTIFIER Disconnections.ECU_Disconections.LifeCheck_AccFront.Data_Store_Memory.InitialValue /end CHARACTERISTIC
/begin CHARACTERISTIC Disconnections_P.DataStoreMemory_InitialValue_f "" VALUE 0x0 SCALAR_FLOAT64_IEEE 3.5e+305 Disconnections_CM_double -1.7e+308 1.7e+308 DISPLAY_IDENTIFIER Disconnections.ECU_Disconections.LifeCheck_AccRear.Data_Store_Memory.InitialValue /end CHARACTERISTIC
/begin CHARACTERISTIC Disconnections_P.DataStoreMemory_InitialValue_j "" VALUE 0x0 SCALAR_FLOAT64_IEEE 3.5e+305 Disconnections_CM_double -1.7e+308 1.7e+308 DISPLAY_IDENTIFIER Disconnections.Counter.Data_Store_Memory.InitialValue /end CHARACTERISTIC
/begin CHARACTERISTIC Disconnections_P.DataStoreMemory_InitialValue_jc "" VALUE 0x0 SCALAR_FLOAT64_IEEE 3.5e+305 Disconnections_CM_double -1.7e+308 1.7e+308 DISPLAY_IDENTIFIER Disconnections.Pedal_Box_Disconnections__Noise_.Life_check1.Data_Store_Memory.InitialValue /end CHARACTERISTIC
/begin CHARACTERISTIC Disconnections_P.DataStoreMemory_InitialValue_k "" VALUE 0x0 SCALAR_FLOAT64_IEEE 3.5e+305 Disconnections_CM_double -1.7e+308 1.7e+308 DISPLAY_IDENTIFIER Disconnections.ECU_Disconections.LifeCheck_Dash.Data_Store_Memory.InitialValue /end CHARACTERISTIC
/begin CHARACTERISTIC Disconnections_P.DataStoreMemory_InitialValue_kg "" VALUE 0x0 SCALAR_FLOAT64_IEEE 3.5e+305 Disconnections_CM_double -1.7e+308 1.7e+308 DISPLAY_IDENTIFIER Disconnections.Pedal_Box_Disconnections__Noise_.Life_check2.Data_Store_Memory.InitialValue /end CHARACTERISTIC
/begin CHARACTERISTIC Disconnections_P.DataStoreMemory_InitialValue_ks "" VALUE 0x0 SCALAR_FLOAT64_IEEE 3.5e+305 Disconnections_CM_double -1.7e+308 1.7e+308 DISPLAY_IDENTIFIER Disconnections.ECU_Disconections.Life_check4.Data_Store_Memory.InitialValue /end CHARACTERISTIC
/begin CHARACTERISTIC Disconnections_P.DataStoreMemory_InitialValue_m "" VALUE 0x0 SCALAR_FLOAT64_IEEE 3.5e+305 Disconnections_CM_double -1.7e+308 1.7e+308 DISPLAY_IDENTIFIER Disconnections.Gyro_Disconnections__Noise_.Life_check6.Data_Store_Memory.InitialValue /end CHARACTERISTIC
/begin CHARACTERISTIC Disconnections_P.DataStoreMemory_InitialValue_o "" VALUE 0x0 SCALAR_FLOAT64_IEEE 3.5e+305 Disconnections_CM_double -1.7e+308 1.7e+308 DISPLAY_IDENTIFIER Disconnections.ECU_Disconections.LifeCheck_Shutdown.Data_Store_Memory.InitialValue /end CHARACTERISTIC
/begin CHARACTERISTIC Disconnections_P.Merge_InitialOutput "" VALUE 0x0 SCALAR_FLOAT64_IEEE 3.5e+305 Disconnections_CM_double -1.7e+308 1.7e+308 DISPLAY_IDENTIFIER Disconnections.ECU_Disconections.LifeCheck_BMS.Merge.InitialOutput /end CHARACTERISTIC
/begin CHARACTERISTIC Disconnections_P.Merge_InitialOutput_a "" VALUE 0x0 SCALAR_FLOAT64_IEEE 3.5e+305 Disconnections_CM_double -1.7e+308 1.7e+308 DISPLAY_IDENTIFIER Disconnections.ECU_Disconections.LifeCheck_ADCAN.Merge.InitialOutput /end CHARACTERISTIC
/begin CHARACTERISTIC Disconnections_P.Merge_InitialOutput_b "" VALUE 0x0 SCALAR_FLOAT64_IEEE 3.5e+305 Disconnections_CM_double -1.7e+308 1.7e+308 DISPLAY_IDENTIFIER Disconnections.ECU_Disconections.LifeCheck_Dash.Merge.InitialOutput /end CHARACTERISTIC
/begin CHARACTERISTIC Disconnections_P.Merge_InitialOutput_l "" VALUE 0x0 SCALAR_FLOAT64_IEEE 3.5e+305 Disconnections_CM_double -1.7e+308 1.7e+308 DISPLAY_IDENTIFIER Disconnections.ECU_Disconections.LifeCheck_Shutdown.Merge.InitialOutput /end CHARACTERISTIC
/begin CHARACTERISTIC Disconnections_P.Merge_InitialOutput_m "" VALUE 0x0 SCALAR_FLOAT64_IEEE 3.5e+305 Disconnections_CM_double -1.7e+308 1.7e+308 DISPLAY_IDENTIFIER Disconnections.ECU_Disconections.LifeCheck_AccFront.Merge.InitialOutput /end CHARACTERISTIC
/begin CHARACTERISTIC Disconnections_P.Merge_InitialOutput_o "" VALUE 0x0 SCALAR_FLOAT64_IEEE 3.5e+305 Disconnections_CM_double -1.7e+308 1.7e+308 DISPLAY_IDENTIFIER Disconnections.ECU_Disconections.Life_check4.Merge.InitialOutput /end CHARACTERISTIC
/begin CHARACTERISTIC Disconnections_P.Merge_InitialOutput_p "" VALUE 0x0 SCALAR_FLOAT64_IEEE 3.5e+305 Disconnections_CM_double -1.7e+308 1.7e+308 DISPLAY_IDENTIFIER Disconnections.ECU_Disconections.LifeCheck_AccRear.Merge.InitialOutput /end CHARACTERISTIC
/begin MEASUREMENT Disconnections_U.ADCAN_Alive "" FLOAT64_IEEE Disconnections_CM_double 0 0 -1.7e+308 1.7e+308 ECU_ADDRESS 0x0 DISPLAY_IDENTIFIER Disconnections.ADCAN_Alive /end MEASUREMENT
/begin MEASUREMENT Disconnections_U.APPS1_Bits "" FLOAT64_IEEE Disconnections_CM_double 0 0 -1.7e+308 1.7e+308 ECU_ADDRESS 0x0 DISPLAY_IDENTIFIER Disconnections.APPS1_Bits /end MEASUREMENT
/begin MEASUREMENT Disconnections_U.APPS2_Bits "" FLOAT64_IEEE Disconnections_CM_double 0 0 -1.7e+308 1.7e+308 ECU_ADDRESS 0x0 DISPLAY_IDENTIFIER Disconnections.APPS2_Bits /end MEASUREMENT
/begin MEASUREMENT Disconnections_U.Accel_F_Alive "" FLOAT64_IEEE Disconnections_CM_double 0 0 -1.7e+308 1.7e+308 ECU_ADDRESS 0x0 DISPLAY_IDENTIFIER Disconnections.Accel_F_Alive /end MEASUREMENT
/begin MEASUREMENT Disconnections_U.Accel_R_Alive "" FLOAT64_IEEE Disconnections_CM_double 0 0 -1.7e+308 1.7e+308 ECU_ADDRESS 0x0 DISPLAY_IDENTIFIER Disconnections.Accel_R_Alive /end MEASUREMENT
/begin MEASUREMENT Disconnections_U.BMS_Alive "" FLOAT64_IEEE Disconnections_CM_double 0 0 -1.7e+308 1.7e+308 ECU_ADDRESS 0x0 DISPLAY_IDENTIFIER Disconnections.BMS_Alive /end MEASUREMENT
/begin MEASUREMENT Disconnections_U.BrakeSensor_Bits "" FLOAT64_IEEE Disconnections_CM_double 0 0 -1.7e+308 1.7e+308 ECU_ADDRESS 0x0 DISPLAY_IDENTIFIER Disconnections.BrakeSensor_Bits /end MEASUREMENT
/begin MEASUREMENT Disconnections_U.Dash_Alive "" FLOAT64_IEEE Disconnections_CM_double 0 0 -1.7e+308 1.7e+308 ECU_ADDRESS 0x0 DISPLAY_IDENTIFIER Disconnections.Dash_Alive /end MEASUREMENT
/begin MEASUREMENT Disconnections_U.Gyroscope_F "" FLOAT64_IEEE Disconnections_CM_double 0 0 -1.7e+308 1.7e+308 ECU_ADDRESS 0x0 DISPLAY_IDENTIFIER Disconnections.Gyroscope_F /end MEASUREMENT
/begin MEASUREMENT Disconnections_U.Gyroscope_R "" FLOAT64_IEEE Disconnections_CM_double 0 0 -1.7e+308 1.7e+308 ECU_ADDRESS 0x0 DISPLAY_IDENTIFIER Disconnections.Gyroscope_R /end MEASUREMENT
/begin MEASUREMENT Disconnections_U.LV_Derivation_Alive "" FLOAT64_IEEE Disconnections_CM_double 0 0 -1.7e+308 1.7e+308 ECU_ADDRESS 0x0 DISPLAY_IDENTIFIER Disconnections.LV_Derivation_Alive /end MEASUREMENT
/begin MEASUREMENT Disconnections_U.Shutdown_Alive "" FLOAT64_IEEE Disconnections_CM_double 0 0 -1.7e+308 1.7e+308 ECU_ADDRESS 0x0 DISPLAY_IDENTIFIER Disconnections.Shutdown_Alive /end MEASUREMENT
/begin MEASUREMENT Disconnections_U.SteeringSensor_Bits "" FLOAT64_IEEE Disconnections_CM_double 0 0 -1.7e+308 1.7e+308 ECU_ADDRESS 0x0 DISPLAY_IDENTIFIER Disconnections.SteeringSensor_Bits /end MEASUREMENT
/begin MEASUREMENT Disconnections_U.Susp_F_L_Bits "" FLOAT64_IEEE Disconnections_CM_double 0 0 -1.7e+308 1.7e+308 ECU_ADDRESS 0x0 DISPLAY_IDENTIFIER Disconnections.Susp_F_L_Bits /end MEASUREMENT
/begin MEASUREMENT Disconnections_U.Susp_F_R_Bits "" FLOAT64_IEEE Disconnections_CM_double 0 0 -1.7e+308 1.7e+308 ECU_ADDRESS 0x0 DISPLAY_IDENTIFIER Disconnections.Susp_F_R_Bits /end MEASUREMENT
/begin MEASUREMENT Disconnections_U.Susp_R_L_Bits "" FLOAT64_IEEE Disconnections_CM_double 0 0 -1.7e+308 1.7e+308 ECU_ADDRESS 0x0 DISPLAY_IDENTIFIER Disconnections.Susp_R_L_Bits /end MEASUREMENT
/begin MEASUREMENT Disconnections_U.Susp_R_R_Bits "" FLOAT64_IEEE Disconnections_CM_double 0 0 -1.7e+308 1.7e+308 ECU_ADDRESS 0x0 DISPLAY_IDENTIFIER Disconnections.Susp_R_R_Bits /end MEASUREMENT
/begin MEASUREMENT Disconnections_Y.CounterOut "" FLOAT64_IEEE Disconnections_CM_double 0 0 -1.7e+308 1.7e+308 ECU_ADDRESS 0x0 DISPLAY_IDENTIFIER Disconnections.CounterOut /end MEASUREMENT
/begin MEASUREMENT Disconnections_Y.CriticalDisconnection "" UBYTE Disconnections_CM_uint8 0 0 0.0 255.0 ECU_ADDRESS 0x0 DISPLAY_IDENTIFIER Disconnections.CriticalDisconnection /end MEASUREMENT
/begin COMPU_METHOD Disconnections_CM_uint8 "Q = V" RAT_FUNC "%9.6" "NO_PHYSICAL_QTY" COEFFS 0.0 1.0 0.0 0.0 0.0 1.0 /end COMPU_METHOD
/begin MEASUREMENT Disconnections_Y.Critical_CAN_Disconnection "" UBYTE Disconnections_CM_boolean 0 0 0 1 ECU_ADDRESS 0x0 DISPLAY_IDENTIFIER Disconnections.Critical_CAN_Disconnection /end MEASUREMENT
/begin COMPU_METHOD Disconnections_CM_boolean "Q = V" RAT_FUNC "%9.6" "NO_PHYSICAL_QTY" COEFFS 0.0 1.0 0.0 0.0 0.0 1.0 /end COMPU_METHOD
/begin MEASUREMENT Disconnections_Y.Critical_Signal_Disconnection "" UBYTE Disconnections_CM_boolean 0 0 0 1 ECU_ADDRESS 0x0 DISPLAY_IDENTIFIER Disconnections.Critical_Signal_Disconnection /end MEASUREMENT
/begin MEASUREMENT Disconnections_Y.Disconnection_ADCAN "" FLOAT64_IEEE Disconnections_CM_double 0 0 -1.7e+308 1.7e+308 ECU_ADDRESS 0x0 DISPLAY_IDENTIFIER Disconnections.Disconnection_ADCAN /end MEASUREMENT
/begin MEASUREMENT Disconnections_Y.Disconnection_APPS1 "" FLOAT64_IEEE Disconnections_CM_double 0 0 -1.7e+308 1.7e+308 ECU_ADDRESS 0x0 DISPLAY_IDENTIFIER Disconnections.Disconnection_APPS1 /end MEASUREMENT
/begin MEASUREMENT Disconnections_Y.Disconnection_APPS2 "" FLOAT64_IEEE Disconnections_CM_double 0 0 -1.7e+308 1.7e+308 ECU_ADDRESS 0x0 DISPLAY_IDENTIFIER Disconnections.Disconnection_APPS2 /end MEASUREMENT
/begin MEASUREMENT Disconnections_Y.Disconnection_Accel_F "" FLOAT64_IEEE Disconnections_CM_double 0 0 -1.7e+308 1.7e+308 ECU_ADDRESS 0x0 DISPLAY_IDENTIFIER Disconnections.Disconnection_Accel_F /end MEASUREMENT
/begin MEASUREMENT Disconnections_Y.Disconnection_Accel_R "" FLOAT64_IEEE Disconnections_CM_double 0 0 -1.7e+308 1.7e+308 ECU_ADDRESS 0x0 DISPLAY_IDENTIFIER Disconnections.Disconnection_Accel_R /end MEASUREMENT
/begin MEASUREMENT Disconnections_Y.Disconnection_BMS "" FLOAT64_IEEE Disconnections_CM_double 0 0 -1.7e+308 1.7e+308 ECU_ADDRESS 0x0 DISPLAY_IDENTIFIER Disconnections.Disconnection_BMS /end MEASUREMENT
/begin MEASUREMENT Disconnections_Y.Disconnection_Brake_Sensor "" FLOAT64_IEEE Disconnections_CM_double 0 0 -1.7e+308 1.7e+308 ECU_ADDRESS 0x0 DISPLAY_IDENTIFIER Disconnections.Disconnection_Brake_Sensor /end MEASUREMENT
/begin MEASUREMENT Disconnections_Y.Disconnection_DashBoard "" FLOAT64_IEEE Disconnections_CM_double 0 0 -1.7e+308 1.7e+308 ECU_ADDRESS 0x0 DISPLAY_IDENTIFIER Disconnections.Disconnection_DashBoard /end MEASUREMENT
/begin MEASUREMENT Disconnections_Y.Disconnection_Gyroscope_F "" FLOAT64_IEEE Disconnections_CM_double 0 0 -1.7e+308 1.7e+308 ECU_ADDRESS 0x0 DISPLAY_IDENTIFIER Disconnections.Disconnection_Gyroscope_F /end MEASUREMENT
/begin MEASUREMENT Disconnections_Y.Disconnection_Gyroscope_R "" FLOAT64_IEEE Disconnections_CM_double 0 0 -1.7e+308 1.7e+308 ECU_ADDRESS 0x0 DISPLAY_IDENTIFIER Disconnections.Disconnection_Gyroscope_R /end MEASUREMENT
/begin MEASUREMENT Disconnections_Y.Disconnection_LV_Derivation "" FLOAT64_IEEE Disconnections_CM_double 0 0 -1.7e+308 1.7e+308 ECU_ADDRESS 0x0 DISPLAY_IDENTIFIER Disconnections.Disconnection_LV_Derivation /end MEASUREMENT
/begin MEASUREMENT Disconnections_Y.Disconnection_Shutdown "" FLOAT64_IEEE Disconnections_CM_double 0 0 -1.7e+308 1.7e+308 ECU_ADDRESS 0x0 DISPLAY_IDENTIFIER Disconnections.Disconnection_Shutdown /end MEASUREMENT
/begin MEASUREMENT Disconnections_Y.Disconnection_SteeringSensor "" UBYTE Disconnections_CM_uint8 0 0 0.0 255.0 ECU_ADDRESS 0x0 DISPLAY_IDENTIFIER Disconnections.Disconnection_SteeringSensor /end MEASUREMENT
/begin MEASUREMENT Disconnections_Y.Disconnection_Susp_F_L "" UBYTE Disconnections_CM_uint8 0 0 0.0 255.0 ECU_ADDRESS 0x0 DISPLAY_IDENTIFIER Disconnections.Disconnection_Susp_F_L /end MEASUREMENT
/begin MEASUREMENT Disconnections_Y.Disconnection_Susp_F_R "" UBYTE Disconnections_CM_uint8 0 0 0.0 255.0 ECU_ADDRESS 0x0 DISPLAY_IDENTIFIER Disconnections.Disconnection_Susp_F_R /end MEASUREMENT
/begin MEASUREMENT Disconnections_Y.Disconnection_Susp_R_L "" UBYTE Disconnections_CM_uint8 0 0 0.0 255.0 ECU_ADDRESS 0x0 DISPLAY_IDENTIFIER Disconnections.Disconnection_Susp_R_L /end MEASUREMENT
/begin MEASUREMENT Disconnections_Y.Disconnection_Susp_R_R "" UBYTE Disconnections_CM_uint8 0 0 0.0 255.0 ECU_ADDRESS 0x0 DISPLAY_IDENTIFIER Disconnections.Disconnection_Susp_R_R /end MEASUREMENT
/begin MEASUREMENT Disconnections_Y.TV_mode "" FLOAT64_IEEE Disconnections_CM_double 0 0 -1.7e+308 1.7e+308 ECU_ADDRESS 0x0 DISPLAY_IDENTIFIER Disconnections.TV_mode /end MEASUREMENT
/end MODULE
/* Disconnections */
/end PROJECT
