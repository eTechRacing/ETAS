ASAP2_VERSION
/begin PROJECT "Generated by ETAS from INTECRIO integration project"
/begin HEADER "" VERSION "" PROJECT_NO Y /end HEADER
/begin MODULE SoC "Generated by ETAS from INTECRIO integration project"
/begin MOD_PAR "" VERSION "" ADDR_EPK 0x0 EPK "" SUPPLIER "ETAS GmbH" CUSTOMER "" CUSTOMER_NO "" USER "" PHONE_NO "" ECU "NO_ECU" CPU_TYPE "MPC750" NO_OF_INTERFACES 1 /end MOD_PAR
/begin MOD_COMMON "Common definitions" BYTE_ORDER MSB_FIRST ALIGNMENT_BYTE 1 ALIGNMENT_WORD 2 ALIGNMENT_LONG 4 ALIGNMENT_FLOAT32_IEEE 4 ALIGNMENT_FLOAT64_IEEE 8 /end MOD_COMMON
/begin MEASUREMENT SoC_B.AccuOCVtoSOC2024 "" FLOAT64_IEEE SoC_CM_double 0 0 -1.7e+308 1.7e+308 ECU_ADDRESS 0x0 DISPLAY_IDENTIFIER SoC.Accu_OCV_to_SOC_2024.AccuOCVtoSOC2024 /end MEASUREMENT
/begin COMPU_METHOD SoC_CM_double "Q = V" /* ConversionType */ RAT_FUNC /* Format */ "%9.6" /* Unit */ "NO_PHYSICAL_QTY" COEFFS 0.0 1.0 0.0 0.0 0.0 1.0 /end COMPU_METHOD
/begin MEASUREMENT SoC_B.CellOCVtoSOC1 "" FLOAT64_IEEE SoC_CM_double 0 0 -1.7e+308 1.7e+308 ECU_ADDRESS 0x0 DISPLAY_IDENTIFIER SoC.Cell_OCV_to_SOC_1.CellOCVtoSOC1 /end MEASUREMENT
/begin MEASUREMENT SoC_B.CellOCVtoSOC2024 "" FLOAT64_IEEE SoC_CM_double 0 0 -1.7e+308 1.7e+308 ECU_ADDRESS 0x0 DISPLAY_IDENTIFIER SoC.Cell_OCV_to_SOC_2024.CellOCVtoSOC2024 /end MEASUREMENT
/begin MEASUREMENT SoC_B.CoreSubsys[0].Pdot "" FLOAT64_IEEE SoC_CM_double 0 0 -1.7e+308 1.7e+308 ECU_ADDRESS 0x0 DISPLAY_IDENTIFIER SoC.3RC_Accu.EKF_3RC.Prediction_correction.Sum.Pdot MATRIX_DIM 4 4 1 /end MEASUREMENT
/begin MEASUREMENT SoC_B.CoreSubsys[0].Sum2 "" FLOAT64_IEEE SoC_CM_double 0 0 -1.7e+308 1.7e+308 ECU_ADDRESS 0x0 DISPLAY_IDENTIFIER SoC.3RC_Accu.EKF_3RC.Prediction_correction.Sum2.Sum2 ARRAY_SIZE 4 /end MEASUREMENT
/begin MEASUREMENT SoC_B.CoreSubsys[0].TmpSignalConversionAtIntegrator "" FLOAT64_IEEE SoC_CM_double 0 0 -1.7e+308 1.7e+308 ECU_ADDRESS 0x0 DISPLAY_IDENTIFIER SoC.Opaque.TmpSignalConversionAtIntegrator ARRAY_SIZE 4 /end MEASUREMENT
/begin MEASUREMENT SoC_B.uRC_Cell_H[0].CoreSubsys.Pdot "" FLOAT64_IEEE SoC_CM_double 0 0 -1.7e+308 1.7e+308 ECU_ADDRESS 0x0 DISPLAY_IDENTIFIER SoC.3RC_Cell_H.EKF_3RC.Prediction_correction.Sum.Pdot MATRIX_DIM 4 4 1 /end MEASUREMENT
/begin MEASUREMENT SoC_B.uRC_Cell_H[0].CoreSubsys.Sum2 "" FLOAT64_IEEE SoC_CM_double 0 0 -1.7e+308 1.7e+308 ECU_ADDRESS 0x0 DISPLAY_IDENTIFIER SoC.3RC_Cell_H.EKF_3RC.Jacobian.Sum2.Sum2 /end MEASUREMENT
/begin MEASUREMENT SoC_B.uRC_Cell_H[0].CoreSubsys.Sum2_h "" FLOAT64_IEEE SoC_CM_double 0 0 -1.7e+308 1.7e+308 ECU_ADDRESS 0x0 DISPLAY_IDENTIFIER SoC.3RC_Cell_H.EKF_3RC.Prediction_correction.Sum2.Sum2_h ARRAY_SIZE 4 /end MEASUREMENT
/begin MEASUREMENT SoC_B.uRC_Cell_H[0].CoreSubsys.TmpSignalConversionAtIntegrator "" FLOAT64_IEEE SoC_CM_double 0 0 -1.7e+308 1.7e+308 ECU_ADDRESS 0x0 DISPLAY_IDENTIFIER SoC.Opaque.TmpSignalConversionAtIntegrator ARRAY_SIZE 4 /end MEASUREMENT
/begin MEASUREMENT SoC_B.uRC_Cell_L[0].CoreSubsys.Pdot "" FLOAT64_IEEE SoC_CM_double 0 0 -1.7e+308 1.7e+308 ECU_ADDRESS 0x0 DISPLAY_IDENTIFIER SoC.3RC_Cell_L.EKF_3RC.Prediction_correction.Sum.Pdot MATRIX_DIM 4 4 1 /end MEASUREMENT
/begin MEASUREMENT SoC_B.uRC_Cell_L[0].CoreSubsys.Sum2 "" FLOAT64_IEEE SoC_CM_double 0 0 -1.7e+308 1.7e+308 ECU_ADDRESS 0x0 DISPLAY_IDENTIFIER SoC.3RC_Cell_L.EKF_3RC.Jacobian.Sum2.Sum2 /end MEASUREMENT
/begin MEASUREMENT SoC_B.uRC_Cell_L[0].CoreSubsys.Sum2_h "" FLOAT64_IEEE SoC_CM_double 0 0 -1.7e+308 1.7e+308 ECU_ADDRESS 0x0 DISPLAY_IDENTIFIER SoC.3RC_Cell_L.EKF_3RC.Prediction_correction.Sum2.Sum2_h ARRAY_SIZE 4 /end MEASUREMENT
/begin MEASUREMENT SoC_B.uRC_Cell_L[0].CoreSubsys.TmpSignalConversionAtIntegrator "" FLOAT64_IEEE SoC_CM_double 0 0 -1.7e+308 1.7e+308 ECU_ADDRESS 0x0 DISPLAY_IDENTIFIER SoC.Opaque.TmpSignalConversionAtIntegrator ARRAY_SIZE 4 /end MEASUREMENT
/begin MEASUREMENT SoC_ConstB.CoreSubsys.Divide "" FLOAT64_IEEE SoC_CM_double 0 0 -1.7e+308 1.7e+308 ECU_ADDRESS 0x0 DISPLAY_IDENTIFIER SoC.3RC_Accu.EKF_3RC.Prediction_correction.Divide.Divide /end MEASUREMENT
/begin MEASUREMENT SoC_ConstB.uRC_Cell_H.CoreSubsys.Divide "" FLOAT64_IEEE SoC_CM_double 0 0 -1.7e+308 1.7e+308 ECU_ADDRESS 0x0 DISPLAY_IDENTIFIER SoC.3RC_Cell_H.EKF_3RC.Prediction_correction.Divide.Divide /end MEASUREMENT
/begin MEASUREMENT SoC_ConstB.uRC_Cell_L.CoreSubsys.Divide "" FLOAT64_IEEE SoC_CM_double 0 0 -1.7e+308 1.7e+308 ECU_ADDRESS 0x0 DISPLAY_IDENTIFIER SoC.3RC_Cell_L.EKF_3RC.Prediction_correction.Divide.Divide /end MEASUREMENT
/begin MEASUREMENT SoC_U.Accumulator_Current "" FLOAT64_IEEE SoC_CM_double 0 0 -1.7e+308 1.7e+308 ECU_ADDRESS 0x0 DISPLAY_IDENTIFIER SoC.Accumulator_Current /end MEASUREMENT
/begin MEASUREMENT SoC_U.Accumulator_Voltage "" FLOAT64_IEEE SoC_CM_double 0 0 -1.7e+308 1.7e+308 ECU_ADDRESS 0x0 DISPLAY_IDENTIFIER SoC.Accumulator_Voltage /end MEASUREMENT
/begin MEASUREMENT SoC_U.Average_CellTemp "" FLOAT64_IEEE SoC_CM_double 0 0 -1.7e+308 1.7e+308 ECU_ADDRESS 0x0 DISPLAY_IDENTIFIER SoC.Average_CellTemp /end MEASUREMENT
/begin MEASUREMENT SoC_U.Highest_CellVoltage "" FLOAT64_IEEE SoC_CM_double 0 0 -1.7e+308 1.7e+308 ECU_ADDRESS 0x0 DISPLAY_IDENTIFIER SoC.Highest_CellVoltage /end MEASUREMENT
/begin MEASUREMENT SoC_U.Lowest_CellVoltage "" FLOAT64_IEEE SoC_CM_double 0 0 -1.7e+308 1.7e+308 ECU_ADDRESS 0x0 DISPLAY_IDENTIFIER SoC.Lowest_CellVoltage /end MEASUREMENT
/begin MEASUREMENT SoC_Y.SoC_Avg "" FLOAT64_IEEE SoC_CM_double 0 0 -1.7e+308 1.7e+308 ECU_ADDRESS 0x0 DISPLAY_IDENTIFIER SoC.SoC_Avg /end MEASUREMENT
/begin MEASUREMENT SoC_Y.SoC_High "" FLOAT64_IEEE SoC_CM_double 0 0 -1.7e+308 1.7e+308 ECU_ADDRESS 0x0 DISPLAY_IDENTIFIER SoC.SoC_High /end MEASUREMENT
/begin MEASUREMENT SoC_Y.SoC_KF "" FLOAT64_IEEE SoC_CM_double 0 0 -1.7e+308 1.7e+308 ECU_ADDRESS 0x0 DISPLAY_IDENTIFIER SoC.SoC_KF /end MEASUREMENT
/begin MEASUREMENT SoC_Y.SoC_Low "" FLOAT64_IEEE SoC_CM_double 0 0 -1.7e+308 1.7e+308 ECU_ADDRESS 0x0 DISPLAY_IDENTIFIER SoC.SoC_Low /end MEASUREMENT
/end MODULE
/* SoC */
/end PROJECT
