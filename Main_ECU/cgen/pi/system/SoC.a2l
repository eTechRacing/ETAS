ASAP2_VERSION
/begin PROJECT "Generated by ETAS from INTECRIO integration project"
/begin HEADER "" VERSION "" PROJECT_NO Y /end HEADER
/begin MODULE SoC "Generated by ETAS from INTECRIO integration project"
/begin MOD_PAR "" VERSION "" ADDR_EPK 0x0 EPK "" SUPPLIER "ETAS GmbH" CUSTOMER "" CUSTOMER_NO "" USER "" PHONE_NO "" ECU "NO_ECU" CPU_TYPE "MPC750" NO_OF_INTERFACES 1 /end MOD_PAR
/begin MOD_COMMON "Common definitions" BYTE_ORDER MSB_FIRST ALIGNMENT_BYTE 1 ALIGNMENT_WORD 2 ALIGNMENT_LONG 4 ALIGNMENT_FLOAT32_IEEE 4 ALIGNMENT_FLOAT64_IEEE 8 /end MOD_COMMON
/begin MEASUREMENT SoC_B.Switch "" FLOAT64_IEEE SoC_CM_double 0 0 -1.7e+308 1.7e+308 ECU_ADDRESS 0x0 DISPLAY_IDENTIFIER SoC.SoC_Highest1.Switch.Switch /end MEASUREMENT
/begin COMPU_METHOD SoC_CM_double "Q = V" /* ConversionType */ RAT_FUNC /* Format */ "%9.6" /* Unit */ "NO_PHYSICAL_QTY" COEFFS 0.0 1.0 0.0 0.0 0.0 1.0 /end COMPU_METHOD
/begin MEASUREMENT SoC_B.Switch_d "" FLOAT64_IEEE SoC_CM_double 0 0 -1.7e+308 1.7e+308 ECU_ADDRESS 0x0 DISPLAY_IDENTIFIER SoC.SoC_Lowest.Switch.Switch_d /end MEASUREMENT
/begin MEASUREMENT SoC_B.uRC1[0].CoreSubsys.Probe "" FLOAT64_IEEE SoC_CM_double 0 0 -1.7e+308 1.7e+308 ECU_ADDRESS 0x0 DISPLAY_IDENTIFIER SoC.SoC_Highest1.3RC1.EKF_3RC.Jacobian.Probe.Probe ARRAY_SIZE 2 /end MEASUREMENT
/begin MEASUREMENT SoC_B.uRC1[0].CoreSubsys.Product5 "" FLOAT64_IEEE SoC_CM_double 0 0 -1.7e+308 1.7e+308 ECU_ADDRESS 0x0 DISPLAY_IDENTIFIER SoC.SoC_Highest1.3RC1.EKF_3RC.Correction.Product5.Product5 MATRIX_DIM 4 4 1 /end MEASUREMENT
/begin MEASUREMENT SoC_B.uRC1[0].CoreSubsys.Sum "" FLOAT64_IEEE SoC_CM_double 0 0 -1.7e+308 1.7e+308 ECU_ADDRESS 0x0 DISPLAY_IDENTIFIER SoC.SoC_Highest1.3RC1.EKF_3RC.Correction.Sum.Sum ARRAY_SIZE 4 /end MEASUREMENT
/begin MEASUREMENT SoC_B.uRC1[0].CoreSubsys.TmpSignalConversionAtDelayInpor "" FLOAT64_IEEE SoC_CM_double 0 0 -1.7e+308 1.7e+308 ECU_ADDRESS 0x0 DISPLAY_IDENTIFIER SoC.Opaque.TmpSignalConversionAtDelayInpor ARRAY_SIZE 4 /end MEASUREMENT
/begin MEASUREMENT SoC_B.uRC1_p[0].CoreSubsys.Probe "" FLOAT64_IEEE SoC_CM_double 0 0 -1.7e+308 1.7e+308 ECU_ADDRESS 0x0 DISPLAY_IDENTIFIER SoC.SoC_Lowest.3RC1.EKF_3RC.Jacobian.Probe.Probe ARRAY_SIZE 2 /end MEASUREMENT
/begin MEASUREMENT SoC_B.uRC1_p[0].CoreSubsys.Product5 "" FLOAT64_IEEE SoC_CM_double 0 0 -1.7e+308 1.7e+308 ECU_ADDRESS 0x0 DISPLAY_IDENTIFIER SoC.SoC_Lowest.3RC1.EKF_3RC.Correction.Product5.Product5 MATRIX_DIM 4 4 1 /end MEASUREMENT
/begin MEASUREMENT SoC_B.uRC1_p[0].CoreSubsys.Sum "" FLOAT64_IEEE SoC_CM_double 0 0 -1.7e+308 1.7e+308 ECU_ADDRESS 0x0 DISPLAY_IDENTIFIER SoC.SoC_Lowest.3RC1.EKF_3RC.Correction.Sum.Sum ARRAY_SIZE 4 /end MEASUREMENT
/begin MEASUREMENT SoC_B.uRC1_p[0].CoreSubsys.TmpSignalConversionAtDelayInpor "" FLOAT64_IEEE SoC_CM_double 0 0 -1.7e+308 1.7e+308 ECU_ADDRESS 0x0 DISPLAY_IDENTIFIER SoC.Opaque.TmpSignalConversionAtDelayInpor ARRAY_SIZE 4 /end MEASUREMENT
/begin MEASUREMENT SoC_U.Accumulator_Current "" FLOAT64_IEEE SoC_CM_double 0 0 -1.7e+308 1.7e+308 ECU_ADDRESS 0x0 DISPLAY_IDENTIFIER SoC.Accumulator_Current /end MEASUREMENT
/begin MEASUREMENT SoC_U.Car_State "" FLOAT64_IEEE SoC_CM_double 0 0 -1.7e+308 1.7e+308 ECU_ADDRESS 0x0 DISPLAY_IDENTIFIER SoC.Car_State /end MEASUREMENT
/begin MEASUREMENT SoC_U.Highest_CellTemp "" FLOAT64_IEEE SoC_CM_double 0 0 -1.7e+308 1.7e+308 ECU_ADDRESS 0x0 DISPLAY_IDENTIFIER SoC.Highest_CellTemp /end MEASUREMENT
/begin MEASUREMENT SoC_U.Highest_CellVoltage "" FLOAT64_IEEE SoC_CM_double 0 0 -1.7e+308 1.7e+308 ECU_ADDRESS 0x0 DISPLAY_IDENTIFIER SoC.Highest_CellVoltage /end MEASUREMENT
/begin MEASUREMENT SoC_U.Lowest_CellTemp "" FLOAT64_IEEE SoC_CM_double 0 0 -1.7e+308 1.7e+308 ECU_ADDRESS 0x0 DISPLAY_IDENTIFIER SoC.Lowest_CellTemp /end MEASUREMENT
/begin MEASUREMENT SoC_U.Lowest_CellVoltage "" FLOAT64_IEEE SoC_CM_double 0 0 -1.7e+308 1.7e+308 ECU_ADDRESS 0x0 DISPLAY_IDENTIFIER SoC.Lowest_CellVoltage /end MEASUREMENT
/begin MEASUREMENT SoC_Y.SoC_Avg "" FLOAT64_IEEE SoC_CM_double 0 0 -1.7e+308 1.7e+308 ECU_ADDRESS 0x0 DISPLAY_IDENTIFIER SoC.SoC_Avg /end MEASUREMENT
/begin MEASUREMENT SoC_Y.SoC_High "" FLOAT64_IEEE SoC_CM_double 0 0 -1.7e+308 1.7e+308 ECU_ADDRESS 0x0 DISPLAY_IDENTIFIER SoC.SoC_High /end MEASUREMENT
/begin MEASUREMENT SoC_Y.SoC_Low "" FLOAT64_IEEE SoC_CM_double 0 0 -1.7e+308 1.7e+308 ECU_ADDRESS 0x0 DISPLAY_IDENTIFIER SoC.SoC_Low /end MEASUREMENT
/end MODULE
/* SoC */
/end PROJECT
