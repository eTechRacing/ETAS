ASAP2_VERSION
/begin PROJECT "Generated by ETAS from INTECRIO integration project"
/begin HEADER "" VERSION "" PROJECT_NO Y /end HEADER
/begin MODULE SoC "Generated by ETAS from INTECRIO integration project"
/begin MOD_PAR "" VERSION "" ADDR_EPK 0x0 EPK "" SUPPLIER "ETAS GmbH" CUSTOMER "" CUSTOMER_NO "" USER "" PHONE_NO "" ECU "NO_ECU" CPU_TYPE "MPC750" NO_OF_INTERFACES 1 /end MOD_PAR
/begin MOD_COMMON "Common definitions" BYTE_ORDER MSB_FIRST ALIGNMENT_BYTE 1 ALIGNMENT_WORD 2 ALIGNMENT_LONG 4 ALIGNMENT_FLOAT32_IEEE 4 ALIGNMENT_FLOAT64_IEEE 8 /end MOD_COMMON
/begin MEASUREMENT SoC_B.Memory "" FLOAT64_IEEE SoC_CM_double 0 0 -1.7e+308 1.7e+308 ECU_ADDRESS 0x0 DISPLAY_IDENTIFIER SoC.SoC_Lowest.Memory.Memory /end MEASUREMENT
/begin COMPU_METHOD SoC_CM_double "Q = V" /* ConversionType */ RAT_FUNC /* Format */ "%9.6" /* Unit */ "NO_PHYSICAL_QTY" COEFFS 0.0 1.0 0.0 0.0 0.0 1.0 /end COMPU_METHOD
/begin MEASUREMENT SoC_B.Memory_p "" FLOAT64_IEEE SoC_CM_double 0 0 -1.7e+308 1.7e+308 ECU_ADDRESS 0x0 DISPLAY_IDENTIFIER SoC.SoC_Highest.Memory.Memory_p /end MEASUREMENT
/begin MEASUREMENT SoC_B.NOT "" UBYTE SoC_CM_boolean 0 0 0 1 ECU_ADDRESS 0x0 DISPLAY_IDENTIFIER SoC.SoC_Lowest.NOT.NOT /end MEASUREMENT
/begin COMPU_METHOD SoC_CM_boolean "Q = V" /* ConversionType */ RAT_FUNC /* Format */ "%9.6" /* Unit */ "NO_PHYSICAL_QTY" COEFFS 0.0 1.0 0.0 0.0 0.0 1.0 /end COMPU_METHOD
/begin MEASUREMENT SoC_B.NOT_p "" UBYTE SoC_CM_boolean 0 0 0 1 ECU_ADDRESS 0x0 DISPLAY_IDENTIFIER SoC.SoC_Highest.NOT.NOT_p /end MEASUREMENT
/begin MEASUREMENT SoC_B.Switch "" FLOAT64_IEEE SoC_CM_double 0 0 -1.7e+308 1.7e+308 ECU_ADDRESS 0x0 DISPLAY_IDENTIFIER SoC.SoC_Lowest.Switch.Switch /end MEASUREMENT
/begin MEASUREMENT SoC_B.Switch_d "" FLOAT64_IEEE SoC_CM_double 0 0 -1.7e+308 1.7e+308 ECU_ADDRESS 0x0 DISPLAY_IDENTIFIER SoC.SoC_Highest.Switch.Switch_d /end MEASUREMENT
/begin CHARACTERISTIC SoC_P.Constant_Value "" VALUE 0x0 SCALAR_FLOAT64_IEEE 3.5e+305 SoC_CM_double -1.7e+308 1.7e+308 DISPLAY_IDENTIFIER SoC.Init_SoC_Trigger_value.Latches_OCV_SoC.Constant.Value /end CHARACTERISTIC
/begin RECORD_LAYOUT SCALAR_FLOAT64_IEEE FNC_VALUES 1 FLOAT64_IEEE COLUMN_DIR DIRECT /end RECORD_LAYOUT
/begin CHARACTERISTIC SoC_P.Constant_Value_j "" VALUE 0x0 SCALAR_FLOAT64_IEEE 3.5e+305 SoC_CM_double -1.7e+308 1.7e+308 DISPLAY_IDENTIFIER SoC.Init_SoC_Trigger_value.Measures_OCV_SoC.Constant.Value /end CHARACTERISTIC
/begin CHARACTERISTIC SoC_P.Gain1_Gain "" VALUE 0x0 SCALAR_FLOAT64_IEEE 3.5e+305 SoC_CM_double -1.7e+308 1.7e+308 DISPLAY_IDENTIFIER SoC.Gain1.Gain /end CHARACTERISTIC
/begin CHARACTERISTIC SoC_P.Gain_Gain "" VALUE 0x0 SCALAR_FLOAT64_IEEE 3.5e+305 SoC_CM_double -1.7e+308 1.7e+308 DISPLAY_IDENTIFIER SoC.SoC_Lowest.Gain.Gain /end CHARACTERISTIC
/begin CHARACTERISTIC SoC_P.Gain_Gain_e "" VALUE 0x0 SCALAR_FLOAT64_IEEE 3.5e+305 SoC_CM_double -1.7e+308 1.7e+308 DISPLAY_IDENTIFIER SoC.SoC_Highest.Gain.Gain /end CHARACTERISTIC
/begin CHARACTERISTIC SoC_P.Integrator_IC "" VALUE 0x0 SCALAR_FLOAT64_IEEE 3.5e+305 SoC_CM_double -1.7e+308 1.7e+308 DISPLAY_IDENTIFIER SoC.SoC_Lowest.Integrator.InitialCondition /end CHARACTERISTIC
/begin CHARACTERISTIC SoC_P.Integrator_IC_d "" VALUE 0x0 SCALAR_FLOAT64_IEEE 3.5e+305 SoC_CM_double -1.7e+308 1.7e+308 DISPLAY_IDENTIFIER SoC.SoC_Highest.Integrator.InitialCondition /end CHARACTERISTIC
/begin CHARACTERISTIC SoC_P.Memory_InitialCondition "" VALUE 0x0 SCALAR_FLOAT64_IEEE 3.5e+305 SoC_CM_double -1.7e+308 1.7e+308 DISPLAY_IDENTIFIER SoC.SoC_Lowest.Memory.InitialCondition /end CHARACTERISTIC
/begin CHARACTERISTIC SoC_P.Memory_InitialCondition_o "" VALUE 0x0 SCALAR_FLOAT64_IEEE 3.5e+305 SoC_CM_double -1.7e+308 1.7e+308 DISPLAY_IDENTIFIER SoC.SoC_Highest.Memory.InitialCondition /end CHARACTERISTIC
/begin CHARACTERISTIC SoC_P.OCVtoSoC_bp01Data "" VAL_BLK 0x0 SCALAR_FLOAT64_IEEE 3.5e+305 SoC_CM_double -1.7e+308 1.7e+308 DISPLAY_IDENTIFIER SoC.SoC_Highest.OCV_to_SoC.BreakpointsForDimension1 NUMBER 26 /end CHARACTERISTIC
/begin CHARACTERISTIC SoC_P.OCVtoSoC_bp01Data_n "" VAL_BLK 0x0 SCALAR_FLOAT64_IEEE 3.5e+305 SoC_CM_double -1.7e+308 1.7e+308 DISPLAY_IDENTIFIER SoC.SoC_Lowest.OCV_to_SoC.BreakpointsForDimension1 NUMBER 26 /end CHARACTERISTIC
/begin CHARACTERISTIC SoC_P.OCVtoSoC_tableData "" VAL_BLK 0x0 SCALAR_FLOAT64_IEEE 3.5e+305 SoC_CM_double -1.7e+308 1.7e+308 DISPLAY_IDENTIFIER SoC.SoC_Highest.OCV_to_SoC.Table NUMBER 26 /end CHARACTERISTIC
/begin CHARACTERISTIC SoC_P.OCVtoSoC_tableData_k "" VAL_BLK 0x0 SCALAR_FLOAT64_IEEE 3.5e+305 SoC_CM_double -1.7e+308 1.7e+308 DISPLAY_IDENTIFIER SoC.SoC_Lowest.OCV_to_SoC.Table NUMBER 26 /end CHARACTERISTIC
/begin CHARACTERISTIC SoC_P.Saturation1_LowerSat "" VALUE 0x0 SCALAR_FLOAT64_IEEE 3.5e+305 SoC_CM_double -1.7e+308 1.7e+308 DISPLAY_IDENTIFIER SoC.SoC_Lowest.Saturation1.LowerLimit /end CHARACTERISTIC
/begin CHARACTERISTIC SoC_P.Saturation1_LowerSat_e "" VALUE 0x0 SCALAR_FLOAT64_IEEE 3.5e+305 SoC_CM_double -1.7e+308 1.7e+308 DISPLAY_IDENTIFIER SoC.SoC_Highest.Saturation1.LowerLimit /end CHARACTERISTIC
/begin CHARACTERISTIC SoC_P.Saturation1_UpperSat "" VALUE 0x0 SCALAR_FLOAT64_IEEE 3.5e+305 SoC_CM_double -1.7e+308 1.7e+308 DISPLAY_IDENTIFIER SoC.SoC_Lowest.Saturation1.UpperLimit /end CHARACTERISTIC
/begin CHARACTERISTIC SoC_P.Saturation1_UpperSat_m "" VALUE 0x0 SCALAR_FLOAT64_IEEE 3.5e+305 SoC_CM_double -1.7e+308 1.7e+308 DISPLAY_IDENTIFIER SoC.SoC_Highest.Saturation1.UpperLimit /end CHARACTERISTIC
/begin MEASUREMENT SoC_U.Accumulator_Current "" FLOAT64_IEEE SoC_CM_double 0 0 -1.7e+308 1.7e+308 ECU_ADDRESS 0x0 DISPLAY_IDENTIFIER SoC.Accumulator_Current /end MEASUREMENT
/begin MEASUREMENT SoC_U.Car_State "" FLOAT64_IEEE SoC_CM_double 0 0 -1.7e+308 1.7e+308 ECU_ADDRESS 0x0 DISPLAY_IDENTIFIER SoC.Car_State /end MEASUREMENT
/begin MEASUREMENT SoC_U.Highest_CellVoltage "" FLOAT64_IEEE SoC_CM_double 0 0 -1.7e+308 1.7e+308 ECU_ADDRESS 0x0 DISPLAY_IDENTIFIER SoC.Highest_CellVoltage /end MEASUREMENT
/begin MEASUREMENT SoC_U.Lowest_CellVoltage "" FLOAT64_IEEE SoC_CM_double 0 0 -1.7e+308 1.7e+308 ECU_ADDRESS 0x0 DISPLAY_IDENTIFIER SoC.Lowest_CellVoltage /end MEASUREMENT
/begin MEASUREMENT SoC_Y.SoC_Avg "" FLOAT64_IEEE SoC_CM_double 0 0 -1.7e+308 1.7e+308 ECU_ADDRESS 0x0 DISPLAY_IDENTIFIER SoC.SoC_Avg /end MEASUREMENT
/begin MEASUREMENT SoC_Y.SoC_High "" FLOAT64_IEEE SoC_CM_double 0 0 -1.7e+308 1.7e+308 ECU_ADDRESS 0x0 DISPLAY_IDENTIFIER SoC.SoC_High /end MEASUREMENT
/begin MEASUREMENT SoC_Y.SoC_Low "" FLOAT64_IEEE SoC_CM_double 0 0 -1.7e+308 1.7e+308 ECU_ADDRESS 0x0 DISPLAY_IDENTIFIER SoC.SoC_Low /end MEASUREMENT
/end MODULE
/* SoC */
/end PROJECT
