ASAP2_VERSION
/begin PROJECT "Generated by ETAS from INTECRIO integration project"
/begin HEADER "" VERSION "" PROJECT_NO Y /end HEADER
/begin MODULE SoC "Generated by ETAS from INTECRIO integration project"
/begin MOD_PAR "" VERSION "" ADDR_EPK 0x0 EPK "" SUPPLIER "ETAS GmbH" CUSTOMER "" CUSTOMER_NO "" USER "" PHONE_NO "" ECU "NO_ECU" CPU_TYPE "MPC750" NO_OF_INTERFACES 1 /end MOD_PAR
/begin MOD_COMMON "Common definitions" BYTE_ORDER MSB_FIRST ALIGNMENT_BYTE 1 ALIGNMENT_WORD 2 ALIGNMENT_LONG 4 ALIGNMENT_FLOAT32_IEEE 4 ALIGNMENT_FLOAT64_IEEE 8 /end MOD_COMMON
/begin MEASUREMENT SoC_B.CoreSubsys[0].Assignment2 "" FLOAT64_IEEE SoC_CM_double 0 0 -1.7e+308 1.7e+308 ECU_ADDRESS 0x0 DISPLAY_IDENTIFIER SoC.SoC_Highest.SOC_Estimator__Kalman_Filter_.Kalman_Filter.UKF.Sigma_points.Assignment2.Assignment2 MATRIX_DIM 5 2 1 /end MEASUREMENT
/begin COMPU_METHOD SoC_CM_double "Q = V" /* ConversionType */ RAT_FUNC /* Format */ "%9.6" /* Unit */ "NO_PHYSICAL_QTY" COEFFS 0.0 1.0 0.0 0.0 0.0 1.0 /end COMPU_METHOD
/begin MEASUREMENT SoC_B.CoreSubsys[0].CoreSubsys[4].Probe "" FLOAT64_IEEE SoC_CM_double 0 0 -1.7e+308 1.7e+308 ECU_ADDRESS 0x0 DISPLAY_IDENTIFIER SoC.SoC_Highest.SOC_Estimator__Kalman_Filter_.Kalman_Filter.UKF.Prediction.State_function.State_function.Probe.Probe ARRAY_SIZE 2 /end MEASUREMENT
/begin MEASUREMENT SoC_B.CoreSubsys[0].Gain "" FLOAT64_IEEE SoC_CM_double 0 0 -1.7e+308 1.7e+308 ECU_ADDRESS 0x0 DISPLAY_IDENTIFIER SoC.SoC_Highest.SOC_Estimator__Kalman_Filter_.Gain.Gain /end MEASUREMENT
/begin MEASUREMENT SoC_B.CoreSubsys[0].ImpAsg_InsertedFor_xk1_at_inpor "" FLOAT64_IEEE SoC_CM_double 0 0 -1.7e+308 1.7e+308 ECU_ADDRESS 0x0 DISPLAY_IDENTIFIER SoC.SoC_Highest.SOC_Estimator__Kalman_Filter_.Kalman_Filter.UKF.Prediction.State_function.State_function.ImpAsg_InsertedFor_xk1_at_inpor MATRIX_DIM 5 2 1 /end MEASUREMENT
/begin MEASUREMENT SoC_B.CoreSubsys[0].Pk1_k1 "" FLOAT64_IEEE SoC_CM_double 0 0 -1.7e+308 1.7e+308 ECU_ADDRESS 0x0 DISPLAY_IDENTIFIER SoC.SoC_Highest.SOC_Estimator__Kalman_Filter_.Kalman_Filter.UKF.Correction.updatePk.Pk1_k1 MATRIX_DIM 2 2 1 /end MEASUREMENT
/begin MEASUREMENT SoC_B.CoreSubsys[0].RateTransition1 "" FLOAT64_IEEE SoC_CM_double 0 0 -1.7e+308 1.7e+308 ECU_ADDRESS 0x0 DISPLAY_IDENTIFIER SoC.SoC_Highest.SOC_Estimator__Kalman_Filter_.Kalman_Filter.UKF.Rate_Transition1.RateTransition1 /end MEASUREMENT
/begin MEASUREMENT SoC_B.CoreSubsys[0].Reshape "" FLOAT64_IEEE SoC_CM_double 0 0 -1.7e+308 1.7e+308 ECU_ADDRESS 0x0 DISPLAY_IDENTIFIER SoC.SoC_Highest.SOC_Estimator__Kalman_Filter_.Kalman_Filter.UKF.Delay___X.Reshape.Reshape ARRAY_SIZE 2 /end MEASUREMENT
/begin MEASUREMENT SoC_B.CoreSubsys[0].Sum "" FLOAT64_IEEE SoC_CM_double 0 0 -1.7e+308 1.7e+308 ECU_ADDRESS 0x0 DISPLAY_IDENTIFIER SoC.SoC_Highest.SOC_Estimator__Kalman_Filter_.Kalman_Filter.UKF.Correction.Sum.Sum ARRAY_SIZE 2 /end MEASUREMENT
/begin MEASUREMENT SoC_B.CoreSubsys_g[0].Gain "" FLOAT64_IEEE SoC_CM_double 0 0 -1.7e+308 1.7e+308 ECU_ADDRESS 0x0 DISPLAY_IDENTIFIER SoC.SoC_Lowest.SOC_Estimator__Kalman_Filter_.Gain.Gain /end MEASUREMENT
/begin MEASUREMENT SoC_B.CoreSubsys_g[0].Probe "" FLOAT64_IEEE SoC_CM_double 0 0 -1.7e+308 1.7e+308 ECU_ADDRESS 0x0 DISPLAY_IDENTIFIER SoC.SoC_Lowest.SOC_Estimator__Kalman_Filter_.Kalman_Filter.EKF.Jacobian.Probe.Probe ARRAY_SIZE 2 /end MEASUREMENT
/begin MEASUREMENT SoC_B.CoreSubsys_g[0].Product5 "" FLOAT64_IEEE SoC_CM_double 0 0 -1.7e+308 1.7e+308 ECU_ADDRESS 0x0 DISPLAY_IDENTIFIER SoC.SoC_Lowest.SOC_Estimator__Kalman_Filter_.Kalman_Filter.EKF.Correction.Product5.Product5 MATRIX_DIM 2 2 1 /end MEASUREMENT
/begin MEASUREMENT SoC_B.CoreSubsys_g[0].RateTransition1 "" FLOAT64_IEEE SoC_CM_double 0 0 -1.7e+308 1.7e+308 ECU_ADDRESS 0x0 DISPLAY_IDENTIFIER SoC.SoC_Lowest.SOC_Estimator__Kalman_Filter_.Kalman_Filter.EKF.Rate_Transition1.RateTransition1 /end MEASUREMENT
/begin MEASUREMENT SoC_B.CoreSubsys_g[0].Sum "" FLOAT64_IEEE SoC_CM_double 0 0 -1.7e+308 1.7e+308 ECU_ADDRESS 0x0 DISPLAY_IDENTIFIER SoC.SoC_Lowest.SOC_Estimator__Kalman_Filter_.Kalman_Filter.EKF.Correction.Sum.Sum ARRAY_SIZE 2 /end MEASUREMENT
/begin MEASUREMENT SoC_B.CoreSubsys_g[0].TmpSignalConversionAtDelayInpor "" FLOAT64_IEEE SoC_CM_double 0 0 -1.7e+308 1.7e+308 ECU_ADDRESS 0x0 DISPLAY_IDENTIFIER SoC.Opaque.TmpSignalConversionAtDelayInpor ARRAY_SIZE 2 /end MEASUREMENT
/begin MEASUREMENT SoC_B.SOCEstimatorCoulombCounting[0].CoreSubsys.Gain "" FLOAT64_IEEE SoC_CM_double 0 0 -1.7e+308 1.7e+308 ECU_ADDRESS 0x0 DISPLAY_IDENTIFIER SoC.SoC_Highest.SOC_Estimator__Coulomb_Counting_.Gain.Gain /end MEASUREMENT
/begin MEASUREMENT SoC_B.SOCEstimatorCoulombCounting_p[0].CoreSubsys.Gain "" FLOAT64_IEEE SoC_CM_double 0 0 -1.7e+308 1.7e+308 ECU_ADDRESS 0x0 DISPLAY_IDENTIFIER SoC.SoC_Lowest.SOC_Estimator__Coulomb_Counting_.Gain.Gain /end MEASUREMENT
/begin MEASUREMENT SoC_B.Saturation1 "" FLOAT64_IEEE SoC_CM_double 0 0 -1.7e+308 1.7e+308 ECU_ADDRESS 0x0 DISPLAY_IDENTIFIER SoC.SoC_Lowest.Saturation1.Saturation1 /end MEASUREMENT
/begin MEASUREMENT SoC_B.Saturation1_i "" FLOAT64_IEEE SoC_CM_double 0 0 -1.7e+308 1.7e+308 ECU_ADDRESS 0x0 DISPLAY_IDENTIFIER SoC.SoC_Highest.Saturation1.Saturation1_i /end MEASUREMENT
/begin MEASUREMENT SoC_B.Switch "" FLOAT64_IEEE SoC_CM_double 0 0 -1.7e+308 1.7e+308 ECU_ADDRESS 0x0 DISPLAY_IDENTIFIER SoC.SoC_Lowest.Switch.Switch /end MEASUREMENT
/begin MEASUREMENT SoC_B.Switch_d "" FLOAT64_IEEE SoC_CM_double 0 0 -1.7e+308 1.7e+308 ECU_ADDRESS 0x0 DISPLAY_IDENTIFIER SoC.SoC_Highest.Switch.Switch_d /end MEASUREMENT
/begin MEASUREMENT SoC_U.Accumulator_Current "" FLOAT64_IEEE SoC_CM_double 0 0 -1.7e+308 1.7e+308 ECU_ADDRESS 0x0 DISPLAY_IDENTIFIER SoC.Accumulator_Current /end MEASUREMENT
/begin MEASUREMENT SoC_U.Car_State "" FLOAT64_IEEE SoC_CM_double 0 0 -1.7e+308 1.7e+308 ECU_ADDRESS 0x0 DISPLAY_IDENTIFIER SoC.Car_State /end MEASUREMENT
/begin MEASUREMENT SoC_U.Highest_Cell_Voltage "" FLOAT64_IEEE SoC_CM_double 0 0 -1.7e+308 1.7e+308 ECU_ADDRESS 0x0 DISPLAY_IDENTIFIER SoC.Highest_Cell_Voltage /end MEASUREMENT
/begin MEASUREMENT SoC_U.Lowest_Cell_Voltage "" FLOAT64_IEEE SoC_CM_double 0 0 -1.7e+308 1.7e+308 ECU_ADDRESS 0x0 DISPLAY_IDENTIFIER SoC.Lowest_Cell_Voltage /end MEASUREMENT
/begin MEASUREMENT SoC_Y.CSoC_H "" FLOAT64_IEEE SoC_CM_double 0 0 -1.7e+308 1.7e+308 ECU_ADDRESS 0x0 DISPLAY_IDENTIFIER SoC.CSoC_H /end MEASUREMENT
/begin MEASUREMENT SoC_Y.CSoC_L "" FLOAT64_IEEE SoC_CM_double 0 0 -1.7e+308 1.7e+308 ECU_ADDRESS 0x0 DISPLAY_IDENTIFIER SoC.CSoC_L /end MEASUREMENT
/begin MEASUREMENT SoC_Y.KFSoC_H "" FLOAT64_IEEE SoC_CM_double 0 0 -1.7e+308 1.7e+308 ECU_ADDRESS 0x0 DISPLAY_IDENTIFIER SoC.KFSoC_H /end MEASUREMENT
/begin MEASUREMENT SoC_Y.KFSoC_L "" FLOAT64_IEEE SoC_CM_double 0 0 -1.7e+308 1.7e+308 ECU_ADDRESS 0x0 DISPLAY_IDENTIFIER SoC.KFSoC_L /end MEASUREMENT
/begin MEASUREMENT SoC_Y.SoC_Avg "" FLOAT64_IEEE SoC_CM_double 0 0 -1.7e+308 1.7e+308 ECU_ADDRESS 0x0 DISPLAY_IDENTIFIER SoC.SoC_Avg /end MEASUREMENT
/begin MEASUREMENT SoC_Y.SoC_High "" FLOAT64_IEEE SoC_CM_double 0 0 -1.7e+308 1.7e+308 ECU_ADDRESS 0x0 DISPLAY_IDENTIFIER SoC.SoC_High /end MEASUREMENT
/begin MEASUREMENT SoC_Y.SoC_Low "" FLOAT64_IEEE SoC_CM_double 0 0 -1.7e+308 1.7e+308 ECU_ADDRESS 0x0 DISPLAY_IDENTIFIER SoC.SoC_Low /end MEASUREMENT
/end MODULE
/* SoC */
/end PROJECT
