ASAP2_VERSION
/begin PROJECT "Generated by ETAS from INTECRIO integration project"
/begin HEADER "" VERSION "" PROJECT_NO Y /end HEADER
/begin MODULE racing_modes_R2022a "Generated by ETAS from INTECRIO integration project"
/begin MOD_PAR "" VERSION "" ADDR_EPK 0x0 EPK "" SUPPLIER "ETAS GmbH" CUSTOMER "" CUSTOMER_NO "" USER "" PHONE_NO "" ECU "NO_ECU" CPU_TYPE "MPC750" NO_OF_INTERFACES 1 /end MOD_PAR
/begin MOD_COMMON "Common definitions" BYTE_ORDER MSB_FIRST ALIGNMENT_BYTE 1 ALIGNMENT_WORD 2 ALIGNMENT_LONG 4 ALIGNMENT_FLOAT32_IEEE 4 ALIGNMENT_FLOAT64_IEEE 8 /end MOD_COMMON
/begin MEASUREMENT racing_modes_R2022a_B.Gain "" FLOAT64_IEEE racing_modes_R2022a_CM_double 0 0 -1.7e+308 1.7e+308 ECU_ADDRESS 0x0 DISPLAY_IDENTIFIER racing_modes_R2022a.Custom_Dash__11_.Max_tyre_slip.Gain.Gain /end MEASUREMENT
/begin COMPU_METHOD racing_modes_R2022a_CM_double "Q = V" RAT_FUNC "%9.6" "NO_PHYSICAL_QTY" COEFFS 0.0 1.0 0.0 0.0 0.0 1.0 /end COMPU_METHOD
/begin MEASUREMENT racing_modes_R2022a_B.Merge "" FLOAT64_IEEE racing_modes_R2022a_CM_double 0 0 -1.7e+308 1.7e+308 ECU_ADDRESS 0x0 DISPLAY_IDENTIFIER racing_modes_R2022a.Merge.Merge /end MEASUREMENT
/begin MEASUREMENT racing_modes_R2022a_U.CustomMode_Data "" FLOAT64_IEEE racing_modes_R2022a_CM_double 0 0 -1.7e+308 1.7e+308 ECU_ADDRESS 0x0 DISPLAY_IDENTIFIER racing_modes_R2022a.CustomMode_Data /end MEASUREMENT
/begin MEASUREMENT racing_modes_R2022a_U.CustomMode_Identifier "" FLOAT64_IEEE racing_modes_R2022a_CM_double 0 0 -1.7e+308 1.7e+308 ECU_ADDRESS 0x0 DISPLAY_IDENTIFIER racing_modes_R2022a.CustomMode_Identifier /end MEASUREMENT
/begin MEASUREMENT racing_modes_R2022a_U.RacingMode "" UBYTE racing_modes_R2022a_CM_uint8 0 0 0.0 255.0 ECU_ADDRESS 0x0 DISPLAY_IDENTIFIER racing_modes_R2022a.RacingMode /end MEASUREMENT
/begin COMPU_METHOD racing_modes_R2022a_CM_uint8 "Q = V" RAT_FUNC "%9.6" "NO_PHYSICAL_QTY" COEFFS 0.0 1.0 0.0 0.0 0.0 1.0 /end COMPU_METHOD
/begin MEASUREMENT racing_modes_R2022a_Y.VDC_Max_tire_slip "" FLOAT64_IEEE racing_modes_R2022a_CM_double 0 0 -1.7e+308 1.7e+308 ECU_ADDRESS 0x0 DISPLAY_IDENTIFIER racing_modes_R2022a.VDC_Max_tire_slip /end MEASUREMENT
/begin MEASUREMENT racing_modes_R2022a_Y.Workshop_Mode_Enable "" UBYTE racing_modes_R2022a_CM_boolean 0 0 0 1 ECU_ADDRESS 0x0 DISPLAY_IDENTIFIER racing_modes_R2022a.Workshop_Mode_Enable /end MEASUREMENT
/begin COMPU_METHOD racing_modes_R2022a_CM_boolean "Q = V" RAT_FUNC "%9.6" "NO_PHYSICAL_QTY" COEFFS 0.0 1.0 0.0 0.0 0.0 1.0 /end COMPU_METHOD
/end MODULE
/* racing_modes_R2022a */
/end PROJECT
