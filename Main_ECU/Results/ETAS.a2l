ASAP2_VERSION 1 61
/begin PROJECT ETAS "Generated by ETAS from INTECRIO V5.0.5.1003 integration project"
/begin HEADER "" VERSION "" PROJECT_NO Y /end HEADER
/begin MODULE INTECRIO_MERGED "Generated by ETAS INTECRIO V5.0.5.1003 for M/C interface ETARGET"
/begin MOD_COMMON "Common definitions" BYTE_ORDER MSB_FIRST ALIGNMENT_BYTE 1 ALIGNMENT_WORD 2 ALIGNMENT_LONG 4 ALIGNMENT_FLOAT32_IEEE 4 ALIGNMENT_FLOAT64_IEEE 8 /end MOD_COMMON
/begin MEASUREMENT ETCSignals.ES900.ES910.CAN1.Presence.PresenceGroup.PresenceFlag "" FLOAT64_IEEE LINEAR_FUNCTION_M1_T0_U1 1 100 0 1 ECU_ADDRESS 0x0 /end MEASUREMENT
/begin MEASUREMENT ETCSignals.ES900.ES910.CAN1.CAN1.AP_BMS_SDC.Shutdown_PackageIntck "" FLOAT64_IEEE LINEAR_FUNCTION_M1_T0_U2 1 100 0 0 ECU_ADDRESS 0x0 /end MEASUREMENT
/begin MEASUREMENT ETCSignals.ES900.ES910.CAN1.CAN1.AP_BMS_SDC.Shutdown_IMD "" FLOAT64_IEEE LINEAR_FUNCTION_M1_T0_U2 1 100 0 0 ECU_ADDRESS 0x0 /end MEASUREMENT
/begin MEASUREMENT ETCSignals.ES900.ES910.CAN1.CAN1.AP_BMS_SDC.Shutdown_BMS "" FLOAT64_IEEE LINEAR_FUNCTION_M1_T0_U2 1 100 0 0 ECU_ADDRESS 0x0 /end MEASUREMENT
/begin MEASUREMENT ETCSignals.ES900.ES910.CAN1.CAN1.AP_CurrentSensor.ERROR "" FLOAT64_IEEE LINEAR_FUNCTION_M1_T0_U2 1 100 0 0 ECU_ADDRESS 0x0 /end MEASUREMENT
/begin MEASUREMENT ETCSignals.ES900.ES910.CAN1.CAN1.AP_CurrentSensor.Accumulator_Current "" FLOAT64_IEEE LINEAR_FUNCTION_M1_T0_U3 1 100 0 0 ECU_ADDRESS 0x0 /end MEASUREMENT
/begin MEASUREMENT ETCSignals.ES900.ES910.CAN1.CAN1.AP_BMS_Voltages.Lowest_CellVoltage "" FLOAT64_IEEE LINEAR_FUNCTION_M1_T0_U4 1 100 0 0 ECU_ADDRESS 0x0 /end MEASUREMENT
/begin MEASUREMENT ETCSignals.ES900.ES910.CAN1.CAN1.AP_BMS_Voltages.Highest_CellVoltage "" FLOAT64_IEEE LINEAR_FUNCTION_M1_T0_U4 1 100 0 0 ECU_ADDRESS 0x0 /end MEASUREMENT
/begin MEASUREMENT ETCSignals.ES900.ES910.CAN1.CAN1.AP_BMS_Voltages.Accumulator_Voltage "" FLOAT64_IEEE LINEAR_FUNCTION_M1_T0_U4 1 100 0 0 ECU_ADDRESS 0x0 /end MEASUREMENT
/begin MEASUREMENT ETCSignals.ES900.ES910.CAN1.CAN1.AP_BMS_ChargerParameters.Charger_MaxVoltage "" FLOAT64_IEEE LINEAR_FUNCTION_M1_T0_U1 1 100 0 0 ECU_ADDRESS 0x0 /end MEASUREMENT
/begin MEASUREMENT ETCSignals.ES900.ES910.CAN1.CAN1.AP_BMS_ChargerParameters.Charger_MaxCurrent "" FLOAT64_IEEE LINEAR_FUNCTION_M1_T0_U1 1 100 0 0 ECU_ADDRESS 0x0 /end MEASUREMENT
/begin MEASUREMENT ETCSignals.ES900.ES910.CAN1.CAN1.AP_BMS_Temperatures.Lowest_CellTemp "" FLOAT64_IEEE LINEAR_FUNCTION_M1_T0_U5 1 100 0 0 ECU_ADDRESS 0x0 /end MEASUREMENT
/begin MEASUREMENT ETCSignals.ES900.ES910.CAN1.CAN1.AP_BMS_Temperatures.Highest_CellTemp "" FLOAT64_IEEE LINEAR_FUNCTION_M1_T0_U5 1 100 0 0 ECU_ADDRESS 0x0 /end MEASUREMENT
/begin MEASUREMENT ETCSignals.ES900.ES910.CAN1.CAN1.AP_BMS_Temperatures.Average_CellTemp "" FLOAT64_IEEE LINEAR_FUNCTION_M1_T0_U5 1 100 0 0 ECU_ADDRESS 0x0 /end MEASUREMENT
/begin MEASUREMENT ETCSignals.ES900.ES910.CAN1.CAN1.AP_Inverter_R_Tx.Inv_R_RegID "" FLOAT64_IEEE LINEAR_FUNCTION_M1_T0_U6 1 100 0 0 ECU_ADDRESS 0x0 /end MEASUREMENT
/begin MEASUREMENT ETCSignals.ES900.ES910.CAN1.CAN1.AP_Inverter_R_Tx.Inv_R_RegID_M73_Inv_R_TempMotor "" FLOAT64_IEEE LINEAR_FUNCTION_M1_T0_U7 1 100 0 0 ECU_ADDRESS 0x0 /end MEASUREMENT
/begin MEASUREMENT ETCSignals.ES900.ES910.CAN1.CAN1.AP_Inverter_R_Tx.Inv_R_RegID_M74_Inv_R_TempIGBT "" FLOAT64_IEEE LINEAR_FUNCTION_M1_T0_U7 1 100 0 0 ECU_ADDRESS 0x0 /end MEASUREMENT
/begin MEASUREMENT ETCSignals.ES900.ES910.CAN1.CAN1.AP_Inverter_R_Tx.Inv_R_RegID_M48_Inv_R_Speed "" FLOAT64_IEEE LINEAR_FUNCTION_M1_T0_U8 1 100 0 0 ECU_ADDRESS 0x0 /end MEASUREMENT
/begin MEASUREMENT ETCSignals.ES900.ES910.CAN1.CAN1.AP_Inverter_R_Tx.Inv_R_RegID_M39_Inv_R_Iq "" FLOAT64_IEEE LINEAR_FUNCTION_M1_T0_U3 1 100 0 0 ECU_ADDRESS 0x0 /end MEASUREMENT
/begin MEASUREMENT ETCSignals.ES900.ES910.CAN1.CAN1.AP_Inverter_R_Tx.Inv_R_RegID_M38_Inv_R_Icommand "" FLOAT64_IEEE LINEAR_FUNCTION_M1_T0_U3 1 100 0 0 ECU_ADDRESS 0x0 /end MEASUREMENT
/begin MEASUREMENT ETCSignals.ES900.ES910.CAN1.CAN1.AP_Inverter_R_Tx.Inv_R_RegID_M32_Inv_R_Iactual "" FLOAT64_IEEE LINEAR_FUNCTION_M1_T0_U3 1 100 0 0 ECU_ADDRESS 0x0 /end MEASUREMENT
/begin MEASUREMENT ETCSignals.ES900.ES910.CAN1.CAN1.AP_Inverter_R_Tx.Inv_R_RegID_M235_Inv_R_DCBus "" FLOAT64_IEEE LINEAR_FUNCTION_M1_T0_U4 1 100 0 0 ECU_ADDRESS 0x0 /end MEASUREMENT
/begin MEASUREMENT ETCSignals.ES900.ES910.CAN1.CAN1.AP_Inverter_L_Tx.Inv_L_RegID "" FLOAT64_IEEE LINEAR_FUNCTION_M1_T0_U6 1 100 0 0 ECU_ADDRESS 0x0 /end MEASUREMENT
/begin MEASUREMENT ETCSignals.ES900.ES910.CAN1.CAN1.AP_Inverter_L_Tx.Inv_L_RegID_M73_Inv_L_TempMotor "" FLOAT64_IEEE LINEAR_FUNCTION_M1_T0_U7 1 100 0 0 ECU_ADDRESS 0x0 /end MEASUREMENT
/begin MEASUREMENT ETCSignals.ES900.ES910.CAN1.CAN1.AP_Inverter_L_Tx.Inv_L_RegID_M74_Inv_L_TempIGBT "" FLOAT64_IEEE LINEAR_FUNCTION_M1_T0_U7 1 100 0 0 ECU_ADDRESS 0x0 /end MEASUREMENT
/begin MEASUREMENT ETCSignals.ES900.ES910.CAN1.CAN1.AP_Inverter_L_Tx.Inv_L_RegID_M48_Inv_L_Speed "" FLOAT64_IEEE LINEAR_FUNCTION_M1_T0_U8 1 100 0 0 ECU_ADDRESS 0x0 /end MEASUREMENT
/begin MEASUREMENT ETCSignals.ES900.ES910.CAN1.CAN1.AP_Inverter_L_Tx.Inv_L_RegID_M39_Inv_L_Iq "" FLOAT64_IEEE LINEAR_FUNCTION_M1_T0_U3 1 100 0 0 ECU_ADDRESS 0x0 /end MEASUREMENT
/begin MEASUREMENT ETCSignals.ES900.ES910.CAN1.CAN1.AP_Inverter_L_Tx.Inv_L_RegID_M38_Inv_L_Icommand "" FLOAT64_IEEE LINEAR_FUNCTION_M1_T0_U3 1 100 0 0 ECU_ADDRESS 0x0 /end MEASUREMENT
/begin MEASUREMENT ETCSignals.ES900.ES910.CAN1.CAN1.AP_Inverter_L_Tx.Inv_L_RegID_M32_Inv_L_Iactual "" FLOAT64_IEEE LINEAR_FUNCTION_M1_T0_U3 1 100 0 0 ECU_ADDRESS 0x0 /end MEASUREMENT
/begin MEASUREMENT ETCSignals.ES900.ES910.CAN1.CAN1.AP_Inverter_L_Tx.Inv_L_RegID_M235_Inv_L_DCBus "" FLOAT64_IEEE LINEAR_FUNCTION_M1_T0_U4 1 100 0 0 ECU_ADDRESS 0x0 /end MEASUREMENT
/begin MEASUREMENT ETCSignals.ES900.ES910.CAN1.CAN1.AP_DASH_Mode.RacingMode "" FLOAT64_IEEE LINEAR_FUNCTION_M1_T0_U1 1 100 0 0 ECU_ADDRESS 0x0 /end MEASUREMENT
/begin MEASUREMENT ETCSignals.ES900.ES910.CAN1.CAN1.NM_BMS_Keep_Alive.BMS_Alive "" FLOAT64_IEEE LINEAR_FUNCTION_M1_T0_U1 1 100 0 0 ECU_ADDRESS 0x0 /end MEASUREMENT
/begin MEASUREMENT ETCSignals.ES900.ES910.CAN1.CAN1.AP_BMS_AIRs_State.AIRs_State "" FLOAT64_IEEE LINEAR_FUNCTION_M1_T0_U1 1 100 0 0 ECU_ADDRESS 0x0 /end MEASUREMENT
/begin MEASUREMENT ETCSignals.ES900.ES910.CAN1.CAN1.NM_DASH_Keep_Alive.Dash_Alive "" FLOAT64_IEEE LINEAR_FUNCTION_M1_T0_U1 1 100 0 0 ECU_ADDRESS 0x0 /end MEASUREMENT
/begin MEASUREMENT ETCSignals.ES900.ES910.CAN1.CAN1.AP_DASH_PrechargeRequest.PrechargeRequest "" FLOAT64_IEEE LINEAR_FUNCTION_M1_T0_U1 1 100 0 0 ECU_ADDRESS 0x0 /end MEASUREMENT
/begin MEASUREMENT ETCSignals.ES900.ES910.CAN1.CAN1.AP_DASH_EnableDrive.EnableDrive_Order "" FLOAT64_IEEE LINEAR_FUNCTION_M1_T0_U2 1 100 0 0 ECU_ADDRESS 0x0 /end MEASUREMENT
/begin MEASUREMENT ETCSignals.ES900.ES910.CAN1.CAN1.AP_ETAS_DashData.SoC_KF "" FLOAT64_IEEE LINEAR_FUNCTION_M1_T0_U9 1 100 0 255 ECU_ADDRESS 0x0 /end MEASUREMENT
/begin MEASUREMENT ETCSignals.ES900.ES910.CAN1.CAN1.AP_ETAS_DashData.Speed "" FLOAT64_IEEE LINEAR_FUNCTION_M1_T0_U10 1 100 -128 127 ECU_ADDRESS 0x0 /end MEASUREMENT
/begin MEASUREMENT ETCSignals.ES900.ES910.CAN1.CAN1.AP_ETAS_DashData.Precharge_Voltage "" FLOAT64_IEEE LINEAR_FUNCTION_M1_T0_U4 1 100 0 655.35 ECU_ADDRESS 0x0 /end MEASUREMENT
/begin MEASUREMENT ETCSignals.ES900.ES910.CAN1.CAN1.AP_ETAS_DashData.Precharge_Percentage "" FLOAT64_IEEE LINEAR_FUNCTION_M1_T0_U11 1 100 0 100 ECU_ADDRESS 0x0 /end MEASUREMENT
/begin MEASUREMENT ETCSignals.ES900.ES910.CAN1.CAN1.AP_ETAS_VDCParams.VDC_Max_Tyre_Slip "" FLOAT64_IEEE LINEAR_FUNCTION_M1_T0_U6 1 100 0 2.55 ECU_ADDRESS 0x0 /end MEASUREMENT
/begin MEASUREMENT ETCSignals.ES900.ES910.CAN1.CAN1.AP_ETAS_Inverter_R_Rx.Inverter_R_RegID "" FLOAT64_IEEE LINEAR_FUNCTION_M1_T0_U1 1 100 0 255 ECU_ADDRESS 0x0 /end MEASUREMENT
/begin MEASUREMENT ETCSignals.ES900.ES910.CAN1.CAN1.AP_ETAS_Inverter_R_Rx.Inverter_R_b7tob0 "" FLOAT64_IEEE LINEAR_FUNCTION_M1_T0_U1 1 100 0 255 ECU_ADDRESS 0x0 /end MEASUREMENT
/begin MEASUREMENT ETCSignals.ES900.ES910.CAN1.CAN1.AP_ETAS_Inverter_R_Rx.Inverter_R_b15tob8 "" FLOAT64_IEEE LINEAR_FUNCTION_M1_T0_U1 1 100 0 255 ECU_ADDRESS 0x0 /end MEASUREMENT
/begin MEASUREMENT ETCSignals.ES900.ES910.CAN1.CAN1.AP_ETAS_Inverter_L_Rx.Inverter_L_RegID "" FLOAT64_IEEE LINEAR_FUNCTION_M1_T0_U1 1 100 0 255 ECU_ADDRESS 0x0 /end MEASUREMENT
/begin MEASUREMENT ETCSignals.ES900.ES910.CAN1.CAN1.AP_ETAS_Inverter_L_Rx.Inverter_L_b7tob0 "" FLOAT64_IEEE LINEAR_FUNCTION_M1_T0_U1 1 100 0 255 ECU_ADDRESS 0x0 /end MEASUREMENT
/begin MEASUREMENT ETCSignals.ES900.ES910.CAN1.CAN1.AP_ETAS_Inverter_L_Rx.Inverter_L_b15tob8 "" FLOAT64_IEEE LINEAR_FUNCTION_M1_T0_U1 1 100 0 255 ECU_ADDRESS 0x0 /end MEASUREMENT
/begin MEASUREMENT ETCSignals.ES900.ES910.CAN1.CAN1.AP_ETAS_CarState.Car_State "" FLOAT64_IEEE LINEAR_FUNCTION_M1_T0_U1 1 100 0 21 ECU_ADDRESS 0x0 /end MEASUREMENT
/begin MEASUREMENT ETCSignals.ES900.ES910.CAN1.CAN1.AP_ETAS_AIRsRequest.AIRs_Request "" FLOAT64_IEEE LINEAR_FUNCTION_M1_T0_U1 1 100 0 15 ECU_ADDRESS 0x0 /end MEASUREMENT
/begin MEASUREMENT ETCSignals.ES900.ES910.CAN1.CAN1.MEAS_ETAS_InternalVars.InvertersAction "" FLOAT64_IEEE LINEAR_FUNCTION_M1_T0_U6 1 100 0 31 ECU_ADDRESS 0x0 /end MEASUREMENT
/begin MEASUREMENT ETCSignals.ES900.ES910.CAN1.CAN1.MEAS_ETAS_InternalVars.el_Vel_OK "" FLOAT64_IEEE LINEAR_FUNCTION_M1_T0_U2 1 100 0 1 ECU_ADDRESS 0x0 /end MEASUREMENT
/begin MEASUREMENT ETCSignals.ES900.ES910.CAN1.CAN1.MEAS_ETAS_InternalVars.TC_Warning "" FLOAT64_IEEE LINEAR_FUNCTION_M1_T0_U2 1 100 0 1 ECU_ADDRESS 0x0 /end MEASUREMENT
/begin MEASUREMENT ETCSignals.ES900.ES910.CAN1.CAN1.MEAS_ETAS_InternalVars.Regenerative_Enable "" FLOAT64_IEEE LINEAR_FUNCTION_M1_T0_U2 1 100 0 1 ECU_ADDRESS 0x0 /end MEASUREMENT
/begin MEASUREMENT ETCSignals.ES900.ES910.CAN1.CAN1.MEAS_ETAS_InternalVars.CriticalDisconnection "" FLOAT64_IEEE LINEAR_FUNCTION_M1_T0_U2 1 100 0 1 ECU_ADDRESS 0x0 /end MEASUREMENT
/begin MEASUREMENT ETCSignals.ES900.ES910.CAN1.CAN1.MEAS_ETAS_InternalVars.Relay_Error "" FLOAT64_IEEE LINEAR_FUNCTION_M1_T0_U2 1 100 0 1 ECU_ADDRESS 0x0 /end MEASUREMENT
/begin MEASUREMENT ETCSignals.ES900.ES910.CAN1.CAN1.MEAS_ETAS_InternalVars.Car_OK "" FLOAT64_IEEE LINEAR_FUNCTION_M1_T0_U2 1 100 0 1 ECU_ADDRESS 0x0 /end MEASUREMENT
/begin MEASUREMENT ETCSignals.ES900.ES910.CAN1.CAN1.MEAS_ETAS_InternalVars.Power "" FLOAT64_IEEE LINEAR_FUNCTION_M1_T0_U12 1 100 -327.68 327.67 ECU_ADDRESS 0x0 /end MEASUREMENT
/begin MEASUREMENT ETCSignals.ES900.ES910.CAN1.CAN1.MEAS_ETAS_InternalVars.Torque_OK "" FLOAT64_IEEE LINEAR_FUNCTION_M1_T0_U2 1 100 0 1 ECU_ADDRESS 0x0 /end MEASUREMENT
/begin MEASUREMENT ETCSignals.ES900.ES910.CAN1.CAN1.MEAS_ETAS_InternalVars.Sensorics_Mode "" FLOAT64_IEEE LINEAR_FUNCTION_M1_T0_U1 1 100 0 7 ECU_ADDRESS 0x0 /end MEASUREMENT
/begin MEASUREMENT ETCSignals.ES900.ES910.CAN1.CAN1.MEAS_ETAS_InternalVars.Critical_Signal_Disconnection "" FLOAT64_IEEE LINEAR_FUNCTION_M1_T0_U2 1 100 0 1 ECU_ADDRESS 0x0 /end MEASUREMENT
/begin MEASUREMENT ETCSignals.ES900.ES910.CAN1.CAN1.MEAS_ETAS_InternalVars.Critical_CAN_Disconnection "" FLOAT64_IEEE LINEAR_FUNCTION_M1_T0_U2 1 100 0 1 ECU_ADDRESS 0x0 /end MEASUREMENT
/begin MEASUREMENT ETCSignals.ES900.ES910.CAN1.CAN1.MEAS_ETAS_InternalVars.APPS_Implausibility "" FLOAT64_IEEE LINEAR_FUNCTION_M1_T0_U2 1 100 0 1 ECU_ADDRESS 0x0 /end MEASUREMENT
/begin MEASUREMENT ETCSignals.ES900.ES910.CAN1.CAN1.AP_ETAS_Synchronism.Sync_CAN1 "" FLOAT64_IEEE LINEAR_FUNCTION_M1_T0_U1 1 100 0 255 ECU_ADDRESS 0x0 /end MEASUREMENT
/begin MEASUREMENT ETCSignals.ES900.ES910.CAN2.Presence.PresenceGroup.PresenceFlag "" FLOAT64_IEEE LINEAR_FUNCTION_M1_T0_U1 1 100 0 1 ECU_ADDRESS 0x0 /end MEASUREMENT
/begin MEASUREMENT ETCSignals.ES900.ES910.CAN2.CAN2.MEAS_ETAS_SOC.SOC_High "" FLOAT64_IEEE LINEAR_FUNCTION_M1_T0_U9 1 100 0 655.35 ECU_ADDRESS 0x0 /end MEASUREMENT
/begin MEASUREMENT ETCSignals.ES900.ES910.CAN2.CAN2.MEAS_ETAS_SOC.SOC_Low "" FLOAT64_IEEE LINEAR_FUNCTION_M1_T0_U9 1 100 0 655.35 ECU_ADDRESS 0x0 /end MEASUREMENT
/begin MEASUREMENT ETCSignals.ES900.ES910.CAN2.CAN2.MEAS_ETAS_SOC.SOC_Avg "" FLOAT64_IEEE LINEAR_FUNCTION_M1_T0_U9 1 100 0 655.35 ECU_ADDRESS 0x0 /end MEASUREMENT
/begin MEASUREMENT ETCSignals.ES900.ES910.CAN2.CAN2.AP_ELLIPSE_AUTO.el_Track_Valid "" FLOAT64_IEEE LINEAR_FUNCTION_M1_T0_U2 1 100 0 0 ECU_ADDRESS 0x0 /end MEASUREMENT
/begin MEASUREMENT ETCSignals.ES900.ES910.CAN2.CAN2.AP_ELLIPSE_AUTO.el_Slip_Valid "" FLOAT64_IEEE LINEAR_FUNCTION_M1_T0_U2 1 100 0 0 ECU_ADDRESS 0x0 /end MEASUREMENT
/begin MEASUREMENT ETCSignals.ES900.ES910.CAN2.CAN2.AP_ELLIPSE_AUTO.el_Curvature_Valid "" FLOAT64_IEEE LINEAR_FUNCTION_M1_T0_U2 1 100 0 0 ECU_ADDRESS 0x0 /end MEASUREMENT
/begin MEASUREMENT ETCSignals.ES900.ES910.CAN2.CAN2.AP_ELLIPSE_AUTO.el_SlipAngle "" FLOAT64_IEEE LINEAR_FUNCTION_M1_T0_U13 1 100 0 0 ECU_ADDRESS 0x0 /end MEASUREMENT
/begin MEASUREMENT ETCSignals.ES900.ES910.CAN2.CAN2.AP_ELLIPSE_AUTO.el_CurvatureRadius "" FLOAT64_IEEE LINEAR_FUNCTION_M1_T0_U14 1 100 0 0 ECU_ADDRESS 0x0 /end MEASUREMENT
/begin MEASUREMENT ETCSignals.ES900.ES910.CAN2.CAN2.AP_ELLIPSE_AUTO.el_AngleTrack "" FLOAT64_IEEE LINEAR_FUNCTION_M1_T0_U13 1 100 0 0 ECU_ADDRESS 0x0 /end MEASUREMENT
/begin MEASUREMENT ETCSignals.ES900.ES910.CAN2.CAN2.AP_ELLIPSE_GPS_VEL.el_Vel_GPS_N "" FLOAT64_IEEE LINEAR_FUNCTION_M1_T0_U15 1 100 0 0 ECU_ADDRESS 0x0 /end MEASUREMENT
/begin MEASUREMENT ETCSignals.ES900.ES910.CAN2.CAN2.AP_ELLIPSE_GPS_VEL.el_Vel_GPS_E "" FLOAT64_IEEE LINEAR_FUNCTION_M1_T0_U15 1 100 0 0 ECU_ADDRESS 0x0 /end MEASUREMENT
/begin MEASUREMENT ETCSignals.ES900.ES910.CAN2.CAN2.AP_ELLIPSE_GPS_VEL.el_Vel_GPS_D "" FLOAT64_IEEE LINEAR_FUNCTION_M1_T0_U15 1 100 0 0 ECU_ADDRESS 0x0 /end MEASUREMENT
/begin MEASUREMENT ETCSignals.ES900.ES910.CAN2.CAN2.NM_ETAS_Disconnections.Disconnection_InvR "" FLOAT64_IEEE LINEAR_FUNCTION_M1_T0_U2 1 100 0 1 ECU_ADDRESS 0x0 /end MEASUREMENT
/begin MEASUREMENT ETCSignals.ES900.ES910.CAN2.CAN2.NM_ETAS_Disconnections.Disconnection_InvL "" FLOAT64_IEEE LINEAR_FUNCTION_M1_T0_U2 1 100 0 1 ECU_ADDRESS 0x0 /end MEASUREMENT
/begin MEASUREMENT ETCSignals.ES900.ES910.CAN2.CAN2.NM_ETAS_Disconnections.Disconnection_Susp_R_R "" FLOAT64_IEEE LINEAR_FUNCTION_M1_T0_U2 1 100 0 1 ECU_ADDRESS 0x0 /end MEASUREMENT
/begin MEASUREMENT ETCSignals.ES900.ES910.CAN2.CAN2.NM_ETAS_Disconnections.Disconnection_Susp_R_L "" FLOAT64_IEEE LINEAR_FUNCTION_M1_T0_U2 1 100 0 1 ECU_ADDRESS 0x0 /end MEASUREMENT
/begin MEASUREMENT ETCSignals.ES900.ES910.CAN2.CAN2.NM_ETAS_Disconnections.Disconnection_Susp_F_R "" FLOAT64_IEEE LINEAR_FUNCTION_M1_T0_U2 1 100 0 1 ECU_ADDRESS 0x0 /end MEASUREMENT
/begin MEASUREMENT ETCSignals.ES900.ES910.CAN2.CAN2.NM_ETAS_Disconnections.Disconnection_Susp_F_L "" FLOAT64_IEEE LINEAR_FUNCTION_M1_T0_U2 1 100 0 1 ECU_ADDRESS 0x0 /end MEASUREMENT
/begin MEASUREMENT ETCSignals.ES900.ES910.CAN2.CAN2.NM_ETAS_Disconnections.Disconnection_SteeringSensor "" FLOAT64_IEEE LINEAR_FUNCTION_M1_T0_U2 1 100 0 1 ECU_ADDRESS 0x0 /end MEASUREMENT
/begin MEASUREMENT ETCSignals.ES900.ES910.CAN2.CAN2.NM_ETAS_Disconnections.Disconnection_Rear "" FLOAT64_IEEE LINEAR_FUNCTION_M1_T0_U2 1 100 0 1 ECU_ADDRESS 0x0 /end MEASUREMENT
/begin MEASUREMENT ETCSignals.ES900.ES910.CAN2.CAN2.NM_ETAS_Disconnections.Disconnection_Pitot "" FLOAT64_IEEE LINEAR_FUNCTION_M1_T0_U2 1 100 0 1 ECU_ADDRESS 0x0 /end MEASUREMENT
/begin MEASUREMENT ETCSignals.ES900.ES910.CAN2.CAN2.NM_ETAS_Disconnections.Disconnection_Front "" FLOAT64_IEEE LINEAR_FUNCTION_M1_T0_U2 1 100 0 1 ECU_ADDRESS 0x0 /end MEASUREMENT
/begin MEASUREMENT ETCSignals.ES900.ES910.CAN2.CAN2.NM_ETAS_Disconnections.Disconnection_Ellipse "" FLOAT64_IEEE LINEAR_FUNCTION_M1_T0_U2 1 100 0 1 ECU_ADDRESS 0x0 /end MEASUREMENT
/begin MEASUREMENT ETCSignals.ES900.ES910.CAN2.CAN2.NM_ETAS_Disconnections.Disconnection_DashBoard "" FLOAT64_IEEE LINEAR_FUNCTION_M1_T0_U2 1 100 0 1 ECU_ADDRESS 0x0 /end MEASUREMENT
/begin MEASUREMENT ETCSignals.ES900.ES910.CAN2.CAN2.NM_ETAS_Disconnections.Disconnection_BrakePedal "" FLOAT64_IEEE LINEAR_FUNCTION_M1_T0_U2 1 100 0 1 ECU_ADDRESS 0x0 /end MEASUREMENT
/begin MEASUREMENT ETCSignals.ES900.ES910.CAN2.CAN2.NM_ETAS_Disconnections.Disconnection_BMS "" FLOAT64_IEEE LINEAR_FUNCTION_M1_T0_U2 1 100 0 1 ECU_ADDRESS 0x0 /end MEASUREMENT
/begin MEASUREMENT ETCSignals.ES900.ES910.CAN2.CAN2.NM_ETAS_Disconnections.Disconnection_APPS2 "" FLOAT64_IEEE LINEAR_FUNCTION_M1_T0_U2 1 100 0 1 ECU_ADDRESS 0x0 /end MEASUREMENT
/begin MEASUREMENT ETCSignals.ES900.ES910.CAN2.CAN2.NM_ETAS_Disconnections.Disconnection_APPS1 "" FLOAT64_IEEE LINEAR_FUNCTION_M1_T0_U2 1 100 0 1 ECU_ADDRESS 0x0 /end MEASUREMENT
/begin MEASUREMENT ETCSignals.ES900.ES910.CAN2.CAN2.MEAS_ETAS_VDC_Values.el_VEL "" FLOAT64_IEEE LINEAR_FUNCTION_M1_T0_U16 1 100 0 65.535 ECU_ADDRESS 0x0 /end MEASUREMENT
/begin MEASUREMENT ETCSignals.ES900.ES910.CAN2.CAN2.MEAS_ETAS_VDC_Values.SteeringSensor_Value "" FLOAT64_IEEE LINEAR_FUNCTION_M1_T0_U13 1 100 -125 125 ECU_ADDRESS 0x0 /end MEASUREMENT
/begin MEASUREMENT ETCSignals.ES900.ES910.CAN2.CAN2.MEAS_ETAS_VDC_Values.BrakePedal_Value "" FLOAT64_IEEE LINEAR_FUNCTION_M1_T0_U17 1 100 0 1 ECU_ADDRESS 0x0 /end MEASUREMENT
/begin MEASUREMENT ETCSignals.ES900.ES910.CAN2.CAN2.MEAS_ETAS_VDC_Values.APPS2_Value "" FLOAT64_IEEE LINEAR_FUNCTION_M1_T0_U17 1 100 0 1 ECU_ADDRESS 0x0 /end MEASUREMENT
/begin MEASUREMENT ETCSignals.ES900.ES910.CAN2.CAN2.MEAS_ETAS_VDC_Values.APPS1_Value "" FLOAT64_IEEE LINEAR_FUNCTION_M1_T0_U17 1 100 0 1 ECU_ADDRESS 0x0 /end MEASUREMENT
/begin MEASUREMENT ETCSignals.ES900.ES910.CAN2.CAN2.AP_ETAS_BrakeLight.BrakeLight_Control "" FLOAT64_IEEE LINEAR_FUNCTION_M1_T0_U2 1 100 0 1 ECU_ADDRESS 0x0 /end MEASUREMENT
/begin MEASUREMENT ETCSignals.ES900.ES910.CAN2.CAN2.MEAS_RECU_SDC.Shutdown_TSMS_TSMP "" FLOAT64_IEEE LINEAR_FUNCTION_M1_T0_U2 1 100 0 0 ECU_ADDRESS 0x0 /end MEASUREMENT
/begin MEASUREMENT ETCSignals.ES900.ES910.CAN2.CAN2.MEAS_RECU_SDC.Shutdown_HVD "" FLOAT64_IEEE LINEAR_FUNCTION_M1_T0_U2 1 100 0 0 ECU_ADDRESS 0x0 /end MEASUREMENT
/begin MEASUREMENT ETCSignals.ES900.ES910.CAN2.CAN2.MEAS_RECU_SDC.Shutdown_HVBox "" FLOAT64_IEEE LINEAR_FUNCTION_M1_T0_U2 1 100 0 0 ECU_ADDRESS 0x0 /end MEASUREMENT
/begin MEASUREMENT ETCSignals.ES900.ES910.CAN2.CAN2.MEAS_RECU_SDC.Shutdown_LeftTS "" FLOAT64_IEEE LINEAR_FUNCTION_M1_T0_U2 1 100 0 0 ECU_ADDRESS 0x0 /end MEASUREMENT
/begin MEASUREMENT ETCSignals.ES900.ES910.CAN2.CAN2.MEAS_RECU_SDC.Shutdown_RightTS "" FLOAT64_IEEE LINEAR_FUNCTION_M1_T0_U2 1 100 0 0 ECU_ADDRESS 0x0 /end MEASUREMENT
/begin MEASUREMENT ETCSignals.ES900.ES910.CAN2.CAN2.AP_ELLIPSE_EKF_POS.el_LONGITUDE_EKF "" FLOAT64_IEEE LINEAR_FUNCTION_M1_T0_U18 1 100 0 0 ECU_ADDRESS 0x0 /end MEASUREMENT
/begin MEASUREMENT ETCSignals.ES900.ES910.CAN2.CAN2.AP_ELLIPSE_EKF_POS.el_LATITUDE_EKF "" FLOAT64_IEEE LINEAR_FUNCTION_M1_T0_U18 1 100 0 0 ECU_ADDRESS 0x0 /end MEASUREMENT
/begin MEASUREMENT ETCSignals.ES900.ES910.CAN2.CAN2.AP_ELLIPSE_IMU_ACCEL.el_ACCEL_Z "" FLOAT64_IEEE LINEAR_FUNCTION_M1_T0_U19 1 100 0 0 ECU_ADDRESS 0x0 /end MEASUREMENT
/begin MEASUREMENT ETCSignals.ES900.ES910.CAN2.CAN2.AP_ELLIPSE_IMU_ACCEL.el_ACCEL_Y "" FLOAT64_IEEE LINEAR_FUNCTION_M1_T0_U19 1 100 0 0 ECU_ADDRESS 0x0 /end MEASUREMENT
/begin MEASUREMENT ETCSignals.ES900.ES910.CAN2.CAN2.AP_ELLIPSE_IMU_ACCEL.el_ACCEL_X "" FLOAT64_IEEE LINEAR_FUNCTION_M1_T0_U19 1 100 0 0 ECU_ADDRESS 0x0 /end MEASUREMENT
/begin MEASUREMENT ETCSignals.ES900.ES910.CAN2.CAN2.AP_ELLIPSE_EKF_EULER.el_YAW "" FLOAT64_IEEE LINEAR_FUNCTION_M1_T0_U13 1 100 0 0 ECU_ADDRESS 0x0 /end MEASUREMENT
/begin MEASUREMENT ETCSignals.ES900.ES910.CAN2.CAN2.AP_ELLIPSE_EKF_EULER.el_PITCH "" FLOAT64_IEEE LINEAR_FUNCTION_M1_T0_U13 1 100 0 0 ECU_ADDRESS 0x0 /end MEASUREMENT
/begin MEASUREMENT ETCSignals.ES900.ES910.CAN2.CAN2.AP_ELLIPSE_EKF_EULER.el_ROLL "" FLOAT64_IEEE LINEAR_FUNCTION_M1_T0_U13 1 100 0 0 ECU_ADDRESS 0x0 /end MEASUREMENT
/begin MEASUREMENT ETCSignals.ES900.ES910.CAN2.CAN2.AP_ELLIPSE_EKF_VEL.el_Vel_EKF_Z "" FLOAT64_IEEE LINEAR_FUNCTION_M1_T0_U15 1 100 0 0 ECU_ADDRESS 0x0 /end MEASUREMENT
/begin MEASUREMENT ETCSignals.ES900.ES910.CAN2.CAN2.AP_ELLIPSE_EKF_VEL.el_Vel_EKF_Y "" FLOAT64_IEEE LINEAR_FUNCTION_M1_T0_U15 1 100 0 0 ECU_ADDRESS 0x0 /end MEASUREMENT
/begin MEASUREMENT ETCSignals.ES900.ES910.CAN2.CAN2.AP_ELLIPSE_EKF_VEL.el_Vel_EKF_X "" FLOAT64_IEEE LINEAR_FUNCTION_M1_T0_U15 1 100 0 0 ECU_ADDRESS 0x0 /end MEASUREMENT
/begin MEASUREMENT ETCSignals.ES900.ES910.CAN2.CAN2.NM_ELLIPSE_Status.Ellipse_Alive "" FLOAT64_IEEE LINEAR_FUNCTION_M1_T0_U20 1 100 0 0 ECU_ADDRESS 0x0 /end MEASUREMENT
/begin MEASUREMENT ETCSignals.ES900.ES910.CAN2.CAN2.AP_ELLIPSE_IMU_GYRO.el_GYRO_Z "" FLOAT64_IEEE LINEAR_FUNCTION_M1_T0_U21 1 100 0 0 ECU_ADDRESS 0x0 /end MEASUREMENT
/begin MEASUREMENT ETCSignals.ES900.ES910.CAN2.CAN2.AP_ELLIPSE_IMU_GYRO.el_GYRO_Y "" FLOAT64_IEEE LINEAR_FUNCTION_M1_T0_U21 1 100 0 0 ECU_ADDRESS 0x0 /end MEASUREMENT
/begin MEASUREMENT ETCSignals.ES900.ES910.CAN2.CAN2.AP_ELLIPSE_IMU_GYRO.el_GYRO_X "" FLOAT64_IEEE LINEAR_FUNCTION_M1_T0_U21 1 100 0 0 ECU_ADDRESS 0x0 /end MEASUREMENT
/begin MEASUREMENT ETCSignals.ES900.ES910.CAN2.CAN2.AP_ELLIPSE_VEL_Valid.el_SolutionMode "" FLOAT64_IEEE LINEAR_FUNCTION_M1_T0_U6 1 100 0 0 ECU_ADDRESS 0x0 /end MEASUREMENT
/begin MEASUREMENT ETCSignals.ES900.ES910.CAN2.CAN2.AP_ELLIPSE_VEL_Valid.el_Vel_GPS_Valid "" FLOAT64_IEEE LINEAR_FUNCTION_M1_T0_U2 1 100 0 0 ECU_ADDRESS 0x0 /end MEASUREMENT
/begin MEASUREMENT ETCSignals.ES900.ES910.CAN2.CAN2.AP_ELLIPSE_VEL_Valid.el_Vel_EKF_Valid "" FLOAT64_IEEE LINEAR_FUNCTION_M1_T0_U2 1 100 0 0 ECU_ADDRESS 0x0 /end MEASUREMENT
/begin MEASUREMENT ETCSignals.ES900.ES910.CAN2.CAN2.MEAS_ETAS_Inverter_R_Data.Inv_R_TempMotor "" FLOAT64_IEEE LINEAR_FUNCTION_M1_T0_U5 1 100 -327.68 327.67 ECU_ADDRESS 0x0 /end MEASUREMENT
/begin MEASUREMENT ETCSignals.ES900.ES910.CAN2.CAN2.MEAS_ETAS_Inverter_R_Data.current_R "" FLOAT64_IEEE LINEAR_FUNCTION_M1_T0_U3 1 100 -327.68 327.67 ECU_ADDRESS 0x0 /end MEASUREMENT
/begin MEASUREMENT ETCSignals.ES900.ES910.CAN2.CAN2.MEAS_ETAS_Inverter_R_Data.Inv_R_TempIGBT "" FLOAT64_IEEE LINEAR_FUNCTION_M1_T0_U5 1 100 -327.68 327.67 ECU_ADDRESS 0x0 /end MEASUREMENT
/begin MEASUREMENT ETCSignals.ES900.ES910.CAN2.CAN2.MEAS_ETAS_Inverter_R_Data.RR_Vel_ms_Wheel "" FLOAT64_IEEE LINEAR_FUNCTION_M1_T0_U16 1 100 -327.68 327.67 ECU_ADDRESS 0x0 /end MEASUREMENT
/begin MEASUREMENT ETCSignals.ES900.ES910.CAN2.CAN2.MEAS_ETAS_Inverter_L_Data.Inv_L_TempMotor "" FLOAT64_IEEE LINEAR_FUNCTION_M1_T0_U5 1 100 -327.68 327.67 ECU_ADDRESS 0x0 /end MEASUREMENT
/begin MEASUREMENT ETCSignals.ES900.ES910.CAN2.CAN2.MEAS_ETAS_Inverter_L_Data.current_L "" FLOAT64_IEEE LINEAR_FUNCTION_M1_T0_U3 1 100 -327.68 327.67 ECU_ADDRESS 0x0 /end MEASUREMENT
/begin MEASUREMENT ETCSignals.ES900.ES910.CAN2.CAN2.MEAS_ETAS_Inverter_L_Data.Inv_L_TempIGBT "" FLOAT64_IEEE LINEAR_FUNCTION_M1_T0_U5 1 100 -327.68 327.67 ECU_ADDRESS 0x0 /end MEASUREMENT
/begin MEASUREMENT ETCSignals.ES900.ES910.CAN2.CAN2.MEAS_ETAS_Inverter_L_Data.RL_Vel_ms_Wheel "" FLOAT64_IEEE LINEAR_FUNCTION_M1_T0_U16 1 100 -327.68 327.67 ECU_ADDRESS 0x0 /end MEASUREMENT
/begin MEASUREMENT ETCSignals.ES900.ES910.CAN2.CAN2.MEAS_ETAS_VDC_Suspe.SUSP_R_R "" FLOAT64_IEEE LINEAR_FUNCTION_M1_T0_U22 1 100 -327.68 327.67 ECU_ADDRESS 0x0 /end MEASUREMENT
/begin MEASUREMENT ETCSignals.ES900.ES910.CAN2.CAN2.MEAS_ETAS_VDC_Suspe.SUSP_R_L "" FLOAT64_IEEE LINEAR_FUNCTION_M1_T0_U22 1 100 -327.68 327.67 ECU_ADDRESS 0x0 /end MEASUREMENT
/begin MEASUREMENT ETCSignals.ES900.ES910.CAN2.CAN2.MEAS_ETAS_VDC_Suspe.SUSP_F_R "" FLOAT64_IEEE LINEAR_FUNCTION_M1_T0_U22 1 100 -327.68 327.67 ECU_ADDRESS 0x0 /end MEASUREMENT
/begin MEASUREMENT ETCSignals.ES900.ES910.CAN2.CAN2.MEAS_ETAS_VDC_Suspe.SUSP_F_L "" FLOAT64_IEEE LINEAR_FUNCTION_M1_T0_U22 1 100 -327.68 327.67 ECU_ADDRESS 0x0 /end MEASUREMENT
/begin MEASUREMENT ETCSignals.ES900.ES910.CAN2.CAN2.MEAS_ETAS_VDC_Tq.Throttle_Torque "" FLOAT64_IEEE LINEAR_FUNCTION_M1_T0_U23 1 100 0 655.35 ECU_ADDRESS 0x0 /end MEASUREMENT
/begin MEASUREMENT ETCSignals.ES900.ES910.CAN2.CAN2.MEAS_ETAS_VDC_Tq.Torque_R "" FLOAT64_IEEE LINEAR_FUNCTION_M1_T0_U23 1 100 -327.68 327.67 ECU_ADDRESS 0x0 /end MEASUREMENT
/begin MEASUREMENT ETCSignals.ES900.ES910.CAN2.CAN2.MEAS_ETAS_VDC_Tq.Torque_L "" FLOAT64_IEEE LINEAR_FUNCTION_M1_T0_U23 1 100 -327.68 327.67 ECU_ADDRESS 0x0 /end MEASUREMENT
/begin MEASUREMENT ETCSignals.ES900.ES910.CAN2.CAN2.AP_RECU_Data.Susp_R_R_Bits "" FLOAT64_IEEE LINEAR_FUNCTION_M1_T0_U7 1 100 0 0 ECU_ADDRESS 0x0 /end MEASUREMENT
/begin MEASUREMENT ETCSignals.ES900.ES910.CAN2.CAN2.AP_RECU_Data.Susp_R_L_Bits "" FLOAT64_IEEE LINEAR_FUNCTION_M1_T0_U7 1 100 0 0 ECU_ADDRESS 0x0 /end MEASUREMENT
/begin MEASUREMENT ETCSignals.ES900.ES910.CAN2.CAN2.NM_FECU_Keep_Alive.Front_Alive "" FLOAT64_IEEE LINEAR_FUNCTION_M1_T0_U1 1 100 0 0 ECU_ADDRESS 0x0 /end MEASUREMENT
/begin MEASUREMENT ETCSignals.ES900.ES910.CAN2.CAN2.NM_RECU_Keep_Alive.Rear_Alive "" FLOAT64_IEEE LINEAR_FUNCTION_M1_T0_U1 1 100 0 0 ECU_ADDRESS 0x0 /end MEASUREMENT
/begin MEASUREMENT ETCSignals.ES900.ES910.CAN2.CAN2.AP_FECU_Data2.Pitot_Bits "" FLOAT64_IEEE LINEAR_FUNCTION_M1_T0_U7 1 100 0 0 ECU_ADDRESS 0x0 /end MEASUREMENT
/begin MEASUREMENT ETCSignals.ES900.ES910.CAN2.CAN2.AP_FECU_Data2.Susp_F_R_Bits "" FLOAT64_IEEE LINEAR_FUNCTION_M1_T0_U7 1 100 0 0 ECU_ADDRESS 0x0 /end MEASUREMENT
/begin MEASUREMENT ETCSignals.ES900.ES910.CAN2.CAN2.AP_FECU_Data2.Susp_F_L_Bits "" FLOAT64_IEEE LINEAR_FUNCTION_M1_T0_U7 1 100 0 0 ECU_ADDRESS 0x0 /end MEASUREMENT
/begin MEASUREMENT ETCSignals.ES900.ES910.CAN2.CAN2.AP_FECU_Data1.SteeringSensor_Bits "" FLOAT64_IEEE LINEAR_FUNCTION_M1_T0_U7 1 100 0 0 ECU_ADDRESS 0x0 /end MEASUREMENT
/begin MEASUREMENT ETCSignals.ES900.ES910.CAN2.CAN2.AP_FECU_Data1.BrakePedal_Bits "" FLOAT64_IEEE LINEAR_FUNCTION_M1_T0_U7 1 100 0 0 ECU_ADDRESS 0x0 /end MEASUREMENT
/begin MEASUREMENT ETCSignals.ES900.ES910.CAN2.CAN2.AP_FECU_Data1.APPS2_Bits "" FLOAT64_IEEE LINEAR_FUNCTION_M1_T0_U7 1 100 0 0 ECU_ADDRESS 0x0 /end MEASUREMENT
/begin MEASUREMENT ETCSignals.ES900.ES910.CAN2.CAN2.AP_FECU_Data1.APPS1_Bits "" FLOAT64_IEEE LINEAR_FUNCTION_M1_T0_U7 1 100 0 0 ECU_ADDRESS 0x0 /end MEASUREMENT
/begin MEASUREMENT ETCSignals.ES900.ES910.CAN2.CAN2.AP_ETAS_Synchronism.Sync_CAN2 "" FLOAT64_IEEE LINEAR_FUNCTION_M1_T0_U1 1 100 0 255 ECU_ADDRESS 0x0 /end MEASUREMENT
/begin CHARACTERISTIC ETCSignals.ES900.ES910.CAN1.CAN1.AP_ETAS_DashData.SoC_KF_calibrate "" VALUE 0x0 STANDARD_VALUE_R64 0.0 LINEAR_FUNCTION_M1_T0_U9 0 255 MAX_REFRESH 6 1 /end CHARACTERISTIC
/begin CHARACTERISTIC ETCSignals.ES900.ES910.CAN1.CAN1.AP_ETAS_DashData.Speed_calibrate "" VALUE 0x0 STANDARD_VALUE_R64 0.0 LINEAR_FUNCTION_M1_T0_U10 -128 127 MAX_REFRESH 6 1 /end CHARACTERISTIC
/begin CHARACTERISTIC ETCSignals.ES900.ES910.CAN1.CAN1.AP_ETAS_DashData.Precharge_Voltage_calibrate "" VALUE 0x0 STANDARD_VALUE_R64 0.0 LINEAR_FUNCTION_M1_T0_U4 0 655.35 MAX_REFRESH 6 1 /end CHARACTERISTIC
/begin CHARACTERISTIC ETCSignals.ES900.ES910.CAN1.CAN1.AP_ETAS_DashData.Precharge_Percentage_calibrate "" VALUE 0x0 STANDARD_VALUE_R64 0.0 LINEAR_FUNCTION_M1_T0_U11 0 100 MAX_REFRESH 6 1 /end CHARACTERISTIC
/begin CHARACTERISTIC ETCSignals.ES900.ES910.CAN1.CAN1.AP_ETAS_VDCParams.VDC_Max_Tyre_Slip_calibrate "" VALUE 0x0 STANDARD_VALUE_R64 0.0 LINEAR_FUNCTION_M1_T0_U6 0 2.55 MAX_REFRESH 6 1 /end CHARACTERISTIC
/begin CHARACTERISTIC ETCSignals.ES900.ES910.CAN1.CAN1.AP_ETAS_Inverter_R_Rx.Inverter_R_RegID_calibrate "" VALUE 0x0 STANDARD_VALUE_R64 0.0 LINEAR_FUNCTION_M1_T0_U1 0 255 MAX_REFRESH 6 1 /end CHARACTERISTIC
/begin CHARACTERISTIC ETCSignals.ES900.ES910.CAN1.CAN1.AP_ETAS_Inverter_R_Rx.Inverter_R_b7tob0_calibrate "" VALUE 0x0 STANDARD_VALUE_R64 0.0 LINEAR_FUNCTION_M1_T0_U1 0 255 MAX_REFRESH 6 1 /end CHARACTERISTIC
/begin CHARACTERISTIC ETCSignals.ES900.ES910.CAN1.CAN1.AP_ETAS_Inverter_R_Rx.Inverter_R_b15tob8_calibrate "" VALUE 0x0 STANDARD_VALUE_R64 0.0 LINEAR_FUNCTION_M1_T0_U1 0 255 MAX_REFRESH 6 1 /end CHARACTERISTIC
/begin CHARACTERISTIC ETCSignals.ES900.ES910.CAN1.CAN1.AP_ETAS_Inverter_L_Rx.Inverter_L_RegID_calibrate "" VALUE 0x0 STANDARD_VALUE_R64 0.0 LINEAR_FUNCTION_M1_T0_U1 0 255 MAX_REFRESH 6 1 /end CHARACTERISTIC
/begin CHARACTERISTIC ETCSignals.ES900.ES910.CAN1.CAN1.AP_ETAS_Inverter_L_Rx.Inverter_L_b7tob0_calibrate "" VALUE 0x0 STANDARD_VALUE_R64 0.0 LINEAR_FUNCTION_M1_T0_U1 0 255 MAX_REFRESH 6 1 /end CHARACTERISTIC
/begin CHARACTERISTIC ETCSignals.ES900.ES910.CAN1.CAN1.AP_ETAS_Inverter_L_Rx.Inverter_L_b15tob8_calibrate "" VALUE 0x0 STANDARD_VALUE_R64 0.0 LINEAR_FUNCTION_M1_T0_U1 0 255 MAX_REFRESH 6 1 /end CHARACTERISTIC
/begin CHARACTERISTIC ETCSignals.ES900.ES910.CAN1.CAN1.AP_ETAS_CarState.Car_State_calibrate "" VALUE 0x0 STANDARD_VALUE_R64 0.0 LINEAR_FUNCTION_M1_T0_U1 0 21 MAX_REFRESH 6 1 /end CHARACTERISTIC
/begin CHARACTERISTIC ETCSignals.ES900.ES910.CAN1.CAN1.AP_ETAS_AIRsRequest.AIRs_Request_calibrate "" VALUE 0x0 STANDARD_VALUE_R64 0.0 LINEAR_FUNCTION_M1_T0_U1 0 15 MAX_REFRESH 6 1 /end CHARACTERISTIC
/begin CHARACTERISTIC ETCSignals.ES900.ES910.CAN1.CAN1.MEAS_ETAS_InternalVars.InvertersAction_calibrate "" VALUE 0x0 STANDARD_VALUE_R64 0.0 LINEAR_FUNCTION_M1_T0_U6 0 31 MAX_REFRESH 6 1 /end CHARACTERISTIC
/begin CHARACTERISTIC ETCSignals.ES900.ES910.CAN1.CAN1.MEAS_ETAS_InternalVars.el_Vel_OK_calibrate "" VALUE 0x0 STANDARD_VALUE_R64 0.0 LINEAR_FUNCTION_M1_T0_U2 0 1 MAX_REFRESH 6 1 /end CHARACTERISTIC
/begin CHARACTERISTIC ETCSignals.ES900.ES910.CAN1.CAN1.MEAS_ETAS_InternalVars.TC_Warning_calibrate "" VALUE 0x0 STANDARD_VALUE_R64 0.0 LINEAR_FUNCTION_M1_T0_U2 0 1 MAX_REFRESH 6 1 /end CHARACTERISTIC
/begin CHARACTERISTIC ETCSignals.ES900.ES910.CAN1.CAN1.MEAS_ETAS_InternalVars.Regenerative_Enable_calibrate "" VALUE 0x0 STANDARD_VALUE_R64 0.0 LINEAR_FUNCTION_M1_T0_U2 0 1 MAX_REFRESH 6 1 /end CHARACTERISTIC
/begin CHARACTERISTIC ETCSignals.ES900.ES910.CAN1.CAN1.MEAS_ETAS_InternalVars.CriticalDisconnection_calibrate "" VALUE 0x0 STANDARD_VALUE_R64 0.0 LINEAR_FUNCTION_M1_T0_U2 0 1 MAX_REFRESH 6 1 /end CHARACTERISTIC
/begin CHARACTERISTIC ETCSignals.ES900.ES910.CAN1.CAN1.MEAS_ETAS_InternalVars.Relay_Error_calibrate "" VALUE 0x0 STANDARD_VALUE_R64 0.0 LINEAR_FUNCTION_M1_T0_U2 0 1 MAX_REFRESH 6 1 /end CHARACTERISTIC
/begin CHARACTERISTIC ETCSignals.ES900.ES910.CAN1.CAN1.MEAS_ETAS_InternalVars.Car_OK_calibrate "" VALUE 0x0 STANDARD_VALUE_R64 0.0 LINEAR_FUNCTION_M1_T0_U2 0 1 MAX_REFRESH 6 1 /end CHARACTERISTIC
/begin CHARACTERISTIC ETCSignals.ES900.ES910.CAN1.CAN1.MEAS_ETAS_InternalVars.Power_calibrate "" VALUE 0x0 STANDARD_VALUE_R64 0.0 LINEAR_FUNCTION_M1_T0_U12 -327.68 327.67 MAX_REFRESH 6 1 /end CHARACTERISTIC
/begin CHARACTERISTIC ETCSignals.ES900.ES910.CAN1.CAN1.MEAS_ETAS_InternalVars.Torque_OK_calibrate "" VALUE 0x0 STANDARD_VALUE_R64 0.0 LINEAR_FUNCTION_M1_T0_U2 0 1 MAX_REFRESH 6 1 /end CHARACTERISTIC
/begin CHARACTERISTIC ETCSignals.ES900.ES910.CAN1.CAN1.MEAS_ETAS_InternalVars.Sensorics_Mode_calibrate "" VALUE 0x0 STANDARD_VALUE_R64 0.0 LINEAR_FUNCTION_M1_T0_U1 0 7 MAX_REFRESH 6 1 /end CHARACTERISTIC
/begin CHARACTERISTIC ETCSignals.ES900.ES910.CAN1.CAN1.MEAS_ETAS_InternalVars.Critical_Signal_Disconnection_calibrate "" VALUE 0x0 STANDARD_VALUE_R64 0.0 LINEAR_FUNCTION_M1_T0_U2 0 1 MAX_REFRESH 6 1 /end CHARACTERISTIC
/begin CHARACTERISTIC ETCSignals.ES900.ES910.CAN1.CAN1.MEAS_ETAS_InternalVars.Critical_CAN_Disconnection_calibrate "" VALUE 0x0 STANDARD_VALUE_R64 0.0 LINEAR_FUNCTION_M1_T0_U2 0 1 MAX_REFRESH 6 1 /end CHARACTERISTIC
/begin CHARACTERISTIC ETCSignals.ES900.ES910.CAN1.CAN1.MEAS_ETAS_InternalVars.APPS_Implausibility_calibrate "" VALUE 0x0 STANDARD_VALUE_R64 0.0 LINEAR_FUNCTION_M1_T0_U2 0 1 MAX_REFRESH 6 1 /end CHARACTERISTIC
/begin CHARACTERISTIC ETCSignals.ES900.ES910.CAN1.CAN1.AP_ETAS_Synchronism.Sync_CAN1_calibrate "" VALUE 0x0 STANDARD_VALUE_R64 0.0 LINEAR_FUNCTION_M1_T0_U1 0 255 MAX_REFRESH 6 1 /end CHARACTERISTIC
/begin CHARACTERISTIC ETCSignals.ES900.ES910.CAN2.CAN2.MEAS_ETAS_SOC.SOC_High_calibrate "" VALUE 0x0 STANDARD_VALUE_R64 0.0 LINEAR_FUNCTION_M1_T0_U9 0 655.35 MAX_REFRESH 6 1 /end CHARACTERISTIC
/begin CHARACTERISTIC ETCSignals.ES900.ES910.CAN2.CAN2.MEAS_ETAS_SOC.SOC_Low_calibrate "" VALUE 0x0 STANDARD_VALUE_R64 0.0 LINEAR_FUNCTION_M1_T0_U9 0 655.35 MAX_REFRESH 6 1 /end CHARACTERISTIC
/begin CHARACTERISTIC ETCSignals.ES900.ES910.CAN2.CAN2.MEAS_ETAS_SOC.SOC_Avg_calibrate "" VALUE 0x0 STANDARD_VALUE_R64 0.0 LINEAR_FUNCTION_M1_T0_U9 0 655.35 MAX_REFRESH 6 1 /end CHARACTERISTIC
/begin CHARACTERISTIC ETCSignals.ES900.ES910.CAN2.CAN2.NM_ETAS_Disconnections.Disconnection_InvR_calibrate "" VALUE 0x0 STANDARD_VALUE_R64 0.0 LINEAR_FUNCTION_M1_T0_U2 0 1 MAX_REFRESH 6 1 /end CHARACTERISTIC
/begin CHARACTERISTIC ETCSignals.ES900.ES910.CAN2.CAN2.NM_ETAS_Disconnections.Disconnection_InvL_calibrate "" VALUE 0x0 STANDARD_VALUE_R64 0.0 LINEAR_FUNCTION_M1_T0_U2 0 1 MAX_REFRESH 6 1 /end CHARACTERISTIC
/begin CHARACTERISTIC ETCSignals.ES900.ES910.CAN2.CAN2.NM_ETAS_Disconnections.Disconnection_Susp_R_R_calibrate "" VALUE 0x0 STANDARD_VALUE_R64 0.0 LINEAR_FUNCTION_M1_T0_U2 0 1 MAX_REFRESH 6 1 /end CHARACTERISTIC
/begin CHARACTERISTIC ETCSignals.ES900.ES910.CAN2.CAN2.NM_ETAS_Disconnections.Disconnection_Susp_R_L_calibrate "" VALUE 0x0 STANDARD_VALUE_R64 0.0 LINEAR_FUNCTION_M1_T0_U2 0 1 MAX_REFRESH 6 1 /end CHARACTERISTIC
/begin CHARACTERISTIC ETCSignals.ES900.ES910.CAN2.CAN2.NM_ETAS_Disconnections.Disconnection_Susp_F_R_calibrate "" VALUE 0x0 STANDARD_VALUE_R64 0.0 LINEAR_FUNCTION_M1_T0_U2 0 1 MAX_REFRESH 6 1 /end CHARACTERISTIC
/begin CHARACTERISTIC ETCSignals.ES900.ES910.CAN2.CAN2.NM_ETAS_Disconnections.Disconnection_Susp_F_L_calibrate "" VALUE 0x0 STANDARD_VALUE_R64 0.0 LINEAR_FUNCTION_M1_T0_U2 0 1 MAX_REFRESH 6 1 /end CHARACTERISTIC
/begin CHARACTERISTIC ETCSignals.ES900.ES910.CAN2.CAN2.NM_ETAS_Disconnections.Disconnection_SteeringSensor_calibrate "" VALUE 0x0 STANDARD_VALUE_R64 0.0 LINEAR_FUNCTION_M1_T0_U2 0 1 MAX_REFRESH 6 1 /end CHARACTERISTIC
/begin CHARACTERISTIC ETCSignals.ES900.ES910.CAN2.CAN2.NM_ETAS_Disconnections.Disconnection_Rear_calibrate "" VALUE 0x0 STANDARD_VALUE_R64 0.0 LINEAR_FUNCTION_M1_T0_U2 0 1 MAX_REFRESH 6 1 /end CHARACTERISTIC
/begin CHARACTERISTIC ETCSignals.ES900.ES910.CAN2.CAN2.NM_ETAS_Disconnections.Disconnection_Pitot_calibrate "" VALUE 0x0 STANDARD_VALUE_R64 0.0 LINEAR_FUNCTION_M1_T0_U2 0 1 MAX_REFRESH 6 1 /end CHARACTERISTIC
/begin CHARACTERISTIC ETCSignals.ES900.ES910.CAN2.CAN2.NM_ETAS_Disconnections.Disconnection_Front_calibrate "" VALUE 0x0 STANDARD_VALUE_R64 0.0 LINEAR_FUNCTION_M1_T0_U2 0 1 MAX_REFRESH 6 1 /end CHARACTERISTIC
/begin CHARACTERISTIC ETCSignals.ES900.ES910.CAN2.CAN2.NM_ETAS_Disconnections.Disconnection_Ellipse_calibrate "" VALUE 0x0 STANDARD_VALUE_R64 0.0 LINEAR_FUNCTION_M1_T0_U2 0 1 MAX_REFRESH 6 1 /end CHARACTERISTIC
/begin CHARACTERISTIC ETCSignals.ES900.ES910.CAN2.CAN2.NM_ETAS_Disconnections.Disconnection_DashBoard_calibrate "" VALUE 0x0 STANDARD_VALUE_R64 0.0 LINEAR_FUNCTION_M1_T0_U2 0 1 MAX_REFRESH 6 1 /end CHARACTERISTIC
/begin CHARACTERISTIC ETCSignals.ES900.ES910.CAN2.CAN2.NM_ETAS_Disconnections.Disconnection_BrakePedal_calibrate "" VALUE 0x0 STANDARD_VALUE_R64 0.0 LINEAR_FUNCTION_M1_T0_U2 0 1 MAX_REFRESH 6 1 /end CHARACTERISTIC
/begin CHARACTERISTIC ETCSignals.ES900.ES910.CAN2.CAN2.NM_ETAS_Disconnections.Disconnection_BMS_calibrate "" VALUE 0x0 STANDARD_VALUE_R64 0.0 LINEAR_FUNCTION_M1_T0_U2 0 1 MAX_REFRESH 6 1 /end CHARACTERISTIC
/begin CHARACTERISTIC ETCSignals.ES900.ES910.CAN2.CAN2.NM_ETAS_Disconnections.Disconnection_APPS2_calibrate "" VALUE 0x0 STANDARD_VALUE_R64 0.0 LINEAR_FUNCTION_M1_T0_U2 0 1 MAX_REFRESH 6 1 /end CHARACTERISTIC
/begin CHARACTERISTIC ETCSignals.ES900.ES910.CAN2.CAN2.NM_ETAS_Disconnections.Disconnection_APPS1_calibrate "" VALUE 0x0 STANDARD_VALUE_R64 0.0 LINEAR_FUNCTION_M1_T0_U2 0 1 MAX_REFRESH 6 1 /end CHARACTERISTIC
/begin CHARACTERISTIC ETCSignals.ES900.ES910.CAN2.CAN2.MEAS_ETAS_VDC_Values.el_VEL_calibrate "" VALUE 0x0 STANDARD_VALUE_R64 0.0 LINEAR_FUNCTION_M1_T0_U16 0 65.535 MAX_REFRESH 6 1 /end CHARACTERISTIC
/begin CHARACTERISTIC ETCSignals.ES900.ES910.CAN2.CAN2.MEAS_ETAS_VDC_Values.SteeringSensor_Value_calibrate "" VALUE 0x0 STANDARD_VALUE_R64 0.0 LINEAR_FUNCTION_M1_T0_U13 -125 125 MAX_REFRESH 6 1 /end CHARACTERISTIC
/begin CHARACTERISTIC ETCSignals.ES900.ES910.CAN2.CAN2.MEAS_ETAS_VDC_Values.BrakePedal_Value_calibrate "" VALUE 0x0 STANDARD_VALUE_R64 0.0 LINEAR_FUNCTION_M1_T0_U17 0 1 MAX_REFRESH 6 1 /end CHARACTERISTIC
/begin CHARACTERISTIC ETCSignals.ES900.ES910.CAN2.CAN2.MEAS_ETAS_VDC_Values.APPS2_Value_calibrate "" VALUE 0x0 STANDARD_VALUE_R64 0.0 LINEAR_FUNCTION_M1_T0_U17 0 1 MAX_REFRESH 6 1 /end CHARACTERISTIC
/begin CHARACTERISTIC ETCSignals.ES900.ES910.CAN2.CAN2.MEAS_ETAS_VDC_Values.APPS1_Value_calibrate "" VALUE 0x0 STANDARD_VALUE_R64 0.0 LINEAR_FUNCTION_M1_T0_U17 0 1 MAX_REFRESH 6 1 /end CHARACTERISTIC
/begin CHARACTERISTIC ETCSignals.ES900.ES910.CAN2.CAN2.AP_ETAS_BrakeLight.BrakeLight_Control_calibrate "" VALUE 0x0 STANDARD_VALUE_R64 0.0 LINEAR_FUNCTION_M1_T0_U2 0 1 MAX_REFRESH 6 1 /end CHARACTERISTIC
/begin CHARACTERISTIC ETCSignals.ES900.ES910.CAN2.CAN2.MEAS_ETAS_Inverter_R_Data.Inv_R_TempMotor_calibrate "" VALUE 0x0 STANDARD_VALUE_R64 0.0 LINEAR_FUNCTION_M1_T0_U5 -327.68 327.67 MAX_REFRESH 6 1 /end CHARACTERISTIC
/begin CHARACTERISTIC ETCSignals.ES900.ES910.CAN2.CAN2.MEAS_ETAS_Inverter_R_Data.current_R_calibrate "" VALUE 0x0 STANDARD_VALUE_R64 0.0 LINEAR_FUNCTION_M1_T0_U3 -327.68 327.67 MAX_REFRESH 6 1 /end CHARACTERISTIC
/begin CHARACTERISTIC ETCSignals.ES900.ES910.CAN2.CAN2.MEAS_ETAS_Inverter_R_Data.Inv_R_TempIGBT_calibrate "" VALUE 0x0 STANDARD_VALUE_R64 0.0 LINEAR_FUNCTION_M1_T0_U5 -327.68 327.67 MAX_REFRESH 6 1 /end CHARACTERISTIC
/begin CHARACTERISTIC ETCSignals.ES900.ES910.CAN2.CAN2.MEAS_ETAS_Inverter_R_Data.RR_Vel_ms_Wheel_calibrate "" VALUE 0x0 STANDARD_VALUE_R64 0.0 LINEAR_FUNCTION_M1_T0_U16 -327.68 327.67 MAX_REFRESH 6 1 /end CHARACTERISTIC
/begin CHARACTERISTIC ETCSignals.ES900.ES910.CAN2.CAN2.MEAS_ETAS_Inverter_L_Data.Inv_L_TempMotor_calibrate "" VALUE 0x0 STANDARD_VALUE_R64 0.0 LINEAR_FUNCTION_M1_T0_U5 -327.68 327.67 MAX_REFRESH 6 1 /end CHARACTERISTIC
/begin CHARACTERISTIC ETCSignals.ES900.ES910.CAN2.CAN2.MEAS_ETAS_Inverter_L_Data.current_L_calibrate "" VALUE 0x0 STANDARD_VALUE_R64 0.0 LINEAR_FUNCTION_M1_T0_U3 -327.68 327.67 MAX_REFRESH 6 1 /end CHARACTERISTIC
/begin CHARACTERISTIC ETCSignals.ES900.ES910.CAN2.CAN2.MEAS_ETAS_Inverter_L_Data.Inv_L_TempIGBT_calibrate "" VALUE 0x0 STANDARD_VALUE_R64 0.0 LINEAR_FUNCTION_M1_T0_U5 -327.68 327.67 MAX_REFRESH 6 1 /end CHARACTERISTIC
/begin CHARACTERISTIC ETCSignals.ES900.ES910.CAN2.CAN2.MEAS_ETAS_Inverter_L_Data.RL_Vel_ms_Wheel_calibrate "" VALUE 0x0 STANDARD_VALUE_R64 0.0 LINEAR_FUNCTION_M1_T0_U16 -327.68 327.67 MAX_REFRESH 6 1 /end CHARACTERISTIC
/begin CHARACTERISTIC ETCSignals.ES900.ES910.CAN2.CAN2.MEAS_ETAS_VDC_Suspe.SUSP_R_R_calibrate "" VALUE 0x0 STANDARD_VALUE_R64 0.0 LINEAR_FUNCTION_M1_T0_U22 -327.68 327.67 MAX_REFRESH 6 1 /end CHARACTERISTIC
/begin CHARACTERISTIC ETCSignals.ES900.ES910.CAN2.CAN2.MEAS_ETAS_VDC_Suspe.SUSP_R_L_calibrate "" VALUE 0x0 STANDARD_VALUE_R64 0.0 LINEAR_FUNCTION_M1_T0_U22 -327.68 327.67 MAX_REFRESH 6 1 /end CHARACTERISTIC
/begin CHARACTERISTIC ETCSignals.ES900.ES910.CAN2.CAN2.MEAS_ETAS_VDC_Suspe.SUSP_F_R_calibrate "" VALUE 0x0 STANDARD_VALUE_R64 0.0 LINEAR_FUNCTION_M1_T0_U22 -327.68 327.67 MAX_REFRESH 6 1 /end CHARACTERISTIC
/begin CHARACTERISTIC ETCSignals.ES900.ES910.CAN2.CAN2.MEAS_ETAS_VDC_Suspe.SUSP_F_L_calibrate "" VALUE 0x0 STANDARD_VALUE_R64 0.0 LINEAR_FUNCTION_M1_T0_U22 -327.68 327.67 MAX_REFRESH 6 1 /end CHARACTERISTIC
/begin CHARACTERISTIC ETCSignals.ES900.ES910.CAN2.CAN2.MEAS_ETAS_VDC_Tq.Throttle_Torque_calibrate "" VALUE 0x0 STANDARD_VALUE_R64 0.0 LINEAR_FUNCTION_M1_T0_U23 0 655.35 MAX_REFRESH 6 1 /end CHARACTERISTIC
/begin CHARACTERISTIC ETCSignals.ES900.ES910.CAN2.CAN2.MEAS_ETAS_VDC_Tq.Torque_R_calibrate "" VALUE 0x0 STANDARD_VALUE_R64 0.0 LINEAR_FUNCTION_M1_T0_U23 -327.68 327.67 MAX_REFRESH 6 1 /end CHARACTERISTIC
/begin CHARACTERISTIC ETCSignals.ES900.ES910.CAN2.CAN2.MEAS_ETAS_VDC_Tq.Torque_L_calibrate "" VALUE 0x0 STANDARD_VALUE_R64 0.0 LINEAR_FUNCTION_M1_T0_U23 -327.68 327.67 MAX_REFRESH 6 1 /end CHARACTERISTIC
/begin CHARACTERISTIC ETCSignals.ES900.ES910.CAN2.CAN2.AP_ETAS_Synchronism.Sync_CAN2_calibrate "" VALUE 0x0 STANDARD_VALUE_R64 0.0 LINEAR_FUNCTION_M1_T0_U1 0 255 MAX_REFRESH 6 1 /end CHARACTERISTIC
/begin COMPU_METHOD LINEAR_FUNCTION_M1_T0_U1 "" RAT_FUNC "%8.4" "" COEFFS 0 1 0 0 0 1 /end COMPU_METHOD
/begin COMPU_METHOD LINEAR_FUNCTION_M1_T0_U2 "" RAT_FUNC "%8.4" "Bit" COEFFS 0 1 0 0 0 1 /end COMPU_METHOD
/begin COMPU_METHOD LINEAR_FUNCTION_M1_T0_U3 "" RAT_FUNC "%8.4" "A" COEFFS 0 1 0 0 0 1 /end COMPU_METHOD
/begin COMPU_METHOD LINEAR_FUNCTION_M1_T0_U4 "" RAT_FUNC "%8.4" "V" COEFFS 0 1 0 0 0 1 /end COMPU_METHOD
/begin COMPU_METHOD LINEAR_FUNCTION_M1_T0_U5 "" RAT_FUNC "%8.4" "┬║C" COEFFS 0 1 0 0 0 1 /end COMPU_METHOD
/begin COMPU_METHOD LINEAR_FUNCTION_M1_T0_U6 "" RAT_FUNC "%8.4" "-" COEFFS 0 1 0 0 0 1 /end COMPU_METHOD
/begin COMPU_METHOD LINEAR_FUNCTION_M1_T0_U7 "" RAT_FUNC "%8.4" "Bits" COEFFS 0 1 0 0 0 1 /end COMPU_METHOD
/begin COMPU_METHOD LINEAR_FUNCTION_M1_T0_U8 "" RAT_FUNC "%8.4" "RPM" COEFFS 0 1 0 0 0 1 /end COMPU_METHOD
/begin COMPU_METHOD LINEAR_FUNCTION_M1_T0_U9 "" RAT_FUNC "%8.4" "%" COEFFS 0 1 0 0 0 1 /end COMPU_METHOD
/begin COMPU_METHOD LINEAR_FUNCTION_M1_T0_U10 "" RAT_FUNC "%8.4" "km/h" COEFFS 0 1 0 0 0 1 /end COMPU_METHOD
/begin COMPU_METHOD LINEAR_FUNCTION_M1_T0_U11 "" RAT_FUNC "%8.4" "100%" COEFFS 0 1 0 0 0 1 /end COMPU_METHOD
/begin COMPU_METHOD LINEAR_FUNCTION_M1_T0_U12 "" RAT_FUNC "%8.4" "kW" COEFFS 0 1 0 0 0 1 /end COMPU_METHOD
/begin COMPU_METHOD LINEAR_FUNCTION_M1_T0_U13 "" RAT_FUNC "%8.4" "┬║" COEFFS 0 1 0 0 0 1 /end COMPU_METHOD
/begin COMPU_METHOD LINEAR_FUNCTION_M1_T0_U14 "" RAT_FUNC "%8.4" "m" COEFFS 0 1 0 0 0 1 /end COMPU_METHOD
/begin COMPU_METHOD LINEAR_FUNCTION_M1_T0_U15 "" RAT_FUNC "%8.4" "m.s-1" COEFFS 0 1 0 0 0 1 /end COMPU_METHOD
/begin COMPU_METHOD LINEAR_FUNCTION_M1_T0_U16 "" RAT_FUNC "%8.4" "m/s" COEFFS 0 1 0 0 0 1 /end COMPU_METHOD
/begin COMPU_METHOD LINEAR_FUNCTION_M1_T0_U17 "" RAT_FUNC "%8.4" "1%" COEFFS 0 1 0 0 0 1 /end COMPU_METHOD
/begin COMPU_METHOD LINEAR_FUNCTION_M1_T0_U18 "" RAT_FUNC "%8.4" "┬░" COEFFS 0 1 0 0 0 1 /end COMPU_METHOD
/begin COMPU_METHOD LINEAR_FUNCTION_M1_T0_U19 "" RAT_FUNC "%8.4" "m.s-2" COEFFS 0 1 0 0 0 1 /end COMPU_METHOD
/begin COMPU_METHOD LINEAR_FUNCTION_M1_T0_U20 "" RAT_FUNC "%8.4" "s" COEFFS 0 1 0 0 0 1 /end COMPU_METHOD
/begin COMPU_METHOD LINEAR_FUNCTION_M1_T0_U21 "" RAT_FUNC "%8.4" "┬║.s-1" COEFFS 0 1 0 0 0 1 /end COMPU_METHOD
/begin COMPU_METHOD LINEAR_FUNCTION_M1_T0_U22 "" RAT_FUNC "%8.4" "N" COEFFS 0 1 0 0 0 1 /end COMPU_METHOD
/begin COMPU_METHOD LINEAR_FUNCTION_M1_T0_U23 "" RAT_FUNC "%8.4" "Nm" COEFFS 0 1 0 0 0 1 /end COMPU_METHOD
/begin RECORD_LAYOUT STANDARD_VALUE_R64 FNC_VALUES 1 FLOAT64_IEEE COLUMN_DIR DIRECT /end RECORD_LAYOUT
/begin GROUP ETCSignals "" ROOT
 /begin REF_MEASUREMENT ETCSignals.ES900.ES910.CAN1.Presence.PresenceGroup.PresenceFlag ETCSignals.ES900.ES910.CAN1.CAN1.AP_BMS_SDC.Shutdown_PackageIntck ETCSignals.ES900.ES910.CAN1.CAN1.AP_BMS_SDC.Shutdown_IMD ETCSignals.ES900.ES910.CAN1.CAN1.AP_BMS_SDC.Shutdown_BMS ETCSignals.ES900.ES910.CAN1.CAN1.AP_CurrentSensor.ERROR ETCSignals.ES900.ES910.CAN1.CAN1.AP_CurrentSensor.Accumulator_Current ETCSignals.ES900.ES910.CAN1.CAN1.AP_BMS_Voltages.Lowest_CellVoltage ETCSignals.ES900.ES910.CAN1.CAN1.AP_BMS_Voltages.Highest_CellVoltage ETCSignals.ES900.ES910.CAN1.CAN1.AP_BMS_Voltages.Accumulator_Voltage ETCSignals.ES900.ES910.CAN1.CAN1.AP_BMS_ChargerParameters.Charger_MaxVoltage ETCSignals.ES900.ES910.CAN1.CAN1.AP_BMS_ChargerParameters.Charger_MaxCurrent ETCSignals.ES900.ES910.CAN1.CAN1.AP_BMS_Temperatures.Lowest_CellTemp ETCSignals.ES900.ES910.CAN1.CAN1.AP_BMS_Temperatures.Highest_CellTemp ETCSignals.ES900.ES910.CAN1.CAN1.AP_BMS_Temperatures.Average_CellTemp ETCSignals.ES900.ES910.CAN1.CAN1.AP_Inverter_R_Tx.Inv_R_RegID ETCSignals.ES900.ES910.CAN1.CAN1.AP_Inverter_R_Tx.Inv_R_RegID_M73_Inv_R_TempMotor ETCSignals.ES900.ES910.CAN1.CAN1.AP_Inverter_R_Tx.Inv_R_RegID_M74_Inv_R_TempIGBT ETCSignals.ES900.ES910.CAN1.CAN1.AP_Inverter_R_Tx.Inv_R_RegID_M48_Inv_R_Speed ETCSignals.ES900.ES910.CAN1.CAN1.AP_Inverter_R_Tx.Inv_R_RegID_M39_Inv_R_Iq ETCSignals.ES900.ES910.CAN1.CAN1.AP_Inverter_R_Tx.Inv_R_RegID_M38_Inv_R_Icommand ETCSignals.ES900.ES910.CAN1.CAN1.AP_Inverter_R_Tx.Inv_R_RegID_M32_Inv_R_Iactual ETCSignals.ES900.ES910.CAN1.CAN1.AP_Inverter_R_Tx.Inv_R_RegID_M235_Inv_R_DCBus ETCSignals.ES900.ES910.CAN1.CAN1.AP_Inverter_L_Tx.Inv_L_RegID ETCSignals.ES900.ES910.CAN1.CAN1.AP_Inverter_L_Tx.Inv_L_RegID_M73_Inv_L_TempMotor ETCSignals.ES900.ES910.CAN1.CAN1.AP_Inverter_L_Tx.Inv_L_RegID_M74_Inv_L_TempIGBT ETCSignals.ES900.ES910.CAN1.CAN1.AP_Inverter_L_Tx.Inv_L_RegID_M48_Inv_L_Speed ETCSignals.ES900.ES910.CAN1.CAN1.AP_Inverter_L_Tx.Inv_L_RegID_M39_Inv_L_Iq ETCSignals.ES900.ES910.CAN1.CAN1.AP_Inverter_L_Tx.Inv_L_RegID_M38_Inv_L_Icommand ETCSignals.ES900.ES910.CAN1.CAN1.AP_Inverter_L_Tx.Inv_L_RegID_M32_Inv_L_Iactual ETCSignals.ES900.ES910.CAN1.CAN1.AP_Inverter_L_Tx.Inv_L_RegID_M235_Inv_L_DCBus ETCSignals.ES900.ES910.CAN1.CAN1.AP_DASH_Mode.RacingMode ETCSignals.ES900.ES910.CAN1.CAN1.NM_BMS_Keep_Alive.BMS_Alive ETCSignals.ES900.ES910.CAN1.CAN1.AP_BMS_AIRs_State.AIRs_State ETCSignals.ES900.ES910.CAN1.CAN1.NM_DASH_Keep_Alive.Dash_Alive ETCSignals.ES900.ES910.CAN1.CAN1.AP_DASH_PrechargeRequest.PrechargeRequest ETCSignals.ES900.ES910.CAN1.CAN1.AP_DASH_EnableDrive.EnableDrive_Order ETCSignals.ES900.ES910.CAN1.CAN1.AP_ETAS_DashData.SoC_KF ETCSignals.ES900.ES910.CAN1.CAN1.AP_ETAS_DashData.Speed ETCSignals.ES900.ES910.CAN1.CAN1.AP_ETAS_DashData.Precharge_Voltage ETCSignals.ES900.ES910.CAN1.CAN1.AP_ETAS_DashData.Precharge_Percentage ETCSignals.ES900.ES910.CAN1.CAN1.AP_ETAS_VDCParams.VDC_Max_Tyre_Slip ETCSignals.ES900.ES910.CAN1.CAN1.AP_ETAS_Inverter_R_Rx.Inverter_R_RegID ETCSignals.ES900.ES910.CAN1.CAN1.AP_ETAS_Inverter_R_Rx.Inverter_R_b7tob0 ETCSignals.ES900.ES910.CAN1.CAN1.AP_ETAS_Inverter_R_Rx.Inverter_R_b15tob8 ETCSignals.ES900.ES910.CAN1.CAN1.AP_ETAS_Inverter_L_Rx.Inverter_L_RegID ETCSignals.ES900.ES910.CAN1.CAN1.AP_ETAS_Inverter_L_Rx.Inverter_L_b7tob0 ETCSignals.ES900.ES910.CAN1.CAN1.AP_ETAS_Inverter_L_Rx.Inverter_L_b15tob8 ETCSignals.ES900.ES910.CAN1.CAN1.AP_ETAS_CarState.Car_State ETCSignals.ES900.ES910.CAN1.CAN1.AP_ETAS_AIRsRequest.AIRs_Request ETCSignals.ES900.ES910.CAN1.CAN1.MEAS_ETAS_InternalVars.InvertersAction ETCSignals.ES900.ES910.CAN1.CAN1.MEAS_ETAS_InternalVars.el_Vel_OK ETCSignals.ES900.ES910.CAN1.CAN1.MEAS_ETAS_InternalVars.TC_Warning ETCSignals.ES900.ES910.CAN1.CAN1.MEAS_ETAS_InternalVars.Regenerative_Enable ETCSignals.ES900.ES910.CAN1.CAN1.MEAS_ETAS_InternalVars.CriticalDisconnection ETCSignals.ES900.ES910.CAN1.CAN1.MEAS_ETAS_InternalVars.Relay_Error ETCSignals.ES900.ES910.CAN1.CAN1.MEAS_ETAS_InternalVars.Car_OK ETCSignals.ES900.ES910.CAN1.CAN1.MEAS_ETAS_InternalVars.Power ETCSignals.ES900.ES910.CAN1.CAN1.MEAS_ETAS_InternalVars.Torque_OK ETCSignals.ES900.ES910.CAN1.CAN1.MEAS_ETAS_InternalVars.Sensorics_Mode ETCSignals.ES900.ES910.CAN1.CAN1.MEAS_ETAS_InternalVars.Critical_Signal_Disconnection ETCSignals.ES900.ES910.CAN1.CAN1.MEAS_ETAS_InternalVars.Critical_CAN_Disconnection ETCSignals.ES900.ES910.CAN1.CAN1.MEAS_ETAS_InternalVars.APPS_Implausibility ETCSignals.ES900.ES910.CAN1.CAN1.AP_ETAS_Synchronism.Sync_CAN1 ETCSignals.ES900.ES910.CAN2.Presence.PresenceGroup.PresenceFlag ETCSignals.ES900.ES910.CAN2.CAN2.MEAS_ETAS_SOC.SOC_High ETCSignals.ES900.ES910.CAN2.CAN2.MEAS_ETAS_SOC.SOC_Low ETCSignals.ES900.ES910.CAN2.CAN2.MEAS_ETAS_SOC.SOC_Avg ETCSignals.ES900.ES910.CAN2.CAN2.AP_ELLIPSE_AUTO.el_Track_Valid ETCSignals.ES900.ES910.CAN2.CAN2.AP_ELLIPSE_AUTO.el_Slip_Valid ETCSignals.ES900.ES910.CAN2.CAN2.AP_ELLIPSE_AUTO.el_Curvature_Valid ETCSignals.ES900.ES910.CAN2.CAN2.AP_ELLIPSE_AUTO.el_SlipAngle ETCSignals.ES900.ES910.CAN2.CAN2.AP_ELLIPSE_AUTO.el_CurvatureRadius ETCSignals.ES900.ES910.CAN2.CAN2.AP_ELLIPSE_AUTO.el_AngleTrack ETCSignals.ES900.ES910.CAN2.CAN2.AP_ELLIPSE_GPS_VEL.el_Vel_GPS_N ETCSignals.ES900.ES910.CAN2.CAN2.AP_ELLIPSE_GPS_VEL.el_Vel_GPS_E ETCSignals.ES900.ES910.CAN2.CAN2.AP_ELLIPSE_GPS_VEL.el_Vel_GPS_D ETCSignals.ES900.ES910.CAN2.CAN2.NM_ETAS_Disconnections.Disconnection_InvR ETCSignals.ES900.ES910.CAN2.CAN2.NM_ETAS_Disconnections.Disconnection_InvL ETCSignals.ES900.ES910.CAN2.CAN2.NM_ETAS_Disconnections.Disconnection_Susp_R_R ETCSignals.ES900.ES910.CAN2.CAN2.NM_ETAS_Disconnections.Disconnection_Susp_R_L ETCSignals.ES900.ES910.CAN2.CAN2.NM_ETAS_Disconnections.Disconnection_Susp_F_R ETCSignals.ES900.ES910.CAN2.CAN2.NM_ETAS_Disconnections.Disconnection_Susp_F_L ETCSignals.ES900.ES910.CAN2.CAN2.NM_ETAS_Disconnections.Disconnection_SteeringSensor ETCSignals.ES900.ES910.CAN2.CAN2.NM_ETAS_Disconnections.Disconnection_Rear ETCSignals.ES900.ES910.CAN2.CAN2.NM_ETAS_Disconnections.Disconnection_Pitot ETCSignals.ES900.ES910.CAN2.CAN2.NM_ETAS_Disconnections.Disconnection_Front ETCSignals.ES900.ES910.CAN2.CAN2.NM_ETAS_Disconnections.Disconnection_Ellipse ETCSignals.ES900.ES910.CAN2.CAN2.NM_ETAS_Disconnections.Disconnection_DashBoard ETCSignals.ES900.ES910.CAN2.CAN2.NM_ETAS_Disconnections.Disconnection_BrakePedal ETCSignals.ES900.ES910.CAN2.CAN2.NM_ETAS_Disconnections.Disconnection_BMS ETCSignals.ES900.ES910.CAN2.CAN2.NM_ETAS_Disconnections.Disconnection_APPS2 ETCSignals.ES900.ES910.CAN2.CAN2.NM_ETAS_Disconnections.Disconnection_APPS1 ETCSignals.ES900.ES910.CAN2.CAN2.MEAS_ETAS_VDC_Values.el_VEL ETCSignals.ES900.ES910.CAN2.CAN2.MEAS_ETAS_VDC_Values.SteeringSensor_Value ETCSignals.ES900.ES910.CAN2.CAN2.MEAS_ETAS_VDC_Values.BrakePedal_Value ETCSignals.ES900.ES910.CAN2.CAN2.MEAS_ETAS_VDC_Values.APPS2_Value ETCSignals.ES900.ES910.CAN2.CAN2.MEAS_ETAS_VDC_Values.APPS1_Value ETCSignals.ES900.ES910.CAN2.CAN2.AP_ETAS_BrakeLight.BrakeLight_Control ETCSignals.ES900.ES910.CAN2.CAN2.MEAS_RECU_SDC.Shutdown_TSMS_TSMP ETCSignals.ES900.ES910.CAN2.CAN2.MEAS_RECU_SDC.Shutdown_HVD ETCSignals.ES900.ES910.CAN2.CAN2.MEAS_RECU_SDC.Shutdown_HVBox ETCSignals.ES900.ES910.CAN2.CAN2.MEAS_RECU_SDC.Shutdown_LeftTS ETCSignals.ES900.ES910.CAN2.CAN2.MEAS_RECU_SDC.Shutdown_RightTS ETCSignals.ES900.ES910.CAN2.CAN2.AP_ELLIPSE_EKF_POS.el_LONGITUDE_EKF ETCSignals.ES900.ES910.CAN2.CAN2.AP_ELLIPSE_EKF_POS.el_LATITUDE_EKF ETCSignals.ES900.ES910.CAN2.CAN2.AP_ELLIPSE_IMU_ACCEL.el_ACCEL_Z ETCSignals.ES900.ES910.CAN2.CAN2.AP_ELLIPSE_IMU_ACCEL.el_ACCEL_Y ETCSignals.ES900.ES910.CAN2.CAN2.AP_ELLIPSE_IMU_ACCEL.el_ACCEL_X ETCSignals.ES900.ES910.CAN2.CAN2.AP_ELLIPSE_EKF_EULER.el_YAW ETCSignals.ES900.ES910.CAN2.CAN2.AP_ELLIPSE_EKF_EULER.el_PITCH ETCSignals.ES900.ES910.CAN2.CAN2.AP_ELLIPSE_EKF_EULER.el_ROLL ETCSignals.ES900.ES910.CAN2.CAN2.AP_ELLIPSE_EKF_VEL.el_Vel_EKF_Z ETCSignals.ES900.ES910.CAN2.CAN2.AP_ELLIPSE_EKF_VEL.el_Vel_EKF_Y ETCSignals.ES900.ES910.CAN2.CAN2.AP_ELLIPSE_EKF_VEL.el_Vel_EKF_X ETCSignals.ES900.ES910.CAN2.CAN2.NM_ELLIPSE_Status.Ellipse_Alive ETCSignals.ES900.ES910.CAN2.CAN2.AP_ELLIPSE_IMU_GYRO.el_GYRO_Z ETCSignals.ES900.ES910.CAN2.CAN2.AP_ELLIPSE_IMU_GYRO.el_GYRO_Y ETCSignals.ES900.ES910.CAN2.CAN2.AP_ELLIPSE_IMU_GYRO.el_GYRO_X ETCSignals.ES900.ES910.CAN2.CAN2.AP_ELLIPSE_VEL_Valid.el_SolutionMode ETCSignals.ES900.ES910.CAN2.CAN2.AP_ELLIPSE_VEL_Valid.el_Vel_GPS_Valid ETCSignals.ES900.ES910.CAN2.CAN2.AP_ELLIPSE_VEL_Valid.el_Vel_EKF_Valid ETCSignals.ES900.ES910.CAN2.CAN2.MEAS_ETAS_Inverter_R_Data.Inv_R_TempMotor ETCSignals.ES900.ES910.CAN2.CAN2.MEAS_ETAS_Inverter_R_Data.current_R ETCSignals.ES900.ES910.CAN2.CAN2.MEAS_ETAS_Inverter_R_Data.Inv_R_TempIGBT ETCSignals.ES900.ES910.CAN2.CAN2.MEAS_ETAS_Inverter_R_Data.RR_Vel_ms_Wheel ETCSignals.ES900.ES910.CAN2.CAN2.MEAS_ETAS_Inverter_L_Data.Inv_L_TempMotor ETCSignals.ES900.ES910.CAN2.CAN2.MEAS_ETAS_Inverter_L_Data.current_L ETCSignals.ES900.ES910.CAN2.CAN2.MEAS_ETAS_Inverter_L_Data.Inv_L_TempIGBT ETCSignals.ES900.ES910.CAN2.CAN2.MEAS_ETAS_Inverter_L_Data.RL_Vel_ms_Wheel ETCSignals.ES900.ES910.CAN2.CAN2.MEAS_ETAS_VDC_Suspe.SUSP_R_R ETCSignals.ES900.ES910.CAN2.CAN2.MEAS_ETAS_VDC_Suspe.SUSP_R_L ETCSignals.ES900.ES910.CAN2.CAN2.MEAS_ETAS_VDC_Suspe.SUSP_F_R ETCSignals.ES900.ES910.CAN2.CAN2.MEAS_ETAS_VDC_Suspe.SUSP_F_L ETCSignals.ES900.ES910.CAN2.CAN2.MEAS_ETAS_VDC_Tq.Throttle_Torque ETCSignals.ES900.ES910.CAN2.CAN2.MEAS_ETAS_VDC_Tq.Torque_R ETCSignals.ES900.ES910.CAN2.CAN2.MEAS_ETAS_VDC_Tq.Torque_L ETCSignals.ES900.ES910.CAN2.CAN2.AP_RECU_Data.Susp_R_R_Bits ETCSignals.ES900.ES910.CAN2.CAN2.AP_RECU_Data.Susp_R_L_Bits ETCSignals.ES900.ES910.CAN2.CAN2.NM_FECU_Keep_Alive.Front_Alive ETCSignals.ES900.ES910.CAN2.CAN2.NM_RECU_Keep_Alive.Rear_Alive ETCSignals.ES900.ES910.CAN2.CAN2.AP_FECU_Data2.Pitot_Bits ETCSignals.ES900.ES910.CAN2.CAN2.AP_FECU_Data2.Susp_F_R_Bits ETCSignals.ES900.ES910.CAN2.CAN2.AP_FECU_Data2.Susp_F_L_Bits ETCSignals.ES900.ES910.CAN2.CAN2.AP_FECU_Data1.SteeringSensor_Bits ETCSignals.ES900.ES910.CAN2.CAN2.AP_FECU_Data1.BrakePedal_Bits ETCSignals.ES900.ES910.CAN2.CAN2.AP_FECU_Data1.APPS2_Bits ETCSignals.ES900.ES910.CAN2.CAN2.AP_FECU_Data1.APPS1_Bits ETCSignals.ES900.ES910.CAN2.CAN2.AP_ETAS_Synchronism.Sync_CAN2 /end REF_MEASUREMENT
 /begin REF_CHARACTERISTIC ETCSignals.ES900.ES910.CAN1.CAN1.AP_ETAS_DashData.SoC_KF_calibrate ETCSignals.ES900.ES910.CAN1.CAN1.AP_ETAS_DashData.Speed_calibrate ETCSignals.ES900.ES910.CAN1.CAN1.AP_ETAS_DashData.Precharge_Voltage_calibrate ETCSignals.ES900.ES910.CAN1.CAN1.AP_ETAS_DashData.Precharge_Percentage_calibrate ETCSignals.ES900.ES910.CAN1.CAN1.AP_ETAS_VDCParams.VDC_Max_Tyre_Slip_calibrate ETCSignals.ES900.ES910.CAN1.CAN1.AP_ETAS_Inverter_R_Rx.Inverter_R_RegID_calibrate ETCSignals.ES900.ES910.CAN1.CAN1.AP_ETAS_Inverter_R_Rx.Inverter_R_b7tob0_calibrate ETCSignals.ES900.ES910.CAN1.CAN1.AP_ETAS_Inverter_R_Rx.Inverter_R_b15tob8_calibrate ETCSignals.ES900.ES910.CAN1.CAN1.AP_ETAS_Inverter_L_Rx.Inverter_L_RegID_calibrate ETCSignals.ES900.ES910.CAN1.CAN1.AP_ETAS_Inverter_L_Rx.Inverter_L_b7tob0_calibrate ETCSignals.ES900.ES910.CAN1.CAN1.AP_ETAS_Inverter_L_Rx.Inverter_L_b15tob8_calibrate ETCSignals.ES900.ES910.CAN1.CAN1.AP_ETAS_CarState.Car_State_calibrate ETCSignals.ES900.ES910.CAN1.CAN1.AP_ETAS_AIRsRequest.AIRs_Request_calibrate ETCSignals.ES900.ES910.CAN1.CAN1.MEAS_ETAS_InternalVars.InvertersAction_calibrate ETCSignals.ES900.ES910.CAN1.CAN1.MEAS_ETAS_InternalVars.el_Vel_OK_calibrate ETCSignals.ES900.ES910.CAN1.CAN1.MEAS_ETAS_InternalVars.TC_Warning_calibrate ETCSignals.ES900.ES910.CAN1.CAN1.MEAS_ETAS_InternalVars.Regenerative_Enable_calibrate ETCSignals.ES900.ES910.CAN1.CAN1.MEAS_ETAS_InternalVars.CriticalDisconnection_calibrate ETCSignals.ES900.ES910.CAN1.CAN1.MEAS_ETAS_InternalVars.Relay_Error_calibrate ETCSignals.ES900.ES910.CAN1.CAN1.MEAS_ETAS_InternalVars.Car_OK_calibrate ETCSignals.ES900.ES910.CAN1.CAN1.MEAS_ETAS_InternalVars.Power_calibrate ETCSignals.ES900.ES910.CAN1.CAN1.MEAS_ETAS_InternalVars.Torque_OK_calibrate ETCSignals.ES900.ES910.CAN1.CAN1.MEAS_ETAS_InternalVars.Sensorics_Mode_calibrate ETCSignals.ES900.ES910.CAN1.CAN1.MEAS_ETAS_InternalVars.Critical_Signal_Disconnection_calibrate ETCSignals.ES900.ES910.CAN1.CAN1.MEAS_ETAS_InternalVars.Critical_CAN_Disconnection_calibrate ETCSignals.ES900.ES910.CAN1.CAN1.MEAS_ETAS_InternalVars.APPS_Implausibility_calibrate ETCSignals.ES900.ES910.CAN1.CAN1.AP_ETAS_Synchronism.Sync_CAN1_calibrate ETCSignals.ES900.ES910.CAN2.CAN2.MEAS_ETAS_SOC.SOC_High_calibrate ETCSignals.ES900.ES910.CAN2.CAN2.MEAS_ETAS_SOC.SOC_Low_calibrate ETCSignals.ES900.ES910.CAN2.CAN2.MEAS_ETAS_SOC.SOC_Avg_calibrate ETCSignals.ES900.ES910.CAN2.CAN2.NM_ETAS_Disconnections.Disconnection_InvR_calibrate ETCSignals.ES900.ES910.CAN2.CAN2.NM_ETAS_Disconnections.Disconnection_InvL_calibrate ETCSignals.ES900.ES910.CAN2.CAN2.NM_ETAS_Disconnections.Disconnection_Susp_R_R_calibrate ETCSignals.ES900.ES910.CAN2.CAN2.NM_ETAS_Disconnections.Disconnection_Susp_R_L_calibrate ETCSignals.ES900.ES910.CAN2.CAN2.NM_ETAS_Disconnections.Disconnection_Susp_F_R_calibrate ETCSignals.ES900.ES910.CAN2.CAN2.NM_ETAS_Disconnections.Disconnection_Susp_F_L_calibrate ETCSignals.ES900.ES910.CAN2.CAN2.NM_ETAS_Disconnections.Disconnection_SteeringSensor_calibrate ETCSignals.ES900.ES910.CAN2.CAN2.NM_ETAS_Disconnections.Disconnection_Rear_calibrate ETCSignals.ES900.ES910.CAN2.CAN2.NM_ETAS_Disconnections.Disconnection_Pitot_calibrate ETCSignals.ES900.ES910.CAN2.CAN2.NM_ETAS_Disconnections.Disconnection_Front_calibrate ETCSignals.ES900.ES910.CAN2.CAN2.NM_ETAS_Disconnections.Disconnection_Ellipse_calibrate ETCSignals.ES900.ES910.CAN2.CAN2.NM_ETAS_Disconnections.Disconnection_DashBoard_calibrate ETCSignals.ES900.ES910.CAN2.CAN2.NM_ETAS_Disconnections.Disconnection_BrakePedal_calibrate ETCSignals.ES900.ES910.CAN2.CAN2.NM_ETAS_Disconnections.Disconnection_BMS_calibrate ETCSignals.ES900.ES910.CAN2.CAN2.NM_ETAS_Disconnections.Disconnection_APPS2_calibrate ETCSignals.ES900.ES910.CAN2.CAN2.NM_ETAS_Disconnections.Disconnection_APPS1_calibrate ETCSignals.ES900.ES910.CAN2.CAN2.MEAS_ETAS_VDC_Values.el_VEL_calibrate ETCSignals.ES900.ES910.CAN2.CAN2.MEAS_ETAS_VDC_Values.SteeringSensor_Value_calibrate ETCSignals.ES900.ES910.CAN2.CAN2.MEAS_ETAS_VDC_Values.BrakePedal_Value_calibrate ETCSignals.ES900.ES910.CAN2.CAN2.MEAS_ETAS_VDC_Values.APPS2_Value_calibrate ETCSignals.ES900.ES910.CAN2.CAN2.MEAS_ETAS_VDC_Values.APPS1_Value_calibrate ETCSignals.ES900.ES910.CAN2.CAN2.AP_ETAS_BrakeLight.BrakeLight_Control_calibrate ETCSignals.ES900.ES910.CAN2.CAN2.MEAS_ETAS_Inverter_R_Data.Inv_R_TempMotor_calibrate ETCSignals.ES900.ES910.CAN2.CAN2.MEAS_ETAS_Inverter_R_Data.current_R_calibrate ETCSignals.ES900.ES910.CAN2.CAN2.MEAS_ETAS_Inverter_R_Data.Inv_R_TempIGBT_calibrate ETCSignals.ES900.ES910.CAN2.CAN2.MEAS_ETAS_Inverter_R_Data.RR_Vel_ms_Wheel_calibrate ETCSignals.ES900.ES910.CAN2.CAN2.MEAS_ETAS_Inverter_L_Data.Inv_L_TempMotor_calibrate ETCSignals.ES900.ES910.CAN2.CAN2.MEAS_ETAS_Inverter_L_Data.current_L_calibrate ETCSignals.ES900.ES910.CAN2.CAN2.MEAS_ETAS_Inverter_L_Data.Inv_L_TempIGBT_calibrate ETCSignals.ES900.ES910.CAN2.CAN2.MEAS_ETAS_Inverter_L_Data.RL_Vel_ms_Wheel_calibrate ETCSignals.ES900.ES910.CAN2.CAN2.MEAS_ETAS_VDC_Suspe.SUSP_R_R_calibrate ETCSignals.ES900.ES910.CAN2.CAN2.MEAS_ETAS_VDC_Suspe.SUSP_R_L_calibrate ETCSignals.ES900.ES910.CAN2.CAN2.MEAS_ETAS_VDC_Suspe.SUSP_F_R_calibrate ETCSignals.ES900.ES910.CAN2.CAN2.MEAS_ETAS_VDC_Suspe.SUSP_F_L_calibrate ETCSignals.ES900.ES910.CAN2.CAN2.MEAS_ETAS_VDC_Tq.Throttle_Torque_calibrate ETCSignals.ES900.ES910.CAN2.CAN2.MEAS_ETAS_VDC_Tq.Torque_R_calibrate ETCSignals.ES900.ES910.CAN2.CAN2.MEAS_ETAS_VDC_Tq.Torque_L_calibrate ETCSignals.ES900.ES910.CAN2.CAN2.AP_ETAS_Synchronism.Sync_CAN2_calibrate /end REF_CHARACTERISTIC
 /begin SUB_GROUP ETCSignals.ES900 ETCSignals.ES900.ES910 ETCSignals.ES900.ES910.CAN1 ETCSignals.ES900.ES910.CAN1.Presence ETCSignals.ES900.ES910.CAN1.Presence.PresenceGroup ETCSignals.ES900.ES910.CAN1.CAN1 ETCSignals.ES900.ES910.CAN1.CAN1.AP_BMS_SDC ETCSignals.ES900.ES910.CAN1.CAN1.AP_CurrentSensor ETCSignals.ES900.ES910.CAN1.CAN1.AP_BMS_Voltages ETCSignals.ES900.ES910.CAN1.CAN1.AP_BMS_ChargerParameters ETCSignals.ES900.ES910.CAN1.CAN1.AP_BMS_Temperatures ETCSignals.ES900.ES910.CAN1.CAN1.AP_Inverter_R_Tx ETCSignals.ES900.ES910.CAN1.CAN1.AP_Inverter_L_Tx ETCSignals.ES900.ES910.CAN1.CAN1.AP_DASH_Mode ETCSignals.ES900.ES910.CAN1.CAN1.NM_BMS_Keep_Alive ETCSignals.ES900.ES910.CAN1.CAN1.AP_BMS_AIRs_State ETCSignals.ES900.ES910.CAN1.CAN1.NM_DASH_Keep_Alive ETCSignals.ES900.ES910.CAN1.CAN1.AP_DASH_PrechargeRequest ETCSignals.ES900.ES910.CAN1.CAN1.AP_DASH_EnableDrive ETCSignals.ES900.ES910.CAN1.CAN1.AP_ETAS_DashData ETCSignals.ES900.ES910.CAN1.CAN1.AP_ETAS_VDCParams ETCSignals.ES900.ES910.CAN1.CAN1.AP_ETAS_Inverter_R_Rx ETCSignals.ES900.ES910.CAN1.CAN1.AP_ETAS_Inverter_L_Rx ETCSignals.ES900.ES910.CAN1.CAN1.AP_ETAS_CarState ETCSignals.ES900.ES910.CAN1.CAN1.AP_ETAS_AIRsRequest ETCSignals.ES900.ES910.CAN1.CAN1.MEAS_ETAS_InternalVars ETCSignals.ES900.ES910.CAN1.CAN1.AP_ETAS_Synchronism ETCSignals.ES900.ES910.CAN2 ETCSignals.ES900.ES910.CAN2.Presence ETCSignals.ES900.ES910.CAN2.Presence.PresenceGroup ETCSignals.ES900.ES910.CAN2.CAN2 ETCSignals.ES900.ES910.CAN2.CAN2.MEAS_ETAS_SOC ETCSignals.ES900.ES910.CAN2.CAN2.AP_ELLIPSE_AUTO ETCSignals.ES900.ES910.CAN2.CAN2.AP_ELLIPSE_GPS_VEL ETCSignals.ES900.ES910.CAN2.CAN2.NM_ETAS_Disconnections ETCSignals.ES900.ES910.CAN2.CAN2.MEAS_ETAS_VDC_Values ETCSignals.ES900.ES910.CAN2.CAN2.AP_ETAS_BrakeLight ETCSignals.ES900.ES910.CAN2.CAN2.MEAS_RECU_SDC ETCSignals.ES900.ES910.CAN2.CAN2.AP_ELLIPSE_EKF_POS ETCSignals.ES900.ES910.CAN2.CAN2.AP_ELLIPSE_IMU_ACCEL ETCSignals.ES900.ES910.CAN2.CAN2.AP_ELLIPSE_EKF_EULER ETCSignals.ES900.ES910.CAN2.CAN2.AP_ELLIPSE_EKF_VEL ETCSignals.ES900.ES910.CAN2.CAN2.NM_ELLIPSE_Status ETCSignals.ES900.ES910.CAN2.CAN2.AP_ELLIPSE_IMU_GYRO ETCSignals.ES900.ES910.CAN2.CAN2.AP_ELLIPSE_VEL_Valid ETCSignals.ES900.ES910.CAN2.CAN2.MEAS_ETAS_Inverter_R_Data ETCSignals.ES900.ES910.CAN2.CAN2.MEAS_ETAS_Inverter_L_Data ETCSignals.ES900.ES910.CAN2.CAN2.MEAS_ETAS_VDC_Suspe ETCSignals.ES900.ES910.CAN2.CAN2.MEAS_ETAS_VDC_Tq ETCSignals.ES900.ES910.CAN2.CAN2.AP_RECU_Data ETCSignals.ES900.ES910.CAN2.CAN2.NM_FECU_Keep_Alive ETCSignals.ES900.ES910.CAN2.CAN2.NM_RECU_Keep_Alive ETCSignals.ES900.ES910.CAN2.CAN2.AP_FECU_Data2 ETCSignals.ES900.ES910.CAN2.CAN2.AP_FECU_Data1 ETCSignals.ES900.ES910.CAN2.CAN2.AP_ETAS_Synchronism /end SUB_GROUP
/end GROUP
/begin GROUP ETCSignals.ES900 ""
 /begin REF_MEASUREMENT ETCSignals.ES900.ES910.CAN1.Presence.PresenceGroup.PresenceFlag ETCSignals.ES900.ES910.CAN1.CAN1.AP_BMS_SDC.Shutdown_PackageIntck ETCSignals.ES900.ES910.CAN1.CAN1.AP_BMS_SDC.Shutdown_IMD ETCSignals.ES900.ES910.CAN1.CAN1.AP_BMS_SDC.Shutdown_BMS ETCSignals.ES900.ES910.CAN1.CAN1.AP_CurrentSensor.ERROR ETCSignals.ES900.ES910.CAN1.CAN1.AP_CurrentSensor.Accumulator_Current ETCSignals.ES900.ES910.CAN1.CAN1.AP_BMS_Voltages.Lowest_CellVoltage ETCSignals.ES900.ES910.CAN1.CAN1.AP_BMS_Voltages.Highest_CellVoltage ETCSignals.ES900.ES910.CAN1.CAN1.AP_BMS_Voltages.Accumulator_Voltage ETCSignals.ES900.ES910.CAN1.CAN1.AP_BMS_ChargerParameters.Charger_MaxVoltage ETCSignals.ES900.ES910.CAN1.CAN1.AP_BMS_ChargerParameters.Charger_MaxCurrent ETCSignals.ES900.ES910.CAN1.CAN1.AP_BMS_Temperatures.Lowest_CellTemp ETCSignals.ES900.ES910.CAN1.CAN1.AP_BMS_Temperatures.Highest_CellTemp ETCSignals.ES900.ES910.CAN1.CAN1.AP_BMS_Temperatures.Average_CellTemp ETCSignals.ES900.ES910.CAN1.CAN1.AP_Inverter_R_Tx.Inv_R_RegID ETCSignals.ES900.ES910.CAN1.CAN1.AP_Inverter_R_Tx.Inv_R_RegID_M73_Inv_R_TempMotor ETCSignals.ES900.ES910.CAN1.CAN1.AP_Inverter_R_Tx.Inv_R_RegID_M74_Inv_R_TempIGBT ETCSignals.ES900.ES910.CAN1.CAN1.AP_Inverter_R_Tx.Inv_R_RegID_M48_Inv_R_Speed ETCSignals.ES900.ES910.CAN1.CAN1.AP_Inverter_R_Tx.Inv_R_RegID_M39_Inv_R_Iq ETCSignals.ES900.ES910.CAN1.CAN1.AP_Inverter_R_Tx.Inv_R_RegID_M38_Inv_R_Icommand ETCSignals.ES900.ES910.CAN1.CAN1.AP_Inverter_R_Tx.Inv_R_RegID_M32_Inv_R_Iactual ETCSignals.ES900.ES910.CAN1.CAN1.AP_Inverter_R_Tx.Inv_R_RegID_M235_Inv_R_DCBus ETCSignals.ES900.ES910.CAN1.CAN1.AP_Inverter_L_Tx.Inv_L_RegID ETCSignals.ES900.ES910.CAN1.CAN1.AP_Inverter_L_Tx.Inv_L_RegID_M73_Inv_L_TempMotor ETCSignals.ES900.ES910.CAN1.CAN1.AP_Inverter_L_Tx.Inv_L_RegID_M74_Inv_L_TempIGBT ETCSignals.ES900.ES910.CAN1.CAN1.AP_Inverter_L_Tx.Inv_L_RegID_M48_Inv_L_Speed ETCSignals.ES900.ES910.CAN1.CAN1.AP_Inverter_L_Tx.Inv_L_RegID_M39_Inv_L_Iq ETCSignals.ES900.ES910.CAN1.CAN1.AP_Inverter_L_Tx.Inv_L_RegID_M38_Inv_L_Icommand ETCSignals.ES900.ES910.CAN1.CAN1.AP_Inverter_L_Tx.Inv_L_RegID_M32_Inv_L_Iactual ETCSignals.ES900.ES910.CAN1.CAN1.AP_Inverter_L_Tx.Inv_L_RegID_M235_Inv_L_DCBus ETCSignals.ES900.ES910.CAN1.CAN1.AP_DASH_Mode.RacingMode ETCSignals.ES900.ES910.CAN1.CAN1.NM_BMS_Keep_Alive.BMS_Alive ETCSignals.ES900.ES910.CAN1.CAN1.AP_BMS_AIRs_State.AIRs_State ETCSignals.ES900.ES910.CAN1.CAN1.NM_DASH_Keep_Alive.Dash_Alive ETCSignals.ES900.ES910.CAN1.CAN1.AP_DASH_PrechargeRequest.PrechargeRequest ETCSignals.ES900.ES910.CAN1.CAN1.AP_DASH_EnableDrive.EnableDrive_Order ETCSignals.ES900.ES910.CAN1.CAN1.AP_ETAS_DashData.SoC_KF ETCSignals.ES900.ES910.CAN1.CAN1.AP_ETAS_DashData.Speed ETCSignals.ES900.ES910.CAN1.CAN1.AP_ETAS_DashData.Precharge_Voltage ETCSignals.ES900.ES910.CAN1.CAN1.AP_ETAS_DashData.Precharge_Percentage ETCSignals.ES900.ES910.CAN1.CAN1.AP_ETAS_VDCParams.VDC_Max_Tyre_Slip ETCSignals.ES900.ES910.CAN1.CAN1.AP_ETAS_Inverter_R_Rx.Inverter_R_RegID ETCSignals.ES900.ES910.CAN1.CAN1.AP_ETAS_Inverter_R_Rx.Inverter_R_b7tob0 ETCSignals.ES900.ES910.CAN1.CAN1.AP_ETAS_Inverter_R_Rx.Inverter_R_b15tob8 ETCSignals.ES900.ES910.CAN1.CAN1.AP_ETAS_Inverter_L_Rx.Inverter_L_RegID ETCSignals.ES900.ES910.CAN1.CAN1.AP_ETAS_Inverter_L_Rx.Inverter_L_b7tob0 ETCSignals.ES900.ES910.CAN1.CAN1.AP_ETAS_Inverter_L_Rx.Inverter_L_b15tob8 ETCSignals.ES900.ES910.CAN1.CAN1.AP_ETAS_CarState.Car_State ETCSignals.ES900.ES910.CAN1.CAN1.AP_ETAS_AIRsRequest.AIRs_Request ETCSignals.ES900.ES910.CAN1.CAN1.MEAS_ETAS_InternalVars.InvertersAction ETCSignals.ES900.ES910.CAN1.CAN1.MEAS_ETAS_InternalVars.el_Vel_OK ETCSignals.ES900.ES910.CAN1.CAN1.MEAS_ETAS_InternalVars.TC_Warning ETCSignals.ES900.ES910.CAN1.CAN1.MEAS_ETAS_InternalVars.Regenerative_Enable ETCSignals.ES900.ES910.CAN1.CAN1.MEAS_ETAS_InternalVars.CriticalDisconnection ETCSignals.ES900.ES910.CAN1.CAN1.MEAS_ETAS_InternalVars.Relay_Error ETCSignals.ES900.ES910.CAN1.CAN1.MEAS_ETAS_InternalVars.Car_OK ETCSignals.ES900.ES910.CAN1.CAN1.MEAS_ETAS_InternalVars.Power ETCSignals.ES900.ES910.CAN1.CAN1.MEAS_ETAS_InternalVars.Torque_OK ETCSignals.ES900.ES910.CAN1.CAN1.MEAS_ETAS_InternalVars.Sensorics_Mode ETCSignals.ES900.ES910.CAN1.CAN1.MEAS_ETAS_InternalVars.Critical_Signal_Disconnection ETCSignals.ES900.ES910.CAN1.CAN1.MEAS_ETAS_InternalVars.Critical_CAN_Disconnection ETCSignals.ES900.ES910.CAN1.CAN1.MEAS_ETAS_InternalVars.APPS_Implausibility ETCSignals.ES900.ES910.CAN1.CAN1.AP_ETAS_Synchronism.Sync_CAN1 ETCSignals.ES900.ES910.CAN2.Presence.PresenceGroup.PresenceFlag ETCSignals.ES900.ES910.CAN2.CAN2.MEAS_ETAS_SOC.SOC_High ETCSignals.ES900.ES910.CAN2.CAN2.MEAS_ETAS_SOC.SOC_Low ETCSignals.ES900.ES910.CAN2.CAN2.MEAS_ETAS_SOC.SOC_Avg ETCSignals.ES900.ES910.CAN2.CAN2.AP_ELLIPSE_AUTO.el_Track_Valid ETCSignals.ES900.ES910.CAN2.CAN2.AP_ELLIPSE_AUTO.el_Slip_Valid ETCSignals.ES900.ES910.CAN2.CAN2.AP_ELLIPSE_AUTO.el_Curvature_Valid ETCSignals.ES900.ES910.CAN2.CAN2.AP_ELLIPSE_AUTO.el_SlipAngle ETCSignals.ES900.ES910.CAN2.CAN2.AP_ELLIPSE_AUTO.el_CurvatureRadius ETCSignals.ES900.ES910.CAN2.CAN2.AP_ELLIPSE_AUTO.el_AngleTrack ETCSignals.ES900.ES910.CAN2.CAN2.AP_ELLIPSE_GPS_VEL.el_Vel_GPS_N ETCSignals.ES900.ES910.CAN2.CAN2.AP_ELLIPSE_GPS_VEL.el_Vel_GPS_E ETCSignals.ES900.ES910.CAN2.CAN2.AP_ELLIPSE_GPS_VEL.el_Vel_GPS_D ETCSignals.ES900.ES910.CAN2.CAN2.NM_ETAS_Disconnections.Disconnection_InvR ETCSignals.ES900.ES910.CAN2.CAN2.NM_ETAS_Disconnections.Disconnection_InvL ETCSignals.ES900.ES910.CAN2.CAN2.NM_ETAS_Disconnections.Disconnection_Susp_R_R ETCSignals.ES900.ES910.CAN2.CAN2.NM_ETAS_Disconnections.Disconnection_Susp_R_L ETCSignals.ES900.ES910.CAN2.CAN2.NM_ETAS_Disconnections.Disconnection_Susp_F_R ETCSignals.ES900.ES910.CAN2.CAN2.NM_ETAS_Disconnections.Disconnection_Susp_F_L ETCSignals.ES900.ES910.CAN2.CAN2.NM_ETAS_Disconnections.Disconnection_SteeringSensor ETCSignals.ES900.ES910.CAN2.CAN2.NM_ETAS_Disconnections.Disconnection_Rear ETCSignals.ES900.ES910.CAN2.CAN2.NM_ETAS_Disconnections.Disconnection_Pitot ETCSignals.ES900.ES910.CAN2.CAN2.NM_ETAS_Disconnections.Disconnection_Front ETCSignals.ES900.ES910.CAN2.CAN2.NM_ETAS_Disconnections.Disconnection_Ellipse ETCSignals.ES900.ES910.CAN2.CAN2.NM_ETAS_Disconnections.Disconnection_DashBoard ETCSignals.ES900.ES910.CAN2.CAN2.NM_ETAS_Disconnections.Disconnection_BrakePedal ETCSignals.ES900.ES910.CAN2.CAN2.NM_ETAS_Disconnections.Disconnection_BMS ETCSignals.ES900.ES910.CAN2.CAN2.NM_ETAS_Disconnections.Disconnection_APPS2 ETCSignals.ES900.ES910.CAN2.CAN2.NM_ETAS_Disconnections.Disconnection_APPS1 ETCSignals.ES900.ES910.CAN2.CAN2.MEAS_ETAS_VDC_Values.el_VEL ETCSignals.ES900.ES910.CAN2.CAN2.MEAS_ETAS_VDC_Values.SteeringSensor_Value ETCSignals.ES900.ES910.CAN2.CAN2.MEAS_ETAS_VDC_Values.BrakePedal_Value ETCSignals.ES900.ES910.CAN2.CAN2.MEAS_ETAS_VDC_Values.APPS2_Value ETCSignals.ES900.ES910.CAN2.CAN2.MEAS_ETAS_VDC_Values.APPS1_Value ETCSignals.ES900.ES910.CAN2.CAN2.AP_ETAS_BrakeLight.BrakeLight_Control ETCSignals.ES900.ES910.CAN2.CAN2.MEAS_RECU_SDC.Shutdown_TSMS_TSMP ETCSignals.ES900.ES910.CAN2.CAN2.MEAS_RECU_SDC.Shutdown_HVD ETCSignals.ES900.ES910.CAN2.CAN2.MEAS_RECU_SDC.Shutdown_HVBox ETCSignals.ES900.ES910.CAN2.CAN2.MEAS_RECU_SDC.Shutdown_LeftTS ETCSignals.ES900.ES910.CAN2.CAN2.MEAS_RECU_SDC.Shutdown_RightTS ETCSignals.ES900.ES910.CAN2.CAN2.AP_ELLIPSE_EKF_POS.el_LONGITUDE_EKF ETCSignals.ES900.ES910.CAN2.CAN2.AP_ELLIPSE_EKF_POS.el_LATITUDE_EKF ETCSignals.ES900.ES910.CAN2.CAN2.AP_ELLIPSE_IMU_ACCEL.el_ACCEL_Z ETCSignals.ES900.ES910.CAN2.CAN2.AP_ELLIPSE_IMU_ACCEL.el_ACCEL_Y ETCSignals.ES900.ES910.CAN2.CAN2.AP_ELLIPSE_IMU_ACCEL.el_ACCEL_X ETCSignals.ES900.ES910.CAN2.CAN2.AP_ELLIPSE_EKF_EULER.el_YAW ETCSignals.ES900.ES910.CAN2.CAN2.AP_ELLIPSE_EKF_EULER.el_PITCH ETCSignals.ES900.ES910.CAN2.CAN2.AP_ELLIPSE_EKF_EULER.el_ROLL ETCSignals.ES900.ES910.CAN2.CAN2.AP_ELLIPSE_EKF_VEL.el_Vel_EKF_Z ETCSignals.ES900.ES910.CAN2.CAN2.AP_ELLIPSE_EKF_VEL.el_Vel_EKF_Y ETCSignals.ES900.ES910.CAN2.CAN2.AP_ELLIPSE_EKF_VEL.el_Vel_EKF_X ETCSignals.ES900.ES910.CAN2.CAN2.NM_ELLIPSE_Status.Ellipse_Alive ETCSignals.ES900.ES910.CAN2.CAN2.AP_ELLIPSE_IMU_GYRO.el_GYRO_Z ETCSignals.ES900.ES910.CAN2.CAN2.AP_ELLIPSE_IMU_GYRO.el_GYRO_Y ETCSignals.ES900.ES910.CAN2.CAN2.AP_ELLIPSE_IMU_GYRO.el_GYRO_X ETCSignals.ES900.ES910.CAN2.CAN2.AP_ELLIPSE_VEL_Valid.el_SolutionMode ETCSignals.ES900.ES910.CAN2.CAN2.AP_ELLIPSE_VEL_Valid.el_Vel_GPS_Valid ETCSignals.ES900.ES910.CAN2.CAN2.AP_ELLIPSE_VEL_Valid.el_Vel_EKF_Valid ETCSignals.ES900.ES910.CAN2.CAN2.MEAS_ETAS_Inverter_R_Data.Inv_R_TempMotor ETCSignals.ES900.ES910.CAN2.CAN2.MEAS_ETAS_Inverter_R_Data.current_R ETCSignals.ES900.ES910.CAN2.CAN2.MEAS_ETAS_Inverter_R_Data.Inv_R_TempIGBT ETCSignals.ES900.ES910.CAN2.CAN2.MEAS_ETAS_Inverter_R_Data.RR_Vel_ms_Wheel ETCSignals.ES900.ES910.CAN2.CAN2.MEAS_ETAS_Inverter_L_Data.Inv_L_TempMotor ETCSignals.ES900.ES910.CAN2.CAN2.MEAS_ETAS_Inverter_L_Data.current_L ETCSignals.ES900.ES910.CAN2.CAN2.MEAS_ETAS_Inverter_L_Data.Inv_L_TempIGBT ETCSignals.ES900.ES910.CAN2.CAN2.MEAS_ETAS_Inverter_L_Data.RL_Vel_ms_Wheel ETCSignals.ES900.ES910.CAN2.CAN2.MEAS_ETAS_VDC_Suspe.SUSP_R_R ETCSignals.ES900.ES910.CAN2.CAN2.MEAS_ETAS_VDC_Suspe.SUSP_R_L ETCSignals.ES900.ES910.CAN2.CAN2.MEAS_ETAS_VDC_Suspe.SUSP_F_R ETCSignals.ES900.ES910.CAN2.CAN2.MEAS_ETAS_VDC_Suspe.SUSP_F_L ETCSignals.ES900.ES910.CAN2.CAN2.MEAS_ETAS_VDC_Tq.Throttle_Torque ETCSignals.ES900.ES910.CAN2.CAN2.MEAS_ETAS_VDC_Tq.Torque_R ETCSignals.ES900.ES910.CAN2.CAN2.MEAS_ETAS_VDC_Tq.Torque_L ETCSignals.ES900.ES910.CAN2.CAN2.AP_RECU_Data.Susp_R_R_Bits ETCSignals.ES900.ES910.CAN2.CAN2.AP_RECU_Data.Susp_R_L_Bits ETCSignals.ES900.ES910.CAN2.CAN2.NM_FECU_Keep_Alive.Front_Alive ETCSignals.ES900.ES910.CAN2.CAN2.NM_RECU_Keep_Alive.Rear_Alive ETCSignals.ES900.ES910.CAN2.CAN2.AP_FECU_Data2.Pitot_Bits ETCSignals.ES900.ES910.CAN2.CAN2.AP_FECU_Data2.Susp_F_R_Bits ETCSignals.ES900.ES910.CAN2.CAN2.AP_FECU_Data2.Susp_F_L_Bits ETCSignals.ES900.ES910.CAN2.CAN2.AP_FECU_Data1.SteeringSensor_Bits ETCSignals.ES900.ES910.CAN2.CAN2.AP_FECU_Data1.BrakePedal_Bits ETCSignals.ES900.ES910.CAN2.CAN2.AP_FECU_Data1.APPS2_Bits ETCSignals.ES900.ES910.CAN2.CAN2.AP_FECU_Data1.APPS1_Bits ETCSignals.ES900.ES910.CAN2.CAN2.AP_ETAS_Synchronism.Sync_CAN2 /end REF_MEASUREMENT
 /begin REF_CHARACTERISTIC ETCSignals.ES900.ES910.CAN1.CAN1.AP_ETAS_DashData.SoC_KF_calibrate ETCSignals.ES900.ES910.CAN1.CAN1.AP_ETAS_DashData.Speed_calibrate ETCSignals.ES900.ES910.CAN1.CAN1.AP_ETAS_DashData.Precharge_Voltage_calibrate ETCSignals.ES900.ES910.CAN1.CAN1.AP_ETAS_DashData.Precharge_Percentage_calibrate ETCSignals.ES900.ES910.CAN1.CAN1.AP_ETAS_VDCParams.VDC_Max_Tyre_Slip_calibrate ETCSignals.ES900.ES910.CAN1.CAN1.AP_ETAS_Inverter_R_Rx.Inverter_R_RegID_calibrate ETCSignals.ES900.ES910.CAN1.CAN1.AP_ETAS_Inverter_R_Rx.Inverter_R_b7tob0_calibrate ETCSignals.ES900.ES910.CAN1.CAN1.AP_ETAS_Inverter_R_Rx.Inverter_R_b15tob8_calibrate ETCSignals.ES900.ES910.CAN1.CAN1.AP_ETAS_Inverter_L_Rx.Inverter_L_RegID_calibrate ETCSignals.ES900.ES910.CAN1.CAN1.AP_ETAS_Inverter_L_Rx.Inverter_L_b7tob0_calibrate ETCSignals.ES900.ES910.CAN1.CAN1.AP_ETAS_Inverter_L_Rx.Inverter_L_b15tob8_calibrate ETCSignals.ES900.ES910.CAN1.CAN1.AP_ETAS_CarState.Car_State_calibrate ETCSignals.ES900.ES910.CAN1.CAN1.AP_ETAS_AIRsRequest.AIRs_Request_calibrate ETCSignals.ES900.ES910.CAN1.CAN1.MEAS_ETAS_InternalVars.InvertersAction_calibrate ETCSignals.ES900.ES910.CAN1.CAN1.MEAS_ETAS_InternalVars.el_Vel_OK_calibrate ETCSignals.ES900.ES910.CAN1.CAN1.MEAS_ETAS_InternalVars.TC_Warning_calibrate ETCSignals.ES900.ES910.CAN1.CAN1.MEAS_ETAS_InternalVars.Regenerative_Enable_calibrate ETCSignals.ES900.ES910.CAN1.CAN1.MEAS_ETAS_InternalVars.CriticalDisconnection_calibrate ETCSignals.ES900.ES910.CAN1.CAN1.MEAS_ETAS_InternalVars.Relay_Error_calibrate ETCSignals.ES900.ES910.CAN1.CAN1.MEAS_ETAS_InternalVars.Car_OK_calibrate ETCSignals.ES900.ES910.CAN1.CAN1.MEAS_ETAS_InternalVars.Power_calibrate ETCSignals.ES900.ES910.CAN1.CAN1.MEAS_ETAS_InternalVars.Torque_OK_calibrate ETCSignals.ES900.ES910.CAN1.CAN1.MEAS_ETAS_InternalVars.Sensorics_Mode_calibrate ETCSignals.ES900.ES910.CAN1.CAN1.MEAS_ETAS_InternalVars.Critical_Signal_Disconnection_calibrate ETCSignals.ES900.ES910.CAN1.CAN1.MEAS_ETAS_InternalVars.Critical_CAN_Disconnection_calibrate ETCSignals.ES900.ES910.CAN1.CAN1.MEAS_ETAS_InternalVars.APPS_Implausibility_calibrate ETCSignals.ES900.ES910.CAN1.CAN1.AP_ETAS_Synchronism.Sync_CAN1_calibrate ETCSignals.ES900.ES910.CAN2.CAN2.MEAS_ETAS_SOC.SOC_High_calibrate ETCSignals.ES900.ES910.CAN2.CAN2.MEAS_ETAS_SOC.SOC_Low_calibrate ETCSignals.ES900.ES910.CAN2.CAN2.MEAS_ETAS_SOC.SOC_Avg_calibrate ETCSignals.ES900.ES910.CAN2.CAN2.NM_ETAS_Disconnections.Disconnection_InvR_calibrate ETCSignals.ES900.ES910.CAN2.CAN2.NM_ETAS_Disconnections.Disconnection_InvL_calibrate ETCSignals.ES900.ES910.CAN2.CAN2.NM_ETAS_Disconnections.Disconnection_Susp_R_R_calibrate ETCSignals.ES900.ES910.CAN2.CAN2.NM_ETAS_Disconnections.Disconnection_Susp_R_L_calibrate ETCSignals.ES900.ES910.CAN2.CAN2.NM_ETAS_Disconnections.Disconnection_Susp_F_R_calibrate ETCSignals.ES900.ES910.CAN2.CAN2.NM_ETAS_Disconnections.Disconnection_Susp_F_L_calibrate ETCSignals.ES900.ES910.CAN2.CAN2.NM_ETAS_Disconnections.Disconnection_SteeringSensor_calibrate ETCSignals.ES900.ES910.CAN2.CAN2.NM_ETAS_Disconnections.Disconnection_Rear_calibrate ETCSignals.ES900.ES910.CAN2.CAN2.NM_ETAS_Disconnections.Disconnection_Pitot_calibrate ETCSignals.ES900.ES910.CAN2.CAN2.NM_ETAS_Disconnections.Disconnection_Front_calibrate ETCSignals.ES900.ES910.CAN2.CAN2.NM_ETAS_Disconnections.Disconnection_Ellipse_calibrate ETCSignals.ES900.ES910.CAN2.CAN2.NM_ETAS_Disconnections.Disconnection_DashBoard_calibrate ETCSignals.ES900.ES910.CAN2.CAN2.NM_ETAS_Disconnections.Disconnection_BrakePedal_calibrate ETCSignals.ES900.ES910.CAN2.CAN2.NM_ETAS_Disconnections.Disconnection_BMS_calibrate ETCSignals.ES900.ES910.CAN2.CAN2.NM_ETAS_Disconnections.Disconnection_APPS2_calibrate ETCSignals.ES900.ES910.CAN2.CAN2.NM_ETAS_Disconnections.Disconnection_APPS1_calibrate ETCSignals.ES900.ES910.CAN2.CAN2.MEAS_ETAS_VDC_Values.el_VEL_calibrate ETCSignals.ES900.ES910.CAN2.CAN2.MEAS_ETAS_VDC_Values.SteeringSensor_Value_calibrate ETCSignals.ES900.ES910.CAN2.CAN2.MEAS_ETAS_VDC_Values.BrakePedal_Value_calibrate ETCSignals.ES900.ES910.CAN2.CAN2.MEAS_ETAS_VDC_Values.APPS2_Value_calibrate ETCSignals.ES900.ES910.CAN2.CAN2.MEAS_ETAS_VDC_Values.APPS1_Value_calibrate ETCSignals.ES900.ES910.CAN2.CAN2.AP_ETAS_BrakeLight.BrakeLight_Control_calibrate ETCSignals.ES900.ES910.CAN2.CAN2.MEAS_ETAS_Inverter_R_Data.Inv_R_TempMotor_calibrate ETCSignals.ES900.ES910.CAN2.CAN2.MEAS_ETAS_Inverter_R_Data.current_R_calibrate ETCSignals.ES900.ES910.CAN2.CAN2.MEAS_ETAS_Inverter_R_Data.Inv_R_TempIGBT_calibrate ETCSignals.ES900.ES910.CAN2.CAN2.MEAS_ETAS_Inverter_R_Data.RR_Vel_ms_Wheel_calibrate ETCSignals.ES900.ES910.CAN2.CAN2.MEAS_ETAS_Inverter_L_Data.Inv_L_TempMotor_calibrate ETCSignals.ES900.ES910.CAN2.CAN2.MEAS_ETAS_Inverter_L_Data.current_L_calibrate ETCSignals.ES900.ES910.CAN2.CAN2.MEAS_ETAS_Inverter_L_Data.Inv_L_TempIGBT_calibrate ETCSignals.ES900.ES910.CAN2.CAN2.MEAS_ETAS_Inverter_L_Data.RL_Vel_ms_Wheel_calibrate ETCSignals.ES900.ES910.CAN2.CAN2.MEAS_ETAS_VDC_Suspe.SUSP_R_R_calibrate ETCSignals.ES900.ES910.CAN2.CAN2.MEAS_ETAS_VDC_Suspe.SUSP_R_L_calibrate ETCSignals.ES900.ES910.CAN2.CAN2.MEAS_ETAS_VDC_Suspe.SUSP_F_R_calibrate ETCSignals.ES900.ES910.CAN2.CAN2.MEAS_ETAS_VDC_Suspe.SUSP_F_L_calibrate ETCSignals.ES900.ES910.CAN2.CAN2.MEAS_ETAS_VDC_Tq.Throttle_Torque_calibrate ETCSignals.ES900.ES910.CAN2.CAN2.MEAS_ETAS_VDC_Tq.Torque_R_calibrate ETCSignals.ES900.ES910.CAN2.CAN2.MEAS_ETAS_VDC_Tq.Torque_L_calibrate ETCSignals.ES900.ES910.CAN2.CAN2.AP_ETAS_Synchronism.Sync_CAN2_calibrate /end REF_CHARACTERISTIC
/end GROUP
/begin GROUP ETCSignals.ES900.ES910 ""
 /begin REF_MEASUREMENT ETCSignals.ES900.ES910.CAN1.Presence.PresenceGroup.PresenceFlag ETCSignals.ES900.ES910.CAN1.CAN1.AP_BMS_SDC.Shutdown_PackageIntck ETCSignals.ES900.ES910.CAN1.CAN1.AP_BMS_SDC.Shutdown_IMD ETCSignals.ES900.ES910.CAN1.CAN1.AP_BMS_SDC.Shutdown_BMS ETCSignals.ES900.ES910.CAN1.CAN1.AP_CurrentSensor.ERROR ETCSignals.ES900.ES910.CAN1.CAN1.AP_CurrentSensor.Accumulator_Current ETCSignals.ES900.ES910.CAN1.CAN1.AP_BMS_Voltages.Lowest_CellVoltage ETCSignals.ES900.ES910.CAN1.CAN1.AP_BMS_Voltages.Highest_CellVoltage ETCSignals.ES900.ES910.CAN1.CAN1.AP_BMS_Voltages.Accumulator_Voltage ETCSignals.ES900.ES910.CAN1.CAN1.AP_BMS_ChargerParameters.Charger_MaxVoltage ETCSignals.ES900.ES910.CAN1.CAN1.AP_BMS_ChargerParameters.Charger_MaxCurrent ETCSignals.ES900.ES910.CAN1.CAN1.AP_BMS_Temperatures.Lowest_CellTemp ETCSignals.ES900.ES910.CAN1.CAN1.AP_BMS_Temperatures.Highest_CellTemp ETCSignals.ES900.ES910.CAN1.CAN1.AP_BMS_Temperatures.Average_CellTemp ETCSignals.ES900.ES910.CAN1.CAN1.AP_Inverter_R_Tx.Inv_R_RegID ETCSignals.ES900.ES910.CAN1.CAN1.AP_Inverter_R_Tx.Inv_R_RegID_M73_Inv_R_TempMotor ETCSignals.ES900.ES910.CAN1.CAN1.AP_Inverter_R_Tx.Inv_R_RegID_M74_Inv_R_TempIGBT ETCSignals.ES900.ES910.CAN1.CAN1.AP_Inverter_R_Tx.Inv_R_RegID_M48_Inv_R_Speed ETCSignals.ES900.ES910.CAN1.CAN1.AP_Inverter_R_Tx.Inv_R_RegID_M39_Inv_R_Iq ETCSignals.ES900.ES910.CAN1.CAN1.AP_Inverter_R_Tx.Inv_R_RegID_M38_Inv_R_Icommand ETCSignals.ES900.ES910.CAN1.CAN1.AP_Inverter_R_Tx.Inv_R_RegID_M32_Inv_R_Iactual ETCSignals.ES900.ES910.CAN1.CAN1.AP_Inverter_R_Tx.Inv_R_RegID_M235_Inv_R_DCBus ETCSignals.ES900.ES910.CAN1.CAN1.AP_Inverter_L_Tx.Inv_L_RegID ETCSignals.ES900.ES910.CAN1.CAN1.AP_Inverter_L_Tx.Inv_L_RegID_M73_Inv_L_TempMotor ETCSignals.ES900.ES910.CAN1.CAN1.AP_Inverter_L_Tx.Inv_L_RegID_M74_Inv_L_TempIGBT ETCSignals.ES900.ES910.CAN1.CAN1.AP_Inverter_L_Tx.Inv_L_RegID_M48_Inv_L_Speed ETCSignals.ES900.ES910.CAN1.CAN1.AP_Inverter_L_Tx.Inv_L_RegID_M39_Inv_L_Iq ETCSignals.ES900.ES910.CAN1.CAN1.AP_Inverter_L_Tx.Inv_L_RegID_M38_Inv_L_Icommand ETCSignals.ES900.ES910.CAN1.CAN1.AP_Inverter_L_Tx.Inv_L_RegID_M32_Inv_L_Iactual ETCSignals.ES900.ES910.CAN1.CAN1.AP_Inverter_L_Tx.Inv_L_RegID_M235_Inv_L_DCBus ETCSignals.ES900.ES910.CAN1.CAN1.AP_DASH_Mode.RacingMode ETCSignals.ES900.ES910.CAN1.CAN1.NM_BMS_Keep_Alive.BMS_Alive ETCSignals.ES900.ES910.CAN1.CAN1.AP_BMS_AIRs_State.AIRs_State ETCSignals.ES900.ES910.CAN1.CAN1.NM_DASH_Keep_Alive.Dash_Alive ETCSignals.ES900.ES910.CAN1.CAN1.AP_DASH_PrechargeRequest.PrechargeRequest ETCSignals.ES900.ES910.CAN1.CAN1.AP_DASH_EnableDrive.EnableDrive_Order ETCSignals.ES900.ES910.CAN1.CAN1.AP_ETAS_DashData.SoC_KF ETCSignals.ES900.ES910.CAN1.CAN1.AP_ETAS_DashData.Speed ETCSignals.ES900.ES910.CAN1.CAN1.AP_ETAS_DashData.Precharge_Voltage ETCSignals.ES900.ES910.CAN1.CAN1.AP_ETAS_DashData.Precharge_Percentage ETCSignals.ES900.ES910.CAN1.CAN1.AP_ETAS_VDCParams.VDC_Max_Tyre_Slip ETCSignals.ES900.ES910.CAN1.CAN1.AP_ETAS_Inverter_R_Rx.Inverter_R_RegID ETCSignals.ES900.ES910.CAN1.CAN1.AP_ETAS_Inverter_R_Rx.Inverter_R_b7tob0 ETCSignals.ES900.ES910.CAN1.CAN1.AP_ETAS_Inverter_R_Rx.Inverter_R_b15tob8 ETCSignals.ES900.ES910.CAN1.CAN1.AP_ETAS_Inverter_L_Rx.Inverter_L_RegID ETCSignals.ES900.ES910.CAN1.CAN1.AP_ETAS_Inverter_L_Rx.Inverter_L_b7tob0 ETCSignals.ES900.ES910.CAN1.CAN1.AP_ETAS_Inverter_L_Rx.Inverter_L_b15tob8 ETCSignals.ES900.ES910.CAN1.CAN1.AP_ETAS_CarState.Car_State ETCSignals.ES900.ES910.CAN1.CAN1.AP_ETAS_AIRsRequest.AIRs_Request ETCSignals.ES900.ES910.CAN1.CAN1.MEAS_ETAS_InternalVars.InvertersAction ETCSignals.ES900.ES910.CAN1.CAN1.MEAS_ETAS_InternalVars.el_Vel_OK ETCSignals.ES900.ES910.CAN1.CAN1.MEAS_ETAS_InternalVars.TC_Warning ETCSignals.ES900.ES910.CAN1.CAN1.MEAS_ETAS_InternalVars.Regenerative_Enable ETCSignals.ES900.ES910.CAN1.CAN1.MEAS_ETAS_InternalVars.CriticalDisconnection ETCSignals.ES900.ES910.CAN1.CAN1.MEAS_ETAS_InternalVars.Relay_Error ETCSignals.ES900.ES910.CAN1.CAN1.MEAS_ETAS_InternalVars.Car_OK ETCSignals.ES900.ES910.CAN1.CAN1.MEAS_ETAS_InternalVars.Power ETCSignals.ES900.ES910.CAN1.CAN1.MEAS_ETAS_InternalVars.Torque_OK ETCSignals.ES900.ES910.CAN1.CAN1.MEAS_ETAS_InternalVars.Sensorics_Mode ETCSignals.ES900.ES910.CAN1.CAN1.MEAS_ETAS_InternalVars.Critical_Signal_Disconnection ETCSignals.ES900.ES910.CAN1.CAN1.MEAS_ETAS_InternalVars.Critical_CAN_Disconnection ETCSignals.ES900.ES910.CAN1.CAN1.MEAS_ETAS_InternalVars.APPS_Implausibility ETCSignals.ES900.ES910.CAN1.CAN1.AP_ETAS_Synchronism.Sync_CAN1 ETCSignals.ES900.ES910.CAN2.Presence.PresenceGroup.PresenceFlag ETCSignals.ES900.ES910.CAN2.CAN2.MEAS_ETAS_SOC.SOC_High ETCSignals.ES900.ES910.CAN2.CAN2.MEAS_ETAS_SOC.SOC_Low ETCSignals.ES900.ES910.CAN2.CAN2.MEAS_ETAS_SOC.SOC_Avg ETCSignals.ES900.ES910.CAN2.CAN2.AP_ELLIPSE_AUTO.el_Track_Valid ETCSignals.ES900.ES910.CAN2.CAN2.AP_ELLIPSE_AUTO.el_Slip_Valid ETCSignals.ES900.ES910.CAN2.CAN2.AP_ELLIPSE_AUTO.el_Curvature_Valid ETCSignals.ES900.ES910.CAN2.CAN2.AP_ELLIPSE_AUTO.el_SlipAngle ETCSignals.ES900.ES910.CAN2.CAN2.AP_ELLIPSE_AUTO.el_CurvatureRadius ETCSignals.ES900.ES910.CAN2.CAN2.AP_ELLIPSE_AUTO.el_AngleTrack ETCSignals.ES900.ES910.CAN2.CAN2.AP_ELLIPSE_GPS_VEL.el_Vel_GPS_N ETCSignals.ES900.ES910.CAN2.CAN2.AP_ELLIPSE_GPS_VEL.el_Vel_GPS_E ETCSignals.ES900.ES910.CAN2.CAN2.AP_ELLIPSE_GPS_VEL.el_Vel_GPS_D ETCSignals.ES900.ES910.CAN2.CAN2.NM_ETAS_Disconnections.Disconnection_InvR ETCSignals.ES900.ES910.CAN2.CAN2.NM_ETAS_Disconnections.Disconnection_InvL ETCSignals.ES900.ES910.CAN2.CAN2.NM_ETAS_Disconnections.Disconnection_Susp_R_R ETCSignals.ES900.ES910.CAN2.CAN2.NM_ETAS_Disconnections.Disconnection_Susp_R_L ETCSignals.ES900.ES910.CAN2.CAN2.NM_ETAS_Disconnections.Disconnection_Susp_F_R ETCSignals.ES900.ES910.CAN2.CAN2.NM_ETAS_Disconnections.Disconnection_Susp_F_L ETCSignals.ES900.ES910.CAN2.CAN2.NM_ETAS_Disconnections.Disconnection_SteeringSensor ETCSignals.ES900.ES910.CAN2.CAN2.NM_ETAS_Disconnections.Disconnection_Rear ETCSignals.ES900.ES910.CAN2.CAN2.NM_ETAS_Disconnections.Disconnection_Pitot ETCSignals.ES900.ES910.CAN2.CAN2.NM_ETAS_Disconnections.Disconnection_Front ETCSignals.ES900.ES910.CAN2.CAN2.NM_ETAS_Disconnections.Disconnection_Ellipse ETCSignals.ES900.ES910.CAN2.CAN2.NM_ETAS_Disconnections.Disconnection_DashBoard ETCSignals.ES900.ES910.CAN2.CAN2.NM_ETAS_Disconnections.Disconnection_BrakePedal ETCSignals.ES900.ES910.CAN2.CAN2.NM_ETAS_Disconnections.Disconnection_BMS ETCSignals.ES900.ES910.CAN2.CAN2.NM_ETAS_Disconnections.Disconnection_APPS2 ETCSignals.ES900.ES910.CAN2.CAN2.NM_ETAS_Disconnections.Disconnection_APPS1 ETCSignals.ES900.ES910.CAN2.CAN2.MEAS_ETAS_VDC_Values.el_VEL ETCSignals.ES900.ES910.CAN2.CAN2.MEAS_ETAS_VDC_Values.SteeringSensor_Value ETCSignals.ES900.ES910.CAN2.CAN2.MEAS_ETAS_VDC_Values.BrakePedal_Value ETCSignals.ES900.ES910.CAN2.CAN2.MEAS_ETAS_VDC_Values.APPS2_Value ETCSignals.ES900.ES910.CAN2.CAN2.MEAS_ETAS_VDC_Values.APPS1_Value ETCSignals.ES900.ES910.CAN2.CAN2.AP_ETAS_BrakeLight.BrakeLight_Control ETCSignals.ES900.ES910.CAN2.CAN2.MEAS_RECU_SDC.Shutdown_TSMS_TSMP ETCSignals.ES900.ES910.CAN2.CAN2.MEAS_RECU_SDC.Shutdown_HVD ETCSignals.ES900.ES910.CAN2.CAN2.MEAS_RECU_SDC.Shutdown_HVBox ETCSignals.ES900.ES910.CAN2.CAN2.MEAS_RECU_SDC.Shutdown_LeftTS ETCSignals.ES900.ES910.CAN2.CAN2.MEAS_RECU_SDC.Shutdown_RightTS ETCSignals.ES900.ES910.CAN2.CAN2.AP_ELLIPSE_EKF_POS.el_LONGITUDE_EKF ETCSignals.ES900.ES910.CAN2.CAN2.AP_ELLIPSE_EKF_POS.el_LATITUDE_EKF ETCSignals.ES900.ES910.CAN2.CAN2.AP_ELLIPSE_IMU_ACCEL.el_ACCEL_Z ETCSignals.ES900.ES910.CAN2.CAN2.AP_ELLIPSE_IMU_ACCEL.el_ACCEL_Y ETCSignals.ES900.ES910.CAN2.CAN2.AP_ELLIPSE_IMU_ACCEL.el_ACCEL_X ETCSignals.ES900.ES910.CAN2.CAN2.AP_ELLIPSE_EKF_EULER.el_YAW ETCSignals.ES900.ES910.CAN2.CAN2.AP_ELLIPSE_EKF_EULER.el_PITCH ETCSignals.ES900.ES910.CAN2.CAN2.AP_ELLIPSE_EKF_EULER.el_ROLL ETCSignals.ES900.ES910.CAN2.CAN2.AP_ELLIPSE_EKF_VEL.el_Vel_EKF_Z ETCSignals.ES900.ES910.CAN2.CAN2.AP_ELLIPSE_EKF_VEL.el_Vel_EKF_Y ETCSignals.ES900.ES910.CAN2.CAN2.AP_ELLIPSE_EKF_VEL.el_Vel_EKF_X ETCSignals.ES900.ES910.CAN2.CAN2.NM_ELLIPSE_Status.Ellipse_Alive ETCSignals.ES900.ES910.CAN2.CAN2.AP_ELLIPSE_IMU_GYRO.el_GYRO_Z ETCSignals.ES900.ES910.CAN2.CAN2.AP_ELLIPSE_IMU_GYRO.el_GYRO_Y ETCSignals.ES900.ES910.CAN2.CAN2.AP_ELLIPSE_IMU_GYRO.el_GYRO_X ETCSignals.ES900.ES910.CAN2.CAN2.AP_ELLIPSE_VEL_Valid.el_SolutionMode ETCSignals.ES900.ES910.CAN2.CAN2.AP_ELLIPSE_VEL_Valid.el_Vel_GPS_Valid ETCSignals.ES900.ES910.CAN2.CAN2.AP_ELLIPSE_VEL_Valid.el_Vel_EKF_Valid ETCSignals.ES900.ES910.CAN2.CAN2.MEAS_ETAS_Inverter_R_Data.Inv_R_TempMotor ETCSignals.ES900.ES910.CAN2.CAN2.MEAS_ETAS_Inverter_R_Data.current_R ETCSignals.ES900.ES910.CAN2.CAN2.MEAS_ETAS_Inverter_R_Data.Inv_R_TempIGBT ETCSignals.ES900.ES910.CAN2.CAN2.MEAS_ETAS_Inverter_R_Data.RR_Vel_ms_Wheel ETCSignals.ES900.ES910.CAN2.CAN2.MEAS_ETAS_Inverter_L_Data.Inv_L_TempMotor ETCSignals.ES900.ES910.CAN2.CAN2.MEAS_ETAS_Inverter_L_Data.current_L ETCSignals.ES900.ES910.CAN2.CAN2.MEAS_ETAS_Inverter_L_Data.Inv_L_TempIGBT ETCSignals.ES900.ES910.CAN2.CAN2.MEAS_ETAS_Inverter_L_Data.RL_Vel_ms_Wheel ETCSignals.ES900.ES910.CAN2.CAN2.MEAS_ETAS_VDC_Suspe.SUSP_R_R ETCSignals.ES900.ES910.CAN2.CAN2.MEAS_ETAS_VDC_Suspe.SUSP_R_L ETCSignals.ES900.ES910.CAN2.CAN2.MEAS_ETAS_VDC_Suspe.SUSP_F_R ETCSignals.ES900.ES910.CAN2.CAN2.MEAS_ETAS_VDC_Suspe.SUSP_F_L ETCSignals.ES900.ES910.CAN2.CAN2.MEAS_ETAS_VDC_Tq.Throttle_Torque ETCSignals.ES900.ES910.CAN2.CAN2.MEAS_ETAS_VDC_Tq.Torque_R ETCSignals.ES900.ES910.CAN2.CAN2.MEAS_ETAS_VDC_Tq.Torque_L ETCSignals.ES900.ES910.CAN2.CAN2.AP_RECU_Data.Susp_R_R_Bits ETCSignals.ES900.ES910.CAN2.CAN2.AP_RECU_Data.Susp_R_L_Bits ETCSignals.ES900.ES910.CAN2.CAN2.NM_FECU_Keep_Alive.Front_Alive ETCSignals.ES900.ES910.CAN2.CAN2.NM_RECU_Keep_Alive.Rear_Alive ETCSignals.ES900.ES910.CAN2.CAN2.AP_FECU_Data2.Pitot_Bits ETCSignals.ES900.ES910.CAN2.CAN2.AP_FECU_Data2.Susp_F_R_Bits ETCSignals.ES900.ES910.CAN2.CAN2.AP_FECU_Data2.Susp_F_L_Bits ETCSignals.ES900.ES910.CAN2.CAN2.AP_FECU_Data1.SteeringSensor_Bits ETCSignals.ES900.ES910.CAN2.CAN2.AP_FECU_Data1.BrakePedal_Bits ETCSignals.ES900.ES910.CAN2.CAN2.AP_FECU_Data1.APPS2_Bits ETCSignals.ES900.ES910.CAN2.CAN2.AP_FECU_Data1.APPS1_Bits ETCSignals.ES900.ES910.CAN2.CAN2.AP_ETAS_Synchronism.Sync_CAN2 /end REF_MEASUREMENT
 /begin REF_CHARACTERISTIC ETCSignals.ES900.ES910.CAN1.CAN1.AP_ETAS_DashData.SoC_KF_calibrate ETCSignals.ES900.ES910.CAN1.CAN1.AP_ETAS_DashData.Speed_calibrate ETCSignals.ES900.ES910.CAN1.CAN1.AP_ETAS_DashData.Precharge_Voltage_calibrate ETCSignals.ES900.ES910.CAN1.CAN1.AP_ETAS_DashData.Precharge_Percentage_calibrate ETCSignals.ES900.ES910.CAN1.CAN1.AP_ETAS_VDCParams.VDC_Max_Tyre_Slip_calibrate ETCSignals.ES900.ES910.CAN1.CAN1.AP_ETAS_Inverter_R_Rx.Inverter_R_RegID_calibrate ETCSignals.ES900.ES910.CAN1.CAN1.AP_ETAS_Inverter_R_Rx.Inverter_R_b7tob0_calibrate ETCSignals.ES900.ES910.CAN1.CAN1.AP_ETAS_Inverter_R_Rx.Inverter_R_b15tob8_calibrate ETCSignals.ES900.ES910.CAN1.CAN1.AP_ETAS_Inverter_L_Rx.Inverter_L_RegID_calibrate ETCSignals.ES900.ES910.CAN1.CAN1.AP_ETAS_Inverter_L_Rx.Inverter_L_b7tob0_calibrate ETCSignals.ES900.ES910.CAN1.CAN1.AP_ETAS_Inverter_L_Rx.Inverter_L_b15tob8_calibrate ETCSignals.ES900.ES910.CAN1.CAN1.AP_ETAS_CarState.Car_State_calibrate ETCSignals.ES900.ES910.CAN1.CAN1.AP_ETAS_AIRsRequest.AIRs_Request_calibrate ETCSignals.ES900.ES910.CAN1.CAN1.MEAS_ETAS_InternalVars.InvertersAction_calibrate ETCSignals.ES900.ES910.CAN1.CAN1.MEAS_ETAS_InternalVars.el_Vel_OK_calibrate ETCSignals.ES900.ES910.CAN1.CAN1.MEAS_ETAS_InternalVars.TC_Warning_calibrate ETCSignals.ES900.ES910.CAN1.CAN1.MEAS_ETAS_InternalVars.Regenerative_Enable_calibrate ETCSignals.ES900.ES910.CAN1.CAN1.MEAS_ETAS_InternalVars.CriticalDisconnection_calibrate ETCSignals.ES900.ES910.CAN1.CAN1.MEAS_ETAS_InternalVars.Relay_Error_calibrate ETCSignals.ES900.ES910.CAN1.CAN1.MEAS_ETAS_InternalVars.Car_OK_calibrate ETCSignals.ES900.ES910.CAN1.CAN1.MEAS_ETAS_InternalVars.Power_calibrate ETCSignals.ES900.ES910.CAN1.CAN1.MEAS_ETAS_InternalVars.Torque_OK_calibrate ETCSignals.ES900.ES910.CAN1.CAN1.MEAS_ETAS_InternalVars.Sensorics_Mode_calibrate ETCSignals.ES900.ES910.CAN1.CAN1.MEAS_ETAS_InternalVars.Critical_Signal_Disconnection_calibrate ETCSignals.ES900.ES910.CAN1.CAN1.MEAS_ETAS_InternalVars.Critical_CAN_Disconnection_calibrate ETCSignals.ES900.ES910.CAN1.CAN1.MEAS_ETAS_InternalVars.APPS_Implausibility_calibrate ETCSignals.ES900.ES910.CAN1.CAN1.AP_ETAS_Synchronism.Sync_CAN1_calibrate ETCSignals.ES900.ES910.CAN2.CAN2.MEAS_ETAS_SOC.SOC_High_calibrate ETCSignals.ES900.ES910.CAN2.CAN2.MEAS_ETAS_SOC.SOC_Low_calibrate ETCSignals.ES900.ES910.CAN2.CAN2.MEAS_ETAS_SOC.SOC_Avg_calibrate ETCSignals.ES900.ES910.CAN2.CAN2.NM_ETAS_Disconnections.Disconnection_InvR_calibrate ETCSignals.ES900.ES910.CAN2.CAN2.NM_ETAS_Disconnections.Disconnection_InvL_calibrate ETCSignals.ES900.ES910.CAN2.CAN2.NM_ETAS_Disconnections.Disconnection_Susp_R_R_calibrate ETCSignals.ES900.ES910.CAN2.CAN2.NM_ETAS_Disconnections.Disconnection_Susp_R_L_calibrate ETCSignals.ES900.ES910.CAN2.CAN2.NM_ETAS_Disconnections.Disconnection_Susp_F_R_calibrate ETCSignals.ES900.ES910.CAN2.CAN2.NM_ETAS_Disconnections.Disconnection_Susp_F_L_calibrate ETCSignals.ES900.ES910.CAN2.CAN2.NM_ETAS_Disconnections.Disconnection_SteeringSensor_calibrate ETCSignals.ES900.ES910.CAN2.CAN2.NM_ETAS_Disconnections.Disconnection_Rear_calibrate ETCSignals.ES900.ES910.CAN2.CAN2.NM_ETAS_Disconnections.Disconnection_Pitot_calibrate ETCSignals.ES900.ES910.CAN2.CAN2.NM_ETAS_Disconnections.Disconnection_Front_calibrate ETCSignals.ES900.ES910.CAN2.CAN2.NM_ETAS_Disconnections.Disconnection_Ellipse_calibrate ETCSignals.ES900.ES910.CAN2.CAN2.NM_ETAS_Disconnections.Disconnection_DashBoard_calibrate ETCSignals.ES900.ES910.CAN2.CAN2.NM_ETAS_Disconnections.Disconnection_BrakePedal_calibrate ETCSignals.ES900.ES910.CAN2.CAN2.NM_ETAS_Disconnections.Disconnection_BMS_calibrate ETCSignals.ES900.ES910.CAN2.CAN2.NM_ETAS_Disconnections.Disconnection_APPS2_calibrate ETCSignals.ES900.ES910.CAN2.CAN2.NM_ETAS_Disconnections.Disconnection_APPS1_calibrate ETCSignals.ES900.ES910.CAN2.CAN2.MEAS_ETAS_VDC_Values.el_VEL_calibrate ETCSignals.ES900.ES910.CAN2.CAN2.MEAS_ETAS_VDC_Values.SteeringSensor_Value_calibrate ETCSignals.ES900.ES910.CAN2.CAN2.MEAS_ETAS_VDC_Values.BrakePedal_Value_calibrate ETCSignals.ES900.ES910.CAN2.CAN2.MEAS_ETAS_VDC_Values.APPS2_Value_calibrate ETCSignals.ES900.ES910.CAN2.CAN2.MEAS_ETAS_VDC_Values.APPS1_Value_calibrate ETCSignals.ES900.ES910.CAN2.CAN2.AP_ETAS_BrakeLight.BrakeLight_Control_calibrate ETCSignals.ES900.ES910.CAN2.CAN2.MEAS_ETAS_Inverter_R_Data.Inv_R_TempMotor_calibrate ETCSignals.ES900.ES910.CAN2.CAN2.MEAS_ETAS_Inverter_R_Data.current_R_calibrate ETCSignals.ES900.ES910.CAN2.CAN2.MEAS_ETAS_Inverter_R_Data.Inv_R_TempIGBT_calibrate ETCSignals.ES900.ES910.CAN2.CAN2.MEAS_ETAS_Inverter_R_Data.RR_Vel_ms_Wheel_calibrate ETCSignals.ES900.ES910.CAN2.CAN2.MEAS_ETAS_Inverter_L_Data.Inv_L_TempMotor_calibrate ETCSignals.ES900.ES910.CAN2.CAN2.MEAS_ETAS_Inverter_L_Data.current_L_calibrate ETCSignals.ES900.ES910.CAN2.CAN2.MEAS_ETAS_Inverter_L_Data.Inv_L_TempIGBT_calibrate ETCSignals.ES900.ES910.CAN2.CAN2.MEAS_ETAS_Inverter_L_Data.RL_Vel_ms_Wheel_calibrate ETCSignals.ES900.ES910.CAN2.CAN2.MEAS_ETAS_VDC_Suspe.SUSP_R_R_calibrate ETCSignals.ES900.ES910.CAN2.CAN2.MEAS_ETAS_VDC_Suspe.SUSP_R_L_calibrate ETCSignals.ES900.ES910.CAN2.CAN2.MEAS_ETAS_VDC_Suspe.SUSP_F_R_calibrate ETCSignals.ES900.ES910.CAN2.CAN2.MEAS_ETAS_VDC_Suspe.SUSP_F_L_calibrate ETCSignals.ES900.ES910.CAN2.CAN2.MEAS_ETAS_VDC_Tq.Throttle_Torque_calibrate ETCSignals.ES900.ES910.CAN2.CAN2.MEAS_ETAS_VDC_Tq.Torque_R_calibrate ETCSignals.ES900.ES910.CAN2.CAN2.MEAS_ETAS_VDC_Tq.Torque_L_calibrate ETCSignals.ES900.ES910.CAN2.CAN2.AP_ETAS_Synchronism.Sync_CAN2_calibrate /end REF_CHARACTERISTIC
/end GROUP
/begin GROUP ETCSignals.ES900.ES910.CAN1 ""
 /begin REF_MEASUREMENT ETCSignals.ES900.ES910.CAN1.Presence.PresenceGroup.PresenceFlag ETCSignals.ES900.ES910.CAN1.CAN1.AP_BMS_SDC.Shutdown_PackageIntck ETCSignals.ES900.ES910.CAN1.CAN1.AP_BMS_SDC.Shutdown_IMD ETCSignals.ES900.ES910.CAN1.CAN1.AP_BMS_SDC.Shutdown_BMS ETCSignals.ES900.ES910.CAN1.CAN1.AP_CurrentSensor.ERROR ETCSignals.ES900.ES910.CAN1.CAN1.AP_CurrentSensor.Accumulator_Current ETCSignals.ES900.ES910.CAN1.CAN1.AP_BMS_Voltages.Lowest_CellVoltage ETCSignals.ES900.ES910.CAN1.CAN1.AP_BMS_Voltages.Highest_CellVoltage ETCSignals.ES900.ES910.CAN1.CAN1.AP_BMS_Voltages.Accumulator_Voltage ETCSignals.ES900.ES910.CAN1.CAN1.AP_BMS_ChargerParameters.Charger_MaxVoltage ETCSignals.ES900.ES910.CAN1.CAN1.AP_BMS_ChargerParameters.Charger_MaxCurrent ETCSignals.ES900.ES910.CAN1.CAN1.AP_BMS_Temperatures.Lowest_CellTemp ETCSignals.ES900.ES910.CAN1.CAN1.AP_BMS_Temperatures.Highest_CellTemp ETCSignals.ES900.ES910.CAN1.CAN1.AP_BMS_Temperatures.Average_CellTemp ETCSignals.ES900.ES910.CAN1.CAN1.AP_Inverter_R_Tx.Inv_R_RegID ETCSignals.ES900.ES910.CAN1.CAN1.AP_Inverter_R_Tx.Inv_R_RegID_M73_Inv_R_TempMotor ETCSignals.ES900.ES910.CAN1.CAN1.AP_Inverter_R_Tx.Inv_R_RegID_M74_Inv_R_TempIGBT ETCSignals.ES900.ES910.CAN1.CAN1.AP_Inverter_R_Tx.Inv_R_RegID_M48_Inv_R_Speed ETCSignals.ES900.ES910.CAN1.CAN1.AP_Inverter_R_Tx.Inv_R_RegID_M39_Inv_R_Iq ETCSignals.ES900.ES910.CAN1.CAN1.AP_Inverter_R_Tx.Inv_R_RegID_M38_Inv_R_Icommand ETCSignals.ES900.ES910.CAN1.CAN1.AP_Inverter_R_Tx.Inv_R_RegID_M32_Inv_R_Iactual ETCSignals.ES900.ES910.CAN1.CAN1.AP_Inverter_R_Tx.Inv_R_RegID_M235_Inv_R_DCBus ETCSignals.ES900.ES910.CAN1.CAN1.AP_Inverter_L_Tx.Inv_L_RegID ETCSignals.ES900.ES910.CAN1.CAN1.AP_Inverter_L_Tx.Inv_L_RegID_M73_Inv_L_TempMotor ETCSignals.ES900.ES910.CAN1.CAN1.AP_Inverter_L_Tx.Inv_L_RegID_M74_Inv_L_TempIGBT ETCSignals.ES900.ES910.CAN1.CAN1.AP_Inverter_L_Tx.Inv_L_RegID_M48_Inv_L_Speed ETCSignals.ES900.ES910.CAN1.CAN1.AP_Inverter_L_Tx.Inv_L_RegID_M39_Inv_L_Iq ETCSignals.ES900.ES910.CAN1.CAN1.AP_Inverter_L_Tx.Inv_L_RegID_M38_Inv_L_Icommand ETCSignals.ES900.ES910.CAN1.CAN1.AP_Inverter_L_Tx.Inv_L_RegID_M32_Inv_L_Iactual ETCSignals.ES900.ES910.CAN1.CAN1.AP_Inverter_L_Tx.Inv_L_RegID_M235_Inv_L_DCBus ETCSignals.ES900.ES910.CAN1.CAN1.AP_DASH_Mode.RacingMode ETCSignals.ES900.ES910.CAN1.CAN1.NM_BMS_Keep_Alive.BMS_Alive ETCSignals.ES900.ES910.CAN1.CAN1.AP_BMS_AIRs_State.AIRs_State ETCSignals.ES900.ES910.CAN1.CAN1.NM_DASH_Keep_Alive.Dash_Alive ETCSignals.ES900.ES910.CAN1.CAN1.AP_DASH_PrechargeRequest.PrechargeRequest ETCSignals.ES900.ES910.CAN1.CAN1.AP_DASH_EnableDrive.EnableDrive_Order ETCSignals.ES900.ES910.CAN1.CAN1.AP_ETAS_DashData.SoC_KF ETCSignals.ES900.ES910.CAN1.CAN1.AP_ETAS_DashData.Speed ETCSignals.ES900.ES910.CAN1.CAN1.AP_ETAS_DashData.Precharge_Voltage ETCSignals.ES900.ES910.CAN1.CAN1.AP_ETAS_DashData.Precharge_Percentage ETCSignals.ES900.ES910.CAN1.CAN1.AP_ETAS_VDCParams.VDC_Max_Tyre_Slip ETCSignals.ES900.ES910.CAN1.CAN1.AP_ETAS_Inverter_R_Rx.Inverter_R_RegID ETCSignals.ES900.ES910.CAN1.CAN1.AP_ETAS_Inverter_R_Rx.Inverter_R_b7tob0 ETCSignals.ES900.ES910.CAN1.CAN1.AP_ETAS_Inverter_R_Rx.Inverter_R_b15tob8 ETCSignals.ES900.ES910.CAN1.CAN1.AP_ETAS_Inverter_L_Rx.Inverter_L_RegID ETCSignals.ES900.ES910.CAN1.CAN1.AP_ETAS_Inverter_L_Rx.Inverter_L_b7tob0 ETCSignals.ES900.ES910.CAN1.CAN1.AP_ETAS_Inverter_L_Rx.Inverter_L_b15tob8 ETCSignals.ES900.ES910.CAN1.CAN1.AP_ETAS_CarState.Car_State ETCSignals.ES900.ES910.CAN1.CAN1.AP_ETAS_AIRsRequest.AIRs_Request ETCSignals.ES900.ES910.CAN1.CAN1.MEAS_ETAS_InternalVars.InvertersAction ETCSignals.ES900.ES910.CAN1.CAN1.MEAS_ETAS_InternalVars.el_Vel_OK ETCSignals.ES900.ES910.CAN1.CAN1.MEAS_ETAS_InternalVars.TC_Warning ETCSignals.ES900.ES910.CAN1.CAN1.MEAS_ETAS_InternalVars.Regenerative_Enable ETCSignals.ES900.ES910.CAN1.CAN1.MEAS_ETAS_InternalVars.CriticalDisconnection ETCSignals.ES900.ES910.CAN1.CAN1.MEAS_ETAS_InternalVars.Relay_Error ETCSignals.ES900.ES910.CAN1.CAN1.MEAS_ETAS_InternalVars.Car_OK ETCSignals.ES900.ES910.CAN1.CAN1.MEAS_ETAS_InternalVars.Power ETCSignals.ES900.ES910.CAN1.CAN1.MEAS_ETAS_InternalVars.Torque_OK ETCSignals.ES900.ES910.CAN1.CAN1.MEAS_ETAS_InternalVars.Sensorics_Mode ETCSignals.ES900.ES910.CAN1.CAN1.MEAS_ETAS_InternalVars.Critical_Signal_Disconnection ETCSignals.ES900.ES910.CAN1.CAN1.MEAS_ETAS_InternalVars.Critical_CAN_Disconnection ETCSignals.ES900.ES910.CAN1.CAN1.MEAS_ETAS_InternalVars.APPS_Implausibility ETCSignals.ES900.ES910.CAN1.CAN1.AP_ETAS_Synchronism.Sync_CAN1 /end REF_MEASUREMENT
 /begin REF_CHARACTERISTIC ETCSignals.ES900.ES910.CAN1.CAN1.AP_ETAS_DashData.SoC_KF_calibrate ETCSignals.ES900.ES910.CAN1.CAN1.AP_ETAS_DashData.Speed_calibrate ETCSignals.ES900.ES910.CAN1.CAN1.AP_ETAS_DashData.Precharge_Voltage_calibrate ETCSignals.ES900.ES910.CAN1.CAN1.AP_ETAS_DashData.Precharge_Percentage_calibrate ETCSignals.ES900.ES910.CAN1.CAN1.AP_ETAS_VDCParams.VDC_Max_Tyre_Slip_calibrate ETCSignals.ES900.ES910.CAN1.CAN1.AP_ETAS_Inverter_R_Rx.Inverter_R_RegID_calibrate ETCSignals.ES900.ES910.CAN1.CAN1.AP_ETAS_Inverter_R_Rx.Inverter_R_b7tob0_calibrate ETCSignals.ES900.ES910.CAN1.CAN1.AP_ETAS_Inverter_R_Rx.Inverter_R_b15tob8_calibrate ETCSignals.ES900.ES910.CAN1.CAN1.AP_ETAS_Inverter_L_Rx.Inverter_L_RegID_calibrate ETCSignals.ES900.ES910.CAN1.CAN1.AP_ETAS_Inverter_L_Rx.Inverter_L_b7tob0_calibrate ETCSignals.ES900.ES910.CAN1.CAN1.AP_ETAS_Inverter_L_Rx.Inverter_L_b15tob8_calibrate ETCSignals.ES900.ES910.CAN1.CAN1.AP_ETAS_CarState.Car_State_calibrate ETCSignals.ES900.ES910.CAN1.CAN1.AP_ETAS_AIRsRequest.AIRs_Request_calibrate ETCSignals.ES900.ES910.CAN1.CAN1.MEAS_ETAS_InternalVars.InvertersAction_calibrate ETCSignals.ES900.ES910.CAN1.CAN1.MEAS_ETAS_InternalVars.el_Vel_OK_calibrate ETCSignals.ES900.ES910.CAN1.CAN1.MEAS_ETAS_InternalVars.TC_Warning_calibrate ETCSignals.ES900.ES910.CAN1.CAN1.MEAS_ETAS_InternalVars.Regenerative_Enable_calibrate ETCSignals.ES900.ES910.CAN1.CAN1.MEAS_ETAS_InternalVars.CriticalDisconnection_calibrate ETCSignals.ES900.ES910.CAN1.CAN1.MEAS_ETAS_InternalVars.Relay_Error_calibrate ETCSignals.ES900.ES910.CAN1.CAN1.MEAS_ETAS_InternalVars.Car_OK_calibrate ETCSignals.ES900.ES910.CAN1.CAN1.MEAS_ETAS_InternalVars.Power_calibrate ETCSignals.ES900.ES910.CAN1.CAN1.MEAS_ETAS_InternalVars.Torque_OK_calibrate ETCSignals.ES900.ES910.CAN1.CAN1.MEAS_ETAS_InternalVars.Sensorics_Mode_calibrate ETCSignals.ES900.ES910.CAN1.CAN1.MEAS_ETAS_InternalVars.Critical_Signal_Disconnection_calibrate ETCSignals.ES900.ES910.CAN1.CAN1.MEAS_ETAS_InternalVars.Critical_CAN_Disconnection_calibrate ETCSignals.ES900.ES910.CAN1.CAN1.MEAS_ETAS_InternalVars.APPS_Implausibility_calibrate ETCSignals.ES900.ES910.CAN1.CAN1.AP_ETAS_Synchronism.Sync_CAN1_calibrate /end REF_CHARACTERISTIC
/end GROUP
/begin GROUP ETCSignals.ES900.ES910.CAN1.Presence ""
 /begin REF_MEASUREMENT ETCSignals.ES900.ES910.CAN1.Presence.PresenceGroup.PresenceFlag /end REF_MEASUREMENT
/end GROUP
/begin GROUP ETCSignals.ES900.ES910.CAN1.Presence.PresenceGroup ""
 /begin REF_MEASUREMENT ETCSignals.ES900.ES910.CAN1.Presence.PresenceGroup.PresenceFlag /end REF_MEASUREMENT
/end GROUP
/begin GROUP ETCSignals.ES900.ES910.CAN1.CAN1 ""
 /begin REF_MEASUREMENT ETCSignals.ES900.ES910.CAN1.CAN1.AP_BMS_SDC.Shutdown_PackageIntck ETCSignals.ES900.ES910.CAN1.CAN1.AP_BMS_SDC.Shutdown_IMD ETCSignals.ES900.ES910.CAN1.CAN1.AP_BMS_SDC.Shutdown_BMS ETCSignals.ES900.ES910.CAN1.CAN1.AP_CurrentSensor.ERROR ETCSignals.ES900.ES910.CAN1.CAN1.AP_CurrentSensor.Accumulator_Current ETCSignals.ES900.ES910.CAN1.CAN1.AP_BMS_Voltages.Lowest_CellVoltage ETCSignals.ES900.ES910.CAN1.CAN1.AP_BMS_Voltages.Highest_CellVoltage ETCSignals.ES900.ES910.CAN1.CAN1.AP_BMS_Voltages.Accumulator_Voltage ETCSignals.ES900.ES910.CAN1.CAN1.AP_BMS_ChargerParameters.Charger_MaxVoltage ETCSignals.ES900.ES910.CAN1.CAN1.AP_BMS_ChargerParameters.Charger_MaxCurrent ETCSignals.ES900.ES910.CAN1.CAN1.AP_BMS_Temperatures.Lowest_CellTemp ETCSignals.ES900.ES910.CAN1.CAN1.AP_BMS_Temperatures.Highest_CellTemp ETCSignals.ES900.ES910.CAN1.CAN1.AP_BMS_Temperatures.Average_CellTemp ETCSignals.ES900.ES910.CAN1.CAN1.AP_Inverter_R_Tx.Inv_R_RegID ETCSignals.ES900.ES910.CAN1.CAN1.AP_Inverter_R_Tx.Inv_R_RegID_M73_Inv_R_TempMotor ETCSignals.ES900.ES910.CAN1.CAN1.AP_Inverter_R_Tx.Inv_R_RegID_M74_Inv_R_TempIGBT ETCSignals.ES900.ES910.CAN1.CAN1.AP_Inverter_R_Tx.Inv_R_RegID_M48_Inv_R_Speed ETCSignals.ES900.ES910.CAN1.CAN1.AP_Inverter_R_Tx.Inv_R_RegID_M39_Inv_R_Iq ETCSignals.ES900.ES910.CAN1.CAN1.AP_Inverter_R_Tx.Inv_R_RegID_M38_Inv_R_Icommand ETCSignals.ES900.ES910.CAN1.CAN1.AP_Inverter_R_Tx.Inv_R_RegID_M32_Inv_R_Iactual ETCSignals.ES900.ES910.CAN1.CAN1.AP_Inverter_R_Tx.Inv_R_RegID_M235_Inv_R_DCBus ETCSignals.ES900.ES910.CAN1.CAN1.AP_Inverter_L_Tx.Inv_L_RegID ETCSignals.ES900.ES910.CAN1.CAN1.AP_Inverter_L_Tx.Inv_L_RegID_M73_Inv_L_TempMotor ETCSignals.ES900.ES910.CAN1.CAN1.AP_Inverter_L_Tx.Inv_L_RegID_M74_Inv_L_TempIGBT ETCSignals.ES900.ES910.CAN1.CAN1.AP_Inverter_L_Tx.Inv_L_RegID_M48_Inv_L_Speed ETCSignals.ES900.ES910.CAN1.CAN1.AP_Inverter_L_Tx.Inv_L_RegID_M39_Inv_L_Iq ETCSignals.ES900.ES910.CAN1.CAN1.AP_Inverter_L_Tx.Inv_L_RegID_M38_Inv_L_Icommand ETCSignals.ES900.ES910.CAN1.CAN1.AP_Inverter_L_Tx.Inv_L_RegID_M32_Inv_L_Iactual ETCSignals.ES900.ES910.CAN1.CAN1.AP_Inverter_L_Tx.Inv_L_RegID_M235_Inv_L_DCBus ETCSignals.ES900.ES910.CAN1.CAN1.AP_DASH_Mode.RacingMode ETCSignals.ES900.ES910.CAN1.CAN1.NM_BMS_Keep_Alive.BMS_Alive ETCSignals.ES900.ES910.CAN1.CAN1.AP_BMS_AIRs_State.AIRs_State ETCSignals.ES900.ES910.CAN1.CAN1.NM_DASH_Keep_Alive.Dash_Alive ETCSignals.ES900.ES910.CAN1.CAN1.AP_DASH_PrechargeRequest.PrechargeRequest ETCSignals.ES900.ES910.CAN1.CAN1.AP_DASH_EnableDrive.EnableDrive_Order ETCSignals.ES900.ES910.CAN1.CAN1.AP_ETAS_DashData.SoC_KF ETCSignals.ES900.ES910.CAN1.CAN1.AP_ETAS_DashData.Speed ETCSignals.ES900.ES910.CAN1.CAN1.AP_ETAS_DashData.Precharge_Voltage ETCSignals.ES900.ES910.CAN1.CAN1.AP_ETAS_DashData.Precharge_Percentage ETCSignals.ES900.ES910.CAN1.CAN1.AP_ETAS_VDCParams.VDC_Max_Tyre_Slip ETCSignals.ES900.ES910.CAN1.CAN1.AP_ETAS_Inverter_R_Rx.Inverter_R_RegID ETCSignals.ES900.ES910.CAN1.CAN1.AP_ETAS_Inverter_R_Rx.Inverter_R_b7tob0 ETCSignals.ES900.ES910.CAN1.CAN1.AP_ETAS_Inverter_R_Rx.Inverter_R_b15tob8 ETCSignals.ES900.ES910.CAN1.CAN1.AP_ETAS_Inverter_L_Rx.Inverter_L_RegID ETCSignals.ES900.ES910.CAN1.CAN1.AP_ETAS_Inverter_L_Rx.Inverter_L_b7tob0 ETCSignals.ES900.ES910.CAN1.CAN1.AP_ETAS_Inverter_L_Rx.Inverter_L_b15tob8 ETCSignals.ES900.ES910.CAN1.CAN1.AP_ETAS_CarState.Car_State ETCSignals.ES900.ES910.CAN1.CAN1.AP_ETAS_AIRsRequest.AIRs_Request ETCSignals.ES900.ES910.CAN1.CAN1.MEAS_ETAS_InternalVars.InvertersAction ETCSignals.ES900.ES910.CAN1.CAN1.MEAS_ETAS_InternalVars.el_Vel_OK ETCSignals.ES900.ES910.CAN1.CAN1.MEAS_ETAS_InternalVars.TC_Warning ETCSignals.ES900.ES910.CAN1.CAN1.MEAS_ETAS_InternalVars.Regenerative_Enable ETCSignals.ES900.ES910.CAN1.CAN1.MEAS_ETAS_InternalVars.CriticalDisconnection ETCSignals.ES900.ES910.CAN1.CAN1.MEAS_ETAS_InternalVars.Relay_Error ETCSignals.ES900.ES910.CAN1.CAN1.MEAS_ETAS_InternalVars.Car_OK ETCSignals.ES900.ES910.CAN1.CAN1.MEAS_ETAS_InternalVars.Power ETCSignals.ES900.ES910.CAN1.CAN1.MEAS_ETAS_InternalVars.Torque_OK ETCSignals.ES900.ES910.CAN1.CAN1.MEAS_ETAS_InternalVars.Sensorics_Mode ETCSignals.ES900.ES910.CAN1.CAN1.MEAS_ETAS_InternalVars.Critical_Signal_Disconnection ETCSignals.ES900.ES910.CAN1.CAN1.MEAS_ETAS_InternalVars.Critical_CAN_Disconnection ETCSignals.ES900.ES910.CAN1.CAN1.MEAS_ETAS_InternalVars.APPS_Implausibility ETCSignals.ES900.ES910.CAN1.CAN1.AP_ETAS_Synchronism.Sync_CAN1 /end REF_MEASUREMENT
 /begin REF_CHARACTERISTIC ETCSignals.ES900.ES910.CAN1.CAN1.AP_ETAS_DashData.SoC_KF_calibrate ETCSignals.ES900.ES910.CAN1.CAN1.AP_ETAS_DashData.Speed_calibrate ETCSignals.ES900.ES910.CAN1.CAN1.AP_ETAS_DashData.Precharge_Voltage_calibrate ETCSignals.ES900.ES910.CAN1.CAN1.AP_ETAS_DashData.Precharge_Percentage_calibrate ETCSignals.ES900.ES910.CAN1.CAN1.AP_ETAS_VDCParams.VDC_Max_Tyre_Slip_calibrate ETCSignals.ES900.ES910.CAN1.CAN1.AP_ETAS_Inverter_R_Rx.Inverter_R_RegID_calibrate ETCSignals.ES900.ES910.CAN1.CAN1.AP_ETAS_Inverter_R_Rx.Inverter_R_b7tob0_calibrate ETCSignals.ES900.ES910.CAN1.CAN1.AP_ETAS_Inverter_R_Rx.Inverter_R_b15tob8_calibrate ETCSignals.ES900.ES910.CAN1.CAN1.AP_ETAS_Inverter_L_Rx.Inverter_L_RegID_calibrate ETCSignals.ES900.ES910.CAN1.CAN1.AP_ETAS_Inverter_L_Rx.Inverter_L_b7tob0_calibrate ETCSignals.ES900.ES910.CAN1.CAN1.AP_ETAS_Inverter_L_Rx.Inverter_L_b15tob8_calibrate ETCSignals.ES900.ES910.CAN1.CAN1.AP_ETAS_CarState.Car_State_calibrate ETCSignals.ES900.ES910.CAN1.CAN1.AP_ETAS_AIRsRequest.AIRs_Request_calibrate ETCSignals.ES900.ES910.CAN1.CAN1.MEAS_ETAS_InternalVars.InvertersAction_calibrate ETCSignals.ES900.ES910.CAN1.CAN1.MEAS_ETAS_InternalVars.el_Vel_OK_calibrate ETCSignals.ES900.ES910.CAN1.CAN1.MEAS_ETAS_InternalVars.TC_Warning_calibrate ETCSignals.ES900.ES910.CAN1.CAN1.MEAS_ETAS_InternalVars.Regenerative_Enable_calibrate ETCSignals.ES900.ES910.CAN1.CAN1.MEAS_ETAS_InternalVars.CriticalDisconnection_calibrate ETCSignals.ES900.ES910.CAN1.CAN1.MEAS_ETAS_InternalVars.Relay_Error_calibrate ETCSignals.ES900.ES910.CAN1.CAN1.MEAS_ETAS_InternalVars.Car_OK_calibrate ETCSignals.ES900.ES910.CAN1.CAN1.MEAS_ETAS_InternalVars.Power_calibrate ETCSignals.ES900.ES910.CAN1.CAN1.MEAS_ETAS_InternalVars.Torque_OK_calibrate ETCSignals.ES900.ES910.CAN1.CAN1.MEAS_ETAS_InternalVars.Sensorics_Mode_calibrate ETCSignals.ES900.ES910.CAN1.CAN1.MEAS_ETAS_InternalVars.Critical_Signal_Disconnection_calibrate ETCSignals.ES900.ES910.CAN1.CAN1.MEAS_ETAS_InternalVars.Critical_CAN_Disconnection_calibrate ETCSignals.ES900.ES910.CAN1.CAN1.MEAS_ETAS_InternalVars.APPS_Implausibility_calibrate ETCSignals.ES900.ES910.CAN1.CAN1.AP_ETAS_Synchronism.Sync_CAN1_calibrate /end REF_CHARACTERISTIC
/end GROUP
/begin GROUP ETCSignals.ES900.ES910.CAN1.CAN1.AP_BMS_SDC ""
 /begin REF_MEASUREMENT ETCSignals.ES900.ES910.CAN1.CAN1.AP_BMS_SDC.Shutdown_PackageIntck ETCSignals.ES900.ES910.CAN1.CAN1.AP_BMS_SDC.Shutdown_IMD ETCSignals.ES900.ES910.CAN1.CAN1.AP_BMS_SDC.Shutdown_BMS /end REF_MEASUREMENT
/end GROUP
/begin GROUP ETCSignals.ES900.ES910.CAN1.CAN1.AP_CurrentSensor ""
 /begin REF_MEASUREMENT ETCSignals.ES900.ES910.CAN1.CAN1.AP_CurrentSensor.ERROR ETCSignals.ES900.ES910.CAN1.CAN1.AP_CurrentSensor.Accumulator_Current /end REF_MEASUREMENT
/end GROUP
/begin GROUP ETCSignals.ES900.ES910.CAN1.CAN1.AP_BMS_Voltages ""
 /begin REF_MEASUREMENT ETCSignals.ES900.ES910.CAN1.CAN1.AP_BMS_Voltages.Lowest_CellVoltage ETCSignals.ES900.ES910.CAN1.CAN1.AP_BMS_Voltages.Highest_CellVoltage ETCSignals.ES900.ES910.CAN1.CAN1.AP_BMS_Voltages.Accumulator_Voltage /end REF_MEASUREMENT
/end GROUP
/begin GROUP ETCSignals.ES900.ES910.CAN1.CAN1.AP_BMS_ChargerParameters ""
 /begin REF_MEASUREMENT ETCSignals.ES900.ES910.CAN1.CAN1.AP_BMS_ChargerParameters.Charger_MaxVoltage ETCSignals.ES900.ES910.CAN1.CAN1.AP_BMS_ChargerParameters.Charger_MaxCurrent /end REF_MEASUREMENT
/end GROUP
/begin GROUP ETCSignals.ES900.ES910.CAN1.CAN1.AP_BMS_Temperatures ""
 /begin REF_MEASUREMENT ETCSignals.ES900.ES910.CAN1.CAN1.AP_BMS_Temperatures.Lowest_CellTemp ETCSignals.ES900.ES910.CAN1.CAN1.AP_BMS_Temperatures.Highest_CellTemp ETCSignals.ES900.ES910.CAN1.CAN1.AP_BMS_Temperatures.Average_CellTemp /end REF_MEASUREMENT
/end GROUP
/begin GROUP ETCSignals.ES900.ES910.CAN1.CAN1.AP_Inverter_R_Tx ""
 /begin REF_MEASUREMENT ETCSignals.ES900.ES910.CAN1.CAN1.AP_Inverter_R_Tx.Inv_R_RegID ETCSignals.ES900.ES910.CAN1.CAN1.AP_Inverter_R_Tx.Inv_R_RegID_M73_Inv_R_TempMotor ETCSignals.ES900.ES910.CAN1.CAN1.AP_Inverter_R_Tx.Inv_R_RegID_M74_Inv_R_TempIGBT ETCSignals.ES900.ES910.CAN1.CAN1.AP_Inverter_R_Tx.Inv_R_RegID_M48_Inv_R_Speed ETCSignals.ES900.ES910.CAN1.CAN1.AP_Inverter_R_Tx.Inv_R_RegID_M39_Inv_R_Iq ETCSignals.ES900.ES910.CAN1.CAN1.AP_Inverter_R_Tx.Inv_R_RegID_M38_Inv_R_Icommand ETCSignals.ES900.ES910.CAN1.CAN1.AP_Inverter_R_Tx.Inv_R_RegID_M32_Inv_R_Iactual ETCSignals.ES900.ES910.CAN1.CAN1.AP_Inverter_R_Tx.Inv_R_RegID_M235_Inv_R_DCBus /end REF_MEASUREMENT
/end GROUP
/begin GROUP ETCSignals.ES900.ES910.CAN1.CAN1.AP_Inverter_L_Tx ""
 /begin REF_MEASUREMENT ETCSignals.ES900.ES910.CAN1.CAN1.AP_Inverter_L_Tx.Inv_L_RegID ETCSignals.ES900.ES910.CAN1.CAN1.AP_Inverter_L_Tx.Inv_L_RegID_M73_Inv_L_TempMotor ETCSignals.ES900.ES910.CAN1.CAN1.AP_Inverter_L_Tx.Inv_L_RegID_M74_Inv_L_TempIGBT ETCSignals.ES900.ES910.CAN1.CAN1.AP_Inverter_L_Tx.Inv_L_RegID_M48_Inv_L_Speed ETCSignals.ES900.ES910.CAN1.CAN1.AP_Inverter_L_Tx.Inv_L_RegID_M39_Inv_L_Iq ETCSignals.ES900.ES910.CAN1.CAN1.AP_Inverter_L_Tx.Inv_L_RegID_M38_Inv_L_Icommand ETCSignals.ES900.ES910.CAN1.CAN1.AP_Inverter_L_Tx.Inv_L_RegID_M32_Inv_L_Iactual ETCSignals.ES900.ES910.CAN1.CAN1.AP_Inverter_L_Tx.Inv_L_RegID_M235_Inv_L_DCBus /end REF_MEASUREMENT
/end GROUP
/begin GROUP ETCSignals.ES900.ES910.CAN1.CAN1.AP_DASH_Mode "" /begin REF_MEASUREMENT ETCSignals.ES900.ES910.CAN1.CAN1.AP_DASH_Mode.RacingMode /end REF_MEASUREMENT /end GROUP
/begin GROUP ETCSignals.ES900.ES910.CAN1.CAN1.NM_BMS_Keep_Alive ""
 /begin REF_MEASUREMENT ETCSignals.ES900.ES910.CAN1.CAN1.NM_BMS_Keep_Alive.BMS_Alive /end REF_MEASUREMENT
/end GROUP
/begin GROUP ETCSignals.ES900.ES910.CAN1.CAN1.AP_BMS_AIRs_State ""
 /begin REF_MEASUREMENT ETCSignals.ES900.ES910.CAN1.CAN1.AP_BMS_AIRs_State.AIRs_State /end REF_MEASUREMENT
/end GROUP
/begin GROUP ETCSignals.ES900.ES910.CAN1.CAN1.NM_DASH_Keep_Alive ""
 /begin REF_MEASUREMENT ETCSignals.ES900.ES910.CAN1.CAN1.NM_DASH_Keep_Alive.Dash_Alive /end REF_MEASUREMENT
/end GROUP
/begin GROUP ETCSignals.ES900.ES910.CAN1.CAN1.AP_DASH_PrechargeRequest ""
 /begin REF_MEASUREMENT ETCSignals.ES900.ES910.CAN1.CAN1.AP_DASH_PrechargeRequest.PrechargeRequest /end REF_MEASUREMENT
/end GROUP
/begin GROUP ETCSignals.ES900.ES910.CAN1.CAN1.AP_DASH_EnableDrive ""
 /begin REF_MEASUREMENT ETCSignals.ES900.ES910.CAN1.CAN1.AP_DASH_EnableDrive.EnableDrive_Order /end REF_MEASUREMENT
/end GROUP
/begin GROUP ETCSignals.ES900.ES910.CAN1.CAN1.AP_ETAS_DashData ""
 /begin REF_MEASUREMENT ETCSignals.ES900.ES910.CAN1.CAN1.AP_ETAS_DashData.SoC_KF ETCSignals.ES900.ES910.CAN1.CAN1.AP_ETAS_DashData.Speed ETCSignals.ES900.ES910.CAN1.CAN1.AP_ETAS_DashData.Precharge_Voltage ETCSignals.ES900.ES910.CAN1.CAN1.AP_ETAS_DashData.Precharge_Percentage /end REF_MEASUREMENT
 /begin REF_CHARACTERISTIC ETCSignals.ES900.ES910.CAN1.CAN1.AP_ETAS_DashData.SoC_KF_calibrate ETCSignals.ES900.ES910.CAN1.CAN1.AP_ETAS_DashData.Speed_calibrate ETCSignals.ES900.ES910.CAN1.CAN1.AP_ETAS_DashData.Precharge_Voltage_calibrate ETCSignals.ES900.ES910.CAN1.CAN1.AP_ETAS_DashData.Precharge_Percentage_calibrate /end REF_CHARACTERISTIC
/end GROUP
/begin GROUP ETCSignals.ES900.ES910.CAN1.CAN1.AP_ETAS_VDCParams ""
 /begin REF_MEASUREMENT ETCSignals.ES900.ES910.CAN1.CAN1.AP_ETAS_VDCParams.VDC_Max_Tyre_Slip /end REF_MEASUREMENT
 /begin REF_CHARACTERISTIC ETCSignals.ES900.ES910.CAN1.CAN1.AP_ETAS_VDCParams.VDC_Max_Tyre_Slip_calibrate /end REF_CHARACTERISTIC
/end GROUP
/begin GROUP ETCSignals.ES900.ES910.CAN1.CAN1.AP_ETAS_Inverter_R_Rx ""
 /begin REF_MEASUREMENT ETCSignals.ES900.ES910.CAN1.CAN1.AP_ETAS_Inverter_R_Rx.Inverter_R_RegID ETCSignals.ES900.ES910.CAN1.CAN1.AP_ETAS_Inverter_R_Rx.Inverter_R_b7tob0 ETCSignals.ES900.ES910.CAN1.CAN1.AP_ETAS_Inverter_R_Rx.Inverter_R_b15tob8 /end REF_MEASUREMENT
 /begin REF_CHARACTERISTIC ETCSignals.ES900.ES910.CAN1.CAN1.AP_ETAS_Inverter_R_Rx.Inverter_R_RegID_calibrate ETCSignals.ES900.ES910.CAN1.CAN1.AP_ETAS_Inverter_R_Rx.Inverter_R_b7tob0_calibrate ETCSignals.ES900.ES910.CAN1.CAN1.AP_ETAS_Inverter_R_Rx.Inverter_R_b15tob8_calibrate /end REF_CHARACTERISTIC
/end GROUP
/begin GROUP ETCSignals.ES900.ES910.CAN1.CAN1.AP_ETAS_Inverter_L_Rx ""
 /begin REF_MEASUREMENT ETCSignals.ES900.ES910.CAN1.CAN1.AP_ETAS_Inverter_L_Rx.Inverter_L_RegID ETCSignals.ES900.ES910.CAN1.CAN1.AP_ETAS_Inverter_L_Rx.Inverter_L_b7tob0 ETCSignals.ES900.ES910.CAN1.CAN1.AP_ETAS_Inverter_L_Rx.Inverter_L_b15tob8 /end REF_MEASUREMENT
 /begin REF_CHARACTERISTIC ETCSignals.ES900.ES910.CAN1.CAN1.AP_ETAS_Inverter_L_Rx.Inverter_L_RegID_calibrate ETCSignals.ES900.ES910.CAN1.CAN1.AP_ETAS_Inverter_L_Rx.Inverter_L_b7tob0_calibrate ETCSignals.ES900.ES910.CAN1.CAN1.AP_ETAS_Inverter_L_Rx.Inverter_L_b15tob8_calibrate /end REF_CHARACTERISTIC
/end GROUP
/begin GROUP ETCSignals.ES900.ES910.CAN1.CAN1.AP_ETAS_CarState ""
 /begin REF_MEASUREMENT ETCSignals.ES900.ES910.CAN1.CAN1.AP_ETAS_CarState.Car_State /end REF_MEASUREMENT
 /begin REF_CHARACTERISTIC ETCSignals.ES900.ES910.CAN1.CAN1.AP_ETAS_CarState.Car_State_calibrate /end REF_CHARACTERISTIC
/end GROUP
/begin GROUP ETCSignals.ES900.ES910.CAN1.CAN1.AP_ETAS_AIRsRequest ""
 /begin REF_MEASUREMENT ETCSignals.ES900.ES910.CAN1.CAN1.AP_ETAS_AIRsRequest.AIRs_Request /end REF_MEASUREMENT
 /begin REF_CHARACTERISTIC ETCSignals.ES900.ES910.CAN1.CAN1.AP_ETAS_AIRsRequest.AIRs_Request_calibrate /end REF_CHARACTERISTIC
/end GROUP
/begin GROUP ETCSignals.ES900.ES910.CAN1.CAN1.MEAS_ETAS_InternalVars ""
 /begin REF_MEASUREMENT ETCSignals.ES900.ES910.CAN1.CAN1.MEAS_ETAS_InternalVars.InvertersAction ETCSignals.ES900.ES910.CAN1.CAN1.MEAS_ETAS_InternalVars.el_Vel_OK ETCSignals.ES900.ES910.CAN1.CAN1.MEAS_ETAS_InternalVars.TC_Warning ETCSignals.ES900.ES910.CAN1.CAN1.MEAS_ETAS_InternalVars.Regenerative_Enable ETCSignals.ES900.ES910.CAN1.CAN1.MEAS_ETAS_InternalVars.CriticalDisconnection ETCSignals.ES900.ES910.CAN1.CAN1.MEAS_ETAS_InternalVars.Relay_Error ETCSignals.ES900.ES910.CAN1.CAN1.MEAS_ETAS_InternalVars.Car_OK ETCSignals.ES900.ES910.CAN1.CAN1.MEAS_ETAS_InternalVars.Power ETCSignals.ES900.ES910.CAN1.CAN1.MEAS_ETAS_InternalVars.Torque_OK ETCSignals.ES900.ES910.CAN1.CAN1.MEAS_ETAS_InternalVars.Sensorics_Mode ETCSignals.ES900.ES910.CAN1.CAN1.MEAS_ETAS_InternalVars.Critical_Signal_Disconnection ETCSignals.ES900.ES910.CAN1.CAN1.MEAS_ETAS_InternalVars.Critical_CAN_Disconnection ETCSignals.ES900.ES910.CAN1.CAN1.MEAS_ETAS_InternalVars.APPS_Implausibility /end REF_MEASUREMENT
 /begin REF_CHARACTERISTIC ETCSignals.ES900.ES910.CAN1.CAN1.MEAS_ETAS_InternalVars.InvertersAction_calibrate ETCSignals.ES900.ES910.CAN1.CAN1.MEAS_ETAS_InternalVars.el_Vel_OK_calibrate ETCSignals.ES900.ES910.CAN1.CAN1.MEAS_ETAS_InternalVars.TC_Warning_calibrate ETCSignals.ES900.ES910.CAN1.CAN1.MEAS_ETAS_InternalVars.Regenerative_Enable_calibrate ETCSignals.ES900.ES910.CAN1.CAN1.MEAS_ETAS_InternalVars.CriticalDisconnection_calibrate ETCSignals.ES900.ES910.CAN1.CAN1.MEAS_ETAS_InternalVars.Relay_Error_calibrate ETCSignals.ES900.ES910.CAN1.CAN1.MEAS_ETAS_InternalVars.Car_OK_calibrate ETCSignals.ES900.ES910.CAN1.CAN1.MEAS_ETAS_InternalVars.Power_calibrate ETCSignals.ES900.ES910.CAN1.CAN1.MEAS_ETAS_InternalVars.Torque_OK_calibrate ETCSignals.ES900.ES910.CAN1.CAN1.MEAS_ETAS_InternalVars.Sensorics_Mode_calibrate ETCSignals.ES900.ES910.CAN1.CAN1.MEAS_ETAS_InternalVars.Critical_Signal_Disconnection_calibrate ETCSignals.ES900.ES910.CAN1.CAN1.MEAS_ETAS_InternalVars.Critical_CAN_Disconnection_calibrate ETCSignals.ES900.ES910.CAN1.CAN1.MEAS_ETAS_InternalVars.APPS_Implausibility_calibrate /end REF_CHARACTERISTIC
/end GROUP
/begin GROUP ETCSignals.ES900.ES910.CAN1.CAN1.AP_ETAS_Synchronism ""
 /begin REF_MEASUREMENT ETCSignals.ES900.ES910.CAN1.CAN1.AP_ETAS_Synchronism.Sync_CAN1 /end REF_MEASUREMENT
 /begin REF_CHARACTERISTIC ETCSignals.ES900.ES910.CAN1.CAN1.AP_ETAS_Synchronism.Sync_CAN1_calibrate /end REF_CHARACTERISTIC
/end GROUP
/begin GROUP ETCSignals.ES900.ES910.CAN2 ""
 /begin REF_MEASUREMENT ETCSignals.ES900.ES910.CAN2.Presence.PresenceGroup.PresenceFlag ETCSignals.ES900.ES910.CAN2.CAN2.MEAS_ETAS_SOC.SOC_High ETCSignals.ES900.ES910.CAN2.CAN2.MEAS_ETAS_SOC.SOC_Low ETCSignals.ES900.ES910.CAN2.CAN2.MEAS_ETAS_SOC.SOC_Avg ETCSignals.ES900.ES910.CAN2.CAN2.AP_ELLIPSE_AUTO.el_Track_Valid ETCSignals.ES900.ES910.CAN2.CAN2.AP_ELLIPSE_AUTO.el_Slip_Valid ETCSignals.ES900.ES910.CAN2.CAN2.AP_ELLIPSE_AUTO.el_Curvature_Valid ETCSignals.ES900.ES910.CAN2.CAN2.AP_ELLIPSE_AUTO.el_SlipAngle ETCSignals.ES900.ES910.CAN2.CAN2.AP_ELLIPSE_AUTO.el_CurvatureRadius ETCSignals.ES900.ES910.CAN2.CAN2.AP_ELLIPSE_AUTO.el_AngleTrack ETCSignals.ES900.ES910.CAN2.CAN2.AP_ELLIPSE_GPS_VEL.el_Vel_GPS_N ETCSignals.ES900.ES910.CAN2.CAN2.AP_ELLIPSE_GPS_VEL.el_Vel_GPS_E ETCSignals.ES900.ES910.CAN2.CAN2.AP_ELLIPSE_GPS_VEL.el_Vel_GPS_D ETCSignals.ES900.ES910.CAN2.CAN2.NM_ETAS_Disconnections.Disconnection_InvR ETCSignals.ES900.ES910.CAN2.CAN2.NM_ETAS_Disconnections.Disconnection_InvL ETCSignals.ES900.ES910.CAN2.CAN2.NM_ETAS_Disconnections.Disconnection_Susp_R_R ETCSignals.ES900.ES910.CAN2.CAN2.NM_ETAS_Disconnections.Disconnection_Susp_R_L ETCSignals.ES900.ES910.CAN2.CAN2.NM_ETAS_Disconnections.Disconnection_Susp_F_R ETCSignals.ES900.ES910.CAN2.CAN2.NM_ETAS_Disconnections.Disconnection_Susp_F_L ETCSignals.ES900.ES910.CAN2.CAN2.NM_ETAS_Disconnections.Disconnection_SteeringSensor ETCSignals.ES900.ES910.CAN2.CAN2.NM_ETAS_Disconnections.Disconnection_Rear ETCSignals.ES900.ES910.CAN2.CAN2.NM_ETAS_Disconnections.Disconnection_Pitot ETCSignals.ES900.ES910.CAN2.CAN2.NM_ETAS_Disconnections.Disconnection_Front ETCSignals.ES900.ES910.CAN2.CAN2.NM_ETAS_Disconnections.Disconnection_Ellipse ETCSignals.ES900.ES910.CAN2.CAN2.NM_ETAS_Disconnections.Disconnection_DashBoard ETCSignals.ES900.ES910.CAN2.CAN2.NM_ETAS_Disconnections.Disconnection_BrakePedal ETCSignals.ES900.ES910.CAN2.CAN2.NM_ETAS_Disconnections.Disconnection_BMS ETCSignals.ES900.ES910.CAN2.CAN2.NM_ETAS_Disconnections.Disconnection_APPS2 ETCSignals.ES900.ES910.CAN2.CAN2.NM_ETAS_Disconnections.Disconnection_APPS1 ETCSignals.ES900.ES910.CAN2.CAN2.MEAS_ETAS_VDC_Values.el_VEL ETCSignals.ES900.ES910.CAN2.CAN2.MEAS_ETAS_VDC_Values.SteeringSensor_Value ETCSignals.ES900.ES910.CAN2.CAN2.MEAS_ETAS_VDC_Values.BrakePedal_Value ETCSignals.ES900.ES910.CAN2.CAN2.MEAS_ETAS_VDC_Values.APPS2_Value ETCSignals.ES900.ES910.CAN2.CAN2.MEAS_ETAS_VDC_Values.APPS1_Value ETCSignals.ES900.ES910.CAN2.CAN2.AP_ETAS_BrakeLight.BrakeLight_Control ETCSignals.ES900.ES910.CAN2.CAN2.MEAS_RECU_SDC.Shutdown_TSMS_TSMP ETCSignals.ES900.ES910.CAN2.CAN2.MEAS_RECU_SDC.Shutdown_HVD ETCSignals.ES900.ES910.CAN2.CAN2.MEAS_RECU_SDC.Shutdown_HVBox ETCSignals.ES900.ES910.CAN2.CAN2.MEAS_RECU_SDC.Shutdown_LeftTS ETCSignals.ES900.ES910.CAN2.CAN2.MEAS_RECU_SDC.Shutdown_RightTS ETCSignals.ES900.ES910.CAN2.CAN2.AP_ELLIPSE_EKF_POS.el_LONGITUDE_EKF ETCSignals.ES900.ES910.CAN2.CAN2.AP_ELLIPSE_EKF_POS.el_LATITUDE_EKF ETCSignals.ES900.ES910.CAN2.CAN2.AP_ELLIPSE_IMU_ACCEL.el_ACCEL_Z ETCSignals.ES900.ES910.CAN2.CAN2.AP_ELLIPSE_IMU_ACCEL.el_ACCEL_Y ETCSignals.ES900.ES910.CAN2.CAN2.AP_ELLIPSE_IMU_ACCEL.el_ACCEL_X ETCSignals.ES900.ES910.CAN2.CAN2.AP_ELLIPSE_EKF_EULER.el_YAW ETCSignals.ES900.ES910.CAN2.CAN2.AP_ELLIPSE_EKF_EULER.el_PITCH ETCSignals.ES900.ES910.CAN2.CAN2.AP_ELLIPSE_EKF_EULER.el_ROLL ETCSignals.ES900.ES910.CAN2.CAN2.AP_ELLIPSE_EKF_VEL.el_Vel_EKF_Z ETCSignals.ES900.ES910.CAN2.CAN2.AP_ELLIPSE_EKF_VEL.el_Vel_EKF_Y ETCSignals.ES900.ES910.CAN2.CAN2.AP_ELLIPSE_EKF_VEL.el_Vel_EKF_X ETCSignals.ES900.ES910.CAN2.CAN2.NM_ELLIPSE_Status.Ellipse_Alive ETCSignals.ES900.ES910.CAN2.CAN2.AP_ELLIPSE_IMU_GYRO.el_GYRO_Z ETCSignals.ES900.ES910.CAN2.CAN2.AP_ELLIPSE_IMU_GYRO.el_GYRO_Y ETCSignals.ES900.ES910.CAN2.CAN2.AP_ELLIPSE_IMU_GYRO.el_GYRO_X ETCSignals.ES900.ES910.CAN2.CAN2.AP_ELLIPSE_VEL_Valid.el_SolutionMode ETCSignals.ES900.ES910.CAN2.CAN2.AP_ELLIPSE_VEL_Valid.el_Vel_GPS_Valid ETCSignals.ES900.ES910.CAN2.CAN2.AP_ELLIPSE_VEL_Valid.el_Vel_EKF_Valid ETCSignals.ES900.ES910.CAN2.CAN2.MEAS_ETAS_Inverter_R_Data.Inv_R_TempMotor ETCSignals.ES900.ES910.CAN2.CAN2.MEAS_ETAS_Inverter_R_Data.current_R ETCSignals.ES900.ES910.CAN2.CAN2.MEAS_ETAS_Inverter_R_Data.Inv_R_TempIGBT ETCSignals.ES900.ES910.CAN2.CAN2.MEAS_ETAS_Inverter_R_Data.RR_Vel_ms_Wheel ETCSignals.ES900.ES910.CAN2.CAN2.MEAS_ETAS_Inverter_L_Data.Inv_L_TempMotor ETCSignals.ES900.ES910.CAN2.CAN2.MEAS_ETAS_Inverter_L_Data.current_L ETCSignals.ES900.ES910.CAN2.CAN2.MEAS_ETAS_Inverter_L_Data.Inv_L_TempIGBT ETCSignals.ES900.ES910.CAN2.CAN2.MEAS_ETAS_Inverter_L_Data.RL_Vel_ms_Wheel ETCSignals.ES900.ES910.CAN2.CAN2.MEAS_ETAS_VDC_Suspe.SUSP_R_R ETCSignals.ES900.ES910.CAN2.CAN2.MEAS_ETAS_VDC_Suspe.SUSP_R_L ETCSignals.ES900.ES910.CAN2.CAN2.MEAS_ETAS_VDC_Suspe.SUSP_F_R ETCSignals.ES900.ES910.CAN2.CAN2.MEAS_ETAS_VDC_Suspe.SUSP_F_L ETCSignals.ES900.ES910.CAN2.CAN2.MEAS_ETAS_VDC_Tq.Throttle_Torque ETCSignals.ES900.ES910.CAN2.CAN2.MEAS_ETAS_VDC_Tq.Torque_R ETCSignals.ES900.ES910.CAN2.CAN2.MEAS_ETAS_VDC_Tq.Torque_L ETCSignals.ES900.ES910.CAN2.CAN2.AP_RECU_Data.Susp_R_R_Bits ETCSignals.ES900.ES910.CAN2.CAN2.AP_RECU_Data.Susp_R_L_Bits ETCSignals.ES900.ES910.CAN2.CAN2.NM_FECU_Keep_Alive.Front_Alive ETCSignals.ES900.ES910.CAN2.CAN2.NM_RECU_Keep_Alive.Rear_Alive ETCSignals.ES900.ES910.CAN2.CAN2.AP_FECU_Data2.Pitot_Bits ETCSignals.ES900.ES910.CAN2.CAN2.AP_FECU_Data2.Susp_F_R_Bits ETCSignals.ES900.ES910.CAN2.CAN2.AP_FECU_Data2.Susp_F_L_Bits ETCSignals.ES900.ES910.CAN2.CAN2.AP_FECU_Data1.SteeringSensor_Bits ETCSignals.ES900.ES910.CAN2.CAN2.AP_FECU_Data1.BrakePedal_Bits ETCSignals.ES900.ES910.CAN2.CAN2.AP_FECU_Data1.APPS2_Bits ETCSignals.ES900.ES910.CAN2.CAN2.AP_FECU_Data1.APPS1_Bits ETCSignals.ES900.ES910.CAN2.CAN2.AP_ETAS_Synchronism.Sync_CAN2 /end REF_MEASUREMENT
 /begin REF_CHARACTERISTIC ETCSignals.ES900.ES910.CAN2.CAN2.MEAS_ETAS_SOC.SOC_High_calibrate ETCSignals.ES900.ES910.CAN2.CAN2.MEAS_ETAS_SOC.SOC_Low_calibrate ETCSignals.ES900.ES910.CAN2.CAN2.MEAS_ETAS_SOC.SOC_Avg_calibrate ETCSignals.ES900.ES910.CAN2.CAN2.NM_ETAS_Disconnections.Disconnection_InvR_calibrate ETCSignals.ES900.ES910.CAN2.CAN2.NM_ETAS_Disconnections.Disconnection_InvL_calibrate ETCSignals.ES900.ES910.CAN2.CAN2.NM_ETAS_Disconnections.Disconnection_Susp_R_R_calibrate ETCSignals.ES900.ES910.CAN2.CAN2.NM_ETAS_Disconnections.Disconnection_Susp_R_L_calibrate ETCSignals.ES900.ES910.CAN2.CAN2.NM_ETAS_Disconnections.Disconnection_Susp_F_R_calibrate ETCSignals.ES900.ES910.CAN2.CAN2.NM_ETAS_Disconnections.Disconnection_Susp_F_L_calibrate ETCSignals.ES900.ES910.CAN2.CAN2.NM_ETAS_Disconnections.Disconnection_SteeringSensor_calibrate ETCSignals.ES900.ES910.CAN2.CAN2.NM_ETAS_Disconnections.Disconnection_Rear_calibrate ETCSignals.ES900.ES910.CAN2.CAN2.NM_ETAS_Disconnections.Disconnection_Pitot_calibrate ETCSignals.ES900.ES910.CAN2.CAN2.NM_ETAS_Disconnections.Disconnection_Front_calibrate ETCSignals.ES900.ES910.CAN2.CAN2.NM_ETAS_Disconnections.Disconnection_Ellipse_calibrate ETCSignals.ES900.ES910.CAN2.CAN2.NM_ETAS_Disconnections.Disconnection_DashBoard_calibrate ETCSignals.ES900.ES910.CAN2.CAN2.NM_ETAS_Disconnections.Disconnection_BrakePedal_calibrate ETCSignals.ES900.ES910.CAN2.CAN2.NM_ETAS_Disconnections.Disconnection_BMS_calibrate ETCSignals.ES900.ES910.CAN2.CAN2.NM_ETAS_Disconnections.Disconnection_APPS2_calibrate ETCSignals.ES900.ES910.CAN2.CAN2.NM_ETAS_Disconnections.Disconnection_APPS1_calibrate ETCSignals.ES900.ES910.CAN2.CAN2.MEAS_ETAS_VDC_Values.el_VEL_calibrate ETCSignals.ES900.ES910.CAN2.CAN2.MEAS_ETAS_VDC_Values.SteeringSensor_Value_calibrate ETCSignals.ES900.ES910.CAN2.CAN2.MEAS_ETAS_VDC_Values.BrakePedal_Value_calibrate ETCSignals.ES900.ES910.CAN2.CAN2.MEAS_ETAS_VDC_Values.APPS2_Value_calibrate ETCSignals.ES900.ES910.CAN2.CAN2.MEAS_ETAS_VDC_Values.APPS1_Value_calibrate ETCSignals.ES900.ES910.CAN2.CAN2.AP_ETAS_BrakeLight.BrakeLight_Control_calibrate ETCSignals.ES900.ES910.CAN2.CAN2.MEAS_ETAS_Inverter_R_Data.Inv_R_TempMotor_calibrate ETCSignals.ES900.ES910.CAN2.CAN2.MEAS_ETAS_Inverter_R_Data.current_R_calibrate ETCSignals.ES900.ES910.CAN2.CAN2.MEAS_ETAS_Inverter_R_Data.Inv_R_TempIGBT_calibrate ETCSignals.ES900.ES910.CAN2.CAN2.MEAS_ETAS_Inverter_R_Data.RR_Vel_ms_Wheel_calibrate ETCSignals.ES900.ES910.CAN2.CAN2.MEAS_ETAS_Inverter_L_Data.Inv_L_TempMotor_calibrate ETCSignals.ES900.ES910.CAN2.CAN2.MEAS_ETAS_Inverter_L_Data.current_L_calibrate ETCSignals.ES900.ES910.CAN2.CAN2.MEAS_ETAS_Inverter_L_Data.Inv_L_TempIGBT_calibrate ETCSignals.ES900.ES910.CAN2.CAN2.MEAS_ETAS_Inverter_L_Data.RL_Vel_ms_Wheel_calibrate ETCSignals.ES900.ES910.CAN2.CAN2.MEAS_ETAS_VDC_Suspe.SUSP_R_R_calibrate ETCSignals.ES900.ES910.CAN2.CAN2.MEAS_ETAS_VDC_Suspe.SUSP_R_L_calibrate ETCSignals.ES900.ES910.CAN2.CAN2.MEAS_ETAS_VDC_Suspe.SUSP_F_R_calibrate ETCSignals.ES900.ES910.CAN2.CAN2.MEAS_ETAS_VDC_Suspe.SUSP_F_L_calibrate ETCSignals.ES900.ES910.CAN2.CAN2.MEAS_ETAS_VDC_Tq.Throttle_Torque_calibrate ETCSignals.ES900.ES910.CAN2.CAN2.MEAS_ETAS_VDC_Tq.Torque_R_calibrate ETCSignals.ES900.ES910.CAN2.CAN2.MEAS_ETAS_VDC_Tq.Torque_L_calibrate ETCSignals.ES900.ES910.CAN2.CAN2.AP_ETAS_Synchronism.Sync_CAN2_calibrate /end REF_CHARACTERISTIC
/end GROUP
/begin GROUP ETCSignals.ES900.ES910.CAN2.Presence ""
 /begin REF_MEASUREMENT ETCSignals.ES900.ES910.CAN2.Presence.PresenceGroup.PresenceFlag /end REF_MEASUREMENT
/end GROUP
/begin GROUP ETCSignals.ES900.ES910.CAN2.Presence.PresenceGroup ""
 /begin REF_MEASUREMENT ETCSignals.ES900.ES910.CAN2.Presence.PresenceGroup.PresenceFlag /end REF_MEASUREMENT
/end GROUP
/begin GROUP ETCSignals.ES900.ES910.CAN2.CAN2 ""
 /begin REF_MEASUREMENT ETCSignals.ES900.ES910.CAN2.CAN2.MEAS_ETAS_SOC.SOC_High ETCSignals.ES900.ES910.CAN2.CAN2.MEAS_ETAS_SOC.SOC_Low ETCSignals.ES900.ES910.CAN2.CAN2.MEAS_ETAS_SOC.SOC_Avg ETCSignals.ES900.ES910.CAN2.CAN2.AP_ELLIPSE_AUTO.el_Track_Valid ETCSignals.ES900.ES910.CAN2.CAN2.AP_ELLIPSE_AUTO.el_Slip_Valid ETCSignals.ES900.ES910.CAN2.CAN2.AP_ELLIPSE_AUTO.el_Curvature_Valid ETCSignals.ES900.ES910.CAN2.CAN2.AP_ELLIPSE_AUTO.el_SlipAngle ETCSignals.ES900.ES910.CAN2.CAN2.AP_ELLIPSE_AUTO.el_CurvatureRadius ETCSignals.ES900.ES910.CAN2.CAN2.AP_ELLIPSE_AUTO.el_AngleTrack ETCSignals.ES900.ES910.CAN2.CAN2.AP_ELLIPSE_GPS_VEL.el_Vel_GPS_N ETCSignals.ES900.ES910.CAN2.CAN2.AP_ELLIPSE_GPS_VEL.el_Vel_GPS_E ETCSignals.ES900.ES910.CAN2.CAN2.AP_ELLIPSE_GPS_VEL.el_Vel_GPS_D ETCSignals.ES900.ES910.CAN2.CAN2.NM_ETAS_Disconnections.Disconnection_InvR ETCSignals.ES900.ES910.CAN2.CAN2.NM_ETAS_Disconnections.Disconnection_InvL ETCSignals.ES900.ES910.CAN2.CAN2.NM_ETAS_Disconnections.Disconnection_Susp_R_R ETCSignals.ES900.ES910.CAN2.CAN2.NM_ETAS_Disconnections.Disconnection_Susp_R_L ETCSignals.ES900.ES910.CAN2.CAN2.NM_ETAS_Disconnections.Disconnection_Susp_F_R ETCSignals.ES900.ES910.CAN2.CAN2.NM_ETAS_Disconnections.Disconnection_Susp_F_L ETCSignals.ES900.ES910.CAN2.CAN2.NM_ETAS_Disconnections.Disconnection_SteeringSensor ETCSignals.ES900.ES910.CAN2.CAN2.NM_ETAS_Disconnections.Disconnection_Rear ETCSignals.ES900.ES910.CAN2.CAN2.NM_ETAS_Disconnections.Disconnection_Pitot ETCSignals.ES900.ES910.CAN2.CAN2.NM_ETAS_Disconnections.Disconnection_Front ETCSignals.ES900.ES910.CAN2.CAN2.NM_ETAS_Disconnections.Disconnection_Ellipse ETCSignals.ES900.ES910.CAN2.CAN2.NM_ETAS_Disconnections.Disconnection_DashBoard ETCSignals.ES900.ES910.CAN2.CAN2.NM_ETAS_Disconnections.Disconnection_BrakePedal ETCSignals.ES900.ES910.CAN2.CAN2.NM_ETAS_Disconnections.Disconnection_BMS ETCSignals.ES900.ES910.CAN2.CAN2.NM_ETAS_Disconnections.Disconnection_APPS2 ETCSignals.ES900.ES910.CAN2.CAN2.NM_ETAS_Disconnections.Disconnection_APPS1 ETCSignals.ES900.ES910.CAN2.CAN2.MEAS_ETAS_VDC_Values.el_VEL ETCSignals.ES900.ES910.CAN2.CAN2.MEAS_ETAS_VDC_Values.SteeringSensor_Value ETCSignals.ES900.ES910.CAN2.CAN2.MEAS_ETAS_VDC_Values.BrakePedal_Value ETCSignals.ES900.ES910.CAN2.CAN2.MEAS_ETAS_VDC_Values.APPS2_Value ETCSignals.ES900.ES910.CAN2.CAN2.MEAS_ETAS_VDC_Values.APPS1_Value ETCSignals.ES900.ES910.CAN2.CAN2.AP_ETAS_BrakeLight.BrakeLight_Control ETCSignals.ES900.ES910.CAN2.CAN2.MEAS_RECU_SDC.Shutdown_TSMS_TSMP ETCSignals.ES900.ES910.CAN2.CAN2.MEAS_RECU_SDC.Shutdown_HVD ETCSignals.ES900.ES910.CAN2.CAN2.MEAS_RECU_SDC.Shutdown_HVBox ETCSignals.ES900.ES910.CAN2.CAN2.MEAS_RECU_SDC.Shutdown_LeftTS ETCSignals.ES900.ES910.CAN2.CAN2.MEAS_RECU_SDC.Shutdown_RightTS ETCSignals.ES900.ES910.CAN2.CAN2.AP_ELLIPSE_EKF_POS.el_LONGITUDE_EKF ETCSignals.ES900.ES910.CAN2.CAN2.AP_ELLIPSE_EKF_POS.el_LATITUDE_EKF ETCSignals.ES900.ES910.CAN2.CAN2.AP_ELLIPSE_IMU_ACCEL.el_ACCEL_Z ETCSignals.ES900.ES910.CAN2.CAN2.AP_ELLIPSE_IMU_ACCEL.el_ACCEL_Y ETCSignals.ES900.ES910.CAN2.CAN2.AP_ELLIPSE_IMU_ACCEL.el_ACCEL_X ETCSignals.ES900.ES910.CAN2.CAN2.AP_ELLIPSE_EKF_EULER.el_YAW ETCSignals.ES900.ES910.CAN2.CAN2.AP_ELLIPSE_EKF_EULER.el_PITCH ETCSignals.ES900.ES910.CAN2.CAN2.AP_ELLIPSE_EKF_EULER.el_ROLL ETCSignals.ES900.ES910.CAN2.CAN2.AP_ELLIPSE_EKF_VEL.el_Vel_EKF_Z ETCSignals.ES900.ES910.CAN2.CAN2.AP_ELLIPSE_EKF_VEL.el_Vel_EKF_Y ETCSignals.ES900.ES910.CAN2.CAN2.AP_ELLIPSE_EKF_VEL.el_Vel_EKF_X ETCSignals.ES900.ES910.CAN2.CAN2.NM_ELLIPSE_Status.Ellipse_Alive ETCSignals.ES900.ES910.CAN2.CAN2.AP_ELLIPSE_IMU_GYRO.el_GYRO_Z ETCSignals.ES900.ES910.CAN2.CAN2.AP_ELLIPSE_IMU_GYRO.el_GYRO_Y ETCSignals.ES900.ES910.CAN2.CAN2.AP_ELLIPSE_IMU_GYRO.el_GYRO_X ETCSignals.ES900.ES910.CAN2.CAN2.AP_ELLIPSE_VEL_Valid.el_SolutionMode ETCSignals.ES900.ES910.CAN2.CAN2.AP_ELLIPSE_VEL_Valid.el_Vel_GPS_Valid ETCSignals.ES900.ES910.CAN2.CAN2.AP_ELLIPSE_VEL_Valid.el_Vel_EKF_Valid ETCSignals.ES900.ES910.CAN2.CAN2.MEAS_ETAS_Inverter_R_Data.Inv_R_TempMotor ETCSignals.ES900.ES910.CAN2.CAN2.MEAS_ETAS_Inverter_R_Data.current_R ETCSignals.ES900.ES910.CAN2.CAN2.MEAS_ETAS_Inverter_R_Data.Inv_R_TempIGBT ETCSignals.ES900.ES910.CAN2.CAN2.MEAS_ETAS_Inverter_R_Data.RR_Vel_ms_Wheel ETCSignals.ES900.ES910.CAN2.CAN2.MEAS_ETAS_Inverter_L_Data.Inv_L_TempMotor ETCSignals.ES900.ES910.CAN2.CAN2.MEAS_ETAS_Inverter_L_Data.current_L ETCSignals.ES900.ES910.CAN2.CAN2.MEAS_ETAS_Inverter_L_Data.Inv_L_TempIGBT ETCSignals.ES900.ES910.CAN2.CAN2.MEAS_ETAS_Inverter_L_Data.RL_Vel_ms_Wheel ETCSignals.ES900.ES910.CAN2.CAN2.MEAS_ETAS_VDC_Suspe.SUSP_R_R ETCSignals.ES900.ES910.CAN2.CAN2.MEAS_ETAS_VDC_Suspe.SUSP_R_L ETCSignals.ES900.ES910.CAN2.CAN2.MEAS_ETAS_VDC_Suspe.SUSP_F_R ETCSignals.ES900.ES910.CAN2.CAN2.MEAS_ETAS_VDC_Suspe.SUSP_F_L ETCSignals.ES900.ES910.CAN2.CAN2.MEAS_ETAS_VDC_Tq.Throttle_Torque ETCSignals.ES900.ES910.CAN2.CAN2.MEAS_ETAS_VDC_Tq.Torque_R ETCSignals.ES900.ES910.CAN2.CAN2.MEAS_ETAS_VDC_Tq.Torque_L ETCSignals.ES900.ES910.CAN2.CAN2.AP_RECU_Data.Susp_R_R_Bits ETCSignals.ES900.ES910.CAN2.CAN2.AP_RECU_Data.Susp_R_L_Bits ETCSignals.ES900.ES910.CAN2.CAN2.NM_FECU_Keep_Alive.Front_Alive ETCSignals.ES900.ES910.CAN2.CAN2.NM_RECU_Keep_Alive.Rear_Alive ETCSignals.ES900.ES910.CAN2.CAN2.AP_FECU_Data2.Pitot_Bits ETCSignals.ES900.ES910.CAN2.CAN2.AP_FECU_Data2.Susp_F_R_Bits ETCSignals.ES900.ES910.CAN2.CAN2.AP_FECU_Data2.Susp_F_L_Bits ETCSignals.ES900.ES910.CAN2.CAN2.AP_FECU_Data1.SteeringSensor_Bits ETCSignals.ES900.ES910.CAN2.CAN2.AP_FECU_Data1.BrakePedal_Bits ETCSignals.ES900.ES910.CAN2.CAN2.AP_FECU_Data1.APPS2_Bits ETCSignals.ES900.ES910.CAN2.CAN2.AP_FECU_Data1.APPS1_Bits ETCSignals.ES900.ES910.CAN2.CAN2.AP_ETAS_Synchronism.Sync_CAN2 /end REF_MEASUREMENT
 /begin REF_CHARACTERISTIC ETCSignals.ES900.ES910.CAN2.CAN2.MEAS_ETAS_SOC.SOC_High_calibrate ETCSignals.ES900.ES910.CAN2.CAN2.MEAS_ETAS_SOC.SOC_Low_calibrate ETCSignals.ES900.ES910.CAN2.CAN2.MEAS_ETAS_SOC.SOC_Avg_calibrate ETCSignals.ES900.ES910.CAN2.CAN2.NM_ETAS_Disconnections.Disconnection_InvR_calibrate ETCSignals.ES900.ES910.CAN2.CAN2.NM_ETAS_Disconnections.Disconnection_InvL_calibrate ETCSignals.ES900.ES910.CAN2.CAN2.NM_ETAS_Disconnections.Disconnection_Susp_R_R_calibrate ETCSignals.ES900.ES910.CAN2.CAN2.NM_ETAS_Disconnections.Disconnection_Susp_R_L_calibrate ETCSignals.ES900.ES910.CAN2.CAN2.NM_ETAS_Disconnections.Disconnection_Susp_F_R_calibrate ETCSignals.ES900.ES910.CAN2.CAN2.NM_ETAS_Disconnections.Disconnection_Susp_F_L_calibrate ETCSignals.ES900.ES910.CAN2.CAN2.NM_ETAS_Disconnections.Disconnection_SteeringSensor_calibrate ETCSignals.ES900.ES910.CAN2.CAN2.NM_ETAS_Disconnections.Disconnection_Rear_calibrate ETCSignals.ES900.ES910.CAN2.CAN2.NM_ETAS_Disconnections.Disconnection_Pitot_calibrate ETCSignals.ES900.ES910.CAN2.CAN2.NM_ETAS_Disconnections.Disconnection_Front_calibrate ETCSignals.ES900.ES910.CAN2.CAN2.NM_ETAS_Disconnections.Disconnection_Ellipse_calibrate ETCSignals.ES900.ES910.CAN2.CAN2.NM_ETAS_Disconnections.Disconnection_DashBoard_calibrate ETCSignals.ES900.ES910.CAN2.CAN2.NM_ETAS_Disconnections.Disconnection_BrakePedal_calibrate ETCSignals.ES900.ES910.CAN2.CAN2.NM_ETAS_Disconnections.Disconnection_BMS_calibrate ETCSignals.ES900.ES910.CAN2.CAN2.NM_ETAS_Disconnections.Disconnection_APPS2_calibrate ETCSignals.ES900.ES910.CAN2.CAN2.NM_ETAS_Disconnections.Disconnection_APPS1_calibrate ETCSignals.ES900.ES910.CAN2.CAN2.MEAS_ETAS_VDC_Values.el_VEL_calibrate ETCSignals.ES900.ES910.CAN2.CAN2.MEAS_ETAS_VDC_Values.SteeringSensor_Value_calibrate ETCSignals.ES900.ES910.CAN2.CAN2.MEAS_ETAS_VDC_Values.BrakePedal_Value_calibrate ETCSignals.ES900.ES910.CAN2.CAN2.MEAS_ETAS_VDC_Values.APPS2_Value_calibrate ETCSignals.ES900.ES910.CAN2.CAN2.MEAS_ETAS_VDC_Values.APPS1_Value_calibrate ETCSignals.ES900.ES910.CAN2.CAN2.AP_ETAS_BrakeLight.BrakeLight_Control_calibrate ETCSignals.ES900.ES910.CAN2.CAN2.MEAS_ETAS_Inverter_R_Data.Inv_R_TempMotor_calibrate ETCSignals.ES900.ES910.CAN2.CAN2.MEAS_ETAS_Inverter_R_Data.current_R_calibrate ETCSignals.ES900.ES910.CAN2.CAN2.MEAS_ETAS_Inverter_R_Data.Inv_R_TempIGBT_calibrate ETCSignals.ES900.ES910.CAN2.CAN2.MEAS_ETAS_Inverter_R_Data.RR_Vel_ms_Wheel_calibrate ETCSignals.ES900.ES910.CAN2.CAN2.MEAS_ETAS_Inverter_L_Data.Inv_L_TempMotor_calibrate ETCSignals.ES900.ES910.CAN2.CAN2.MEAS_ETAS_Inverter_L_Data.current_L_calibrate ETCSignals.ES900.ES910.CAN2.CAN2.MEAS_ETAS_Inverter_L_Data.Inv_L_TempIGBT_calibrate ETCSignals.ES900.ES910.CAN2.CAN2.MEAS_ETAS_Inverter_L_Data.RL_Vel_ms_Wheel_calibrate ETCSignals.ES900.ES910.CAN2.CAN2.MEAS_ETAS_VDC_Suspe.SUSP_R_R_calibrate ETCSignals.ES900.ES910.CAN2.CAN2.MEAS_ETAS_VDC_Suspe.SUSP_R_L_calibrate ETCSignals.ES900.ES910.CAN2.CAN2.MEAS_ETAS_VDC_Suspe.SUSP_F_R_calibrate ETCSignals.ES900.ES910.CAN2.CAN2.MEAS_ETAS_VDC_Suspe.SUSP_F_L_calibrate ETCSignals.ES900.ES910.CAN2.CAN2.MEAS_ETAS_VDC_Tq.Throttle_Torque_calibrate ETCSignals.ES900.ES910.CAN2.CAN2.MEAS_ETAS_VDC_Tq.Torque_R_calibrate ETCSignals.ES900.ES910.CAN2.CAN2.MEAS_ETAS_VDC_Tq.Torque_L_calibrate ETCSignals.ES900.ES910.CAN2.CAN2.AP_ETAS_Synchronism.Sync_CAN2_calibrate /end REF_CHARACTERISTIC
/end GROUP
/begin GROUP ETCSignals.ES900.ES910.CAN2.CAN2.MEAS_ETAS_SOC ""
 /begin REF_MEASUREMENT ETCSignals.ES900.ES910.CAN2.CAN2.MEAS_ETAS_SOC.SOC_High ETCSignals.ES900.ES910.CAN2.CAN2.MEAS_ETAS_SOC.SOC_Low ETCSignals.ES900.ES910.CAN2.CAN2.MEAS_ETAS_SOC.SOC_Avg /end REF_MEASUREMENT
 /begin REF_CHARACTERISTIC ETCSignals.ES900.ES910.CAN2.CAN2.MEAS_ETAS_SOC.SOC_High_calibrate ETCSignals.ES900.ES910.CAN2.CAN2.MEAS_ETAS_SOC.SOC_Low_calibrate ETCSignals.ES900.ES910.CAN2.CAN2.MEAS_ETAS_SOC.SOC_Avg_calibrate /end REF_CHARACTERISTIC
/end GROUP
/begin GROUP ETCSignals.ES900.ES910.CAN2.CAN2.AP_ELLIPSE_AUTO ""
 /begin REF_MEASUREMENT ETCSignals.ES900.ES910.CAN2.CAN2.AP_ELLIPSE_AUTO.el_Track_Valid ETCSignals.ES900.ES910.CAN2.CAN2.AP_ELLIPSE_AUTO.el_Slip_Valid ETCSignals.ES900.ES910.CAN2.CAN2.AP_ELLIPSE_AUTO.el_Curvature_Valid ETCSignals.ES900.ES910.CAN2.CAN2.AP_ELLIPSE_AUTO.el_SlipAngle ETCSignals.ES900.ES910.CAN2.CAN2.AP_ELLIPSE_AUTO.el_CurvatureRadius ETCSignals.ES900.ES910.CAN2.CAN2.AP_ELLIPSE_AUTO.el_AngleTrack /end REF_MEASUREMENT
/end GROUP
/begin GROUP ETCSignals.ES900.ES910.CAN2.CAN2.AP_ELLIPSE_GPS_VEL ""
 /begin REF_MEASUREMENT ETCSignals.ES900.ES910.CAN2.CAN2.AP_ELLIPSE_GPS_VEL.el_Vel_GPS_N ETCSignals.ES900.ES910.CAN2.CAN2.AP_ELLIPSE_GPS_VEL.el_Vel_GPS_E ETCSignals.ES900.ES910.CAN2.CAN2.AP_ELLIPSE_GPS_VEL.el_Vel_GPS_D /end REF_MEASUREMENT
/end GROUP
/begin GROUP ETCSignals.ES900.ES910.CAN2.CAN2.NM_ETAS_Disconnections ""
 /begin REF_MEASUREMENT ETCSignals.ES900.ES910.CAN2.CAN2.NM_ETAS_Disconnections.Disconnection_InvR ETCSignals.ES900.ES910.CAN2.CAN2.NM_ETAS_Disconnections.Disconnection_InvL ETCSignals.ES900.ES910.CAN2.CAN2.NM_ETAS_Disconnections.Disconnection_Susp_R_R ETCSignals.ES900.ES910.CAN2.CAN2.NM_ETAS_Disconnections.Disconnection_Susp_R_L ETCSignals.ES900.ES910.CAN2.CAN2.NM_ETAS_Disconnections.Disconnection_Susp_F_R ETCSignals.ES900.ES910.CAN2.CAN2.NM_ETAS_Disconnections.Disconnection_Susp_F_L ETCSignals.ES900.ES910.CAN2.CAN2.NM_ETAS_Disconnections.Disconnection_SteeringSensor ETCSignals.ES900.ES910.CAN2.CAN2.NM_ETAS_Disconnections.Disconnection_Rear ETCSignals.ES900.ES910.CAN2.CAN2.NM_ETAS_Disconnections.Disconnection_Pitot ETCSignals.ES900.ES910.CAN2.CAN2.NM_ETAS_Disconnections.Disconnection_Front ETCSignals.ES900.ES910.CAN2.CAN2.NM_ETAS_Disconnections.Disconnection_Ellipse ETCSignals.ES900.ES910.CAN2.CAN2.NM_ETAS_Disconnections.Disconnection_DashBoard ETCSignals.ES900.ES910.CAN2.CAN2.NM_ETAS_Disconnections.Disconnection_BrakePedal ETCSignals.ES900.ES910.CAN2.CAN2.NM_ETAS_Disconnections.Disconnection_BMS ETCSignals.ES900.ES910.CAN2.CAN2.NM_ETAS_Disconnections.Disconnection_APPS2 ETCSignals.ES900.ES910.CAN2.CAN2.NM_ETAS_Disconnections.Disconnection_APPS1 /end REF_MEASUREMENT
 /begin REF_CHARACTERISTIC ETCSignals.ES900.ES910.CAN2.CAN2.NM_ETAS_Disconnections.Disconnection_InvR_calibrate ETCSignals.ES900.ES910.CAN2.CAN2.NM_ETAS_Disconnections.Disconnection_InvL_calibrate ETCSignals.ES900.ES910.CAN2.CAN2.NM_ETAS_Disconnections.Disconnection_Susp_R_R_calibrate ETCSignals.ES900.ES910.CAN2.CAN2.NM_ETAS_Disconnections.Disconnection_Susp_R_L_calibrate ETCSignals.ES900.ES910.CAN2.CAN2.NM_ETAS_Disconnections.Disconnection_Susp_F_R_calibrate ETCSignals.ES900.ES910.CAN2.CAN2.NM_ETAS_Disconnections.Disconnection_Susp_F_L_calibrate ETCSignals.ES900.ES910.CAN2.CAN2.NM_ETAS_Disconnections.Disconnection_SteeringSensor_calibrate ETCSignals.ES900.ES910.CAN2.CAN2.NM_ETAS_Disconnections.Disconnection_Rear_calibrate ETCSignals.ES900.ES910.CAN2.CAN2.NM_ETAS_Disconnections.Disconnection_Pitot_calibrate ETCSignals.ES900.ES910.CAN2.CAN2.NM_ETAS_Disconnections.Disconnection_Front_calibrate ETCSignals.ES900.ES910.CAN2.CAN2.NM_ETAS_Disconnections.Disconnection_Ellipse_calibrate ETCSignals.ES900.ES910.CAN2.CAN2.NM_ETAS_Disconnections.Disconnection_DashBoard_calibrate ETCSignals.ES900.ES910.CAN2.CAN2.NM_ETAS_Disconnections.Disconnection_BrakePedal_calibrate ETCSignals.ES900.ES910.CAN2.CAN2.NM_ETAS_Disconnections.Disconnection_BMS_calibrate ETCSignals.ES900.ES910.CAN2.CAN2.NM_ETAS_Disconnections.Disconnection_APPS2_calibrate ETCSignals.ES900.ES910.CAN2.CAN2.NM_ETAS_Disconnections.Disconnection_APPS1_calibrate /end REF_CHARACTERISTIC
/end GROUP
/begin GROUP ETCSignals.ES900.ES910.CAN2.CAN2.MEAS_ETAS_VDC_Values ""
 /begin REF_MEASUREMENT ETCSignals.ES900.ES910.CAN2.CAN2.MEAS_ETAS_VDC_Values.el_VEL ETCSignals.ES900.ES910.CAN2.CAN2.MEAS_ETAS_VDC_Values.SteeringSensor_Value ETCSignals.ES900.ES910.CAN2.CAN2.MEAS_ETAS_VDC_Values.BrakePedal_Value ETCSignals.ES900.ES910.CAN2.CAN2.MEAS_ETAS_VDC_Values.APPS2_Value ETCSignals.ES900.ES910.CAN2.CAN2.MEAS_ETAS_VDC_Values.APPS1_Value /end REF_MEASUREMENT
 /begin REF_CHARACTERISTIC ETCSignals.ES900.ES910.CAN2.CAN2.MEAS_ETAS_VDC_Values.el_VEL_calibrate ETCSignals.ES900.ES910.CAN2.CAN2.MEAS_ETAS_VDC_Values.SteeringSensor_Value_calibrate ETCSignals.ES900.ES910.CAN2.CAN2.MEAS_ETAS_VDC_Values.BrakePedal_Value_calibrate ETCSignals.ES900.ES910.CAN2.CAN2.MEAS_ETAS_VDC_Values.APPS2_Value_calibrate ETCSignals.ES900.ES910.CAN2.CAN2.MEAS_ETAS_VDC_Values.APPS1_Value_calibrate /end REF_CHARACTERISTIC
/end GROUP
/begin GROUP ETCSignals.ES900.ES910.CAN2.CAN2.AP_ETAS_BrakeLight ""
 /begin REF_MEASUREMENT ETCSignals.ES900.ES910.CAN2.CAN2.AP_ETAS_BrakeLight.BrakeLight_Control /end REF_MEASUREMENT
 /begin REF_CHARACTERISTIC ETCSignals.ES900.ES910.CAN2.CAN2.AP_ETAS_BrakeLight.BrakeLight_Control_calibrate /end REF_CHARACTERISTIC
/end GROUP
/begin GROUP ETCSignals.ES900.ES910.CAN2.CAN2.MEAS_RECU_SDC ""
 /begin REF_MEASUREMENT ETCSignals.ES900.ES910.CAN2.CAN2.MEAS_RECU_SDC.Shutdown_TSMS_TSMP ETCSignals.ES900.ES910.CAN2.CAN2.MEAS_RECU_SDC.Shutdown_HVD ETCSignals.ES900.ES910.CAN2.CAN2.MEAS_RECU_SDC.Shutdown_HVBox ETCSignals.ES900.ES910.CAN2.CAN2.MEAS_RECU_SDC.Shutdown_LeftTS ETCSignals.ES900.ES910.CAN2.CAN2.MEAS_RECU_SDC.Shutdown_RightTS /end REF_MEASUREMENT
/end GROUP
/begin GROUP ETCSignals.ES900.ES910.CAN2.CAN2.AP_ELLIPSE_EKF_POS ""
 /begin REF_MEASUREMENT ETCSignals.ES900.ES910.CAN2.CAN2.AP_ELLIPSE_EKF_POS.el_LONGITUDE_EKF ETCSignals.ES900.ES910.CAN2.CAN2.AP_ELLIPSE_EKF_POS.el_LATITUDE_EKF /end REF_MEASUREMENT
/end GROUP
/begin GROUP ETCSignals.ES900.ES910.CAN2.CAN2.AP_ELLIPSE_IMU_ACCEL ""
 /begin REF_MEASUREMENT ETCSignals.ES900.ES910.CAN2.CAN2.AP_ELLIPSE_IMU_ACCEL.el_ACCEL_Z ETCSignals.ES900.ES910.CAN2.CAN2.AP_ELLIPSE_IMU_ACCEL.el_ACCEL_Y ETCSignals.ES900.ES910.CAN2.CAN2.AP_ELLIPSE_IMU_ACCEL.el_ACCEL_X /end REF_MEASUREMENT
/end GROUP
/begin GROUP ETCSignals.ES900.ES910.CAN2.CAN2.AP_ELLIPSE_EKF_EULER ""
 /begin REF_MEASUREMENT ETCSignals.ES900.ES910.CAN2.CAN2.AP_ELLIPSE_EKF_EULER.el_YAW ETCSignals.ES900.ES910.CAN2.CAN2.AP_ELLIPSE_EKF_EULER.el_PITCH ETCSignals.ES900.ES910.CAN2.CAN2.AP_ELLIPSE_EKF_EULER.el_ROLL /end REF_MEASUREMENT
/end GROUP
/begin GROUP ETCSignals.ES900.ES910.CAN2.CAN2.AP_ELLIPSE_EKF_VEL ""
 /begin REF_MEASUREMENT ETCSignals.ES900.ES910.CAN2.CAN2.AP_ELLIPSE_EKF_VEL.el_Vel_EKF_Z ETCSignals.ES900.ES910.CAN2.CAN2.AP_ELLIPSE_EKF_VEL.el_Vel_EKF_Y ETCSignals.ES900.ES910.CAN2.CAN2.AP_ELLIPSE_EKF_VEL.el_Vel_EKF_X /end REF_MEASUREMENT
/end GROUP
/begin GROUP ETCSignals.ES900.ES910.CAN2.CAN2.NM_ELLIPSE_Status ""
 /begin REF_MEASUREMENT ETCSignals.ES900.ES910.CAN2.CAN2.NM_ELLIPSE_Status.Ellipse_Alive /end REF_MEASUREMENT
/end GROUP
/begin GROUP ETCSignals.ES900.ES910.CAN2.CAN2.AP_ELLIPSE_IMU_GYRO ""
 /begin REF_MEASUREMENT ETCSignals.ES900.ES910.CAN2.CAN2.AP_ELLIPSE_IMU_GYRO.el_GYRO_Z ETCSignals.ES900.ES910.CAN2.CAN2.AP_ELLIPSE_IMU_GYRO.el_GYRO_Y ETCSignals.ES900.ES910.CAN2.CAN2.AP_ELLIPSE_IMU_GYRO.el_GYRO_X /end REF_MEASUREMENT
/end GROUP
/begin GROUP ETCSignals.ES900.ES910.CAN2.CAN2.AP_ELLIPSE_VEL_Valid ""
 /begin REF_MEASUREMENT ETCSignals.ES900.ES910.CAN2.CAN2.AP_ELLIPSE_VEL_Valid.el_SolutionMode ETCSignals.ES900.ES910.CAN2.CAN2.AP_ELLIPSE_VEL_Valid.el_Vel_GPS_Valid ETCSignals.ES900.ES910.CAN2.CAN2.AP_ELLIPSE_VEL_Valid.el_Vel_EKF_Valid /end REF_MEASUREMENT
/end GROUP
/begin GROUP ETCSignals.ES900.ES910.CAN2.CAN2.MEAS_ETAS_Inverter_R_Data ""
 /begin REF_MEASUREMENT ETCSignals.ES900.ES910.CAN2.CAN2.MEAS_ETAS_Inverter_R_Data.Inv_R_TempMotor ETCSignals.ES900.ES910.CAN2.CAN2.MEAS_ETAS_Inverter_R_Data.current_R ETCSignals.ES900.ES910.CAN2.CAN2.MEAS_ETAS_Inverter_R_Data.Inv_R_TempIGBT ETCSignals.ES900.ES910.CAN2.CAN2.MEAS_ETAS_Inverter_R_Data.RR_Vel_ms_Wheel /end REF_MEASUREMENT
 /begin REF_CHARACTERISTIC ETCSignals.ES900.ES910.CAN2.CAN2.MEAS_ETAS_Inverter_R_Data.Inv_R_TempMotor_calibrate ETCSignals.ES900.ES910.CAN2.CAN2.MEAS_ETAS_Inverter_R_Data.current_R_calibrate ETCSignals.ES900.ES910.CAN2.CAN2.MEAS_ETAS_Inverter_R_Data.Inv_R_TempIGBT_calibrate ETCSignals.ES900.ES910.CAN2.CAN2.MEAS_ETAS_Inverter_R_Data.RR_Vel_ms_Wheel_calibrate /end REF_CHARACTERISTIC
/end GROUP
/begin GROUP ETCSignals.ES900.ES910.CAN2.CAN2.MEAS_ETAS_Inverter_L_Data ""
 /begin REF_MEASUREMENT ETCSignals.ES900.ES910.CAN2.CAN2.MEAS_ETAS_Inverter_L_Data.Inv_L_TempMotor ETCSignals.ES900.ES910.CAN2.CAN2.MEAS_ETAS_Inverter_L_Data.current_L ETCSignals.ES900.ES910.CAN2.CAN2.MEAS_ETAS_Inverter_L_Data.Inv_L_TempIGBT ETCSignals.ES900.ES910.CAN2.CAN2.MEAS_ETAS_Inverter_L_Data.RL_Vel_ms_Wheel /end REF_MEASUREMENT
 /begin REF_CHARACTERISTIC ETCSignals.ES900.ES910.CAN2.CAN2.MEAS_ETAS_Inverter_L_Data.Inv_L_TempMotor_calibrate ETCSignals.ES900.ES910.CAN2.CAN2.MEAS_ETAS_Inverter_L_Data.current_L_calibrate ETCSignals.ES900.ES910.CAN2.CAN2.MEAS_ETAS_Inverter_L_Data.Inv_L_TempIGBT_calibrate ETCSignals.ES900.ES910.CAN2.CAN2.MEAS_ETAS_Inverter_L_Data.RL_Vel_ms_Wheel_calibrate /end REF_CHARACTERISTIC
/end GROUP
/begin GROUP ETCSignals.ES900.ES910.CAN2.CAN2.MEAS_ETAS_VDC_Suspe ""
 /begin REF_MEASUREMENT ETCSignals.ES900.ES910.CAN2.CAN2.MEAS_ETAS_VDC_Suspe.SUSP_R_R ETCSignals.ES900.ES910.CAN2.CAN2.MEAS_ETAS_VDC_Suspe.SUSP_R_L ETCSignals.ES900.ES910.CAN2.CAN2.MEAS_ETAS_VDC_Suspe.SUSP_F_R ETCSignals.ES900.ES910.CAN2.CAN2.MEAS_ETAS_VDC_Suspe.SUSP_F_L /end REF_MEASUREMENT
 /begin REF_CHARACTERISTIC ETCSignals.ES900.ES910.CAN2.CAN2.MEAS_ETAS_VDC_Suspe.SUSP_R_R_calibrate ETCSignals.ES900.ES910.CAN2.CAN2.MEAS_ETAS_VDC_Suspe.SUSP_R_L_calibrate ETCSignals.ES900.ES910.CAN2.CAN2.MEAS_ETAS_VDC_Suspe.SUSP_F_R_calibrate ETCSignals.ES900.ES910.CAN2.CAN2.MEAS_ETAS_VDC_Suspe.SUSP_F_L_calibrate /end REF_CHARACTERISTIC
/end GROUP
/begin GROUP ETCSignals.ES900.ES910.CAN2.CAN2.MEAS_ETAS_VDC_Tq ""
 /begin REF_MEASUREMENT ETCSignals.ES900.ES910.CAN2.CAN2.MEAS_ETAS_VDC_Tq.Throttle_Torque ETCSignals.ES900.ES910.CAN2.CAN2.MEAS_ETAS_VDC_Tq.Torque_R ETCSignals.ES900.ES910.CAN2.CAN2.MEAS_ETAS_VDC_Tq.Torque_L /end REF_MEASUREMENT
 /begin REF_CHARACTERISTIC ETCSignals.ES900.ES910.CAN2.CAN2.MEAS_ETAS_VDC_Tq.Throttle_Torque_calibrate ETCSignals.ES900.ES910.CAN2.CAN2.MEAS_ETAS_VDC_Tq.Torque_R_calibrate ETCSignals.ES900.ES910.CAN2.CAN2.MEAS_ETAS_VDC_Tq.Torque_L_calibrate /end REF_CHARACTERISTIC
/end GROUP
/begin GROUP ETCSignals.ES900.ES910.CAN2.CAN2.AP_RECU_Data ""
 /begin REF_MEASUREMENT ETCSignals.ES900.ES910.CAN2.CAN2.AP_RECU_Data.Susp_R_R_Bits ETCSignals.ES900.ES910.CAN2.CAN2.AP_RECU_Data.Susp_R_L_Bits /end REF_MEASUREMENT
/end GROUP
/begin GROUP ETCSignals.ES900.ES910.CAN2.CAN2.NM_FECU_Keep_Alive ""
 /begin REF_MEASUREMENT ETCSignals.ES900.ES910.CAN2.CAN2.NM_FECU_Keep_Alive.Front_Alive /end REF_MEASUREMENT
/end GROUP
/begin GROUP ETCSignals.ES900.ES910.CAN2.CAN2.NM_RECU_Keep_Alive ""
 /begin REF_MEASUREMENT ETCSignals.ES900.ES910.CAN2.CAN2.NM_RECU_Keep_Alive.Rear_Alive /end REF_MEASUREMENT
/end GROUP
/begin GROUP ETCSignals.ES900.ES910.CAN2.CAN2.AP_FECU_Data2 ""
 /begin REF_MEASUREMENT ETCSignals.ES900.ES910.CAN2.CAN2.AP_FECU_Data2.Pitot_Bits ETCSignals.ES900.ES910.CAN2.CAN2.AP_FECU_Data2.Susp_F_R_Bits ETCSignals.ES900.ES910.CAN2.CAN2.AP_FECU_Data2.Susp_F_L_Bits /end REF_MEASUREMENT
/end GROUP
/begin GROUP ETCSignals.ES900.ES910.CAN2.CAN2.AP_FECU_Data1 ""
 /begin REF_MEASUREMENT ETCSignals.ES900.ES910.CAN2.CAN2.AP_FECU_Data1.SteeringSensor_Bits ETCSignals.ES900.ES910.CAN2.CAN2.AP_FECU_Data1.BrakePedal_Bits ETCSignals.ES900.ES910.CAN2.CAN2.AP_FECU_Data1.APPS2_Bits ETCSignals.ES900.ES910.CAN2.CAN2.AP_FECU_Data1.APPS1_Bits /end REF_MEASUREMENT
/end GROUP
/begin GROUP ETCSignals.ES900.ES910.CAN2.CAN2.AP_ETAS_Synchronism ""
 /begin REF_MEASUREMENT ETCSignals.ES900.ES910.CAN2.CAN2.AP_ETAS_Synchronism.Sync_CAN2 /end REF_MEASUREMENT
 /begin REF_CHARACTERISTIC ETCSignals.ES900.ES910.CAN2.CAN2.AP_ETAS_Synchronism.Sync_CAN2_calibrate /end REF_CHARACTERISTIC
/end GROUP
/end MODULE
/end PROJECT
