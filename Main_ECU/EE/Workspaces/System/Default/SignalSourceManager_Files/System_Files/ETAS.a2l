ASAP2_VERSION 1 41
/begin PROJECT ETAS "Generated by ETAS from INTECRIO V4.7.0.1005 integration project"
/begin HEADER "" VERSION "" PROJECT_NO Y /end HEADER
/begin MODULE INTECRIO_MERGED "Generated by ETAS INTECRIO V4.7.0.1005 for M/C interface ETARGET"
/begin MOD_COMMON "Common definitions" BYTE_ORDER MSB_FIRST ALIGNMENT_BYTE 1 ALIGNMENT_WORD 2 ALIGNMENT_LONG 4 ALIGNMENT_FLOAT32_IEEE 4 ALIGNMENT_FLOAT64_IEEE 8 /end MOD_COMMON
/begin MEASUREMENT Torque_Control.Torque_Control_B.Abs "" FLOAT64_IEEE Torque_Control_CM_double 0 0 -1.7e+308 1.7e+308 ECU_ADDRESS 0x0 DISPLAY_IDENTIFIER Torque_Control.VDC.Abs.Abs /end MEASUREMENT
/begin MEASUREMENT Torque_Control.Torque_Control_B.BrakingwithRegenerative.sf_MATLABFunction.RegTq_RL "" FLOAT64_IEEE Torque_Control_CM_double 0 0 -1.7e+308 1.7e+308 ECU_ADDRESS 0x0 DISPLAY_IDENTIFIER Torque_Control.VDC.Vehicle_Dynamics_Control_Modes.VDC_Complete.Constraints_and_motor_to_wheel_Tq.Braking_with_Regenerative.MATLAB_Function.RegTq_RL /end MEASUREMENT
/begin MEASUREMENT Torque_Control.Torque_Control_B.BrakingwithRegenerative.sf_MATLABFunction.RegTq_RR "" FLOAT64_IEEE Torque_Control_CM_double 0 0 -1.7e+308 1.7e+308 ECU_ADDRESS 0x0 DISPLAY_IDENTIFIER Torque_Control.VDC.Vehicle_Dynamics_Control_Modes.VDC_Complete.Constraints_and_motor_to_wheel_Tq.Braking_with_Regenerative.MATLAB_Function.RegTq_RR /end MEASUREMENT
/begin MEASUREMENT Torque_Control.Torque_Control_B.BrakingwithRegenerative_b.sf_MATLABFunction.RegTq_RL "" FLOAT64_IEEE Torque_Control_CM_double 0 0 -1.7e+308 1.7e+308 ECU_ADDRESS 0x0 DISPLAY_IDENTIFIER Torque_Control.VDC.Vehicle_Dynamics_Control_Modes.VDC_without_Longitudinal.Constraints.Braking_with_Regenerative.MATLAB_Function.RegTq_RL /end MEASUREMENT
/begin MEASUREMENT Torque_Control.Torque_Control_B.BrakingwithRegenerative_b.sf_MATLABFunction.RegTq_RR "" FLOAT64_IEEE Torque_Control_CM_double 0 0 -1.7e+308 1.7e+308 ECU_ADDRESS 0x0 DISPLAY_IDENTIFIER Torque_Control.VDC.Vehicle_Dynamics_Control_Modes.VDC_without_Longitudinal.Constraints.Braking_with_Regenerative.MATLAB_Function.RegTq_RR /end MEASUREMENT
/begin MEASUREMENT Torque_Control.Torque_Control_B.Compare "" UBYTE Torque_Control_CM_boolean 0 0 0 1 ECU_ADDRESS 0x0 DISPLAY_IDENTIFIER Torque_Control.Controls_Temperature_by_limiting_Torque.temperature_SoP.Flag_Accu.Compare.Compare /end MEASUREMENT
/begin MEASUREMENT Torque_Control.Torque_Control_B.Compare_d "" UBYTE Torque_Control_CM_boolean 0 0 0 1 ECU_ADDRESS 0x0 DISPLAY_IDENTIFIER Torque_Control.Controls_Temperature_by_limiting_Torque.temperature_SoP.Flag_Inv.Compare.Compare_d /end MEASUREMENT
/begin MEASUREMENT Torque_Control.Torque_Control_B.Compare_g "" UBYTE Torque_Control_CM_boolean 0 0 0 1 ECU_ADDRESS 0x0 DISPLAY_IDENTIFIER Torque_Control.Controls_Temperature_by_limiting_Torque.temperature_SoP.Flag_Mot.Compare.Compare_g /end MEASUREMENT
/begin MEASUREMENT Torque_Control.Torque_Control_B.Constant "" FLOAT64_IEEE Torque_Control_CM_double 0 0 -1.7e+308 1.7e+308 ECU_ADDRESS 0x0 DISPLAY_IDENTIFIER Torque_Control.SAFETY_BLOCK.Compare_To_Constant.Constant.Constant /end MEASUREMENT
/begin MEASUREMENT Torque_Control.Torque_Control_B.Constant1 "" FLOAT64_IEEE Torque_Control_CM_double 0 0 -1.7e+308 1.7e+308 ECU_ADDRESS 0x0 DISPLAY_IDENTIFIER Torque_Control.power_limitation1.temperature_SoP.temperature_rise_limitator_Accu.Constant1.Constant1 /end MEASUREMENT
/begin MEASUREMENT Torque_Control.Torque_Control_B.Constant14 "" FLOAT64_IEEE Torque_Control_CM_double 0 0 -1.7e+308 1.7e+308 ECU_ADDRESS 0x0 DISPLAY_IDENTIFIER Torque_Control.Constant14.Constant14 /end MEASUREMENT
/begin MEASUREMENT Torque_Control.Torque_Control_B.Constant1_a "" FLOAT64_IEEE Torque_Control_CM_double 0 0 -1.7e+308 1.7e+308 ECU_ADDRESS 0x0 DISPLAY_IDENTIFIER Torque_Control.power_limitation1.temperature_SoP.temperature_rise_limitator_Inverters.Constant1.Constant1_a /end MEASUREMENT
/begin MEASUREMENT Torque_Control.Torque_Control_B.Constant1_b "" FLOAT64_IEEE Torque_Control_CM_double 0 0 -1.7e+308 1.7e+308 ECU_ADDRESS 0x0 DISPLAY_IDENTIFIER Torque_Control.VDC.Vehicle_Dynamics_Control_Modes.VDC_without_Longitudinal.Kamm_Circle_Lateral.Constant1.Constant1_b /end MEASUREMENT
/begin MEASUREMENT Torque_Control.Torque_Control_B.Constant1_c "" FLOAT64_IEEE Torque_Control_CM_double 0 0 -1.7e+308 1.7e+308 ECU_ADDRESS 0x0 DISPLAY_IDENTIFIER Torque_Control.Controls_Temperature_by_limiting_Torque.temperature_SoP.temperature_rise_limitator_Motors.Constant1.Constant1_c /end MEASUREMENT
/begin MEASUREMENT Torque_Control.Torque_Control_B.Constant1_d "" FLOAT64_IEEE Torque_Control_CM_double 0 0 -1.7e+308 1.7e+308 ECU_ADDRESS 0x0 DISPLAY_IDENTIFIER Torque_Control.Controls_Temperature_by_limiting_Torque.temperature_SoP.temperature_rise_limitator_Inverters.Constant1.Constant1_d /end MEASUREMENT
/begin MEASUREMENT Torque_Control.Torque_Control_B.Constant1_h "" FLOAT64_IEEE Torque_Control_CM_double 0 0 -1.7e+308 1.7e+308 ECU_ADDRESS 0x0 DISPLAY_IDENTIFIER Torque_Control.power_limitation1.temperature_SoP.temperature_rise_limitator_Motors.Constant1.Constant1_h /end MEASUREMENT
/begin MEASUREMENT Torque_Control.Torque_Control_B.Constant1_i "" FLOAT64_IEEE Torque_Control_CM_double 0 0 -1.7e+308 1.7e+308 ECU_ADDRESS 0x0 DISPLAY_IDENTIFIER Torque_Control.VDC.Vehicle_Dynamics_Control_Modes.VDC_Complete.Wheel_to_motor.Constant1.Constant1_i /end MEASUREMENT
/begin MEASUREMENT Torque_Control.Torque_Control_B.Constant1_j "" FLOAT64_IEEE Torque_Control_CM_double 0 0 -1.7e+308 1.7e+308 ECU_ADDRESS 0x0 DISPLAY_IDENTIFIER Torque_Control.VDC.Vehicle_Dynamics_Control_Modes.VDC_Complete.In_Numbers.Constant1.Constant1_j /end MEASUREMENT
/begin MEASUREMENT Torque_Control.Torque_Control_B.Constant1_k "" FLOAT64_IEEE Torque_Control_CM_double 0 0 -1.7e+308 1.7e+308 ECU_ADDRESS 0x0 DISPLAY_IDENTIFIER Torque_Control.VDC.Vehicle_Dynamics_Control_Modes.VDC_without_Longitudinal.Force_to_Tq.Constant1.Constant1_k /end MEASUREMENT
/begin MEASUREMENT Torque_Control.Torque_Control_B.Constant1_l "" FLOAT64_IEEE Torque_Control_CM_double 0 0 -1.7e+308 1.7e+308 ECU_ADDRESS 0x0 DISPLAY_IDENTIFIER Torque_Control.Controls_Temperature_by_limiting_Torque.temperature_SoP.temperature_rise_limitator_Accu.Constant1.Constant1_l /end MEASUREMENT
/begin MEASUREMENT Torque_Control.Torque_Control_B.Constant2 "" FLOAT64_IEEE Torque_Control_CM_double 0 0 -1.7e+308 1.7e+308 ECU_ADDRESS 0x0 DISPLAY_IDENTIFIER Torque_Control.power_limitation1.temperature_SoP.temperature_rise_limitator_Accu.Constant2.Constant2 /end MEASUREMENT
/begin MEASUREMENT Torque_Control.Torque_Control_B.Constant2_k "" FLOAT64_IEEE Torque_Control_CM_double 0 0 -1.7e+308 1.7e+308 ECU_ADDRESS 0x0 DISPLAY_IDENTIFIER Torque_Control.Controls_Temperature_by_limiting_Torque.temperature_SoP.temperature_rise_limitator_Inverters.Constant2.Constant2_k /end MEASUREMENT
/begin MEASUREMENT Torque_Control.Torque_Control_B.Constant2_m "" FLOAT64_IEEE Torque_Control_CM_double 0 0 -1.7e+308 1.7e+308 ECU_ADDRESS 0x0 DISPLAY_IDENTIFIER Torque_Control.Controls_Temperature_by_limiting_Torque.temperature_SoP.temperature_rise_limitator_Motors.Constant2.Constant2_m /end MEASUREMENT
/begin MEASUREMENT Torque_Control.Torque_Control_B.Constant2_n "" FLOAT64_IEEE Torque_Control_CM_double 0 0 -1.7e+308 1.7e+308 ECU_ADDRESS 0x0 DISPLAY_IDENTIFIER Torque_Control.Controls_Temperature_by_limiting_Torque.temperature_SoP.temperature_rise_limitator_Accu.Constant2.Constant2_n /end MEASUREMENT
/begin MEASUREMENT Torque_Control.Torque_Control_B.Constant2_p "" FLOAT64_IEEE Torque_Control_CM_double 0 0 -1.7e+308 1.7e+308 ECU_ADDRESS 0x0 DISPLAY_IDENTIFIER Torque_Control.power_limitation1.temperature_SoP.temperature_rise_limitator_Inverters.Constant2.Constant2_p /end MEASUREMENT
/begin MEASUREMENT Torque_Control.Torque_Control_B.Constant2_pf "" FLOAT64_IEEE Torque_Control_CM_double 0 0 -1.7e+308 1.7e+308 ECU_ADDRESS 0x0 DISPLAY_IDENTIFIER Torque_Control.power_limitation1.temperature_SoP.temperature_rise_limitator_Motors.Constant2.Constant2_pf /end MEASUREMENT
/begin MEASUREMENT Torque_Control.Torque_Control_B.Constant3 "" FLOAT64_IEEE Torque_Control_CM_double 0 0 -1.7e+308 1.7e+308 ECU_ADDRESS 0x0 DISPLAY_IDENTIFIER Torque_Control.power_limitation1.temperature_SoP.temperature_rise_limitator_Accu.Constant3.Constant3 /end MEASUREMENT
/begin MEASUREMENT Torque_Control.Torque_Control_B.Constant3_b "" FLOAT64_IEEE Torque_Control_CM_double 0 0 -1.7e+308 1.7e+308 ECU_ADDRESS 0x0 DISPLAY_IDENTIFIER Torque_Control.VDC.Vehicle_Dynamics_Control_Modes.VDC_Complete.Lateral_Dynamics.Constant3.Constant3_b /end MEASUREMENT
/begin MEASUREMENT Torque_Control.Torque_Control_B.Constant3_e "" FLOAT64_IEEE Torque_Control_CM_double 0 0 -1.7e+308 1.7e+308 ECU_ADDRESS 0x0 DISPLAY_IDENTIFIER Torque_Control.VDC.Vehicle_Dynamics_Control_Modes.VDC_Complete.Longitudinal_Dynamics.Constant3.Constant3_e /end MEASUREMENT
/begin MEASUREMENT Torque_Control.Torque_Control_B.Constant3_f "" FLOAT64_IEEE Torque_Control_CM_double 0 0 -1.7e+308 1.7e+308 ECU_ADDRESS 0x0 DISPLAY_IDENTIFIER Torque_Control.power_limitation1.temperature_SoP.temperature_rise_limitator_Motors.Constant3.Constant3_f /end MEASUREMENT
/begin MEASUREMENT Torque_Control.Torque_Control_B.Constant3_i "" FLOAT64_IEEE Torque_Control_CM_double 0 0 -1.7e+308 1.7e+308 ECU_ADDRESS 0x0 DISPLAY_IDENTIFIER Torque_Control.power_limitation1.temperature_SoP.temperature_rise_limitator_Inverters.Constant3.Constant3_i /end MEASUREMENT
/begin MEASUREMENT Torque_Control.Torque_Control_B.Constant3_it "" FLOAT64_IEEE Torque_Control_CM_double 0 0 -1.7e+308 1.7e+308 ECU_ADDRESS 0x0 DISPLAY_IDENTIFIER Torque_Control.Controls_Temperature_by_limiting_Torque.temperature_SoP.temperature_rise_limitator_Motors.Constant3.Constant3_it /end MEASUREMENT
/begin MEASUREMENT Torque_Control.Torque_Control_B.Constant3_n "" FLOAT64_IEEE Torque_Control_CM_double 0 0 -1.7e+308 1.7e+308 ECU_ADDRESS 0x0 DISPLAY_IDENTIFIER Torque_Control.Controls_Temperature_by_limiting_Torque.temperature_SoP.temperature_rise_limitator_Inverters.Constant3.Constant3_n /end MEASUREMENT
/begin MEASUREMENT Torque_Control.Torque_Control_B.Constant3_o "" FLOAT64_IEEE Torque_Control_CM_double 0 0 -1.7e+308 1.7e+308 ECU_ADDRESS 0x0 DISPLAY_IDENTIFIER Torque_Control.Controls_Temperature_by_limiting_Torque.temperature_SoP.temperature_rise_limitator_Accu.Constant3.Constant3_o /end MEASUREMENT
/begin MEASUREMENT Torque_Control.Torque_Control_B.Constant4 "" FLOAT64_IEEE Torque_Control_CM_double 0 0 -1.7e+308 1.7e+308 ECU_ADDRESS 0x0 DISPLAY_IDENTIFIER Torque_Control.VDC.Vehicle_Dynamics_Control_Modes.VDC_Complete.Lateral_Dynamics.Constant4.Constant4 /end MEASUREMENT
/begin MEASUREMENT Torque_Control.Torque_Control_B.Constant4_m "" FLOAT64_IEEE Torque_Control_CM_double 0 0 -1.7e+308 1.7e+308 ECU_ADDRESS 0x0 DISPLAY_IDENTIFIER Torque_Control.VDC.Vehicle_Dynamics_Control_Modes.VDC_Complete.Longitudinal_Dynamics.Constant4.Constant4_m /end MEASUREMENT
/begin MEASUREMENT Torque_Control.Torque_Control_B.Constant7 "" FLOAT64_IEEE Torque_Control_CM_double 0 0 -1.7e+308 1.7e+308 ECU_ADDRESS 0x0 DISPLAY_IDENTIFIER Torque_Control.VDC.Vehicle_Dynamics_Control_Modes.VDC_Complete.Lateral_Dynamics.Yaw_Rate_Reference.Constant7.Constant7 /end MEASUREMENT
/begin MEASUREMENT Torque_Control.Torque_Control_B.Constant8 "" FLOAT64_IEEE Torque_Control_CM_double 0 0 -1.7e+308 1.7e+308 ECU_ADDRESS 0x0 DISPLAY_IDENTIFIER Torque_Control.VDC.Vehicle_Dynamics_Control_Modes.VDC_Complete.Lateral_Dynamics.Yaw_Rate_Reference.Constant8.Constant8 /end MEASUREMENT
/begin MEASUREMENT Torque_Control.Torque_Control_B.Constant_a "" FLOAT64_IEEE Torque_Control_CM_double 0 0 -1.7e+308 1.7e+308 ECU_ADDRESS 0x0 DISPLAY_IDENTIFIER Torque_Control.power_limitation1.temperature_SoP.temperature_rise_limitator_Inverters.Temp_higher_than_50.Constant.Constant_a /end MEASUREMENT
/begin MEASUREMENT Torque_Control.Torque_Control_B.Constant_aq "" FLOAT64_IEEE Torque_Control_CM_double 0 0 -1.7e+308 1.7e+308 ECU_ADDRESS 0x0 DISPLAY_IDENTIFIER Torque_Control.VDC.Vehicle_Dynamics_Control_Modes.Constant.Constant_aq /end MEASUREMENT
/begin MEASUREMENT Torque_Control.Torque_Control_B.Constant_b "" FLOAT64_IEEE Torque_Control_CM_double 0 0 -1.7e+308 1.7e+308 ECU_ADDRESS 0x0 DISPLAY_IDENTIFIER Torque_Control.power_limitation1.temperature_SoP.temperature_rise_limitator_Accu.Temp_higher_than_50.Constant.Constant_b /end MEASUREMENT
/begin MEASUREMENT Torque_Control.Torque_Control_B.Constant_bb "" FLOAT64_IEEE Torque_Control_CM_double 0 0 -1.7e+308 1.7e+308 ECU_ADDRESS 0x0 DISPLAY_IDENTIFIER Torque_Control.VDC.Vehicle_Dynamics_Control_Modes.VDC_Complete.Wheel_to_motor.Constant.Constant_bb /end MEASUREMENT
/begin MEASUREMENT Torque_Control.Torque_Control_B.Constant_bc "" FLOAT64_IEEE Torque_Control_CM_double 0 0 -1.7e+308 1.7e+308 ECU_ADDRESS 0x0 DISPLAY_IDENTIFIER Torque_Control.power_limitation1.temperature_SoP.Flag_Mot.Constant.Constant_bc /end MEASUREMENT
/begin MEASUREMENT Torque_Control.Torque_Control_B.Constant_c "" FLOAT64_IEEE Torque_Control_CM_double 0 0 -1.7e+308 1.7e+308 ECU_ADDRESS 0x0 DISPLAY_IDENTIFIER Torque_Control.VDC.Vehicle_Dynamics_Control_Modes.VDC_Complete.Constraints_and_motor_to_wheel_Tq.Acelerating_and_braking_without_Regenerative.Constant.Constant_c /end MEASUREMENT
/begin MEASUREMENT Torque_Control.Torque_Control_B.Constant_d "" FLOAT64_IEEE Torque_Control_CM_double 0 0 -1.7e+308 1.7e+308 ECU_ADDRESS 0x0 DISPLAY_IDENTIFIER Torque_Control.power_limitation1.temperature_SoP.temperature_rise_limitator_Motors.Temp_higher_than_110.Constant.Constant_d /end MEASUREMENT
/begin MEASUREMENT Torque_Control.Torque_Control_B.Constant_dd "" FLOAT64_IEEE Torque_Control_CM_double 0 0 -1.7e+308 1.7e+308 ECU_ADDRESS 0x0 DISPLAY_IDENTIFIER Torque_Control.VDC.Vehicle_Dynamics_Control_Modes.VDC_without_Longitudinal.Kamm_Circle_Lateral.Constant.Constant_dd /end MEASUREMENT
/begin MEASUREMENT Torque_Control.Torque_Control_B.Constant_do "" FLOAT64_IEEE Torque_Control_CM_double 0 0 -1.7e+308 1.7e+308 ECU_ADDRESS 0x0 DISPLAY_IDENTIFIER Torque_Control.power_limitation1.temperature_SoP.Flag_Inv.Constant.Constant_do /end MEASUREMENT
/begin MEASUREMENT Torque_Control.Torque_Control_B.Constant_du "" FLOAT64_IEEE Torque_Control_CM_double 0 0 -1.7e+308 1.7e+308 ECU_ADDRESS 0x0 DISPLAY_IDENTIFIER Torque_Control.VDC.Vehicle_Dynamics_Control_Modes.Steering_TV_with_TC.Optimization_SKF__amp__CKF.Subsystem.SKF.Spin.Constant.Constant_du /end MEASUREMENT
/begin MEASUREMENT Torque_Control.Torque_Control_B.Constant_dw "" FLOAT64_IEEE Torque_Control_CM_double 0 0 -1.7e+308 1.7e+308 ECU_ADDRESS 0x0 DISPLAY_IDENTIFIER Torque_Control.VDC.Vehicle_Dynamics_Control_Modes.VDC_Complete.Optimization_SKF__amp__CKF.Subsystem.CKF.Spin.Constant.Constant_dw /end MEASUREMENT
/begin MEASUREMENT Torque_Control.Torque_Control_B.Constant_e "" FLOAT64_IEEE Torque_Control_CM_double 0 0 -1.7e+308 1.7e+308 ECU_ADDRESS 0x0 DISPLAY_IDENTIFIER Torque_Control.VDC.Vehicle_Dynamics_Control_Modes.VDC_without_Longitudinal.Force_to_Tq.Constant.Constant_e /end MEASUREMENT
/begin MEASUREMENT Torque_Control.Torque_Control_B.Constant_f "" FLOAT64_IEEE Torque_Control_CM_double 0 0 -1.7e+308 1.7e+308 ECU_ADDRESS 0x0 DISPLAY_IDENTIFIER Torque_Control.VDC.Vehicle_Dynamics_Control_Modes.VDC_without_Longitudinal.Optimization_SKF__amp__CKF.Subsystem.CKF.Spin.Constant.Constant_f /end MEASUREMENT
/begin MEASUREMENT Torque_Control.Torque_Control_B.Constant_g "" FLOAT64_IEEE Torque_Control_CM_double 0 0 -1.7e+308 1.7e+308 ECU_ADDRESS 0x0 DISPLAY_IDENTIFIER Torque_Control.Controls_Temperature_by_limiting_Torque.temperature_SoP.temperature_rise_limitator_Accu.Temp_higher_than_50.Constant.Constant_g /end MEASUREMENT
/begin MEASUREMENT Torque_Control.Torque_Control_B.Constant_i "" FLOAT64_IEEE Torque_Control_CM_double 0 0 -1.7e+308 1.7e+308 ECU_ADDRESS 0x0 DISPLAY_IDENTIFIER Torque_Control.Pumps_Controller.Compare_To_Constant.Constant.Constant_i /end MEASUREMENT
/begin MEASUREMENT Torque_Control.Torque_Control_B.Constant_j "" FLOAT64_IEEE Torque_Control_CM_double 0 0 -1.7e+308 1.7e+308 ECU_ADDRESS 0x0 DISPLAY_IDENTIFIER Torque_Control.power_limitation1.temperature_SoP.Flag_Accu.Constant.Constant_j /end MEASUREMENT
/begin MEASUREMENT Torque_Control.Torque_Control_B.Constant_j3 "" FLOAT64_IEEE Torque_Control_CM_double 0 0 -1.7e+308 1.7e+308 ECU_ADDRESS 0x0 DISPLAY_IDENTIFIER Torque_Control.Controls_Temperature_by_limiting_Torque.temperature_SoP.temperature_rise_limitator_Inverters.Temp_higher_than_50.Constant.Constant_j3 /end MEASUREMENT
/begin MEASUREMENT Torque_Control.Torque_Control_B.Constant_jv "" FLOAT64_IEEE Torque_Control_CM_double 0 0 -1.7e+308 1.7e+308 ECU_ADDRESS 0x0 DISPLAY_IDENTIFIER Torque_Control.Controls_Temperature_by_limiting_Torque.temperature_SoP.Flag_Accu.Constant.Constant_jv /end MEASUREMENT
/begin MEASUREMENT Torque_Control.Torque_Control_B.Constant_k "" FLOAT64_IEEE Torque_Control_CM_double 0 0 -1.7e+308 1.7e+308 ECU_ADDRESS 0x0 DISPLAY_IDENTIFIER Torque_Control.VDC.Vehicle_Dynamics_Control_Modes.VDC_Complete.Optimization_SKF__amp__CKF.Subsystem.SKF.Spin.Constant.Constant_k /end MEASUREMENT
/begin MEASUREMENT Torque_Control.Torque_Control_B.Constant_kc "" FLOAT64_IEEE Torque_Control_CM_double 0 0 -1.7e+308 1.7e+308 ECU_ADDRESS 0x0 DISPLAY_IDENTIFIER Torque_Control.Controls_Temperature_by_limiting_Torque.temperature_SoP.Flag_Mot.Constant.Constant_kc /end MEASUREMENT
/begin MEASUREMENT Torque_Control.Torque_Control_B.Constant_m "" FLOAT64_IEEE Torque_Control_CM_double 0 0 -1.7e+308 1.7e+308 ECU_ADDRESS 0x0 DISPLAY_IDENTIFIER Torque_Control.VDC.WORKSHOP_MODE_RESTRICTIONS.Torque_Reduction.Constant.Constant_m /end MEASUREMENT
/begin MEASUREMENT Torque_Control.Torque_Control_B.Constant_mf "" FLOAT64_IEEE Torque_Control_CM_double 0 0 -1.7e+308 1.7e+308 ECU_ADDRESS 0x0 DISPLAY_IDENTIFIER Torque_Control.VDC.Vehicle_Dynamics_Control_Modes.VDC_Complete.Longitudinal_Dynamics.Constant.Constant_mf /end MEASUREMENT
/begin MEASUREMENT Torque_Control.Torque_Control_B.Constant_mu "" FLOAT64_IEEE Torque_Control_CM_double 0 0 -1.7e+308 1.7e+308 ECU_ADDRESS 0x0 DISPLAY_IDENTIFIER Torque_Control.Controls_Temperature_by_limiting_Torque.temperature_SoP.temperature_rise_limitator_Motors.Temp_higher_than_110.Constant.Constant_mu /end MEASUREMENT
/begin MEASUREMENT Torque_Control.Torque_Control_B.Constant_n "" FLOAT64_IEEE Torque_Control_CM_double 0 0 -1.7e+308 1.7e+308 ECU_ADDRESS 0x0 DISPLAY_IDENTIFIER Torque_Control.Pumps_Controller.Compare_To_Constant1.Constant.Constant_n /end MEASUREMENT
/begin MEASUREMENT Torque_Control.Torque_Control_B.Constant_o "" FLOAT64_IEEE Torque_Control_CM_double 0 0 -1.7e+308 1.7e+308 ECU_ADDRESS 0x0 DISPLAY_IDENTIFIER Torque_Control.VDC.Regeneration_Enable.Constant.Constant_o /end MEASUREMENT
/begin MEASUREMENT Torque_Control.Torque_Control_B.Constant_o4 "" FLOAT64_IEEE Torque_Control_CM_double 0 0 -1.7e+308 1.7e+308 ECU_ADDRESS 0x0 DISPLAY_IDENTIFIER Torque_Control.Controls_Temperature_by_limiting_Torque.temperature_SoP.Flag_Inv.Constant.Constant_o4 /end MEASUREMENT
/begin MEASUREMENT Torque_Control.Torque_Control_B.Constant_ob "" FLOAT64_IEEE Torque_Control_CM_double 0 0 -1.7e+308 1.7e+308 ECU_ADDRESS 0x0 DISPLAY_IDENTIFIER Torque_Control.VDC.Vehicle_Dynamics_Control_Modes.Steering_TV_with_TC.Optimization_SKF__amp__CKF.Subsystem.CKF.Spin.Constant.Constant_ob /end MEASUREMENT
/begin MEASUREMENT Torque_Control.Torque_Control_B.Constant_p "" FLOAT64_IEEE Torque_Control_CM_double 0 0 -1.7e+308 1.7e+308 ECU_ADDRESS 0x0 DISPLAY_IDENTIFIER Torque_Control.VDC.Vehicle_Dynamics_Control_Modes.VDC_Complete.Constant.Constant_p /end MEASUREMENT
/begin MEASUREMENT Torque_Control.Torque_Control_B.Divide "" FLOAT64_IEEE Torque_Control_CM_double 0 0 -1.7e+308 1.7e+308 ECU_ADDRESS 0x0 DISPLAY_IDENTIFIER Torque_Control.VDC.Vehicle_Dynamics_Control_Modes.VDC_Complete.Wheel_to_motor.Fx_to_engineTqRR.Divide.Divide /end MEASUREMENT
/begin MEASUREMENT Torque_Control.Torque_Control_B.Divide1 "" FLOAT64_IEEE Torque_Control_CM_double 0 0 -1.7e+308 1.7e+308 ECU_ADDRESS 0x0 DISPLAY_IDENTIFIER Torque_Control.VDC.Vehicle_Dynamics_Control_Modes.VDC_Complete.Lateral_Dynamics.Tire_Longitudinal_Force_Difference.Momentum_Z_to_Longitudinal_Force_Difference.Divide1.Divide1 /end MEASUREMENT
/begin MEASUREMENT Torque_Control.Torque_Control_B.Divide_i "" FLOAT64_IEEE Torque_Control_CM_double 0 0 -1.7e+308 1.7e+308 ECU_ADDRESS 0x0 DISPLAY_IDENTIFIER Torque_Control.VDC.Vehicle_Dynamics_Control_Modes.VDC_Complete.Wheel_to_motor.Fx_to_engineTqRL.Divide.Divide_i /end MEASUREMENT
/begin MEASUREMENT Torque_Control.Torque_Control_B.Enabled_a "" FLOAT64_IEEE Torque_Control_CM_double 0 0 -1.7e+308 1.7e+308 ECU_ADDRESS 0x0 DISPLAY_IDENTIFIER Torque_Control.VDC.Regeneration_Enable.Enabled.Enabled_a /end MEASUREMENT
/begin MEASUREMENT Torque_Control.Torque_Control_B.Gain "" FLOAT64_IEEE Torque_Control_CM_double 0 0 -1.7e+308 1.7e+308 ECU_ADDRESS 0x0 DISPLAY_IDENTIFIER Torque_Control.VDC.Vehicle_Dynamics_Control_Modes.Gain.Gain /end MEASUREMENT
/begin MEASUREMENT Torque_Control.Torque_Control_B.GearRatio "" FLOAT64_IEEE Torque_Control_CM_double 0 0 -1.7e+308 1.7e+308 ECU_ADDRESS 0x0 DISPLAY_IDENTIFIER Torque_Control.Gear_Ratio.GearRatio /end MEASUREMENT
/begin MEASUREMENT Torque_Control.Torque_Control_B.LogicalOperator "" UBYTE Torque_Control_CM_boolean 0 0 0 1 ECU_ADDRESS 0x0 DISPLAY_IDENTIFIER Torque_Control.SAFETY_BLOCK.Logical_Operator.LogicalOperator /end MEASUREMENT
/begin MEASUREMENT Torque_Control.Torque_Control_B.LogicalOperator1 "" UBYTE Torque_Control_CM_boolean 0 0 0 1 ECU_ADDRESS 0x0 DISPLAY_IDENTIFIER Torque_Control.SAFETY_BLOCK.BRAKE_IMPLAUSIBILITY.Logical_Operator1.LogicalOperator1 /end MEASUREMENT
/begin MEASUREMENT Torque_Control.Torque_Control_B.Lookup_SoC_SoP_chg "" FLOAT64_IEEE Torque_Control_CM_double 0 0 -1.7e+308 1.7e+308 ECU_ADDRESS 0x0 DISPLAY_IDENTIFIER Torque_Control.power_limitation1.SoC_SoP.Lookup_SoC_SoP_chg.Lookup_SoC_SoP_chg /end MEASUREMENT
/begin MEASUREMENT Torque_Control.Torque_Control_B.Lookup_SoC_SoP_chg_j "" FLOAT64_IEEE Torque_Control_CM_double 0 0 -1.7e+308 1.7e+308 ECU_ADDRESS 0x0 DISPLAY_IDENTIFIER Torque_Control.Controls_Temperature_by_limiting_Torque.SoC_SoP.Lookup_SoC_SoP_chg.Lookup_SoC_SoP_chg_j /end MEASUREMENT
/begin MEASUREMENT Torque_Control.Torque_Control_B.Lookup_SoC_SoP_dischg "" FLOAT64_IEEE Torque_Control_CM_double 0 0 -1.7e+308 1.7e+308 ECU_ADDRESS 0x0 DISPLAY_IDENTIFIER Torque_Control.power_limitation1.SoC_SoP.Lookup_SoC_SoP_dischg.Lookup_SoC_SoP_dischg /end MEASUREMENT
/begin MEASUREMENT Torque_Control.Torque_Control_B.Lookup_SoC_SoP_dischg_k "" FLOAT64_IEEE Torque_Control_CM_double 0 0 -1.7e+308 1.7e+308 ECU_ADDRESS 0x0 DISPLAY_IDENTIFIER Torque_Control.Controls_Temperature_by_limiting_Torque.SoC_SoP.Lookup_SoC_SoP_dischg.Lookup_SoC_SoP_dischg_k /end MEASUREMENT
/begin MEASUREMENT Torque_Control.Torque_Control_B.MaxTqpermotorNm "" FLOAT64_IEEE Torque_Control_CM_double 0 0 -1.7e+308 1.7e+308 ECU_ADDRESS 0x0 DISPLAY_IDENTIFIER Torque_Control.Max_Tq_per_motor_[Nm].MaxTqpermotorNm /end MEASUREMENT
/begin MEASUREMENT Torque_Control.Torque_Control_B.Max_Power_chargekW "" FLOAT64_IEEE Torque_Control_CM_double 0 0 -1.7e+308 1.7e+308 ECU_ADDRESS 0x0 DISPLAY_IDENTIFIER Torque_Control.Power_limitation.Max_Power_charge_[kW].Max_Power_chargekW /end MEASUREMENT
/begin MEASUREMENT Torque_Control.Torque_Control_B.Max_Power_dischargekW "" FLOAT64_IEEE Torque_Control_CM_double 0 0 -1.7e+308 1.7e+308 ECU_ADDRESS 0x0 DISPLAY_IDENTIFIER Torque_Control.Power_limitation.Max_Power_discharge_[kW].Max_Power_dischargekW /end MEASUREMENT
/begin MEASUREMENT Torque_Control.Torque_Control_B.Max_Tq_per_motor "" FLOAT64_IEEE Torque_Control_CM_double 0 0 -1.7e+308 1.7e+308 ECU_ADDRESS 0x0 DISPLAY_IDENTIFIER Torque_Control.Controls_Temperature_by_limiting_Torque.Max_Tq_per_motor.Max_Tq_per_motor /end MEASUREMENT
/begin MEASUREMENT Torque_Control.Torque_Control_B.MaximumTorqueperengineNm "" FLOAT64_IEEE Torque_Control_CM_double 0 0 -1.7e+308 1.7e+308 ECU_ADDRESS 0x0 DISPLAY_IDENTIFIER Torque_Control.VDC.Vehicle_Dynamics_Control_Modes.VDC_Complete.In_Numbers.Maximum_Torque_per_engine_[Nm].MaximumTorqueperengineNm /end MEASUREMENT
/begin MEASUREMENT Torque_Control.Torque_Control_B.MaximumTransmissionTorqueDynami "" FLOAT64_IEEE Torque_Control_CM_double 0 0 -1.7e+308 1.7e+308 ECU_ADDRESS 0x0 DISPLAY_IDENTIFIER Torque_Control.VDC.Vehicle_Dynamics_Control_Modes.VDC_Complete.In_Numbers.Maximum_Transmission_Torque_Dynamic_[Nm].MaximumTransmissionTorqueDynami /end MEASUREMENT
/begin MEASUREMENT Torque_Control.Torque_Control_B.MaximumTransmissionTorqueStatic "" FLOAT64_IEEE Torque_Control_CM_double 0 0 -1.7e+308 1.7e+308 ECU_ADDRESS 0x0 DISPLAY_IDENTIFIER Torque_Control.VDC.Vehicle_Dynamics_Control_Modes.VDC_Complete.In_Numbers.Maximum_Transmission_Torque_Static_[Nm].MaximumTransmissionTorqueStatic /end MEASUREMENT
/begin MEASUREMENT Torque_Control.Torque_Control_B.Merge "" FLOAT64_IEEE Torque_Control_CM_double 0 0 -1.7e+308 1.7e+308 ECU_ADDRESS 0x0 DISPLAY_IDENTIFIER Torque_Control.VDC.TEST_MODE_IN.Merge.Merge /end MEASUREMENT
/begin MEASUREMENT Torque_Control.Torque_Control_B.Merge1 "" FLOAT64_IEEE Torque_Control_CM_double 0 0 -1.7e+308 1.7e+308 ECU_ADDRESS 0x0 DISPLAY_IDENTIFIER Torque_Control.VDC.TEST_MODE_IN.Merge1.Merge1 /end MEASUREMENT
/begin MEASUREMENT Torque_Control.Torque_Control_B.Merge1_a "" FLOAT64_IEEE Torque_Control_CM_double 0 0 -1.7e+308 1.7e+308 ECU_ADDRESS 0x0 DISPLAY_IDENTIFIER Torque_Control.VDC.Regeneration_Enable.Merge1.Merge1_a /end MEASUREMENT
/begin MEASUREMENT Torque_Control.Torque_Control_B.Merge1_a0 "" FLOAT64_IEEE Torque_Control_CM_double 0 0 -1.7e+308 1.7e+308 ECU_ADDRESS 0x0 DISPLAY_IDENTIFIER Torque_Control.Merge1.Merge1_a0 /end MEASUREMENT
/begin MEASUREMENT Torque_Control.Torque_Control_B.Merge1_b "" FLOAT64_IEEE Torque_Control_CM_double 0 0 -1.7e+308 1.7e+308 ECU_ADDRESS 0x0 DISPLAY_IDENTIFIER Torque_Control.VDC.Vehicle_Dynamics_Control_Modes.VDC_Complete.Driver____CarBehaviours.Merge1.Merge1_b /end MEASUREMENT
/begin MEASUREMENT Torque_Control.Torque_Control_B.Merge1_l "" FLOAT64_IEEE Torque_Control_CM_double 0 0 -1.7e+308 1.7e+308 ECU_ADDRESS 0x0 DISPLAY_IDENTIFIER Torque_Control.VDC.Vehicle_Dynamics_Control_Modes.VDC_without_Longitudinal.Driver____CarBehaviours.Merge1.Merge1_l /end MEASUREMENT
/begin MEASUREMENT Torque_Control.Torque_Control_B.Merge1_n "" FLOAT64_IEEE Torque_Control_CM_double 0 0 -1.7e+308 1.7e+308 ECU_ADDRESS 0x0 DISPLAY_IDENTIFIER Torque_Control.VDC.Vehicle_Dynamics_Control_Modes.VDC_Complete.Merge1.Merge1_n /end MEASUREMENT
/begin MEASUREMENT Torque_Control.Torque_Control_B.Merge1_p "" FLOAT64_IEEE Torque_Control_CM_double 0 0 -1.7e+308 1.7e+308 ECU_ADDRESS 0x0 DISPLAY_IDENTIFIER Torque_Control.VDC.Vehicle_Dynamics_Control_Modes.Steering_TV_with_TC.Accelerating__Braking_or_Regen_Braking.Merge1.Merge1_p /end MEASUREMENT
/begin MEASUREMENT Torque_Control.Torque_Control_B.Merge1_pg "" FLOAT64_IEEE Torque_Control_CM_double 0 0 -1.7e+308 1.7e+308 ECU_ADDRESS 0x0 DISPLAY_IDENTIFIER Torque_Control.Accumulator_Power.PowerLimitDetection.Merge1.Merge1_pg /end MEASUREMENT
/begin MEASUREMENT Torque_Control.Torque_Control_B.Merge2 "" FLOAT64_IEEE Torque_Control_CM_double 0 0 -1.7e+308 1.7e+308 ECU_ADDRESS 0x0 DISPLAY_IDENTIFIER Torque_Control.VDC.TEST_MODE_IN.Merge2.Merge2 /end MEASUREMENT
/begin MEASUREMENT Torque_Control.Torque_Control_B.Merge2_e "" FLOAT64_IEEE Torque_Control_CM_double 0 0 -1.7e+308 1.7e+308 ECU_ADDRESS 0x0 DISPLAY_IDENTIFIER Torque_Control.Merge2.Merge2_e /end MEASUREMENT
/begin MEASUREMENT Torque_Control.Torque_Control_B.Merge2_j "" FLOAT64_IEEE Torque_Control_CM_double 0 0 -1.7e+308 1.7e+308 ECU_ADDRESS 0x0 DISPLAY_IDENTIFIER Torque_Control.VDC.Vehicle_Dynamics_Control_Modes.VDC_Complete.Constraints_and_motor_to_wheel_Tq.Acelerating_and_braking_without_Regenerative.Merge2.Merge2_j /end MEASUREMENT
/begin MEASUREMENT Torque_Control.Torque_Control_B.Merge2_l "" FLOAT64_IEEE Torque_Control_CM_double 0 0 -1.7e+308 1.7e+308 ECU_ADDRESS 0x0 DISPLAY_IDENTIFIER Torque_Control.VDC.Vehicle_Dynamics_Control_Modes.Merge2.Merge2_l /end MEASUREMENT
/begin MEASUREMENT Torque_Control.Torque_Control_B.Merge2_lx "" FLOAT64_IEEE Torque_Control_CM_double 0 0 -1.7e+308 1.7e+308 ECU_ADDRESS 0x0 DISPLAY_IDENTIFIER Torque_Control.VDC.Vehicle_Dynamics_Control_Modes.VDC_Complete.Merge2.Merge2_lx /end MEASUREMENT
/begin MEASUREMENT Torque_Control.Torque_Control_B.Merge2_o "" FLOAT64_IEEE Torque_Control_CM_double 0 0 -1.7e+308 1.7e+308 ECU_ADDRESS 0x0 DISPLAY_IDENTIFIER Torque_Control.VDC.Vehicle_Dynamics_Control_Modes.VDC_without_Longitudinal.Constraints.Acelerating_and_braking_without_Regenerative.Merge2.Merge2_o /end MEASUREMENT
/begin MEASUREMENT Torque_Control.Torque_Control_B.Merge3 "" FLOAT64_IEEE Torque_Control_CM_double 0 0 -1.7e+308 1.7e+308 ECU_ADDRESS 0x0 DISPLAY_IDENTIFIER Torque_Control.VDC.TEST_MODE_IN.Merge3.Merge3 /end MEASUREMENT
/begin MEASUREMENT Torque_Control.Torque_Control_B.Merge3_c "" FLOAT64_IEEE Torque_Control_CM_double 0 0 -1.7e+308 1.7e+308 ECU_ADDRESS 0x0 DISPLAY_IDENTIFIER Torque_Control.VDC.Vehicle_Dynamics_Control_Modes.Merge3.Merge3_c /end MEASUREMENT
/begin MEASUREMENT Torque_Control.Torque_Control_B.Merge3_e "" FLOAT64_IEEE Torque_Control_CM_double 0 0 -1.7e+308 1.7e+308 ECU_ADDRESS 0x0 DISPLAY_IDENTIFIER Torque_Control.VDC.Vehicle_Dynamics_Control_Modes.VDC_Complete.Merge3.Merge3_e /end MEASUREMENT
/begin MEASUREMENT Torque_Control.Torque_Control_B.Merge4 "" FLOAT64_IEEE Torque_Control_CM_double 0 0 -1.7e+308 1.7e+308 ECU_ADDRESS 0x0 DISPLAY_IDENTIFIER Torque_Control.VDC.Vehicle_Dynamics_Control_Modes.VDC_Complete.Merge4.Merge4 /end MEASUREMENT
/begin MEASUREMENT Torque_Control.Torque_Control_B.Merge5 "" FLOAT64_IEEE Torque_Control_CM_double 0 0 -1.7e+308 1.7e+308 ECU_ADDRESS 0x0 DISPLAY_IDENTIFIER Torque_Control.SAFETY_BLOCK.BRAKE_IMPLAUSIBILITY.Merge5.Merge5 /end MEASUREMENT
/begin MEASUREMENT Torque_Control.Torque_Control_B.Merge5_e "" FLOAT64_IEEE Torque_Control_CM_double 0 0 -1.7e+308 1.7e+308 ECU_ADDRESS 0x0 DISPLAY_IDENTIFIER Torque_Control.VDC.Vehicle_Dynamics_Control_Modes.VDC_Complete.Merge5.Merge5_e /end MEASUREMENT
/begin MEASUREMENT Torque_Control.Torque_Control_B.Merge6 "" FLOAT64_IEEE Torque_Control_CM_double 0 0 -1.7e+308 1.7e+308 ECU_ADDRESS 0x0 DISPLAY_IDENTIFIER Torque_Control.VDC.Vehicle_Dynamics_Control_Modes.VDC_Complete.Merge6.Merge6 /end MEASUREMENT
/begin MEASUREMENT Torque_Control.Torque_Control_B.Merge7 "" FLOAT64_IEEE Torque_Control_CM_double 0 0 -1.7e+308 1.7e+308 ECU_ADDRESS 0x0 DISPLAY_IDENTIFIER Torque_Control.VDC.Vehicle_Dynamics_Control_Modes.VDC_Complete.Merge7.Merge7 /end MEASUREMENT
/begin MEASUREMENT Torque_Control.Torque_Control_B.MergeTq_RL "" FLOAT64_IEEE Torque_Control_CM_double 0 0 -1.7e+308 1.7e+308 ECU_ADDRESS 0x0 DISPLAY_IDENTIFIER Torque_Control.VDC.Vehicle_Dynamics_Control_Modes.Merge_Tq_RL.MergeTq_RL /end MEASUREMENT
/begin MEASUREMENT Torque_Control.Torque_Control_B.MergeTq_RR "" FLOAT64_IEEE Torque_Control_CM_double 0 0 -1.7e+308 1.7e+308 ECU_ADDRESS 0x0 DISPLAY_IDENTIFIER Torque_Control.VDC.Vehicle_Dynamics_Control_Modes.Merge_Tq_RR.MergeTq_RR /end MEASUREMENT
/begin MEASUREMENT Torque_Control.Torque_Control_B.Merge_c "" FLOAT64_IEEE Torque_Control_CM_double 0 0 -1.7e+308 1.7e+308 ECU_ADDRESS 0x0 DISPLAY_IDENTIFIER Torque_Control.VDC.Vehicle_Dynamics_Control_Modes.VDC_Complete.Optimization_SKF__amp__CKF.Subsystem.CKF.Merge.Merge_c /end MEASUREMENT
/begin MEASUREMENT Torque_Control.Torque_Control_B.Merge_d "" FLOAT64_IEEE Torque_Control_CM_double 0 0 -1.7e+308 1.7e+308 ECU_ADDRESS 0x0 DISPLAY_IDENTIFIER Torque_Control.VDC.Vehicle_Dynamics_Control_Modes.Steering_TV_with_TC.Accelerating__Braking_or_Regen_Braking.Merge.Merge_d /end MEASUREMENT
/begin MEASUREMENT Torque_Control.Torque_Control_B.Merge_g "" FLOAT64_IEEE Torque_Control_CM_double 0 0 -1.7e+308 1.7e+308 ECU_ADDRESS 0x0 DISPLAY_IDENTIFIER Torque_Control.VDC.Vehicle_Dynamics_Control_Modes.VDC_without_Longitudinal.Optimization_SKF__amp__CKF.Subsystem.CKF.Merge.Merge_g /end MEASUREMENT
/begin MEASUREMENT Torque_Control.Torque_Control_B.Merge_i "" FLOAT64_IEEE Torque_Control_CM_double 0 0 -1.7e+308 1.7e+308 ECU_ADDRESS 0x0 DISPLAY_IDENTIFIER Torque_Control.VDC.Vehicle_Dynamics_Control_Modes.VDC_Complete.Optimization_SKF__amp__CKF.Subsystem.SKF.Merge.Merge_i /end MEASUREMENT
/begin MEASUREMENT Torque_Control.Torque_Control_B.Merge_j "" UBYTE Torque_Control_CM_boolean 0 0 0 1 ECU_ADDRESS 0x0 DISPLAY_IDENTIFIER Torque_Control.SAFETY_BLOCK.APPS_IMPLAUSIBILITY.Merge.Merge_j /end MEASUREMENT
/begin MEASUREMENT Torque_Control.Torque_Control_B.Merge_k "" FLOAT64_IEEE Torque_Control_CM_double 0 0 -1.7e+308 1.7e+308 ECU_ADDRESS 0x0 DISPLAY_IDENTIFIER Torque_Control.VDC.Vehicle_Dynamics_Control_Modes.Steering_TV_with_TC.Optimization_SKF__amp__CKF.Subsystem.CKF.Merge.Merge_k /end MEASUREMENT
/begin MEASUREMENT Torque_Control.Torque_Control_B.Merge_kj "" FLOAT64_IEEE Torque_Control_CM_double 0 0 -1.7e+308 1.7e+308 ECU_ADDRESS 0x0 DISPLAY_IDENTIFIER Torque_Control.VDC.Vehicle_Dynamics_Control_Modes.Steering_TV_with_TC.Optimization_SKF__amp__CKF.Subsystem.SKF.Merge.Merge_kj /end MEASUREMENT
/begin MEASUREMENT Torque_Control.Torque_Control_B.Merge_kt "" FLOAT64_IEEE Torque_Control_CM_double 0 0 -1.7e+308 1.7e+308 ECU_ADDRESS 0x0 DISPLAY_IDENTIFIER Torque_Control.VDC.Vehicle_Dynamics_Control_Modes.VDC_Complete.Driver____CarBehaviours.Merge.Merge_kt /end MEASUREMENT
/begin MEASUREMENT Torque_Control.Torque_Control_B.Merge_l "" FLOAT64_IEEE Torque_Control_CM_double 0 0 -1.7e+308 1.7e+308 ECU_ADDRESS 0x0 DISPLAY_IDENTIFIER Torque_Control.VDC.Vehicle_Dynamics_Control_Modes.Merge.Merge_l /end MEASUREMENT
/begin MEASUREMENT Torque_Control.Torque_Control_B.Merge_li "" FLOAT64_IEEE Torque_Control_CM_double 0 0 -1.7e+308 1.7e+308 ECU_ADDRESS 0x0 DISPLAY_IDENTIFIER Torque_Control.VDC.Vehicle_Dynamics_Control_Modes.VDC_without_Longitudinal.Driver____CarBehaviours.Merge.Merge_li /end MEASUREMENT
/begin MEASUREMENT Torque_Control.Torque_Control_B.Merge_m "" FLOAT64_IEEE Torque_Control_CM_double 0 0 -1.7e+308 1.7e+308 ECU_ADDRESS 0x0 DISPLAY_IDENTIFIER Torque_Control.VDC.Vehicle_Dynamics_Control_Modes.VDC_Complete.Merge.Merge_m /end MEASUREMENT
/begin MEASUREMENT Torque_Control.Torque_Control_B.OutportBufferForFlag_Power "" FLOAT64_IEEE Torque_Control_CM_double 0 0 -1.7e+308 1.7e+308 ECU_ADDRESS 0x0 DISPLAY_IDENTIFIER Torque_Control.VDC.Vehicle_Dynamics_Control_Modes.VDC_Complete.Constraints_and_motor_to_wheel_Tq.Acelerating_and_braking_without_Regenerative.Constant.OutportBufferForFlag_Power /end MEASUREMENT
/begin MEASUREMENT Torque_Control.Torque_Control_B.OutportBufferForFlags_num5 "" FLOAT64_IEEE Torque_Control_CM_double 0 0 -1.7e+308 1.7e+308 ECU_ADDRESS 0x0 DISPLAY_IDENTIFIER Torque_Control.VDC.Vehicle_Dynamics_Control_Modes.VDC_Complete.Flags.OutportBufferForFlags_num5 ARRAY_SIZE 4 /end MEASUREMENT
/begin MEASUREMENT Torque_Control.Torque_Control_B.Product "" FLOAT64_IEEE Torque_Control_CM_double 0 0 -1.7e+308 1.7e+308 ECU_ADDRESS 0x0 DISPLAY_IDENTIFIER Torque_Control.VDC.Vehicle_Dynamics_Control_Modes.VDC_without_Longitudinal.In_Numbers.Product.Product /end MEASUREMENT
/begin MEASUREMENT Torque_Control.Torque_Control_B.RT_L "" FLOAT64_IEEE Torque_Control_CM_double 0 0 -1.7e+308 1.7e+308 ECU_ADDRESS 0x0 DISPLAY_IDENTIFIER Torque_Control.VDC.Vehicle_Dynamics_Control_Modes.Rigid_Axle.RT_L.RT_L /end MEASUREMENT
/begin MEASUREMENT Torque_Control.Torque_Control_B.RT_R "" FLOAT64_IEEE Torque_Control_CM_double 0 0 -1.7e+308 1.7e+308 ECU_ADDRESS 0x0 DISPLAY_IDENTIFIER Torque_Control.VDC.Vehicle_Dynamics_Control_Modes.Rigid_Axle.RT_R.RT_R /end MEASUREMENT
/begin MEASUREMENT Torque_Control.Torque_Control_B.Saturation "" FLOAT64_IEEE Torque_Control_CM_double 0 0 -1.7e+308 1.7e+308 ECU_ADDRESS 0x0 DISPLAY_IDENTIFIER Torque_Control.VDC.Vehicle_Dynamics_Control_Modes.Steering_TV_with_TC.Optimization_SKF__amp__CKF.Subsystem.CKF.Saturation.Saturation /end MEASUREMENT
/begin MEASUREMENT Torque_Control.Torque_Control_B.Saturation_f "" FLOAT64_IEEE Torque_Control_CM_double 0 0 -1.7e+308 1.7e+308 ECU_ADDRESS 0x0 DISPLAY_IDENTIFIER Torque_Control.VDC.Vehicle_Dynamics_Control_Modes.VDC_Complete.Optimization_SKF__amp__CKF.Subsystem.SKF.Saturation.Saturation_f /end MEASUREMENT
/begin MEASUREMENT Torque_Control.Torque_Control_B.Saturation_i "" FLOAT64_IEEE Torque_Control_CM_double 0 0 -1.7e+308 1.7e+308 ECU_ADDRESS 0x0 DISPLAY_IDENTIFIER Torque_Control.VDC.Vehicle_Dynamics_Control_Modes.VDC_Complete.Optimization_SKF__amp__CKF.Subsystem.CKF.Saturation.Saturation_i /end MEASUREMENT
/begin MEASUREMENT Torque_Control.Torque_Control_B.Saturation_k "" FLOAT64_IEEE Torque_Control_CM_double 0 0 -1.7e+308 1.7e+308 ECU_ADDRESS 0x0 DISPLAY_IDENTIFIER Torque_Control.VDC.Vehicle_Dynamics_Control_Modes.Steering_TV_with_TC.Optimization_SKF__amp__CKF.Subsystem.SKF.Saturation.Saturation_k /end MEASUREMENT
/begin MEASUREMENT Torque_Control.Torque_Control_B.SteeringWheelMaximumAngle "" FLOAT64_IEEE Torque_Control_CM_double 0 0 -1.7e+308 1.7e+308 ECU_ADDRESS 0x0 DISPLAY_IDENTIFIER Torque_Control.VDC.Vehicle_Dynamics_Control_Modes.Steering_TV_with_TC.Optimization_SKF__amp__CKF.Subsystem.Steering_Wheel_Maximum_Angle.SteeringWheelMaximumAngle /end MEASUREMENT
/begin MEASUREMENT Torque_Control.Torque_Control_B.SteeringWheelMaximumAngle_m "" FLOAT64_IEEE Torque_Control_CM_double 0 0 -1.7e+308 1.7e+308 ECU_ADDRESS 0x0 DISPLAY_IDENTIFIER Torque_Control.VDC.Vehicle_Dynamics_Control_Modes.Steering_TV_with_TC.Steering_Wheel_Maximum_Angle.SteeringWheelMaximumAngle_m /end MEASUREMENT
/begin MEASUREMENT Torque_Control.Torque_Control_B.SteeringWheelMaximumAngle_p "" FLOAT64_IEEE Torque_Control_CM_double 0 0 -1.7e+308 1.7e+308 ECU_ADDRESS 0x0 DISPLAY_IDENTIFIER Torque_Control.VDC.Vehicle_Dynamics_Control_Modes.VDC_Complete.Optimization_SKF__amp__CKF.Subsystem.Steering_Wheel_Maximum_Angle.SteeringWheelMaximumAngle_p /end MEASUREMENT
/begin MEASUREMENT Torque_Control.Torque_Control_B.SteeringWheelSaturationpersited "" FLOAT64_IEEE Torque_Control_CM_double 0 0 -1.7e+308 1.7e+308 ECU_ADDRESS 0x0 DISPLAY_IDENTIFIER Torque_Control.VDC.Vehicle_Dynamics_Control_Modes.Steering_Wheel_Saturation__per_site__[deg].SteeringWheelSaturationpersited /end MEASUREMENT
/begin MEASUREMENT Torque_Control.Torque_Control_B.Steering_Ratio "" FLOAT64_IEEE Torque_Control_CM_double 0 0 -1.7e+308 1.7e+308 ECU_ADDRESS 0x0 DISPLAY_IDENTIFIER Torque_Control.VDC.Vehicle_Dynamics_Control_Modes.VDC_Complete.Lateral_Dynamics.Yaw_Rate_Reference.Steering_Ratio____.Steering_Ratio /end MEASUREMENT
/begin MEASUREMENT Torque_Control.Torque_Control_B.Subtract "" FLOAT64_IEEE Torque_Control_CM_double 0 0 -1.7e+308 1.7e+308 ECU_ADDRESS 0x0 DISPLAY_IDENTIFIER Torque_Control.Steering_Data_Conv.Low_Pass.Subtract.Subtract /end MEASUREMENT
/begin MEASUREMENT Torque_Control.Torque_Control_B.Throttle "" FLOAT64_IEEE Torque_Control_CM_double 0 0 -1.7e+308 1.7e+308 ECU_ADDRESS 0x0 DISPLAY_IDENTIFIER Torque_Control.VDC.Vehicle_Dynamics_Control_Modes.VDC_Complete.Driver____CarBehaviours.Accelerating.Throttle.Throttle /end MEASUREMENT
/begin MEASUREMENT Torque_Control.Torque_Control_B.TowheelTqdynamic "" FLOAT64_IEEE Torque_Control_CM_double 0 0 -1.7e+308 1.7e+308 ECU_ADDRESS 0x0 DISPLAY_IDENTIFIER Torque_Control.VDC.Vehicle_Dynamics_Control_Modes.VDC_without_Longitudinal.Constraints.Acelerating_and_braking_without_Regenerative.To_wheel_Tq__dynamic_.TowheelTqdynamic /end MEASUREMENT
/begin MEASUREMENT Torque_Control.Torque_Control_B.TowheelTqstatic "" FLOAT64_IEEE Torque_Control_CM_double 0 0 -1.7e+308 1.7e+308 ECU_ADDRESS 0x0 DISPLAY_IDENTIFIER Torque_Control.VDC.Vehicle_Dynamics_Control_Modes.VDC_without_Longitudinal.Constraints.Acelerating_and_braking_without_Regenerative.To_wheel_Tq__static_.TowheelTqstatic /end MEASUREMENT
/begin MEASUREMENT Torque_Control.Torque_Control_B.Tq_diff_Max "" FLOAT64_IEEE Torque_Control_CM_double 0 0 -1.7e+308 1.7e+308 ECU_ADDRESS 0x0 DISPLAY_IDENTIFIER Torque_Control.VDC.Vehicle_Dynamics_Control_Modes.VDC_Complete.In_Numbers.Tq_diff_Max.Tq_diff_Max /end MEASUREMENT
/begin MEASUREMENT Torque_Control.Torque_Control_B.Tq_diff_maxNm "" FLOAT64_IEEE Torque_Control_CM_double 0 0 -1.7e+308 1.7e+308 ECU_ADDRESS 0x0 DISPLAY_IDENTIFIER Torque_Control.VDC.Vehicle_Dynamics_Control_Modes.Steering_TV_with_TC.Tq_diff_max_[Nm].Tq_diff_maxNm /end MEASUREMENT
/begin MEASUREMENT Torque_Control.Torque_Control_B.Tq_max_motorNm "" FLOAT64_IEEE Torque_Control_CM_double 0 0 -1.7e+308 1.7e+308 ECU_ADDRESS 0x0 DISPLAY_IDENTIFIER Torque_Control.VDC.Vehicle_Dynamics_Control_Modes.Steering_TV_with_TC.Tq_max_motor_[Nm].Tq_max_motorNm /end MEASUREMENT
/begin MEASUREMENT Torque_Control.Torque_Control_B.TransmisionRatio "" FLOAT64_IEEE Torque_Control_CM_double 0 0 -1.7e+308 1.7e+308 ECU_ADDRESS 0x0 DISPLAY_IDENTIFIER Torque_Control.VDC.Vehicle_Dynamics_Control_Modes.VDC_Complete.In_Numbers.Transmision_Ratio___.TransmisionRatio /end MEASUREMENT
/begin MEASUREMENT Torque_Control.Torque_Control_B.Wheelbasem "" FLOAT64_IEEE Torque_Control_CM_double 0 0 -1.7e+308 1.7e+308 ECU_ADDRESS 0x0 DISPLAY_IDENTIFIER Torque_Control.VDC.Vehicle_Dynamics_Control_Modes.VDC_Complete.Lateral_Dynamics.Yaw_Rate_Reference.Wheelbase_[m].Wheelbasem /end MEASUREMENT
/begin MEASUREMENT Torque_Control.Torque_Control_B.Yaw_Inertiakgm3 "" FLOAT64_IEEE Torque_Control_CM_double 0 0 -1.7e+308 1.7e+308 ECU_ADDRESS 0x0 DISPLAY_IDENTIFIER Torque_Control.VDC.Vehicle_Dynamics_Control_Modes.VDC_Complete.Lateral_Dynamics.Yaw_Inertia__kg__m_3_.Yaw_Inertiakgm3 /end MEASUREMENT
/begin MEASUREMENT Torque_Control.Torque_Control_B.Zero "" FLOAT64_IEEE Torque_Control_CM_double 0 0 -1.7e+308 1.7e+308 ECU_ADDRESS 0x0 DISPLAY_IDENTIFIER Torque_Control.VDC.Regeneration_Enable.Zero.Zero /end MEASUREMENT
/begin MEASUREMENT Torque_Control.Torque_Control_B.approx2095 "" FLOAT64_IEEE Torque_Control_CM_double 0 0 -1.7e+308 1.7e+308 ECU_ADDRESS 0x0 DISPLAY_IDENTIFIER Torque_Control.VDC.Vehicle_Dynamics_Control_Modes.VDC_without_Longitudinal.Constraints.Acelerating_and_braking_without_Regenerative.Gain.approx_20.95 /end MEASUREMENT
/begin MEASUREMENT Torque_Control.Torque_Control_B.approx2095_h "" FLOAT64_IEEE Torque_Control_CM_double 0 0 -1.7e+308 1.7e+308 ECU_ADDRESS 0x0 DISPLAY_IDENTIFIER Torque_Control.VDC.Vehicle_Dynamics_Control_Modes.VDC_Complete.Constraints_and_motor_to_wheel_Tq.Acelerating_and_braking_without_Regenerative.Gain.approx_20.95 /end MEASUREMENT
/begin MEASUREMENT Torque_Control.Torque_Control_B.exptcycletau1 "" FLOAT64_IEEE Torque_Control_CM_double 0 0 -1.7e+308 1.7e+308 ECU_ADDRESS 0x0 DISPLAY_IDENTIFIER Torque_Control.Steering_Data_Conv.Low_Pass.exp__tcycle__tau_1.exptcycletau1 /end MEASUREMENT
/begin MEASUREMENT Torque_Control.Torque_Control_B.initial_limitation "" FLOAT64_IEEE Torque_Control_CM_double 0 0 -1.7e+308 1.7e+308 ECU_ADDRESS 0x0 DISPLAY_IDENTIFIER Torque_Control.power_limitation1.initial_limitation.initial_limitation /end MEASUREMENT
/begin MEASUREMENT Torque_Control.Torque_Control_B.initial_limitation_m "" FLOAT64_IEEE Torque_Control_CM_double 0 0 -1.7e+308 1.7e+308 ECU_ADDRESS 0x0 DISPLAY_IDENTIFIER Torque_Control.Controls_Temperature_by_limiting_Torque.initial_limitation.initial_limitation_m /end MEASUREMENT
/begin MEASUREMENT Torque_Control.Torque_Control_B.sf_Acceleratorbehaviour.throttle "" FLOAT64_IEEE Torque_Control_CM_double 0 0 -1.7e+308 1.7e+308 ECU_ADDRESS 0x0 DISPLAY_IDENTIFIER Torque_Control.VDC.Vehicle_Dynamics_Control_Modes.VDC_Complete.Driver____CarBehaviours.Accelerator_behaviour.throttle /end MEASUREMENT
/begin MEASUREMENT Torque_Control.Torque_Control_B.sf_Acceleratorbehaviour_b.throttle "" FLOAT64_IEEE Torque_Control_CM_double 0 0 -1.7e+308 1.7e+308 ECU_ADDRESS 0x0 DISPLAY_IDENTIFIER Torque_Control.VDC.Vehicle_Dynamics_Control_Modes.VDC_without_Longitudinal.Driver____CarBehaviours.Accelerating.Accelerator_behaviour.throttle /end MEASUREMENT
/begin MEASUREMENT Torque_Control.Torque_Control_B.sf_Acceleratorbehaviour_br.throttle "" FLOAT64_IEEE Torque_Control_CM_double 0 0 -1.7e+308 1.7e+308 ECU_ADDRESS 0x0 DISPLAY_IDENTIFIER Torque_Control.VDC.Vehicle_Dynamics_Control_Modes.Steering_TV_with_TC.Accelerator_behaviour.throttle /end MEASUREMENT
/begin MEASUREMENT Torque_Control.Torque_Control_B.sf_Acceleratorbehaviour_o.throttle "" FLOAT64_IEEE Torque_Control_CM_double 0 0 -1.7e+308 1.7e+308 ECU_ADDRESS 0x0 DISPLAY_IDENTIFIER Torque_Control.VDC.Vehicle_Dynamics_Control_Modes.Rigid_Axle.Accelerating.Accelerator_behaviour.throttle /end MEASUREMENT
/begin MEASUREMENT Torque_Control.Torque_Control_B.sf_MATLABFunction1_b.CKF_act0 "" FLOAT64_IEEE Torque_Control_CM_double 0 0 -1.7e+308 1.7e+308 ECU_ADDRESS 0x0 DISPLAY_IDENTIFIER Torque_Control.VDC.Vehicle_Dynamics_Control_Modes.VDC_Complete.Optimization_SKF__amp__CKF.Subsystem.CKF.No_spin.MATLAB_Function1.CKF_act0 /end MEASUREMENT
/begin MEASUREMENT Torque_Control.Torque_Control_B.sf_MATLABFunction1_f.value "" FLOAT64_IEEE Torque_Control_CM_double 0 0 -1.7e+308 1.7e+308 ECU_ADDRESS 0x0 DISPLAY_IDENTIFIER Torque_Control.VDC.Vehicle_Dynamics_Control_Modes.VDC_without_Longitudinal.Kamm_Circle_Lateral.MATLAB_Function1.value /end MEASUREMENT
/begin MEASUREMENT Torque_Control.Torque_Control_B.sf_MATLABFunction1_g.value "" FLOAT64_IEEE Torque_Control_CM_double 0 0 -1.7e+308 1.7e+308 ECU_ADDRESS 0x0 DISPLAY_IDENTIFIER Torque_Control.VDC.Vehicle_Dynamics_Control_Modes.VDC_Complete.Longitudinal_Dynamics.MATLAB_Function1.value /end MEASUREMENT
/begin MEASUREMENT Torque_Control.Torque_Control_B.sf_MATLABFunction1_gm.value "" FLOAT64_IEEE Torque_Control_CM_double 0 0 -1.7e+308 1.7e+308 ECU_ADDRESS 0x0 DISPLAY_IDENTIFIER Torque_Control.VDC.Vehicle_Dynamics_Control_Modes.VDC_without_Longitudinal.Force_to_Tq.MATLAB_Function1.value /end MEASUREMENT
/begin MEASUREMENT Torque_Control.Torque_Control_B.sf_MATLABFunction1_h.RegTq_RL "" FLOAT64_IEEE Torque_Control_CM_double 0 0 -1.7e+308 1.7e+308 ECU_ADDRESS 0x0 DISPLAY_IDENTIFIER Torque_Control.VDC.Vehicle_Dynamics_Control_Modes.Steering_TV_with_TC.Accelerating__Braking_or_Regen_Braking.Regenerative_Mech_Braking.MATLAB_Function1.RegTq_RL /end MEASUREMENT
/begin MEASUREMENT Torque_Control.Torque_Control_B.sf_MATLABFunction1_h.RegTq_RR "" FLOAT64_IEEE Torque_Control_CM_double 0 0 -1.7e+308 1.7e+308 ECU_ADDRESS 0x0 DISPLAY_IDENTIFIER Torque_Control.VDC.Vehicle_Dynamics_Control_Modes.Steering_TV_with_TC.Accelerating__Braking_or_Regen_Braking.Regenerative_Mech_Braking.MATLAB_Function1.RegTq_RR /end MEASUREMENT
/begin MEASUREMENT Torque_Control.Torque_Control_B.sf_MATLABFunction1_m.value "" FLOAT64_IEEE Torque_Control_CM_double 0 0 -1.7e+308 1.7e+308 ECU_ADDRESS 0x0 DISPLAY_IDENTIFIER Torque_Control.VDC.Vehicle_Dynamics_Control_Modes.VDC_Complete.Wheel_to_motor.MATLAB_Function1.value /end MEASUREMENT
/begin MEASUREMENT Torque_Control.Torque_Control_B.sf_MATLABFunction1_mk.value "" FLOAT64_IEEE Torque_Control_CM_double 0 0 -1.7e+308 1.7e+308 ECU_ADDRESS 0x0 DISPLAY_IDENTIFIER Torque_Control.VDC.Vehicle_Dynamics_Control_Modes.VDC_Complete.Lateral_Dynamics.MATLAB_Function1.value /end MEASUREMENT
/begin MEASUREMENT Torque_Control.Torque_Control_B.sf_MATLABFunction1_ny.value "" FLOAT64_IEEE Torque_Control_CM_double 0 0 -1.7e+308 1.7e+308 ECU_ADDRESS 0x0 DISPLAY_IDENTIFIER Torque_Control.VDC.Vehicle_Dynamics_Control_Modes.VDC_Complete.MATLAB_Function1.value /end MEASUREMENT
/begin MEASUREMENT Torque_Control.Torque_Control_B.sf_MATLABFunction2.value "" FLOAT64_IEEE Torque_Control_CM_double 0 0 -1.7e+308 1.7e+308 ECU_ADDRESS 0x0 DISPLAY_IDENTIFIER Torque_Control.VDC.Vehicle_Dynamics_Control_Modes.VDC_Complete.Wheel_to_motor.MATLAB_Function2.value /end MEASUREMENT
/begin MEASUREMENT Torque_Control.Torque_Control_B.sf_MATLABFunction2_b.value "" FLOAT64_IEEE Torque_Control_CM_double 0 0 -1.7e+308 1.7e+308 ECU_ADDRESS 0x0 DISPLAY_IDENTIFIER Torque_Control.VDC.Vehicle_Dynamics_Control_Modes.VDC_without_Longitudinal.Kamm_Circle_Lateral.MATLAB_Function2.value /end MEASUREMENT
/begin MEASUREMENT Torque_Control.Torque_Control_B.sf_MATLABFunction2_e.value "" FLOAT64_IEEE Torque_Control_CM_double 0 0 -1.7e+308 1.7e+308 ECU_ADDRESS 0x0 DISPLAY_IDENTIFIER Torque_Control.VDC.Vehicle_Dynamics_Control_Modes.VDC_Complete.Lateral_Dynamics.MATLAB_Function2.value /end MEASUREMENT
/begin MEASUREMENT Torque_Control.Torque_Control_B.sf_MATLABFunction2_l.value "" FLOAT64_IEEE Torque_Control_CM_double 0 0 -1.7e+308 1.7e+308 ECU_ADDRESS 0x0 DISPLAY_IDENTIFIER Torque_Control.VDC.Vehicle_Dynamics_Control_Modes.VDC_Complete.MATLAB_Function2.value /end MEASUREMENT
/begin MEASUREMENT Torque_Control.Torque_Control_B.sf_MATLABFunction2_m.value "" FLOAT64_IEEE Torque_Control_CM_double 0 0 -1.7e+308 1.7e+308 ECU_ADDRESS 0x0 DISPLAY_IDENTIFIER Torque_Control.VDC.Vehicle_Dynamics_Control_Modes.VDC_without_Longitudinal.Force_to_Tq.MATLAB_Function2.value /end MEASUREMENT
/begin MEASUREMENT Torque_Control.Torque_Control_B.sf_MATLABFunction_a.CKF_act0 "" FLOAT64_IEEE Torque_Control_CM_double 0 0 -1.7e+308 1.7e+308 ECU_ADDRESS 0x0 DISPLAY_IDENTIFIER Torque_Control.VDC.Vehicle_Dynamics_Control_Modes.VDC_without_Longitudinal.Optimization_SKF__amp__CKF.Subsystem.CKF.No_spin.MATLAB_Function.CKF_act0 /end MEASUREMENT
/begin MEASUREMENT Torque_Control.Torque_Control_B.sf_MATLABFunction_ab.RPM "" FLOAT64_IEEE Torque_Control_CM_double 0 0 -1.7e+308 1.7e+308 ECU_ADDRESS 0x0 DISPLAY_IDENTIFIER Torque_Control.VDC.Vehicle_Dynamics_Control_Modes.Steering_TV_with_TC.Optimization_SKF__amp__CKF.MATLAB_Function.RPM /end MEASUREMENT
/begin MEASUREMENT Torque_Control.Torque_Control_B.sf_MATLABFunction_d.value "" FLOAT64_IEEE Torque_Control_CM_double 0 0 -1.7e+308 1.7e+308 ECU_ADDRESS 0x0 DISPLAY_IDENTIFIER Torque_Control.VDC.Vehicle_Dynamics_Control_Modes.VDC_Complete.Longitudinal_Dynamics.MATLAB_Function.value /end MEASUREMENT
/begin MEASUREMENT Torque_Control.Torque_Control_B.sf_MATLABFunction_e.SKF_act0 "" FLOAT64_IEEE Torque_Control_CM_double 0 0 -1.7e+308 1.7e+308 ECU_ADDRESS 0x0 DISPLAY_IDENTIFIER Torque_Control.VDC.Vehicle_Dynamics_Control_Modes.VDC_Complete.Optimization_SKF__amp__CKF.Subsystem.SKF.No_spin.MATLAB_Function.SKF_act0 /end MEASUREMENT
/begin MEASUREMENT Torque_Control.Torque_Control_B.sf_MATLABFunction_fa.RPM "" FLOAT64_IEEE Torque_Control_CM_double 0 0 -1.7e+308 1.7e+308 ECU_ADDRESS 0x0 DISPLAY_IDENTIFIER Torque_Control.VDC.Vehicle_Dynamics_Control_Modes.VDC_without_Longitudinal.Optimization_SKF__amp__CKF.MATLAB_Function.RPM /end MEASUREMENT
/begin MEASUREMENT Torque_Control.Torque_Control_B.sf_MATLABFunction_fq.SKF_act0 "" FLOAT64_IEEE Torque_Control_CM_double 0 0 -1.7e+308 1.7e+308 ECU_ADDRESS 0x0 DISPLAY_IDENTIFIER Torque_Control.VDC.Vehicle_Dynamics_Control_Modes.Steering_TV_with_TC.Optimization_SKF__amp__CKF.Subsystem.SKF.No_spin.MATLAB_Function.SKF_act0 /end MEASUREMENT
/begin MEASUREMENT Torque_Control.Torque_Control_B.sf_MATLABFunction_i1.CKF_act1 "" FLOAT64_IEEE Torque_Control_CM_double 0 0 -1.7e+308 1.7e+308 ECU_ADDRESS 0x0 DISPLAY_IDENTIFIER Torque_Control.VDC.Vehicle_Dynamics_Control_Modes.VDC_without_Longitudinal.Optimization_SKF__amp__CKF.Subsystem.CKF.Spin.MATLAB_Function.CKF_act1 /end MEASUREMENT
/begin MEASUREMENT Torque_Control.Torque_Control_B.sf_MATLABFunction_k2.CKF_act0 "" FLOAT64_IEEE Torque_Control_CM_double 0 0 -1.7e+308 1.7e+308 ECU_ADDRESS 0x0 DISPLAY_IDENTIFIER Torque_Control.VDC.Vehicle_Dynamics_Control_Modes.Steering_TV_with_TC.Optimization_SKF__amp__CKF.Subsystem.CKF.No_spin.MATLAB_Function.CKF_act0 /end MEASUREMENT
/begin MEASUREMENT Torque_Control.Torque_Control_B.sf_MATLABFunction_mt.CKF_act1 "" FLOAT64_IEEE Torque_Control_CM_double 0 0 -1.7e+308 1.7e+308 ECU_ADDRESS 0x0 DISPLAY_IDENTIFIER Torque_Control.VDC.Vehicle_Dynamics_Control_Modes.VDC_Complete.Optimization_SKF__amp__CKF.Subsystem.CKF.Spin.MATLAB_Function.CKF_act1 /end MEASUREMENT
/begin MEASUREMENT Torque_Control.Torque_Control_B.sf_MATLABFunction_n.RPM "" FLOAT64_IEEE Torque_Control_CM_double 0 0 -1.7e+308 1.7e+308 ECU_ADDRESS 0x0 DISPLAY_IDENTIFIER Torque_Control.VDC.Vehicle_Dynamics_Control_Modes.VDC_Complete.Optimization_SKF__amp__CKF.MATLAB_Function.RPM /end MEASUREMENT
/begin MEASUREMENT Torque_Control.Torque_Control_B.u602pi "" FLOAT64_IEEE Torque_Control_CM_double 0 0 -1.7e+308 1.7e+308 ECU_ADDRESS 0x0 DISPLAY_IDENTIFIER Torque_Control.VDC.Vehicle_Dynamics_Control_Modes.VDC_Complete.Lateral_Dynamics.Yaw_Rate_Reference.360___2_pi_.u602pi /end MEASUREMENT
/begin MEASUREMENT Torque_Control.Torque_Control_B.u602pi_e "" FLOAT64_IEEE Torque_Control_CM_double 0 0 -1.7e+308 1.7e+308 ECU_ADDRESS 0x0 DISPLAY_IDENTIFIER Torque_Control.VDC.Vehicle_Dynamics_Control_Modes.VDC_Complete.Lateral_Dynamics.Yaw_Rate_Reference.360___2pi_.u602pi_e /end MEASUREMENT
/begin MEASUREMENT Torque_Control.Torque_Control_B.udifference "" FLOAT64_IEEE Torque_Control_CM_double 0 0 -1.7e+308 1.7e+308 ECU_ADDRESS 0x0 DISPLAY_IDENTIFIER Torque_Control.VDC.Vehicle_Dynamics_Control_Modes.VDC_without_Longitudinal.In_Numbers.3__difference.udifference /end MEASUREMENT
/begin MEASUREMENT Torque_Control.Torque_Control_B.udifference1 "" FLOAT64_IEEE Torque_Control_CM_double 0 0 -1.7e+308 1.7e+308 ECU_ADDRESS 0x0 DISPLAY_IDENTIFIER Torque_Control.VDC.Vehicle_Dynamics_Control_Modes.VDC_Complete.In_Numbers.3__difference1.udifference1 /end MEASUREMENT
/begin MEASUREMENT Torque_Control.Torque_Control_DW.A "" FLOAT64_IEEE Torque_Control_CM_double 0 0 -1.7e+308 1.7e+308 ECU_ADDRESS 0x0 DISPLAY_IDENTIFIER Torque_Control.VDC.Vehicle_Dynamics_Control_Modes.Steering_TV_with_TC.Optimization_SKF__amp__CKF.Data_Store_Memory.A /end MEASUREMENT
/begin MEASUREMENT Torque_Control.Torque_Control_DW.AA "" UBYTE Torque_Control_CM_boolean 0 0 0 1 ECU_ADDRESS 0x0 DISPLAY_IDENTIFIER Torque_Control.SAFETY_BLOCK.BRAKE_IMPLAUSIBILITY.Data_Store_Memory1.AA /end MEASUREMENT
/begin MEASUREMENT Torque_Control.Torque_Control_DW.A_b "" FLOAT64_IEEE Torque_Control_CM_double 0 0 -1.7e+308 1.7e+308 ECU_ADDRESS 0x0 DISPLAY_IDENTIFIER Torque_Control.VDC.Vehicle_Dynamics_Control_Modes.VDC_Complete.Optimization_SKF__amp__CKF.Data_Store_Memory.A_b /end MEASUREMENT
/begin MEASUREMENT Torque_Control.Torque_Control_DW.A_i "" FLOAT64_IEEE Torque_Control_CM_double 0 0 -1.7e+308 1.7e+308 ECU_ADDRESS 0x0 DISPLAY_IDENTIFIER Torque_Control.Accumulator_Power.PowerLimitDetection.Data_Store_Memory10.A_i /end MEASUREMENT
/begin MEASUREMENT Torque_Control.Torque_Control_DW.B "" FLOAT64_IEEE Torque_Control_CM_double 0 0 -1.7e+308 1.7e+308 ECU_ADDRESS 0x0 DISPLAY_IDENTIFIER Torque_Control.VDC.Vehicle_Dynamics_Control_Modes.Steering_TV_with_TC.Optimization_SKF__amp__CKF.Data_Store_Memory1.B /end MEASUREMENT
/begin MEASUREMENT Torque_Control.Torque_Control_DW.B_i "" FLOAT64_IEEE Torque_Control_CM_double 0 0 -1.7e+308 1.7e+308 ECU_ADDRESS 0x0 DISPLAY_IDENTIFIER Torque_Control.VDC.Vehicle_Dynamics_Control_Modes.VDC_Complete.Optimization_SKF__amp__CKF.Data_Store_Memory1.B_i /end MEASUREMENT
/begin MEASUREMENT Torque_Control.Torque_Control_DW.B_k "" FLOAT64_IEEE Torque_Control_CM_double 0 0 -1.7e+308 1.7e+308 ECU_ADDRESS 0x0 DISPLAY_IDENTIFIER Torque_Control.VDC.Vehicle_Dynamics_Control_Modes.VDC_without_Longitudinal.Optimization_SKF__amp__CKF.Data_Store_Memory1.B_k /end MEASUREMENT
/begin MEASUREMENT Torque_Control.Torque_Control_DW.Previous_IN "" FLOAT64_IEEE Torque_Control_CM_double 0 0 -1.7e+308 1.7e+308 ECU_ADDRESS 0x0 DISPLAY_IDENTIFIER Torque_Control.Steering_Data_Conv.Low_Pass.Data_Store_Memory.Previous_IN /end MEASUREMENT
/begin MEASUREMENT Torque_Control.Torque_Control_DW.Previous_OUT "" FLOAT64_IEEE Torque_Control_CM_double 0 0 -1.7e+308 1.7e+308 ECU_ADDRESS 0x0 DISPLAY_IDENTIFIER Torque_Control.Steering_Data_Conv.Low_Pass.Data_Store_Memory1.Previous_OUT /end MEASUREMENT
/begin MEASUREMENT Torque_Control.Torque_Control_U.ACCEL_F_X_SI "" FLOAT64_IEEE Torque_Control_CM_double 0 0 -1.7e+308 1.7e+308 ECU_ADDRESS 0x0 DISPLAY_IDENTIFIER Torque_Control.ACCEL_F_X_SI /end MEASUREMENT
/begin MEASUREMENT Torque_Control.Torque_Control_U.ACCEL_F_Y_SI "" FLOAT64_IEEE Torque_Control_CM_double 0 0 -1.7e+308 1.7e+308 ECU_ADDRESS 0x0 DISPLAY_IDENTIFIER Torque_Control.ACCEL_F_Y_SI /end MEASUREMENT
/begin MEASUREMENT Torque_Control.Torque_Control_U.ACCEL_F_Z_SI "" FLOAT64_IEEE Torque_Control_CM_double 0 0 -1.7e+308 1.7e+308 ECU_ADDRESS 0x0 DISPLAY_IDENTIFIER Torque_Control.ACCEL_F_Z_SI /end MEASUREMENT
/begin MEASUREMENT Torque_Control.Torque_Control_U.ACCEL_R_X_SI "" FLOAT64_IEEE Torque_Control_CM_double 0 0 -1.7e+308 1.7e+308 ECU_ADDRESS 0x0 DISPLAY_IDENTIFIER Torque_Control.ACCEL_R_X_SI /end MEASUREMENT
/begin MEASUREMENT Torque_Control.Torque_Control_U.ACCEL_R_Y_SI "" FLOAT64_IEEE Torque_Control_CM_double 0 0 -1.7e+308 1.7e+308 ECU_ADDRESS 0x0 DISPLAY_IDENTIFIER Torque_Control.ACCEL_R_Y_SI /end MEASUREMENT
/begin MEASUREMENT Torque_Control.Torque_Control_U.ACCEL_R_Z_SI "" FLOAT64_IEEE Torque_Control_CM_double 0 0 -1.7e+308 1.7e+308 ECU_ADDRESS 0x0 DISPLAY_IDENTIFIER Torque_Control.ACCEL_R_Z_SI /end MEASUREMENT
/begin MEASUREMENT Torque_Control.Torque_Control_U.APPS1_Value "" FLOAT64_IEEE Torque_Control_CM_double 0 0 -1.7e+308 1.7e+308 ECU_ADDRESS 0x0 DISPLAY_IDENTIFIER Torque_Control.APPS1_Value /end MEASUREMENT
/begin MEASUREMENT Torque_Control.Torque_Control_U.APPS2_Value "" FLOAT64_IEEE Torque_Control_CM_double 0 0 -1.7e+308 1.7e+308 ECU_ADDRESS 0x0 DISPLAY_IDENTIFIER Torque_Control.APPS2_Value /end MEASUREMENT
/begin MEASUREMENT Torque_Control.Torque_Control_U.Accumulator_Current "" FLOAT64_IEEE Torque_Control_CM_double 0 0 -1.7e+308 1.7e+308 ECU_ADDRESS 0x0 DISPLAY_IDENTIFIER Torque_Control.Accumulator_Current /end MEASUREMENT
/begin MEASUREMENT Torque_Control.Torque_Control_U.Accumulator_Voltage "" FLOAT64_IEEE Torque_Control_CM_double 0 0 -1.7e+308 1.7e+308 ECU_ADDRESS 0x0 DISPLAY_IDENTIFIER Torque_Control.Accumulator_Voltage /end MEASUREMENT
/begin MEASUREMENT Torque_Control.Torque_Control_U.BrakeSensor_Value "" FLOAT64_IEEE Torque_Control_CM_double 0 0 -1.7e+308 1.7e+308 ECU_ADDRESS 0x0 DISPLAY_IDENTIFIER Torque_Control.BrakeSensor_Value /end MEASUREMENT
/begin MEASUREMENT Torque_Control.Torque_Control_U.Car_State "" FLOAT64_IEEE Torque_Control_CM_double 0 0 -1.7e+308 1.7e+308 ECU_ADDRESS 0x0 DISPLAY_IDENTIFIER Torque_Control.Car_State /end MEASUREMENT
/begin MEASUREMENT Torque_Control.Torque_Control_U.CriticalDisconnection "" UBYTE Torque_Control_CM_boolean 0 0 0 1 ECU_ADDRESS 0x0 DISPLAY_IDENTIFIER Torque_Control.CriticalDisconnection /end MEASUREMENT
/begin MEASUREMENT Torque_Control.Torque_Control_U.Gyro_F_Z_Deg "" FLOAT64_IEEE Torque_Control_CM_double 0 0 -1.7e+308 1.7e+308 ECU_ADDRESS 0x0 DISPLAY_IDENTIFIER Torque_Control.Gyro_F_Z_Deg /end MEASUREMENT
/begin MEASUREMENT Torque_Control.Torque_Control_U.Highest_CellTemp "" FLOAT64_IEEE Torque_Control_CM_double 0 0 -1.7e+308 1.7e+308 ECU_ADDRESS 0x0 DISPLAY_IDENTIFIER Torque_Control.Highest_CellTemp /end MEASUREMENT
/begin MEASUREMENT Torque_Control.Torque_Control_U.RL_rads "" FLOAT64_IEEE Torque_Control_CM_double 0 0 -1.7e+308 1.7e+308 ECU_ADDRESS 0x0 DISPLAY_IDENTIFIER Torque_Control.RL_rads /end MEASUREMENT
/begin MEASUREMENT Torque_Control.Torque_Control_U.RR_rads "" FLOAT64_IEEE Torque_Control_CM_double 0 0 -1.7e+308 1.7e+308 ECU_ADDRESS 0x0 DISPLAY_IDENTIFIER Torque_Control.RR_rads /end MEASUREMENT
/begin MEASUREMENT Torque_Control.Torque_Control_U.ShutdownClosed "" UBYTE Torque_Control_CM_boolean 0 0 0 1 ECU_ADDRESS 0x0 DISPLAY_IDENTIFIER Torque_Control.ShutdownClosed /end MEASUREMENT
/begin MEASUREMENT Torque_Control.Torque_Control_U.SteeringSensor_Bits "" FLOAT64_IEEE Torque_Control_CM_double 0 0 -1.7e+308 1.7e+308 ECU_ADDRESS 0x0 DISPLAY_IDENTIFIER Torque_Control.SteeringSensor_Bits /end MEASUREMENT
/begin MEASUREMENT Torque_Control.Torque_Control_U.Susp_F_L "" FLOAT64_IEEE Torque_Control_CM_double 0 0 -1.7e+308 1.7e+308 ECU_ADDRESS 0x0 DISPLAY_IDENTIFIER Torque_Control.Susp_F_L /end MEASUREMENT
/begin MEASUREMENT Torque_Control.Torque_Control_U.Susp_F_R "" FLOAT64_IEEE Torque_Control_CM_double 0 0 -1.7e+308 1.7e+308 ECU_ADDRESS 0x0 DISPLAY_IDENTIFIER Torque_Control.Susp_F_R /end MEASUREMENT
/begin MEASUREMENT Torque_Control.Torque_Control_U.Susp_R_L "" FLOAT64_IEEE Torque_Control_CM_double 0 0 -1.7e+308 1.7e+308 ECU_ADDRESS 0x0 DISPLAY_IDENTIFIER Torque_Control.Susp_R_L /end MEASUREMENT
/begin MEASUREMENT Torque_Control.Torque_Control_U.Susp_R_R "" FLOAT64_IEEE Torque_Control_CM_double 0 0 -1.7e+308 1.7e+308 ECU_ADDRESS 0x0 DISPLAY_IDENTIFIER Torque_Control.Susp_R_R /end MEASUREMENT
/begin MEASUREMENT Torque_Control.Torque_Control_U.TV_Mode "" FLOAT64_IEEE Torque_Control_CM_double 0 0 -1.7e+308 1.7e+308 ECU_ADDRESS 0x0 DISPLAY_IDENTIFIER Torque_Control.TV_Mode /end MEASUREMENT
/begin MEASUREMENT Torque_Control.Torque_Control_U.Temp_IGBT "" FLOAT64_IEEE Torque_Control_CM_double 0 0 -1.7e+308 1.7e+308 ECU_ADDRESS 0x0 DISPLAY_IDENTIFIER Torque_Control.Temp_IGBT /end MEASUREMENT
/begin MEASUREMENT Torque_Control.Torque_Control_U.Temp_Motors "" FLOAT64_IEEE Torque_Control_CM_double 0 0 -1.7e+308 1.7e+308 ECU_ADDRESS 0x0 DISPLAY_IDENTIFIER Torque_Control.Temp_Motors /end MEASUREMENT
/begin MEASUREMENT Torque_Control.Torque_Control_U.TorqueEnable "" UBYTE Torque_Control_CM_boolean 0 0 0 1 ECU_ADDRESS 0x0 DISPLAY_IDENTIFIER Torque_Control.TorqueEnable /end MEASUREMENT
/begin MEASUREMENT Torque_Control.Torque_Control_U.VDC_Apps_Sat_Down "" FLOAT64_IEEE Torque_Control_CM_double 0 0 -1.7e+308 1.7e+308 ECU_ADDRESS 0x0 DISPLAY_IDENTIFIER Torque_Control.VDC_Apps_Sat_Down /end MEASUREMENT
/begin MEASUREMENT Torque_Control.Torque_Control_U.VDC_Apps_Sat_Up "" FLOAT64_IEEE Torque_Control_CM_double 0 0 -1.7e+308 1.7e+308 ECU_ADDRESS 0x0 DISPLAY_IDENTIFIER Torque_Control.VDC_Apps_Sat_Up /end MEASUREMENT
/begin MEASUREMENT Torque_Control.Torque_Control_U.VDC_CKF_Initial "" FLOAT64_IEEE Torque_Control_CM_double 0 0 -1.7e+308 1.7e+308 ECU_ADDRESS 0x0 DISPLAY_IDENTIFIER Torque_Control.VDC_CKF_Initial /end MEASUREMENT
/begin MEASUREMENT Torque_Control.Torque_Control_U.VDC_Cte_CKF "" FLOAT64_IEEE Torque_Control_CM_double 0 0 -1.7e+308 1.7e+308 ECU_ADDRESS 0x0 DISPLAY_IDENTIFIER Torque_Control.VDC_Cte_CKF /end MEASUREMENT
/begin MEASUREMENT Torque_Control.Torque_Control_U.VDC_Cte_SKF "" FLOAT64_IEEE Torque_Control_CM_double 0 0 -1.7e+308 1.7e+308 ECU_ADDRESS 0x0 DISPLAY_IDENTIFIER Torque_Control.VDC_Cte_SKF /end MEASUREMENT
/begin MEASUREMENT Torque_Control.Torque_Control_U.VDC_K_Reduction_P "" FLOAT64_IEEE Torque_Control_CM_double 0 0 -1.7e+308 1.7e+308 ECU_ADDRESS 0x0 DISPLAY_IDENTIFIER Torque_Control.VDC_K_Reduction_P /end MEASUREMENT
/begin MEASUREMENT Torque_Control.Torque_Control_U.VDC_K_Reduction_Temperature "" FLOAT64_IEEE Torque_Control_CM_double 0 0 -1.7e+308 1.7e+308 ECU_ADDRESS 0x0 DISPLAY_IDENTIFIER Torque_Control.VDC_K_Reduction_Temperature /end MEASUREMENT
/begin MEASUREMENT Torque_Control.Torque_Control_U.VDC_Max_Regenerative_Torque "" FLOAT64_IEEE Torque_Control_CM_double 0 0 -1.7e+308 1.7e+308 ECU_ADDRESS 0x0 DISPLAY_IDENTIFIER Torque_Control.VDC_Max_Regenerative_Torque /end MEASUREMENT
/begin MEASUREMENT Torque_Control.Torque_Control_U.VDC_Power_Limit "" FLOAT64_IEEE Torque_Control_CM_double 0 0 -1.7e+308 1.7e+308 ECU_ADDRESS 0x0 DISPLAY_IDENTIFIER Torque_Control.VDC_Power_Limit /end MEASUREMENT
/begin MEASUREMENT Torque_Control.Torque_Control_U.VDC_SKF_Initial "" FLOAT64_IEEE Torque_Control_CM_double 0 0 -1.7e+308 1.7e+308 ECU_ADDRESS 0x0 DISPLAY_IDENTIFIER Torque_Control.VDC_SKF_Initial /end MEASUREMENT
/begin MEASUREMENT Torque_Control.Torque_Control_U.Vel_RL_kmh "" FLOAT64_IEEE Torque_Control_CM_double 0 0 -1.7e+308 1.7e+308 ECU_ADDRESS 0x0 DISPLAY_IDENTIFIER Torque_Control.Vel_RL_kmh /end MEASUREMENT
/begin MEASUREMENT Torque_Control.Torque_Control_U.Vel_RR_kmh "" FLOAT64_IEEE Torque_Control_CM_double 0 0 -1.7e+308 1.7e+308 ECU_ADDRESS 0x0 DISPLAY_IDENTIFIER Torque_Control.Vel_RR_kmh /end MEASUREMENT
/begin MEASUREMENT Torque_Control.Torque_Control_U.Workshop_Mode_Enable "" FLOAT64_IEEE Torque_Control_CM_double 0 0 -1.7e+308 1.7e+308 ECU_ADDRESS 0x0 DISPLAY_IDENTIFIER Torque_Control.Workshop_Mode_Enable /end MEASUREMENT
/begin MEASUREMENT Torque_Control.Torque_Control_Y.APPS_Implausibility "" UBYTE Torque_Control_CM_boolean 0 0 0 1 ECU_ADDRESS 0x0 DISPLAY_IDENTIFIER Torque_Control.APPS_Implausibility /end MEASUREMENT
/begin MEASUREMENT Torque_Control.Torque_Control_Y.Brake_Implausibility "" UBYTE Torque_Control_CM_boolean 0 0 0 1 ECU_ADDRESS 0x0 DISPLAY_IDENTIFIER Torque_Control.Brake_Implausibility /end MEASUREMENT
/begin MEASUREMENT Torque_Control.Torque_Control_Y.CKF_actual "" FLOAT64_IEEE Torque_Control_CM_double 0 0 -1.7e+308 1.7e+308 ECU_ADDRESS 0x0 DISPLAY_IDENTIFIER Torque_Control.CKF_actual /end MEASUREMENT
/begin MEASUREMENT Torque_Control.Torque_Control_Y.Dash_Speed "" FLOAT64_IEEE Torque_Control_CM_double 0 0 -1.7e+308 1.7e+308 ECU_ADDRESS 0x0 DISPLAY_IDENTIFIER Torque_Control.Dash_Speed /end MEASUREMENT
/begin MEASUREMENT Torque_Control.Torque_Control_Y.Fy_R "" FLOAT64_IEEE Torque_Control_CM_double 0 0 -1.7e+308 1.7e+308 ECU_ADDRESS 0x0 DISPLAY_IDENTIFIER Torque_Control.Fy_R /end MEASUREMENT
/begin MEASUREMENT Torque_Control.Torque_Control_Y.Handling "" FLOAT64_IEEE Torque_Control_CM_double 0 0 -1.7e+308 1.7e+308 ECU_ADDRESS 0x0 DISPLAY_IDENTIFIER Torque_Control.Handling /end MEASUREMENT
/begin MEASUREMENT Torque_Control.Torque_Control_Y.Mass "" FLOAT64_IEEE Torque_Control_CM_double 0 0 -1.7e+308 1.7e+308 ECU_ADDRESS 0x0 DISPLAY_IDENTIFIER Torque_Control.Mass /end MEASUREMENT
/begin MEASUREMENT Torque_Control.Torque_Control_Y.Max_Fx_RL "" FLOAT64_IEEE Torque_Control_CM_double 0 0 -1.7e+308 1.7e+308 ECU_ADDRESS 0x0 DISPLAY_IDENTIFIER Torque_Control.Max_Fx_RL /end MEASUREMENT
/begin MEASUREMENT Torque_Control.Torque_Control_Y.Max_Fx_RR "" FLOAT64_IEEE Torque_Control_CM_double 0 0 -1.7e+308 1.7e+308 ECU_ADDRESS 0x0 DISPLAY_IDENTIFIER Torque_Control.Max_Fx_RR /end MEASUREMENT
/begin MEASUREMENT Torque_Control.Torque_Control_Y.Max_Torque_RL "" FLOAT64_IEEE Torque_Control_CM_double 0 0 -1.7e+308 1.7e+308 ECU_ADDRESS 0x0 DISPLAY_IDENTIFIER Torque_Control.Max_Torque_RL /end MEASUREMENT
/begin MEASUREMENT Torque_Control.Torque_Control_Y.Max_Torque_RR "" FLOAT64_IEEE Torque_Control_CM_double 0 0 -1.7e+308 1.7e+308 ECU_ADDRESS 0x0 DISPLAY_IDENTIFIER Torque_Control.Max_Torque_RR /end MEASUREMENT
/begin MEASUREMENT Torque_Control.Torque_Control_Y.MeasVDCTorque_L "" FLOAT64_IEEE Torque_Control_CM_double 0 0 -1.7e+308 1.7e+308 ECU_ADDRESS 0x0 DISPLAY_IDENTIFIER Torque_Control.Meas_VDC_Torque_L /end MEASUREMENT
/begin MEASUREMENT Torque_Control.Torque_Control_Y.MeasVDCTorque_R "" FLOAT64_IEEE Torque_Control_CM_double 0 0 -1.7e+308 1.7e+308 ECU_ADDRESS 0x0 DISPLAY_IDENTIFIER Torque_Control.Meas_VDC_Torque_R /end MEASUREMENT
/begin MEASUREMENT Torque_Control.Torque_Control_Y.Power "" FLOAT64_IEEE Torque_Control_CM_double 0 0 -1.7e+308 1.7e+308 ECU_ADDRESS 0x0 DISPLAY_IDENTIFIER Torque_Control.Power /end MEASUREMENT
/begin MEASUREMENT Torque_Control.Torque_Control_Y.PowerLimitReached "" FLOAT64_IEEE Torque_Control_CM_double 0 0 -1.7e+308 1.7e+308 ECU_ADDRESS 0x0 DISPLAY_IDENTIFIER Torque_Control.PowerLimitReached /end MEASUREMENT
/begin MEASUREMENT Torque_Control.Torque_Control_Y.PowerMean500ms "" FLOAT64_IEEE Torque_Control_CM_double 0 0 -1.7e+308 1.7e+308 ECU_ADDRESS 0x0 DISPLAY_IDENTIFIER Torque_Control.PowerMean500ms /end MEASUREMENT
/begin MEASUREMENT Torque_Control.Torque_Control_Y.Pumps_Control "" FLOAT64_IEEE Torque_Control_CM_double 0 0 -1.7e+308 1.7e+308 ECU_ADDRESS 0x0 DISPLAY_IDENTIFIER Torque_Control.Pumps_Control /end MEASUREMENT
/begin MEASUREMENT Torque_Control.Torque_Control_Y.Regenerative_Enable "" FLOAT64_IEEE Torque_Control_CM_double 0 0 -1.7e+308 1.7e+308 ECU_ADDRESS 0x0 DISPLAY_IDENTIFIER Torque_Control.Regenerative_Enable /end MEASUREMENT
/begin MEASUREMENT Torque_Control.Torque_Control_Y.SKF_actual "" FLOAT64_IEEE Torque_Control_CM_double 0 0 -1.7e+308 1.7e+308 ECU_ADDRESS 0x0 DISPLAY_IDENTIFIER Torque_Control.SKF_actual /end MEASUREMENT
/begin MEASUREMENT Torque_Control.Torque_Control_Y.SteeringSensor_Value "" FLOAT64_IEEE Torque_Control_CM_double 0 0 -1.7e+308 1.7e+308 ECU_ADDRESS 0x0 DISPLAY_IDENTIFIER Torque_Control.SteeringSensor_Value /end MEASUREMENT
/begin MEASUREMENT Torque_Control.Torque_Control_Y.TV_Flag_CarBehaviour "" FLOAT64_IEEE Torque_Control_CM_double 0 0 -1.7e+308 1.7e+308 ECU_ADDRESS 0x0 DISPLAY_IDENTIFIER Torque_Control.TV_Flag_CarBehaviour /end MEASUREMENT
/begin MEASUREMENT Torque_Control.Torque_Control_Y.TV_Flag_Power "" FLOAT64_IEEE Torque_Control_CM_double 0 0 -1.7e+308 1.7e+308 ECU_ADDRESS 0x0 DISPLAY_IDENTIFIER Torque_Control.TV_Flag_Power /end MEASUREMENT
/begin MEASUREMENT Torque_Control.Torque_Control_Y.TV_Flag_Temperature "" FLOAT64_IEEE Torque_Control_CM_double 0 0 -1.7e+308 1.7e+308 ECU_ADDRESS 0x0 DISPLAY_IDENTIFIER Torque_Control.TV_Flag_Temperature /end MEASUREMENT
/begin MEASUREMENT Torque_Control.Torque_Control_Y.TV_Flag_WheelSpinRL "" FLOAT64_IEEE Torque_Control_CM_double 0 0 -1.7e+308 1.7e+308 ECU_ADDRESS 0x0 DISPLAY_IDENTIFIER Torque_Control.TV_Flag_WheelSpinRL /end MEASUREMENT
/begin MEASUREMENT Torque_Control.Torque_Control_Y.TV_Flag_WheelSpinRR "" FLOAT64_IEEE Torque_Control_CM_double 0 0 -1.7e+308 1.7e+308 ECU_ADDRESS 0x0 DISPLAY_IDENTIFIER Torque_Control.TV_Flag_WheelSpinRR /end MEASUREMENT
/begin MEASUREMENT Torque_Control.Torque_Control_Y.Throttle "" FLOAT64_IEEE Torque_Control_CM_double 0 0 -1.7e+308 1.7e+308 ECU_ADDRESS 0x0 DISPLAY_IDENTIFIER Torque_Control.Throttle /end MEASUREMENT
/begin MEASUREMENT Torque_Control.Torque_Control_Y.Torque_L "" FLOAT64_IEEE Torque_Control_CM_double 0 0 -1.7e+308 1.7e+308 ECU_ADDRESS 0x0 DISPLAY_IDENTIFIER Torque_Control.Torque_L /end MEASUREMENT
/begin MEASUREMENT Torque_Control.Torque_Control_Y.Torque_OK "" UBYTE Torque_Control_CM_boolean 0 0 0 1 ECU_ADDRESS 0x0 DISPLAY_IDENTIFIER Torque_Control.Torque_OK /end MEASUREMENT
/begin MEASUREMENT Torque_Control.Torque_Control_Y.Torque_R "" FLOAT64_IEEE Torque_Control_CM_double 0 0 -1.7e+308 1.7e+308 ECU_ADDRESS 0x0 DISPLAY_IDENTIFIER Torque_Control.Torque_R /end MEASUREMENT
/begin MEASUREMENT Torque_Control.Torque_Control_Y.Torque_RLwc "" FLOAT64_IEEE Torque_Control_CM_double 0 0 -1.7e+308 1.7e+308 ECU_ADDRESS 0x0 DISPLAY_IDENTIFIER Torque_Control.Torque_RLwc /end MEASUREMENT
/begin MEASUREMENT Torque_Control.Torque_Control_Y.Torque_RRwc "" FLOAT64_IEEE Torque_Control_CM_double 0 0 -1.7e+308 1.7e+308 ECU_ADDRESS 0x0 DISPLAY_IDENTIFIER Torque_Control.Torque_RRwc /end MEASUREMENT
/begin MEASUREMENT Torque_Control.Torque_Control_Y.current_L "" FLOAT64_IEEE Torque_Control_CM_double 0 0 -1.7e+308 1.7e+308 ECU_ADDRESS 0x0 DISPLAY_IDENTIFIER Torque_Control.current_L /end MEASUREMENT
/begin MEASUREMENT Torque_Control.Torque_Control_Y.current_R "" FLOAT64_IEEE Torque_Control_CM_double 0 0 -1.7e+308 1.7e+308 ECU_ADDRESS 0x0 DISPLAY_IDENTIFIER Torque_Control.current_R /end MEASUREMENT
/begin CHARACTERISTIC Torque_Control.Torque_Control_P.Constant_Value_l "" VALUE 0x0 SCALAR_FLOAT64_IEEE 3.5e+305 Torque_Control_CM_double -1.7e+308 1.7e+308 DISPLAY_IDENTIFIER Torque_Control.VDC.Vehicle_Dynamics_Control_Modes.VDC_Complete.Wheel_to_motor.Constant.Value /end CHARACTERISTIC
/begin CHARACTERISTIC Torque_Control.Torque_Control_P.Constant_Value_m "" VALUE 0x0 SCALAR_FLOAT64_IEEE 3.5e+305 Torque_Control_CM_double -1.7e+308 1.7e+308 DISPLAY_IDENTIFIER Torque_Control.VDC.Regeneration_Enable.Constant.Value /end CHARACTERISTIC
/begin CHARACTERISTIC Torque_Control.Torque_Control_P.Constant_Value_n "" VALUE 0x0 SCALAR_FLOAT64_IEEE 3.5e+305 Torque_Control_CM_double -1.7e+308 1.7e+308 DISPLAY_IDENTIFIER Torque_Control.Pumps_Controller.Pumps_Control_OFF.Constant.Value /end CHARACTERISTIC
/begin CHARACTERISTIC Torque_Control.Torque_Control_P.Constant_Value_n5 "" VALUE 0x0 SCALAR_FLOAT64_IEEE 3.5e+305 Torque_Control_CM_double -1.7e+308 1.7e+308 DISPLAY_IDENTIFIER Torque_Control.VDC.Vehicle_Dynamics_Control_Modes.Steering_TV_with_TC.Optimization_SKF__amp__CKF.Subsystem.SKF.Spin.Constant.Value /end CHARACTERISTIC
/begin CHARACTERISTIC Torque_Control.Torque_Control_P.Cornering_Stiffness_FN_Value "" VALUE 0x0 SCALAR_FLOAT64_IEEE 3.5e+305 Torque_Control_CM_double -1.7e+308 1.7e+308 DISPLAY_IDENTIFIER Torque_Control.VDC.Vehicle_Dynamics_Control_Modes.VDC_Complete.Lateral_Dynamics.Yaw_Rate_Reference.Cornering_Stiffness_F_N___.Value /end CHARACTERISTIC
/begin CHARACTERISTIC Torque_Control.Torque_Control_P.Cornering_Stiffness_RN_Value "" VALUE 0x0 SCALAR_FLOAT64_IEEE 3.5e+305 Torque_Control_CM_double -1.7e+308 1.7e+308 DISPLAY_IDENTIFIER Torque_Control.VDC.Vehicle_Dynamics_Control_Modes.VDC_Complete.Lateral_Dynamics.Yaw_Rate_Reference.Cornering_Stiffness_R_N___.Value /end CHARACTERISTIC
/begin CHARACTERISTIC Torque_Control.Torque_Control_P.DataStoreMemory10_InitialValue "" VALUE 0x0 SCALAR_FLOAT64_IEEE 3.5e+305 Torque_Control_CM_double -1.7e+308 1.7e+308 DISPLAY_IDENTIFIER Torque_Control.Accumulator_Power.PowerLimitDetection.Data_Store_Memory10.InitialValue /end CHARACTERISTIC
/begin CHARACTERISTIC Torque_Control.Torque_Control_P.DataStoreMemory1_InitialValu_fl "" VALUE 0x0 SCALAR_UBYTE 1.0 Torque_Control_CM_boolean 0 1 DISPLAY_IDENTIFIER Torque_Control.SAFETY_BLOCK.BRAKE_IMPLAUSIBILITY.Data_Store_Memory1.InitialValue /end CHARACTERISTIC
/begin CHARACTERISTIC Torque_Control.Torque_Control_P.DataStoreMemory1_InitialValue "" VALUE 0x0 SCALAR_FLOAT64_IEEE 3.5e+305 Torque_Control_CM_double -1.7e+308 1.7e+308 DISPLAY_IDENTIFIER Torque_Control.Steering_Data_Conv.Low_Pass.Data_Store_Memory1.InitialValue /end CHARACTERISTIC
/begin CHARACTERISTIC Torque_Control.Torque_Control_P.DataStoreMemory1_InitialValue_f "" VALUE 0x0 SCALAR_FLOAT64_IEEE 3.5e+305 Torque_Control_CM_double -1.7e+308 1.7e+308 DISPLAY_IDENTIFIER Torque_Control.VDC.Vehicle_Dynamics_Control_Modes.Steering_TV_with_TC.Optimization_SKF__amp__CKF.Data_Store_Memory1.InitialValue /end CHARACTERISTIC
/begin CHARACTERISTIC Torque_Control.Torque_Control_P.DataStoreMemory1_InitialValue_i "" VALUE 0x0 SCALAR_FLOAT64_IEEE 3.5e+305 Torque_Control_CM_double -1.7e+308 1.7e+308 DISPLAY_IDENTIFIER Torque_Control.VDC.Vehicle_Dynamics_Control_Modes.VDC_Complete.Optimization_SKF__amp__CKF.Data_Store_Memory1.InitialValue /end CHARACTERISTIC
/begin CHARACTERISTIC Torque_Control.Torque_Control_P.DataStoreMemory1_InitialValue_m "" VALUE 0x0 SCALAR_FLOAT64_IEEE 3.5e+305 Torque_Control_CM_double -1.7e+308 1.7e+308 DISPLAY_IDENTIFIER Torque_Control.VDC.Vehicle_Dynamics_Control_Modes.VDC_without_Longitudinal.Optimization_SKF__amp__CKF.Data_Store_Memory1.InitialValue /end CHARACTERISTIC
/begin CHARACTERISTIC Torque_Control.Torque_Control_P.DataStoreMemory_InitialValue "" VALUE 0x0 SCALAR_FLOAT64_IEEE 3.5e+305 Torque_Control_CM_double -1.7e+308 1.7e+308 DISPLAY_IDENTIFIER Torque_Control.Steering_Data_Conv.Low_Pass.Data_Store_Memory.InitialValue /end CHARACTERISTIC
/begin CHARACTERISTIC Torque_Control.Torque_Control_P.DataStoreMemory_InitialValue_c "" VALUE 0x0 SCALAR_FLOAT64_IEEE 3.5e+305 Torque_Control_CM_double -1.7e+308 1.7e+308 DISPLAY_IDENTIFIER Torque_Control.VDC.Vehicle_Dynamics_Control_Modes.VDC_Complete.Optimization_SKF__amp__CKF.Data_Store_Memory.InitialValue /end CHARACTERISTIC
/begin CHARACTERISTIC Torque_Control.Torque_Control_P.DataStoreMemory_InitialValue_m "" VALUE 0x0 SCALAR_FLOAT64_IEEE 3.5e+305 Torque_Control_CM_double -1.7e+308 1.7e+308 DISPLAY_IDENTIFIER Torque_Control.VDC.Vehicle_Dynamics_Control_Modes.Steering_TV_with_TC.Optimization_SKF__amp__CKF.Data_Store_Memory.InitialValue /end CHARACTERISTIC
/begin CHARACTERISTIC Torque_Control.Torque_Control_P.DiametertoRadius_Gain "" VALUE 0x0 SCALAR_FLOAT64_IEEE 3.5e+305 Torque_Control_CM_double -1.7e+308 1.7e+308 DISPLAY_IDENTIFIER Torque_Control.VDC.Vehicle_Dynamics_Control_Modes.VDC_Complete.In_Numbers.Diameter_to_Radius.Gain /end CHARACTERISTIC
/begin CHARACTERISTIC Torque_Control.Torque_Control_P.DiametertoRadius_Gain_h "" VALUE 0x0 SCALAR_FLOAT64_IEEE 3.5e+305 Torque_Control_CM_double -1.7e+308 1.7e+308 DISPLAY_IDENTIFIER Torque_Control.VDC.Vehicle_Dynamics_Control_Modes.VDC_without_Longitudinal.In_Numbers.Diameter_to_Radius.Gain /end CHARACTERISTIC
/begin CHARACTERISTIC Torque_Control.Torque_Control_P.EffectiveRollingDiameterinch_Va "" VALUE 0x0 SCALAR_FLOAT64_IEEE 3.5e+305 Torque_Control_CM_double -1.7e+308 1.7e+308 DISPLAY_IDENTIFIER Torque_Control.VDC.Vehicle_Dynamics_Control_Modes.VDC_Complete.In_Numbers.Effective_Rolling_Diameter[inch].Value /end CHARACTERISTIC
/begin CHARACTERISTIC Torque_Control.Torque_Control_P.EffectiveRollingDiameterinch__b "" VALUE 0x0 SCALAR_FLOAT64_IEEE 3.5e+305 Torque_Control_CM_double -1.7e+308 1.7e+308 DISPLAY_IDENTIFIER Torque_Control.VDC.Vehicle_Dynamics_Control_Modes.VDC_without_Longitudinal.In_Numbers.Effective_Rolling_Diameter[inch].Value /end CHARACTERISTIC
/begin CHARACTERISTIC Torque_Control.Torque_Control_P.Enabled_Value "" VALUE 0x0 SCALAR_FLOAT64_IEEE 3.5e+305 Torque_Control_CM_double -1.7e+308 1.7e+308 DISPLAY_IDENTIFIER Torque_Control.VDC.Regeneration_Enable.Enabled.Value /end CHARACTERISTIC
/begin CHARACTERISTIC Torque_Control.Torque_Control_P.Flag_Accu_const "" VALUE 0x0 SCALAR_FLOAT64_IEEE 3.5e+305 Torque_Control_CM_double -1.7e+308 1.7e+308 DISPLAY_IDENTIFIER Torque_Control.Controls_Temperature_by_limiting_Torque.temperature_SoP.Flag_Accu.Constant.Value /end CHARACTERISTIC
/begin CHARACTERISTIC Torque_Control.Torque_Control_P.Flag_Accu_const_h "" VALUE 0x0 SCALAR_FLOAT64_IEEE 3.5e+305 Torque_Control_CM_double -1.7e+308 1.7e+308 DISPLAY_IDENTIFIER Torque_Control.power_limitation1.temperature_SoP.Flag_Accu.Constant.Value /end CHARACTERISTIC
/begin CHARACTERISTIC Torque_Control.Torque_Control_P.Flag_Inv_const "" VALUE 0x0 SCALAR_FLOAT64_IEEE 3.5e+305 Torque_Control_CM_double -1.7e+308 1.7e+308 DISPLAY_IDENTIFIER Torque_Control.Controls_Temperature_by_limiting_Torque.temperature_SoP.Flag_Inv.Constant.Value /end CHARACTERISTIC
/begin CHARACTERISTIC Torque_Control.Torque_Control_P.Flag_Inv_const_e "" VALUE 0x0 SCALAR_FLOAT64_IEEE 3.5e+305 Torque_Control_CM_double -1.7e+308 1.7e+308 DISPLAY_IDENTIFIER Torque_Control.power_limitation1.temperature_SoP.Flag_Inv.Constant.Value /end CHARACTERISTIC
/begin CHARACTERISTIC Torque_Control.Torque_Control_P.Flag_Mot_const "" VALUE 0x0 SCALAR_FLOAT64_IEEE 3.5e+305 Torque_Control_CM_double -1.7e+308 1.7e+308 DISPLAY_IDENTIFIER Torque_Control.Controls_Temperature_by_limiting_Torque.temperature_SoP.Flag_Mot.Constant.Value /end CHARACTERISTIC
/begin CHARACTERISTIC Torque_Control.Torque_Control_P.Flag_Mot_const_n "" VALUE 0x0 SCALAR_FLOAT64_IEEE 3.5e+305 Torque_Control_CM_double -1.7e+308 1.7e+308 DISPLAY_IDENTIFIER Torque_Control.power_limitation1.temperature_SoP.Flag_Mot.Constant.Value /end CHARACTERISTIC
/begin CHARACTERISTIC Torque_Control.Torque_Control_P.Flags_num5_Y0 "" VALUE 0x0 SCALAR_FLOAT64_IEEE 3.5e+305 Torque_Control_CM_double -1.7e+308 1.7e+308 DISPLAY_IDENTIFIER Torque_Control.VDC.Vehicle_Dynamics_Control_Modes.VDC_Complete.Flags_[num5].InitialOutput /end CHARACTERISTIC
/begin CHARACTERISTIC Torque_Control.Torque_Control_P.Fy_RN0inf_Y0 "" VALUE 0x0 SCALAR_FLOAT64_IEEE 3.5e+305 Torque_Control_CM_double -1.7e+308 1.7e+308 DISPLAY_IDENTIFIER Torque_Control.VDC.Vehicle_Dynamics_Control_Modes.VDC_without_Longitudinal.Fy_R_[N]__0_inf_.InitialOutput /end CHARACTERISTIC
/begin CHARACTERISTIC Torque_Control.Torque_Control_P.Fyperwheel_Gain "" VALUE 0x0 SCALAR_FLOAT64_IEEE 3.5e+305 Torque_Control_CM_double -1.7e+308 1.7e+308 DISPLAY_IDENTIFIER Torque_Control.VDC.Vehicle_Dynamics_Control_Modes.VDC_Complete.Lateral_Dynamics.Fy_per_wheel.Gain /end CHARACTERISTIC
/begin CHARACTERISTIC Torque_Control.Torque_Control_P.Fyperwheel_Gain_e "" VALUE 0x0 SCALAR_FLOAT64_IEEE 3.5e+305 Torque_Control_CM_double -1.7e+308 1.7e+308 DISPLAY_IDENTIFIER Torque_Control.VDC.Vehicle_Dynamics_Control_Modes.VDC_without_Longitudinal.Lateral_Dynamics.Fy_per_wheel.Gain /end CHARACTERISTIC
/begin CHARACTERISTIC Torque_Control.Torque_Control_P.Gain1_Gain "" VALUE 0x0 SCALAR_FLOAT64_IEEE 3.5e+305 Torque_Control_CM_double -1.7e+308 1.7e+308 DISPLAY_IDENTIFIER Torque_Control.VDC.Vehicle_Dynamics_Control_Modes.Steering_TV_with_TC.Accelerating__Braking_or_Regen_Braking.Regenerative_Mech_Braking.Gain1.Gain /end CHARACTERISTIC
/begin CHARACTERISTIC Torque_Control.Torque_Control_P.Gain1_Gain_m "" VALUE 0x0 SCALAR_FLOAT64_IEEE 3.5e+305 Torque_Control_CM_double -1.7e+308 1.7e+308 DISPLAY_IDENTIFIER Torque_Control.Gain1.Gain /end CHARACTERISTIC
/begin CHARACTERISTIC Torque_Control.Torque_Control_P.Gain1_Gain_o "" VALUE 0x0 SCALAR_FLOAT64_IEEE 3.5e+305 Torque_Control_CM_double -1.7e+308 1.7e+308 DISPLAY_IDENTIFIER Torque_Control.VDC.Gain1.Gain /end CHARACTERISTIC
/begin CHARACTERISTIC Torque_Control.Torque_Control_P.Gain5_Gain "" VALUE 0x0 SCALAR_FLOAT64_IEEE 3.5e+305 Torque_Control_CM_double -1.7e+308 1.7e+308 DISPLAY_IDENTIFIER Torque_Control.Controls_Temperature_by_limiting_Torque.SoC_SoP.Gain5.Gain /end CHARACTERISTIC
/begin CHARACTERISTIC Torque_Control.Torque_Control_P.Gain5_Gain_n "" VALUE 0x0 SCALAR_FLOAT64_IEEE 3.5e+305 Torque_Control_CM_double -1.7e+308 1.7e+308 DISPLAY_IDENTIFIER Torque_Control.power_limitation1.SoC_SoP.Gain5.Gain /end CHARACTERISTIC
/begin CHARACTERISTIC Torque_Control.Torque_Control_P.Gain6_Gain "" VALUE 0x0 SCALAR_FLOAT64_IEEE 3.5e+305 Torque_Control_CM_double -1.7e+308 1.7e+308 DISPLAY_IDENTIFIER Torque_Control.Controls_Temperature_by_limiting_Torque.SoC_SoP.Gain6.Gain /end CHARACTERISTIC
/begin CHARACTERISTIC Torque_Control.Torque_Control_P.Gain6_Gain_f "" VALUE 0x0 SCALAR_FLOAT64_IEEE 3.5e+305 Torque_Control_CM_double -1.7e+308 1.7e+308 DISPLAY_IDENTIFIER Torque_Control.power_limitation1.SoC_SoP.Gain6.Gain /end CHARACTERISTIC
/begin CHARACTERISTIC Torque_Control.Torque_Control_P.Gain_Gain "" VALUE 0x0 SCALAR_FLOAT64_IEEE 3.5e+305 Torque_Control_CM_double -1.7e+308 1.7e+308 DISPLAY_IDENTIFIER Torque_Control.Calculate_Current_Conversion.Gain.Gain /end CHARACTERISTIC
/begin CHARACTERISTIC Torque_Control.Torque_Control_P.Gain_Gain_b "" VALUE 0x0 SCALAR_FLOAT64_IEEE 3.5e+305 Torque_Control_CM_double -1.7e+308 1.7e+308 DISPLAY_IDENTIFIER Torque_Control.VDC.Vehicle_Dynamics_Control_Modes.Steering_TV_with_TC.Accelerating__Braking_or_Regen_Braking.Regenerative_Mech_Braking.Gain.Gain /end CHARACTERISTIC
/begin CHARACTERISTIC Torque_Control.Torque_Control_P.Gain_Gain_c "" VALUE 0x0 SCALAR_FLOAT64_IEEE 3.5e+305 Torque_Control_CM_double -1.7e+308 1.7e+308 DISPLAY_IDENTIFIER Torque_Control.Steering_Data_Conv.Low_Pass.Gain.Gain /end CHARACTERISTIC
/begin CHARACTERISTIC Torque_Control.Torque_Control_P.Gain_Gain_co "" VALUE 0x0 SCALAR_FLOAT64_IEEE 3.5e+305 Torque_Control_CM_double -1.7e+308 1.7e+308 DISPLAY_IDENTIFIER Torque_Control.VDC.Vehicle_Dynamics_Control_Modes.VDC_Complete.Constraints_and_motor_to_wheel_Tq.Acelerating_and_braking_without_Regenerative.Gain.Gain /end CHARACTERISTIC
/begin CHARACTERISTIC Torque_Control.Torque_Control_P.Gain_Gain_cv "" VALUE 0x0 SCALAR_FLOAT64_IEEE 3.5e+305 Torque_Control_CM_double -1.7e+308 1.7e+308 DISPLAY_IDENTIFIER Torque_Control.VDC.Vehicle_Dynamics_Control_Modes.VDC_without_Longitudinal.Constraints.Acelerating_and_braking_without_Regenerative.Gain.Gain /end CHARACTERISTIC
/begin CHARACTERISTIC Torque_Control.Torque_Control_P.Gain_Gain_f "" VALUE 0x0 SCALAR_FLOAT64_IEEE 3.5e+305 Torque_Control_CM_double -1.7e+308 1.7e+308 DISPLAY_IDENTIFIER Torque_Control.VDC.Vehicle_Dynamics_Control_Modes.Gain.Gain /end CHARACTERISTIC
/begin CHARACTERISTIC Torque_Control.Torque_Control_P.Gain_Gain_g "" VALUE 0x0 SCALAR_FLOAT64_IEEE 3.5e+305 Torque_Control_CM_double -1.7e+308 1.7e+308 DISPLAY_IDENTIFIER Torque_Control.Gain.Gain /end CHARACTERISTIC
/begin CHARACTERISTIC Torque_Control.Torque_Control_P.Gain_Gain_k "" VALUE 0x0 SCALAR_FLOAT64_IEEE 3.5e+305 Torque_Control_CM_double -1.7e+308 1.7e+308 DISPLAY_IDENTIFIER Torque_Control.VDC.Vehicle_Dynamics_Control_Modes.VDC_Complete.Longitudinal_Dynamics.Gain.Gain /end CHARACTERISTIC
/begin CHARACTERISTIC Torque_Control.Torque_Control_P.Gain_Gain_o "" VALUE 0x0 SCALAR_FLOAT64_IEEE 3.5e+305 Torque_Control_CM_double -1.7e+308 1.7e+308 DISPLAY_IDENTIFIER Torque_Control.Steering_Data_Conv.Gain.Gain /end CHARACTERISTIC
/begin CHARACTERISTIC Torque_Control.Torque_Control_P.GearRatio_Value "" VALUE 0x0 SCALAR_FLOAT64_IEEE 3.5e+305 Torque_Control_CM_double -1.7e+308 1.7e+308 DISPLAY_IDENTIFIER Torque_Control.Gear_Ratio.Value /end CHARACTERISTIC
/begin CHARACTERISTIC Torque_Control.Torque_Control_P.Gravity1_Gain "" VALUE 0x0 SCALAR_FLOAT64_IEEE 3.5e+305 Torque_Control_CM_double -1.7e+308 1.7e+308 DISPLAY_IDENTIFIER Torque_Control.VDC.Vehicle_Dynamics_Control_Modes.VDC_Complete.Lateral_Dynamics.Gravity1.Gain /end CHARACTERISTIC
/begin CHARACTERISTIC Torque_Control.Torque_Control_P.Gravity1_Gain_g "" VALUE 0x0 SCALAR_FLOAT64_IEEE 3.5e+305 Torque_Control_CM_double -1.7e+308 1.7e+308 DISPLAY_IDENTIFIER Torque_Control.VDC.Vehicle_Dynamics_Control_Modes.VDC_without_Longitudinal.Lateral_Dynamics.Gravity1.Gain /end CHARACTERISTIC
/begin CHARACTERISTIC Torque_Control.Torque_Control_P.Gravity_Gain "" VALUE 0x0 SCALAR_FLOAT64_IEEE 3.5e+305 Torque_Control_CM_double -1.7e+308 1.7e+308 DISPLAY_IDENTIFIER Torque_Control.VDC.Vehicle_Dynamics_Control_Modes.VDC_Complete.Lateral_Dynamics.Gravity.Gain /end CHARACTERISTIC
/begin CHARACTERISTIC Torque_Control.Torque_Control_P.Handlinginfinf_Y0 "" VALUE 0x0 SCALAR_FLOAT64_IEEE 3.5e+305 Torque_Control_CM_double -1.7e+308 1.7e+308 DISPLAY_IDENTIFIER Torque_Control.VDC.Vehicle_Dynamics_Control_Modes.VDC_without_Longitudinal.Handling_______inf_inf_.InitialOutput /end CHARACTERISTIC
/begin CHARACTERISTIC Torque_Control.Torque_Control_P.Integrator_IC "" VALUE 0x0 SCALAR_FLOAT64_IEEE 3.5e+305 Torque_Control_CM_double -1.7e+308 1.7e+308 DISPLAY_IDENTIFIER Torque_Control.VDC.Vehicle_Dynamics_Control_Modes.VDC_Complete.Lateral_Dynamics.Integrator.InitialCondition /end CHARACTERISTIC
/begin CHARACTERISTIC Torque_Control.Torque_Control_P.Inverters_Temperature_Limitatio "" VALUE 0x0 SCALAR_UBYTE 1.0 Torque_Control_CM_boolean 0 1 DISPLAY_IDENTIFIER Torque_Control.Controls_Temperature_by_limiting_Torque.Inverters_Temperature_Limitation_Flag.InitialOutput /end CHARACTERISTIC
/begin CHARACTERISTIC Torque_Control.Torque_Control_P.Lookup_SoC_SoP_chg_bp01Data "" VAL_BLK 0x0 SCALAR_FLOAT64_IEEE 3.5e+305 Torque_Control_CM_double -1.7e+308 1.7e+308 DISPLAY_IDENTIFIER Torque_Control.Controls_Temperature_by_limiting_Torque.SoC_SoP.Lookup_SoC_SoP_chg.BreakpointsForDimension1 NUMBER 8 /end CHARACTERISTIC
/begin CHARACTERISTIC Torque_Control.Torque_Control_P.Lookup_SoC_SoP_chg_bp01Data_b "" VAL_BLK 0x0 SCALAR_FLOAT64_IEEE 3.5e+305 Torque_Control_CM_double -1.7e+308 1.7e+308 DISPLAY_IDENTIFIER Torque_Control.power_limitation1.SoC_SoP.Lookup_SoC_SoP_chg.BreakpointsForDimension1 NUMBER 8 /end CHARACTERISTIC
/begin CHARACTERISTIC Torque_Control.Torque_Control_P.Lookup_SoC_SoP_chg_tableData "" VAL_BLK 0x0 SCALAR_FLOAT64_IEEE 3.5e+305 Torque_Control_CM_double -1.7e+308 1.7e+308 DISPLAY_IDENTIFIER Torque_Control.Controls_Temperature_by_limiting_Torque.SoC_SoP.Lookup_SoC_SoP_chg.Table NUMBER 8 /end CHARACTERISTIC
/begin CHARACTERISTIC Torque_Control.Torque_Control_P.Lookup_SoC_SoP_chg_tableData_p "" VAL_BLK 0x0 SCALAR_FLOAT64_IEEE 3.5e+305 Torque_Control_CM_double -1.7e+308 1.7e+308 DISPLAY_IDENTIFIER Torque_Control.power_limitation1.SoC_SoP.Lookup_SoC_SoP_chg.Table NUMBER 8 /end CHARACTERISTIC
/begin CHARACTERISTIC Torque_Control.Torque_Control_P.Lookup_SoC_SoP_dischg_bp01Dat_m "" VAL_BLK 0x0 SCALAR_FLOAT64_IEEE 3.5e+305 Torque_Control_CM_double -1.7e+308 1.7e+308 DISPLAY_IDENTIFIER Torque_Control.power_limitation1.SoC_SoP.Lookup_SoC_SoP_dischg.BreakpointsForDimension1 NUMBER 8 /end CHARACTERISTIC
/begin CHARACTERISTIC Torque_Control.Torque_Control_P.Lookup_SoC_SoP_dischg_bp01Data "" VAL_BLK 0x0 SCALAR_FLOAT64_IEEE 3.5e+305 Torque_Control_CM_double -1.7e+308 1.7e+308 DISPLAY_IDENTIFIER Torque_Control.Controls_Temperature_by_limiting_Torque.SoC_SoP.Lookup_SoC_SoP_dischg.BreakpointsForDimension1 NUMBER 8 /end CHARACTERISTIC
/begin CHARACTERISTIC Torque_Control.Torque_Control_P.Lookup_SoC_SoP_dischg_tableDa_g "" VAL_BLK 0x0 SCALAR_FLOAT64_IEEE 3.5e+305 Torque_Control_CM_double -1.7e+308 1.7e+308 DISPLAY_IDENTIFIER Torque_Control.power_limitation1.SoC_SoP.Lookup_SoC_SoP_dischg.Table NUMBER 8 /end CHARACTERISTIC
/begin CHARACTERISTIC Torque_Control.Torque_Control_P.Lookup_SoC_SoP_dischg_tableData "" VAL_BLK 0x0 SCALAR_FLOAT64_IEEE 3.5e+305 Torque_Control_CM_double -1.7e+308 1.7e+308 DISPLAY_IDENTIFIER Torque_Control.Controls_Temperature_by_limiting_Torque.SoC_SoP.Lookup_SoC_SoP_dischg.Table NUMBER 8 /end CHARACTERISTIC
/begin CHARACTERISTIC Torque_Control.Torque_Control_P.Lookup_Temp_SoP_chg_bp01Data "" VAL_BLK 0x0 SCALAR_FLOAT64_IEEE 3.5e+305 Torque_Control_CM_double -1.7e+308 1.7e+308 DISPLAY_IDENTIFIER Torque_Control.Controls_Temperature_by_limiting_Torque.SoC_SoP.Lookup_Temp_SoP_chg.BreakpointsForDimension1 NUMBER 5 /end CHARACTERISTIC
/begin CHARACTERISTIC Torque_Control.Torque_Control_P.Lookup_Temp_SoP_chg_bp01Data_i "" VAL_BLK 0x0 SCALAR_FLOAT64_IEEE 3.5e+305 Torque_Control_CM_double -1.7e+308 1.7e+308 DISPLAY_IDENTIFIER Torque_Control.power_limitation1.SoC_SoP.Lookup_Temp_SoP_chg.BreakpointsForDimension1 NUMBER 5 /end CHARACTERISTIC
/begin CHARACTERISTIC Torque_Control.Torque_Control_P.Lookup_Temp_SoP_chg_tableData "" VAL_BLK 0x0 SCALAR_FLOAT64_IEEE 3.5e+305 Torque_Control_CM_double -1.7e+308 1.7e+308 DISPLAY_IDENTIFIER Torque_Control.Controls_Temperature_by_limiting_Torque.SoC_SoP.Lookup_Temp_SoP_chg.Table NUMBER 5 /end CHARACTERISTIC
/begin CHARACTERISTIC Torque_Control.Torque_Control_P.Lookup_Temp_SoP_chg_tableData_m "" VAL_BLK 0x0 SCALAR_FLOAT64_IEEE 3.5e+305 Torque_Control_CM_double -1.7e+308 1.7e+308 DISPLAY_IDENTIFIER Torque_Control.power_limitation1.SoC_SoP.Lookup_Temp_SoP_chg.Table NUMBER 5 /end CHARACTERISTIC
/begin CHARACTERISTIC Torque_Control.Torque_Control_P.Masskg0inf_Y0 "" VALUE 0x0 SCALAR_FLOAT64_IEEE 3.5e+305 Torque_Control_CM_double -1.7e+308 1.7e+308 DISPLAY_IDENTIFIER Torque_Control.VDC.Vehicle_Dynamics_Control_Modes.VDC_without_Longitudinal.Mass_[kg]__0_inf_.InitialOutput /end CHARACTERISTIC
/begin CHARACTERISTIC Torque_Control.Torque_Control_P.MaxFx_RLN0inf_Y0 "" VALUE 0x0 SCALAR_FLOAT64_IEEE 3.5e+305 Torque_Control_CM_double -1.7e+308 1.7e+308 DISPLAY_IDENTIFIER Torque_Control.VDC.Vehicle_Dynamics_Control_Modes.VDC_without_Longitudinal.MaxFx_RL_[N]__0_inf_.InitialOutput /end CHARACTERISTIC
/begin CHARACTERISTIC Torque_Control.Torque_Control_P.MaxFx_RRN0inf_Y0 "" VALUE 0x0 SCALAR_FLOAT64_IEEE 3.5e+305 Torque_Control_CM_double -1.7e+308 1.7e+308 DISPLAY_IDENTIFIER Torque_Control.VDC.Vehicle_Dynamics_Control_Modes.VDC_without_Longitudinal.MaxFx_RR_[N]__0_inf_.InitialOutput /end CHARACTERISTIC
/begin CHARACTERISTIC Torque_Control.Torque_Control_P.MaxTq_RLNm0inf_Y0 "" VALUE 0x0 SCALAR_FLOAT64_IEEE 3.5e+305 Torque_Control_CM_double -1.7e+308 1.7e+308 DISPLAY_IDENTIFIER Torque_Control.VDC.Vehicle_Dynamics_Control_Modes.VDC_Complete.MaxTq_RL_[Nm]__0_inf_.InitialOutput /end CHARACTERISTIC
/begin CHARACTERISTIC Torque_Control.Torque_Control_P.MaxTq_RLNm0inf_Y0_d "" VALUE 0x0 SCALAR_FLOAT64_IEEE 3.5e+305 Torque_Control_CM_double -1.7e+308 1.7e+308 DISPLAY_IDENTIFIER Torque_Control.VDC.Vehicle_Dynamics_Control_Modes.VDC_without_Longitudinal.MaxTq_RL_[Nm]__0_inf_.InitialOutput /end CHARACTERISTIC
/begin CHARACTERISTIC Torque_Control.Torque_Control_P.MaxTq_RRNm0inf_Y0 "" VALUE 0x0 SCALAR_FLOAT64_IEEE 3.5e+305 Torque_Control_CM_double -1.7e+308 1.7e+308 DISPLAY_IDENTIFIER Torque_Control.VDC.Vehicle_Dynamics_Control_Modes.VDC_Complete.MaxTq_RR_[Nm]__0_inf_.InitialOutput /end CHARACTERISTIC
/begin CHARACTERISTIC Torque_Control.Torque_Control_P.MaxTq_RRNm0inf_Y0_o "" VALUE 0x0 SCALAR_FLOAT64_IEEE 3.5e+305 Torque_Control_CM_double -1.7e+308 1.7e+308 DISPLAY_IDENTIFIER Torque_Control.VDC.Vehicle_Dynamics_Control_Modes.VDC_without_Longitudinal.MaxTq_RR_[Nm]__0_inf_.InitialOutput /end CHARACTERISTIC
/begin CHARACTERISTIC Torque_Control.Torque_Control_P.MaxTqpermotorNm_Value "" VALUE 0x0 SCALAR_FLOAT64_IEEE 3.5e+305 Torque_Control_CM_double -1.7e+308 1.7e+308 DISPLAY_IDENTIFIER Torque_Control.Max_Tq_per_motor_[Nm].Value /end CHARACTERISTIC
/begin CHARACTERISTIC Torque_Control.Torque_Control_P.Max_Power_chargekW_Value "" VALUE 0x0 SCALAR_FLOAT64_IEEE 3.5e+305 Torque_Control_CM_double -1.7e+308 1.7e+308 DISPLAY_IDENTIFIER Torque_Control.Power_limitation.Max_Power_charge_[kW].Value /end CHARACTERISTIC
/begin CHARACTERISTIC Torque_Control.Torque_Control_P.Max_Power_dischargekW_Value "" VALUE 0x0 SCALAR_FLOAT64_IEEE 3.5e+305 Torque_Control_CM_double -1.7e+308 1.7e+308 DISPLAY_IDENTIFIER Torque_Control.Power_limitation.Max_Power_discharge_[kW].Value /end CHARACTERISTIC
/begin CHARACTERISTIC Torque_Control.Torque_Control_P.Max_Tq_per_motor_Value "" VALUE 0x0 SCALAR_FLOAT64_IEEE 3.5e+305 Torque_Control_CM_double -1.7e+308 1.7e+308 DISPLAY_IDENTIFIER Torque_Control.Controls_Temperature_by_limiting_Torque.Max_Tq_per_motor.Value /end CHARACTERISTIC
/begin CHARACTERISTIC Torque_Control.Torque_Control_P.MaximumTorqueperengineNm_Value "" VALUE 0x0 SCALAR_FLOAT64_IEEE 3.5e+305 Torque_Control_CM_double -1.7e+308 1.7e+308 DISPLAY_IDENTIFIER Torque_Control.VDC.Vehicle_Dynamics_Control_Modes.VDC_Complete.In_Numbers.Maximum_Torque_per_engine_[Nm].Value /end CHARACTERISTIC
/begin CHARACTERISTIC Torque_Control.Torque_Control_P.MaximumTorquepermotorNm_Value "" VALUE 0x0 SCALAR_FLOAT64_IEEE 3.5e+305 Torque_Control_CM_double -1.7e+308 1.7e+308 DISPLAY_IDENTIFIER Torque_Control.VDC.Vehicle_Dynamics_Control_Modes.VDC_without_Longitudinal.In_Numbers.Maximum_Torque_per_motor_[Nm].Value /end CHARACTERISTIC
/begin CHARACTERISTIC Torque_Control.Torque_Control_P.MaximumTransmissionTorqueDyna_a "" VALUE 0x0 SCALAR_FLOAT64_IEEE 3.5e+305 Torque_Control_CM_double -1.7e+308 1.7e+308 DISPLAY_IDENTIFIER Torque_Control.VDC.Vehicle_Dynamics_Control_Modes.VDC_without_Longitudinal.In_Numbers.Maximum_Transmission_Torque_Dynamic_[Nm].Value /end CHARACTERISTIC
/begin CHARACTERISTIC Torque_Control.Torque_Control_P.MaximumTransmissionTorqueDynami "" VALUE 0x0 SCALAR_FLOAT64_IEEE 3.5e+305 Torque_Control_CM_double -1.7e+308 1.7e+308 DISPLAY_IDENTIFIER Torque_Control.VDC.Vehicle_Dynamics_Control_Modes.VDC_Complete.In_Numbers.Maximum_Transmission_Torque_Dynamic_[Nm].Value /end CHARACTERISTIC
/begin CHARACTERISTIC Torque_Control.Torque_Control_P.MaximumTransmissionTorqueStat_n "" VALUE 0x0 SCALAR_FLOAT64_IEEE 3.5e+305 Torque_Control_CM_double -1.7e+308 1.7e+308 DISPLAY_IDENTIFIER Torque_Control.VDC.Vehicle_Dynamics_Control_Modes.VDC_without_Longitudinal.In_Numbers.Maximum_Transmission_Torque_Static_[Nm].Value /end CHARACTERISTIC
/begin CHARACTERISTIC Torque_Control.Torque_Control_P.MaximumTransmissionTorqueStatic "" VALUE 0x0 SCALAR_FLOAT64_IEEE 3.5e+305 Torque_Control_CM_double -1.7e+308 1.7e+308 DISPLAY_IDENTIFIER Torque_Control.VDC.Vehicle_Dynamics_Control_Modes.VDC_Complete.In_Numbers.Maximum_Transmission_Torque_Static_[Nm].Value /end CHARACTERISTIC
/begin CHARACTERISTIC Torque_Control.Torque_Control_P.Merge1_InitialOutput "" VALUE 0x0 SCALAR_FLOAT64_IEEE 3.5e+305 Torque_Control_CM_double -1.7e+308 1.7e+308 DISPLAY_IDENTIFIER Torque_Control.VDC.Vehicle_Dynamics_Control_Modes.VDC_Complete.Driver____CarBehaviours.Merge1.InitialOutput /end CHARACTERISTIC
/begin CHARACTERISTIC Torque_Control.Torque_Control_P.Merge1_InitialOutput_e "" VALUE 0x0 SCALAR_FLOAT64_IEEE 3.5e+305 Torque_Control_CM_double -1.7e+308 1.7e+308 DISPLAY_IDENTIFIER Torque_Control.VDC.Vehicle_Dynamics_Control_Modes.Steering_TV_with_TC.Accelerating__Braking_or_Regen_Braking.Merge1.InitialOutput /end CHARACTERISTIC
/begin CHARACTERISTIC Torque_Control.Torque_Control_P.Merge1_InitialOutput_k "" VALUE 0x0 SCALAR_FLOAT64_IEEE 3.5e+305 Torque_Control_CM_double -1.7e+308 1.7e+308 DISPLAY_IDENTIFIER Torque_Control.VDC.Vehicle_Dynamics_Control_Modes.VDC_without_Longitudinal.Driver____CarBehaviours.Merge1.InitialOutput /end CHARACTERISTIC
/begin CHARACTERISTIC Torque_Control.Torque_Control_P.Merge2_InitialOutput "" VALUE 0x0 SCALAR_FLOAT64_IEEE 3.5e+305 Torque_Control_CM_double -1.7e+308 1.7e+308 DISPLAY_IDENTIFIER Torque_Control.VDC.Vehicle_Dynamics_Control_Modes.VDC_Complete.Merge2.InitialOutput /end CHARACTERISTIC
/begin CHARACTERISTIC Torque_Control.Torque_Control_P.Merge2_InitialOutput_o "" VALUE 0x0 SCALAR_FLOAT64_IEEE 3.5e+305 Torque_Control_CM_double -1.7e+308 1.7e+308 DISPLAY_IDENTIFIER Torque_Control.VDC.Vehicle_Dynamics_Control_Modes.Merge2.InitialOutput /end CHARACTERISTIC
/begin CHARACTERISTIC Torque_Control.Torque_Control_P.Merge3_InitialOutput "" VALUE 0x0 SCALAR_FLOAT64_IEEE 3.5e+305 Torque_Control_CM_double -1.7e+308 1.7e+308 DISPLAY_IDENTIFIER Torque_Control.VDC.Vehicle_Dynamics_Control_Modes.VDC_Complete.Merge3.InitialOutput /end CHARACTERISTIC
/begin CHARACTERISTIC Torque_Control.Torque_Control_P.Merge3_InitialOutput_n "" VALUE 0x0 SCALAR_FLOAT64_IEEE 3.5e+305 Torque_Control_CM_double -1.7e+308 1.7e+308 DISPLAY_IDENTIFIER Torque_Control.VDC.Vehicle_Dynamics_Control_Modes.Merge3.InitialOutput /end CHARACTERISTIC
/begin CHARACTERISTIC Torque_Control.Torque_Control_P.Merge4_InitialOutput "" VALUE 0x0 SCALAR_FLOAT64_IEEE 3.5e+305 Torque_Control_CM_double -1.7e+308 1.7e+308 DISPLAY_IDENTIFIER Torque_Control.VDC.Vehicle_Dynamics_Control_Modes.VDC_Complete.Merge4.InitialOutput /end CHARACTERISTIC
/begin CHARACTERISTIC Torque_Control.Torque_Control_P.Merge5_InitialOutput "" VALUE 0x0 SCALAR_FLOAT64_IEEE 3.5e+305 Torque_Control_CM_double -1.7e+308 1.7e+308 DISPLAY_IDENTIFIER Torque_Control.VDC.Vehicle_Dynamics_Control_Modes.VDC_Complete.Merge5.InitialOutput /end CHARACTERISTIC
/begin CHARACTERISTIC Torque_Control.Torque_Control_P.Merge6_InitialOutput "" VALUE 0x0 SCALAR_FLOAT64_IEEE 3.5e+305 Torque_Control_CM_double -1.7e+308 1.7e+308 DISPLAY_IDENTIFIER Torque_Control.VDC.Vehicle_Dynamics_Control_Modes.VDC_Complete.Merge6.InitialOutput /end CHARACTERISTIC
/begin CHARACTERISTIC Torque_Control.Torque_Control_P.Merge7_InitialOutput "" VALUE 0x0 SCALAR_FLOAT64_IEEE 3.5e+305 Torque_Control_CM_double -1.7e+308 1.7e+308 DISPLAY_IDENTIFIER Torque_Control.VDC.Vehicle_Dynamics_Control_Modes.VDC_Complete.Merge7.InitialOutput /end CHARACTERISTIC
/begin CHARACTERISTIC Torque_Control.Torque_Control_P.MergeTq_RL_InitialOutput "" VALUE 0x0 SCALAR_FLOAT64_IEEE 3.5e+305 Torque_Control_CM_double -1.7e+308 1.7e+308 DISPLAY_IDENTIFIER Torque_Control.VDC.Vehicle_Dynamics_Control_Modes.Merge_Tq_RL.InitialOutput /end CHARACTERISTIC
/begin CHARACTERISTIC Torque_Control.Torque_Control_P.MergeTq_RR_InitialOutput "" VALUE 0x0 SCALAR_FLOAT64_IEEE 3.5e+305 Torque_Control_CM_double -1.7e+308 1.7e+308 DISPLAY_IDENTIFIER Torque_Control.VDC.Vehicle_Dynamics_Control_Modes.Merge_Tq_RR.InitialOutput /end CHARACTERISTIC
/begin CHARACTERISTIC Torque_Control.Torque_Control_P.Merge_InitialOutput "" VALUE 0x0 SCALAR_FLOAT64_IEEE 3.5e+305 Torque_Control_CM_double -1.7e+308 1.7e+308 DISPLAY_IDENTIFIER Torque_Control.VDC.Vehicle_Dynamics_Control_Modes.VDC_Complete.Optimization_SKF__amp__CKF.Subsystem.SKF.Merge.InitialOutput /end CHARACTERISTIC
/begin CHARACTERISTIC Torque_Control.Torque_Control_P.Merge_InitialOutput_a "" VALUE 0x0 SCALAR_FLOAT64_IEEE 3.5e+305 Torque_Control_CM_double -1.7e+308 1.7e+308 DISPLAY_IDENTIFIER Torque_Control.VDC.Vehicle_Dynamics_Control_Modes.Steering_TV_with_TC.Optimization_SKF__amp__CKF.Subsystem.CKF.Merge.InitialOutput /end CHARACTERISTIC
/begin CHARACTERISTIC Torque_Control.Torque_Control_P.Merge_InitialOutput_e "" VALUE 0x0 SCALAR_FLOAT64_IEEE 3.5e+305 Torque_Control_CM_double -1.7e+308 1.7e+308 DISPLAY_IDENTIFIER Torque_Control.VDC.Vehicle_Dynamics_Control_Modes.Steering_TV_with_TC.Accelerating__Braking_or_Regen_Braking.Merge.InitialOutput /end CHARACTERISTIC
/begin CHARACTERISTIC Torque_Control.Torque_Control_P.Merge_InitialOutput_h "" VALUE 0x0 SCALAR_FLOAT64_IEEE 3.5e+305 Torque_Control_CM_double -1.7e+308 1.7e+308 DISPLAY_IDENTIFIER Torque_Control.VDC.Vehicle_Dynamics_Control_Modes.VDC_without_Longitudinal.Optimization_SKF__amp__CKF.Subsystem.CKF.Merge.InitialOutput /end CHARACTERISTIC
/begin CHARACTERISTIC Torque_Control.Torque_Control_P.Merge_InitialOutput_i "" VALUE 0x0 SCALAR_FLOAT64_IEEE 3.5e+305 Torque_Control_CM_double -1.7e+308 1.7e+308 DISPLAY_IDENTIFIER Torque_Control.VDC.Vehicle_Dynamics_Control_Modes.VDC_Complete.Driver____CarBehaviours.Merge.InitialOutput /end CHARACTERISTIC
/begin CHARACTERISTIC Torque_Control.Torque_Control_P.Merge_InitialOutput_j "" VALUE 0x0 SCALAR_FLOAT64_IEEE 3.5e+305 Torque_Control_CM_double -1.7e+308 1.7e+308 DISPLAY_IDENTIFIER Torque_Control.VDC.Vehicle_Dynamics_Control_Modes.VDC_Complete.Optimization_SKF__amp__CKF.Subsystem.CKF.Merge.InitialOutput /end CHARACTERISTIC
/begin CHARACTERISTIC Torque_Control.Torque_Control_P.Merge_InitialOutput_l "" VALUE 0x0 SCALAR_FLOAT64_IEEE 3.5e+305 Torque_Control_CM_double -1.7e+308 1.7e+308 DISPLAY_IDENTIFIER Torque_Control.VDC.Vehicle_Dynamics_Control_Modes.VDC_without_Longitudinal.Driver____CarBehaviours.Merge.InitialOutput /end CHARACTERISTIC
/begin CHARACTERISTIC Torque_Control.Torque_Control_P.Merge_InitialOutput_p "" VALUE 0x0 SCALAR_FLOAT64_IEEE 3.5e+305 Torque_Control_CM_double -1.7e+308 1.7e+308 DISPLAY_IDENTIFIER Torque_Control.VDC.Vehicle_Dynamics_Control_Modes.Steering_TV_with_TC.Optimization_SKF__amp__CKF.Subsystem.SKF.Merge.InitialOutput /end CHARACTERISTIC
/begin CHARACTERISTIC Torque_Control.Torque_Control_P.Motors_Temperature_Limitation_F "" VALUE 0x0 SCALAR_UBYTE 1.0 Torque_Control_CM_boolean 0 1 DISPLAY_IDENTIFIER Torque_Control.Controls_Temperature_by_limiting_Torque.Motors_Temperature_Limitation_Flag.InitialOutput /end CHARACTERISTIC
/begin CHARACTERISTIC Torque_Control.Torque_Control_P.Out1_Y0 "" VALUE 0x0 SCALAR_FLOAT64_IEEE 3.5e+305 Torque_Control_CM_double -1.7e+308 1.7e+308 DISPLAY_IDENTIFIER Torque_Control.VDC.Vehicle_Dynamics_Control_Modes.If_Action_Subsystem.Out1.InitialOutput /end CHARACTERISTIC
/begin CHARACTERISTIC Torque_Control.Torque_Control_P.Out_Throttle_Y0 "" VALUE 0x0 SCALAR_FLOAT64_IEEE 3.5e+305 Torque_Control_CM_double -1.7e+308 1.7e+308 DISPLAY_IDENTIFIER Torque_Control.VDC.Vehicle_Dynamics_Control_Modes.VDC_Complete.Driver____CarBehaviours.Accelerating.Out_Throttle.InitialOutput /end CHARACTERISTIC
/begin CHARACTERISTIC Torque_Control.Torque_Control_P.Out_Throttle_Y0_a "" VALUE 0x0 SCALAR_FLOAT64_IEEE 3.5e+305 Torque_Control_CM_double -1.7e+308 1.7e+308 DISPLAY_IDENTIFIER Torque_Control.VDC.Vehicle_Dynamics_Control_Modes.VDC_without_Longitudinal.Driver____CarBehaviours.Accelerating.Out_Throttle.InitialOutput /end CHARACTERISTIC
/begin CHARACTERISTIC Torque_Control.Torque_Control_P.RT_L_Gain "" VALUE 0x0 SCALAR_FLOAT64_IEEE 3.5e+305 Torque_Control_CM_double -1.7e+308 1.7e+308 DISPLAY_IDENTIFIER Torque_Control.VDC.Vehicle_Dynamics_Control_Modes.Rigid_Axle.RT_L.Gain /end CHARACTERISTIC
/begin CHARACTERISTIC Torque_Control.Torque_Control_P.RT_R_Gain "" VALUE 0x0 SCALAR_FLOAT64_IEEE 3.5e+305 Torque_Control_CM_double -1.7e+308 1.7e+308 DISPLAY_IDENTIFIER Torque_Control.VDC.Vehicle_Dynamics_Control_Modes.Rigid_Axle.RT_R.Gain /end CHARACTERISTIC
/begin CHARACTERISTIC Torque_Control.Torque_Control_P.Rear_Trackwidthm_Value "" VALUE 0x0 SCALAR_FLOAT64_IEEE 3.5e+305 Torque_Control_CM_double -1.7e+308 1.7e+308 DISPLAY_IDENTIFIER Torque_Control.VDC.Vehicle_Dynamics_Control_Modes.VDC_Complete.Lateral_Dynamics.Rear_Trackwidth_[m].Value /end CHARACTERISTIC
/begin CHARACTERISTIC Torque_Control.Torque_Control_P.SKF_act_Y0 "" VALUE 0x0 SCALAR_FLOAT64_IEEE 3.5e+305 Torque_Control_CM_double -1.7e+308 1.7e+308 DISPLAY_IDENTIFIER Torque_Control.VDC.Vehicle_Dynamics_Control_Modes.VDC_Complete.Optimization_SKF__amp__CKF.Subsystem.SKF.SKF_act.InitialOutput /end CHARACTERISTIC
/begin CHARACTERISTIC Torque_Control.Torque_Control_P.SKF_act_Y0_l "" VALUE 0x0 SCALAR_FLOAT64_IEEE 3.5e+305 Torque_Control_CM_double -1.7e+308 1.7e+308 DISPLAY_IDENTIFIER Torque_Control.VDC.Vehicle_Dynamics_Control_Modes.Steering_TV_with_TC.Optimization_SKF__amp__CKF.Subsystem.SKF.SKF_act.InitialOutput /end CHARACTERISTIC
/begin CHARACTERISTIC Torque_Control.Torque_Control_P.Saturation1_LowerSat "" VALUE 0x0 SCALAR_FLOAT64_IEEE 3.5e+305 Torque_Control_CM_double -1.7e+308 1.7e+308 DISPLAY_IDENTIFIER Torque_Control.Controls_Temperature_by_limiting_Torque.temperature_SoP.temperature_rise_limitator_Accu.Saturation1.LowerLimit /end CHARACTERISTIC
/begin CHARACTERISTIC Torque_Control.Torque_Control_P.Saturation1_LowerSat_a "" VALUE 0x0 SCALAR_FLOAT64_IEEE 3.5e+305 Torque_Control_CM_double -1.7e+308 1.7e+308 DISPLAY_IDENTIFIER Torque_Control.Controls_Temperature_by_limiting_Torque.temperature_SoP.temperature_rise_limitator_Inverters.Saturation1.LowerLimit /end CHARACTERISTIC
/begin CHARACTERISTIC Torque_Control.Torque_Control_P.Saturation1_LowerSat_b "" VALUE 0x0 SCALAR_FLOAT64_IEEE 3.5e+305 Torque_Control_CM_double -1.7e+308 1.7e+308 DISPLAY_IDENTIFIER Torque_Control.power_limitation1.temperature_SoP.temperature_rise_limitator_Motors.Saturation1.LowerLimit /end CHARACTERISTIC
/begin CHARACTERISTIC Torque_Control.Torque_Control_P.Saturation1_LowerSat_j "" VALUE 0x0 SCALAR_FLOAT64_IEEE 3.5e+305 Torque_Control_CM_double -1.7e+308 1.7e+308 DISPLAY_IDENTIFIER Torque_Control.power_limitation1.Saturation1.LowerLimit /end CHARACTERISTIC
/begin CHARACTERISTIC Torque_Control.Torque_Control_P.Saturation1_LowerSat_k "" VALUE 0x0 SCALAR_FLOAT64_IEEE 3.5e+305 Torque_Control_CM_double -1.7e+308 1.7e+308 DISPLAY_IDENTIFIER Torque_Control.VDC.WORKSHOP_MODE_RESTRICTIONS.Torque_Reduction.Saturation1.LowerLimit /end CHARACTERISTIC
/begin CHARACTERISTIC Torque_Control.Torque_Control_P.Saturation1_LowerSat_ko "" VALUE 0x0 SCALAR_FLOAT64_IEEE 3.5e+305 Torque_Control_CM_double -1.7e+308 1.7e+308 DISPLAY_IDENTIFIER Torque_Control.power_limitation1.temperature_SoP.temperature_rise_limitator_Inverters.Saturation1.LowerLimit /end CHARACTERISTIC
/begin CHARACTERISTIC Torque_Control.Torque_Control_P.Saturation1_LowerSat_l "" VALUE 0x0 SCALAR_FLOAT64_IEEE 3.5e+305 Torque_Control_CM_double -1.7e+308 1.7e+308 DISPLAY_IDENTIFIER Torque_Control.Controls_Temperature_by_limiting_Torque.temperature_SoP.temperature_rise_limitator_Motors.Saturation1.LowerLimit /end CHARACTERISTIC
/begin CHARACTERISTIC Torque_Control.Torque_Control_P.Saturation1_LowerSat_lw "" VALUE 0x0 SCALAR_FLOAT64_IEEE 3.5e+305 Torque_Control_CM_double -1.7e+308 1.7e+308 DISPLAY_IDENTIFIER Torque_Control.VDC.WORKSHOP_MODE_RESTRICTIONS.Saturation1.LowerLimit /end CHARACTERISTIC
/begin CHARACTERISTIC Torque_Control.Torque_Control_P.Saturation1_LowerSat_m "" VALUE 0x0 SCALAR_FLOAT64_IEEE 3.5e+305 Torque_Control_CM_double -1.7e+308 1.7e+308 DISPLAY_IDENTIFIER Torque_Control.power_limitation1.temperature_SoP.temperature_rise_limitator_Accu.Saturation1.LowerLimit /end CHARACTERISTIC
/begin CHARACTERISTIC Torque_Control.Torque_Control_P.Saturation1_LowerSat_o "" VALUE 0x0 SCALAR_FLOAT64_IEEE 3.5e+305 Torque_Control_CM_double -1.7e+308 1.7e+308 DISPLAY_IDENTIFIER Torque_Control.Controls_Temperature_by_limiting_Torque.Saturation1.LowerLimit /end CHARACTERISTIC
/begin CHARACTERISTIC Torque_Control.Torque_Control_P.Saturation1_UpperSat "" VALUE 0x0 SCALAR_FLOAT64_IEEE 3.5e+305 Torque_Control_CM_double -1.7e+308 1.7e+308 DISPLAY_IDENTIFIER Torque_Control.Controls_Temperature_by_limiting_Torque.temperature_SoP.temperature_rise_limitator_Accu.Saturation1.UpperLimit /end CHARACTERISTIC
/begin CHARACTERISTIC Torque_Control.Torque_Control_P.Saturation1_UpperSat_a "" VALUE 0x0 SCALAR_FLOAT64_IEEE 3.5e+305 Torque_Control_CM_double -1.7e+308 1.7e+308 DISPLAY_IDENTIFIER Torque_Control.Controls_Temperature_by_limiting_Torque.temperature_SoP.temperature_rise_limitator_Inverters.Saturation1.UpperLimit /end CHARACTERISTIC
/begin CHARACTERISTIC Torque_Control.Torque_Control_P.Saturation1_UpperSat_b "" VALUE 0x0 SCALAR_FLOAT64_IEEE 3.5e+305 Torque_Control_CM_double -1.7e+308 1.7e+308 DISPLAY_IDENTIFIER Torque_Control.power_limitation1.temperature_SoP.temperature_rise_limitator_Motors.Saturation1.UpperLimit /end CHARACTERISTIC
/begin CHARACTERISTIC Torque_Control.Torque_Control_P.Saturation1_UpperSat_d "" VALUE 0x0 SCALAR_FLOAT64_IEEE 3.5e+305 Torque_Control_CM_double -1.7e+308 1.7e+308 DISPLAY_IDENTIFIER Torque_Control.power_limitation1.temperature_SoP.temperature_rise_limitator_Accu.Saturation1.UpperLimit /end CHARACTERISTIC
/begin CHARACTERISTIC Torque_Control.Torque_Control_P.Saturation1_UpperSat_e "" VALUE 0x0 SCALAR_FLOAT64_IEEE 3.5e+305 Torque_Control_CM_double -1.7e+308 1.7e+308 DISPLAY_IDENTIFIER Torque_Control.Controls_Temperature_by_limiting_Torque.Saturation1.UpperLimit /end CHARACTERISTIC
/begin CHARACTERISTIC Torque_Control.Torque_Control_P.Saturation1_UpperSat_g "" VALUE 0x0 SCALAR_FLOAT64_IEEE 3.5e+305 Torque_Control_CM_double -1.7e+308 1.7e+308 DISPLAY_IDENTIFIER Torque_Control.Controls_Temperature_by_limiting_Torque.temperature_SoP.temperature_rise_limitator_Motors.Saturation1.UpperLimit /end CHARACTERISTIC
/begin CHARACTERISTIC Torque_Control.Torque_Control_P.Saturation1_UpperSat_i "" VALUE 0x0 SCALAR_FLOAT64_IEEE 3.5e+305 Torque_Control_CM_double -1.7e+308 1.7e+308 DISPLAY_IDENTIFIER Torque_Control.power_limitation1.temperature_SoP.temperature_rise_limitator_Inverters.Saturation1.UpperLimit /end CHARACTERISTIC
/begin CHARACTERISTIC Torque_Control.Torque_Control_P.Saturation1_UpperSat_is "" VALUE 0x0 SCALAR_FLOAT64_IEEE 3.5e+305 Torque_Control_CM_double -1.7e+308 1.7e+308 DISPLAY_IDENTIFIER Torque_Control.power_limitation1.Saturation1.UpperLimit /end CHARACTERISTIC
/begin CHARACTERISTIC Torque_Control.Torque_Control_P.Saturation1_UpperSat_k "" VALUE 0x0 SCALAR_FLOAT64_IEEE 3.5e+305 Torque_Control_CM_double -1.7e+308 1.7e+308 DISPLAY_IDENTIFIER Torque_Control.VDC.WORKSHOP_MODE_RESTRICTIONS.Torque_Reduction.Saturation1.UpperLimit /end CHARACTERISTIC
/begin CHARACTERISTIC Torque_Control.Torque_Control_P.Saturation1_UpperSat_m "" VALUE 0x0 SCALAR_FLOAT64_IEEE 3.5e+305 Torque_Control_CM_double -1.7e+308 1.7e+308 DISPLAY_IDENTIFIER Torque_Control.VDC.WORKSHOP_MODE_RESTRICTIONS.Saturation1.UpperLimit /end CHARACTERISTIC
/begin CHARACTERISTIC Torque_Control.Torque_Control_P.Saturation_LowerSat "" VALUE 0x0 SCALAR_FLOAT64_IEEE 3.5e+305 Torque_Control_CM_double -1.7e+308 1.7e+308 DISPLAY_IDENTIFIER Torque_Control.Controls_Temperature_by_limiting_Torque.Saturation.LowerLimit /end CHARACTERISTIC
/begin CHARACTERISTIC Torque_Control.Torque_Control_P.Saturation_LowerSat_c "" VALUE 0x0 SCALAR_FLOAT64_IEEE 3.5e+305 Torque_Control_CM_double -1.7e+308 1.7e+308 DISPLAY_IDENTIFIER Torque_Control.VDC.Vehicle_Dynamics_Control_Modes.VDC_without_Longitudinal.Optimization_SKF__amp__CKF.Subsystem.CKF.Saturation.LowerLimit /end CHARACTERISTIC
/begin CHARACTERISTIC Torque_Control.Torque_Control_P.Saturation_LowerSat_e "" VALUE 0x0 SCALAR_FLOAT64_IEEE 3.5e+305 Torque_Control_CM_double -1.7e+308 1.7e+308 DISPLAY_IDENTIFIER Torque_Control.VDC.Vehicle_Dynamics_Control_Modes.Steering_TV_with_TC.Optimization_SKF__amp__CKF.Subsystem.CKF.Saturation.LowerLimit /end CHARACTERISTIC
/begin CHARACTERISTIC Torque_Control.Torque_Control_P.Saturation_LowerSat_ey "" VALUE 0x0 SCALAR_FLOAT64_IEEE 3.5e+305 Torque_Control_CM_double -1.7e+308 1.7e+308 DISPLAY_IDENTIFIER Torque_Control.power_limitation1.Saturation.LowerLimit /end CHARACTERISTIC
/begin CHARACTERISTIC Torque_Control.Torque_Control_P.Saturation_LowerSat_f "" VALUE 0x0 SCALAR_FLOAT64_IEEE 3.5e+305 Torque_Control_CM_double -1.7e+308 1.7e+308 DISPLAY_IDENTIFIER Torque_Control.VDC.Vehicle_Dynamics_Control_Modes.VDC_Complete.Optimization_SKF__amp__CKF.Subsystem.CKF.Saturation.LowerLimit /end CHARACTERISTIC
/begin CHARACTERISTIC Torque_Control.Torque_Control_P.Saturation_LowerSat_f3 "" VALUE 0x0 SCALAR_FLOAT64_IEEE 3.5e+305 Torque_Control_CM_double -1.7e+308 1.7e+308 DISPLAY_IDENTIFIER Torque_Control.VDC.Vehicle_Dynamics_Control_Modes.Steering_TV_with_TC.Optimization_SKF__amp__CKF.Subsystem.SKF.Saturation.LowerLimit /end CHARACTERISTIC
/begin CHARACTERISTIC Torque_Control.Torque_Control_P.Saturation_LowerSat_fi "" VALUE 0x0 SCALAR_FLOAT64_IEEE 3.5e+305 Torque_Control_CM_double -1.7e+308 1.7e+308 DISPLAY_IDENTIFIER Torque_Control.VDC.WORKSHOP_MODE_RESTRICTIONS.Saturation.LowerLimit /end CHARACTERISTIC
/begin CHARACTERISTIC Torque_Control.Torque_Control_P.Saturation_LowerSat_h "" VALUE 0x0 SCALAR_FLOAT64_IEEE 3.5e+305 Torque_Control_CM_double -1.7e+308 1.7e+308 DISPLAY_IDENTIFIER Torque_Control.VDC.Vehicle_Dynamics_Control_Modes.VDC_Complete.Optimization_SKF__amp__CKF.Subsystem.SKF.Saturation.LowerLimit /end CHARACTERISTIC
/begin CHARACTERISTIC Torque_Control.Torque_Control_P.Saturation_LowerSat_j "" VALUE 0x0 SCALAR_FLOAT64_IEEE 3.5e+305 Torque_Control_CM_double -1.7e+308 1.7e+308 DISPLAY_IDENTIFIER Torque_Control.VDC.WORKSHOP_MODE_RESTRICTIONS.Torque_Reduction.Saturation.LowerLimit /end CHARACTERISTIC
/begin CHARACTERISTIC Torque_Control.Torque_Control_P.Saturation_UpperSat "" VALUE 0x0 SCALAR_FLOAT64_IEEE 3.5e+305 Torque_Control_CM_double -1.7e+308 1.7e+308 DISPLAY_IDENTIFIER Torque_Control.Controls_Temperature_by_limiting_Torque.Saturation.UpperLimit /end CHARACTERISTIC
/begin CHARACTERISTIC Torque_Control.Torque_Control_P.Saturation_UpperSat_c "" VALUE 0x0 SCALAR_FLOAT64_IEEE 3.5e+305 Torque_Control_CM_double -1.7e+308 1.7e+308 DISPLAY_IDENTIFIER Torque_Control.VDC.Vehicle_Dynamics_Control_Modes.Steering_TV_with_TC.Optimization_SKF__amp__CKF.Subsystem.CKF.Saturation.UpperLimit /end CHARACTERISTIC
/begin CHARACTERISTIC Torque_Control.Torque_Control_P.Saturation_UpperSat_d "" VALUE 0x0 SCALAR_FLOAT64_IEEE 3.5e+305 Torque_Control_CM_double -1.7e+308 1.7e+308 DISPLAY_IDENTIFIER Torque_Control.VDC.Vehicle_Dynamics_Control_Modes.VDC_Complete.Optimization_SKF__amp__CKF.Subsystem.SKF.Saturation.UpperLimit /end CHARACTERISTIC
/begin CHARACTERISTIC Torque_Control.Torque_Control_P.Saturation_UpperSat_f "" VALUE 0x0 SCALAR_FLOAT64_IEEE 3.5e+305 Torque_Control_CM_double -1.7e+308 1.7e+308 DISPLAY_IDENTIFIER Torque_Control.VDC.Vehicle_Dynamics_Control_Modes.VDC_Complete.Optimization_SKF__amp__CKF.Subsystem.CKF.Saturation.UpperLimit /end CHARACTERISTIC
/begin CHARACTERISTIC Torque_Control.Torque_Control_P.Saturation_UpperSat_fg "" VALUE 0x0 SCALAR_FLOAT64_IEEE 3.5e+305 Torque_Control_CM_double -1.7e+308 1.7e+308 DISPLAY_IDENTIFIER Torque_Control.power_limitation1.Saturation.UpperLimit /end CHARACTERISTIC
/begin CHARACTERISTIC Torque_Control.Torque_Control_P.Saturation_UpperSat_g "" VALUE 0x0 SCALAR_FLOAT64_IEEE 3.5e+305 Torque_Control_CM_double -1.7e+308 1.7e+308 DISPLAY_IDENTIFIER Torque_Control.VDC.WORKSHOP_MODE_RESTRICTIONS.Saturation.UpperLimit /end CHARACTERISTIC
/begin CHARACTERISTIC Torque_Control.Torque_Control_P.Saturation_UpperSat_h "" VALUE 0x0 SCALAR_FLOAT64_IEEE 3.5e+305 Torque_Control_CM_double -1.7e+308 1.7e+308 DISPLAY_IDENTIFIER Torque_Control.VDC.WORKSHOP_MODE_RESTRICTIONS.Torque_Reduction.Saturation.UpperLimit /end CHARACTERISTIC
/begin CHARACTERISTIC Torque_Control.Torque_Control_P.Saturation_UpperSat_i "" VALUE 0x0 SCALAR_FLOAT64_IEEE 3.5e+305 Torque_Control_CM_double -1.7e+308 1.7e+308 DISPLAY_IDENTIFIER Torque_Control.VDC.Vehicle_Dynamics_Control_Modes.VDC_without_Longitudinal.Optimization_SKF__amp__CKF.Subsystem.CKF.Saturation.UpperLimit /end CHARACTERISTIC
/begin CHARACTERISTIC Torque_Control.Torque_Control_P.Saturation_UpperSat_k "" VALUE 0x0 SCALAR_FLOAT64_IEEE 3.5e+305 Torque_Control_CM_double -1.7e+308 1.7e+308 DISPLAY_IDENTIFIER Torque_Control.VDC.Vehicle_Dynamics_Control_Modes.Steering_TV_with_TC.Optimization_SKF__amp__CKF.Subsystem.SKF.Saturation.UpperLimit /end CHARACTERISTIC
/begin CHARACTERISTIC Torque_Control.Torque_Control_P.SteeringWheelMaximumAngle_Val_i "" VALUE 0x0 SCALAR_FLOAT64_IEEE 3.5e+305 Torque_Control_CM_double -1.7e+308 1.7e+308 DISPLAY_IDENTIFIER Torque_Control.VDC.Vehicle_Dynamics_Control_Modes.Steering_TV_with_TC.Steering_Wheel_Maximum_Angle.Value /end CHARACTERISTIC
/begin CHARACTERISTIC Torque_Control.Torque_Control_P.SteeringWheelMaximumAngle_Val_o "" VALUE 0x0 SCALAR_FLOAT64_IEEE 3.5e+305 Torque_Control_CM_double -1.7e+308 1.7e+308 DISPLAY_IDENTIFIER Torque_Control.VDC.Vehicle_Dynamics_Control_Modes.Steering_TV_with_TC.Optimization_SKF__amp__CKF.Subsystem.Steering_Wheel_Maximum_Angle.Value /end CHARACTERISTIC
/begin CHARACTERISTIC Torque_Control.Torque_Control_P.SteeringWheelMaximumAngle_Value "" VALUE 0x0 SCALAR_FLOAT64_IEEE 3.5e+305 Torque_Control_CM_double -1.7e+308 1.7e+308 DISPLAY_IDENTIFIER Torque_Control.VDC.Vehicle_Dynamics_Control_Modes.VDC_Complete.Optimization_SKF__amp__CKF.Subsystem.Steering_Wheel_Maximum_Angle.Value /end CHARACTERISTIC
/begin CHARACTERISTIC Torque_Control.Torque_Control_P.SteeringWheelSaturationpersited "" VALUE 0x0 SCALAR_FLOAT64_IEEE 3.5e+305 Torque_Control_CM_double -1.7e+308 1.7e+308 DISPLAY_IDENTIFIER Torque_Control.VDC.Vehicle_Dynamics_Control_Modes.Steering_Wheel_Saturation__per_site__[deg].Value /end CHARACTERISTIC
/begin CHARACTERISTIC Torque_Control.Torque_Control_P.Steering_Ratio_Value "" VALUE 0x0 SCALAR_FLOAT64_IEEE 3.5e+305 Torque_Control_CM_double -1.7e+308 1.7e+308 DISPLAY_IDENTIFIER Torque_Control.VDC.Vehicle_Dynamics_Control_Modes.VDC_Complete.Lateral_Dynamics.Yaw_Rate_Reference.Steering_Ratio____.Value /end CHARACTERISTIC
/begin CHARACTERISTIC Torque_Control.Torque_Control_P.Switch1_Threshold "" VALUE 0x0 SCALAR_FLOAT64_IEEE 3.5e+305 Torque_Control_CM_double -1.7e+308 1.7e+308 DISPLAY_IDENTIFIER Torque_Control.VDC.Vehicle_Dynamics_Control_Modes.VDC_Complete.Optimization_SKF__amp__CKF.Subsystem.SKF.Spin.Switch1.Threshold /end CHARACTERISTIC
/begin CHARACTERISTIC Torque_Control.Torque_Control_P.Switch1_Threshold_b "" VALUE 0x0 SCALAR_FLOAT64_IEEE 3.5e+305 Torque_Control_CM_double -1.7e+308 1.7e+308 DISPLAY_IDENTIFIER Torque_Control.VDC.Vehicle_Dynamics_Control_Modes.VDC_without_Longitudinal.Optimization_SKF__amp__CKF.Subsystem.CKF.No_spin.Switch1.Threshold /end CHARACTERISTIC
/begin CHARACTERISTIC Torque_Control.Torque_Control_P.Switch1_Threshold_c "" VALUE 0x0 SCALAR_FLOAT64_IEEE 3.5e+305 Torque_Control_CM_double -1.7e+308 1.7e+308 DISPLAY_IDENTIFIER Torque_Control.VDC.Vehicle_Dynamics_Control_Modes.VDC_without_Longitudinal.Optimization_SKF__amp__CKF.Subsystem.CKF.Spin.Switch1.Threshold /end CHARACTERISTIC
/begin CHARACTERISTIC Torque_Control.Torque_Control_P.Switch1_Threshold_f "" VALUE 0x0 SCALAR_FLOAT64_IEEE 3.5e+305 Torque_Control_CM_double -1.7e+308 1.7e+308 DISPLAY_IDENTIFIER Torque_Control.VDC.Vehicle_Dynamics_Control_Modes.VDC_Complete.Optimization_SKF__amp__CKF.Subsystem.SKF.No_spin.Switch1.Threshold /end CHARACTERISTIC
/begin CHARACTERISTIC Torque_Control.Torque_Control_P.Switch1_Threshold_h "" VALUE 0x0 SCALAR_FLOAT64_IEEE 3.5e+305 Torque_Control_CM_double -1.7e+308 1.7e+308 DISPLAY_IDENTIFIER Torque_Control.VDC.Vehicle_Dynamics_Control_Modes.VDC_Complete.Optimization_SKF__amp__CKF.Subsystem.CKF.No_spin.Switch1.Threshold /end CHARACTERISTIC
/begin CHARACTERISTIC Torque_Control.Torque_Control_P.Switch1_Threshold_j "" VALUE 0x0 SCALAR_FLOAT64_IEEE 3.5e+305 Torque_Control_CM_double -1.7e+308 1.7e+308 DISPLAY_IDENTIFIER Torque_Control.VDC.Vehicle_Dynamics_Control_Modes.VDC_Complete.Optimization_SKF__amp__CKF.Subsystem.CKF.Spin.Switch1.Threshold /end CHARACTERISTIC
/begin CHARACTERISTIC Torque_Control.Torque_Control_P.Switch1_Threshold_k "" VALUE 0x0 SCALAR_FLOAT64_IEEE 3.5e+305 Torque_Control_CM_double -1.7e+308 1.7e+308 DISPLAY_IDENTIFIER Torque_Control.VDC.Vehicle_Dynamics_Control_Modes.Steering_TV_with_TC.Optimization_SKF__amp__CKF.Subsystem.SKF.Spin.Switch1.Threshold /end CHARACTERISTIC
/begin CHARACTERISTIC Torque_Control.Torque_Control_P.Switch1_Threshold_p "" VALUE 0x0 SCALAR_FLOAT64_IEEE 3.5e+305 Torque_Control_CM_double -1.7e+308 1.7e+308 DISPLAY_IDENTIFIER Torque_Control.VDC.Vehicle_Dynamics_Control_Modes.Steering_TV_with_TC.Optimization_SKF__amp__CKF.Subsystem.CKF.Spin.Switch1.Threshold /end CHARACTERISTIC
/begin CHARACTERISTIC Torque_Control.Torque_Control_P.Switch_Threshold "" VALUE 0x0 SCALAR_FLOAT64_IEEE 3.5e+305 Torque_Control_CM_double -1.7e+308 1.7e+308 DISPLAY_IDENTIFIER Torque_Control.VDC.Vehicle_Dynamics_Control_Modes.VDC_Complete.Optimization_SKF__amp__CKF.Subsystem.SKF.Spin.Switch.Threshold /end CHARACTERISTIC
/begin CHARACTERISTIC Torque_Control.Torque_Control_P.Switch_Threshold_a "" VALUE 0x0 SCALAR_FLOAT64_IEEE 3.5e+305 Torque_Control_CM_double -1.7e+308 1.7e+308 DISPLAY_IDENTIFIER Torque_Control.VDC.Vehicle_Dynamics_Control_Modes.Steering_TV_with_TC.Optimization_SKF__amp__CKF.Subsystem.SKF.Spin.Switch.Threshold /end CHARACTERISTIC
/begin CHARACTERISTIC Torque_Control.Torque_Control_P.Switch_Threshold_b "" VALUE 0x0 SCALAR_FLOAT64_IEEE 3.5e+305 Torque_Control_CM_double -1.7e+308 1.7e+308 DISPLAY_IDENTIFIER Torque_Control.VDC.Vehicle_Dynamics_Control_Modes.Steering_TV_with_TC.Optimization_SKF__amp__CKF.Subsystem.CKF.Spin.Switch.Threshold /end CHARACTERISTIC
/begin CHARACTERISTIC Torque_Control.Torque_Control_P.Switch_Threshold_d "" VALUE 0x0 SCALAR_FLOAT64_IEEE 3.5e+305 Torque_Control_CM_double -1.7e+308 1.7e+308 DISPLAY_IDENTIFIER Torque_Control.VDC.Vehicle_Dynamics_Control_Modes.VDC_Complete.Optimization_SKF__amp__CKF.Subsystem.CKF.Spin.Switch.Threshold /end CHARACTERISTIC
/begin CHARACTERISTIC Torque_Control.Torque_Control_P.Switch_Threshold_e "" VALUE 0x0 SCALAR_FLOAT64_IEEE 3.5e+305 Torque_Control_CM_double -1.7e+308 1.7e+308 DISPLAY_IDENTIFIER Torque_Control.VDC.Vehicle_Dynamics_Control_Modes.Steering_TV_with_TC.Optimization_SKF__amp__CKF.Subsystem.CKF.No_spin.Switch.Threshold /end CHARACTERISTIC
/begin CHARACTERISTIC Torque_Control.Torque_Control_P.Switch_Threshold_f "" VALUE 0x0 SCALAR_FLOAT64_IEEE 3.5e+305 Torque_Control_CM_double -1.7e+308 1.7e+308 DISPLAY_IDENTIFIER Torque_Control.VDC.Vehicle_Dynamics_Control_Modes.Steering_TV_with_TC.Optimization_SKF__amp__CKF.Subsystem.SKF.No_spin.Switch.Threshold /end CHARACTERISTIC
/begin CHARACTERISTIC Torque_Control.Torque_Control_P.Switch_Threshold_i "" VALUE 0x0 SCALAR_FLOAT64_IEEE 3.5e+305 Torque_Control_CM_double -1.7e+308 1.7e+308 DISPLAY_IDENTIFIER Torque_Control.VDC.Vehicle_Dynamics_Control_Modes.VDC_without_Longitudinal.Optimization_SKF__amp__CKF.Subsystem.CKF.Spin.Switch.Threshold /end CHARACTERISTIC
/begin CHARACTERISTIC Torque_Control.Torque_Control_P.Temphigherthan110_const "" VALUE 0x0 SCALAR_FLOAT64_IEEE 3.5e+305 Torque_Control_CM_double -1.7e+308 1.7e+308 DISPLAY_IDENTIFIER Torque_Control.Controls_Temperature_by_limiting_Torque.temperature_SoP.temperature_rise_limitator_Motors.Temp_higher_than_110.Constant.Value /end CHARACTERISTIC
/begin CHARACTERISTIC Torque_Control.Torque_Control_P.Temphigherthan110_const_c "" VALUE 0x0 SCALAR_FLOAT64_IEEE 3.5e+305 Torque_Control_CM_double -1.7e+308 1.7e+308 DISPLAY_IDENTIFIER Torque_Control.power_limitation1.temperature_SoP.temperature_rise_limitator_Motors.Temp_higher_than_110.Constant.Value /end CHARACTERISTIC
/begin CHARACTERISTIC Torque_Control.Torque_Control_P.Temphigherthan50_const "" VALUE 0x0 SCALAR_FLOAT64_IEEE 3.5e+305 Torque_Control_CM_double -1.7e+308 1.7e+308 DISPLAY_IDENTIFIER Torque_Control.Controls_Temperature_by_limiting_Torque.temperature_SoP.temperature_rise_limitator_Accu.Temp_higher_than_50.Constant.Value /end CHARACTERISTIC
/begin CHARACTERISTIC Torque_Control.Torque_Control_P.Temphigherthan50_const_g "" VALUE 0x0 SCALAR_FLOAT64_IEEE 3.5e+305 Torque_Control_CM_double -1.7e+308 1.7e+308 DISPLAY_IDENTIFIER Torque_Control.power_limitation1.temperature_SoP.temperature_rise_limitator_Inverters.Temp_higher_than_50.Constant.Value /end CHARACTERISTIC
/begin CHARACTERISTIC Torque_Control.Torque_Control_P.Temphigherthan50_const_k "" VALUE 0x0 SCALAR_FLOAT64_IEEE 3.5e+305 Torque_Control_CM_double -1.7e+308 1.7e+308 DISPLAY_IDENTIFIER Torque_Control.Controls_Temperature_by_limiting_Torque.temperature_SoP.temperature_rise_limitator_Inverters.Temp_higher_than_50.Constant.Value /end CHARACTERISTIC
/begin CHARACTERISTIC Torque_Control.Torque_Control_P.Temphigherthan50_const_l "" VALUE 0x0 SCALAR_FLOAT64_IEEE 3.5e+305 Torque_Control_CM_double -1.7e+308 1.7e+308 DISPLAY_IDENTIFIER Torque_Control.power_limitation1.temperature_SoP.temperature_rise_limitator_Accu.Temp_higher_than_50.Constant.Value /end CHARACTERISTIC
/begin CHARACTERISTIC Torque_Control.Torque_Control_P.TomotorTqRT_Gain "" VALUE 0x0 SCALAR_FLOAT64_IEEE 3.5e+305 Torque_Control_CM_double -1.7e+308 1.7e+308 DISPLAY_IDENTIFIER Torque_Control.VDC.Vehicle_Dynamics_Control_Modes.VDC_Complete.In_Numbers.To_motor_Tq__RT_.Gain /end CHARACTERISTIC
/begin CHARACTERISTIC Torque_Control.Torque_Control_P.Torque_RLNm_Value "" VALUE 0x0 SCALAR_FLOAT64_IEEE 3.5e+305 Torque_Control_CM_double -1.7e+308 1.7e+308 DISPLAY_IDENTIFIER Torque_Control.VDC.Vehicle_Dynamics_Control_Modes.Rigid_Axle.Torque_RL_[Nm].Value /end CHARACTERISTIC
/begin CHARACTERISTIC Torque_Control.Torque_Control_P.Torque_RRNm_Value "" VALUE 0x0 SCALAR_FLOAT64_IEEE 3.5e+305 Torque_Control_CM_double -1.7e+308 1.7e+308 DISPLAY_IDENTIFIER Torque_Control.VDC.Vehicle_Dynamics_Control_Modes.Rigid_Axle.Torque_RR_[Nm].Value /end CHARACTERISTIC
/begin CHARACTERISTIC Torque_Control.Torque_Control_P.Tq_diff_Max_Value "" VALUE 0x0 SCALAR_FLOAT64_IEEE 3.5e+305 Torque_Control_CM_double -1.7e+308 1.7e+308 DISPLAY_IDENTIFIER Torque_Control.VDC.Vehicle_Dynamics_Control_Modes.VDC_Complete.In_Numbers.Tq_diff_Max.Value /end CHARACTERISTIC
/begin CHARACTERISTIC Torque_Control.Torque_Control_P.Tq_diff_maxNm_Value "" VALUE 0x0 SCALAR_FLOAT64_IEEE 3.5e+305 Torque_Control_CM_double -1.7e+308 1.7e+308 DISPLAY_IDENTIFIER Torque_Control.VDC.Vehicle_Dynamics_Control_Modes.Steering_TV_with_TC.Tq_diff_max_[Nm].Value /end CHARACTERISTIC
/begin CHARACTERISTIC Torque_Control.Torque_Control_P.Tq_max_motorNm_Value "" VALUE 0x0 SCALAR_FLOAT64_IEEE 3.5e+305 Torque_Control_CM_double -1.7e+308 1.7e+308 DISPLAY_IDENTIFIER Torque_Control.VDC.Vehicle_Dynamics_Control_Modes.Steering_TV_with_TC.Tq_max_motor_[Nm].Value /end CHARACTERISTIC
/begin CHARACTERISTIC Torque_Control.Torque_Control_P.TransmisionRatio_Value "" VALUE 0x0 SCALAR_FLOAT64_IEEE 3.5e+305 Torque_Control_CM_double -1.7e+308 1.7e+308 DISPLAY_IDENTIFIER Torque_Control.VDC.Vehicle_Dynamics_Control_Modes.VDC_Complete.In_Numbers.Transmision_Ratio___.Value /end CHARACTERISTIC
/begin CHARACTERISTIC Torque_Control.Torque_Control_P.TransmisionRatio_Value_j "" VALUE 0x0 SCALAR_FLOAT64_IEEE 3.5e+305 Torque_Control_CM_double -1.7e+308 1.7e+308 DISPLAY_IDENTIFIER Torque_Control.VDC.Vehicle_Dynamics_Control_Modes.VDC_without_Longitudinal.In_Numbers.Transmision_Ratio___.Value /end CHARACTERISTIC
/begin CHARACTERISTIC Torque_Control.Torque_Control_P.TransmissionGearRatio_Gain "" VALUE 0x0 SCALAR_FLOAT64_IEEE 3.5e+305 Torque_Control_CM_double -1.7e+308 1.7e+308 DISPLAY_IDENTIFIER Torque_Control.Transmission_Gear_Ratio.Gain /end CHARACTERISTIC
/begin CHARACTERISTIC Torque_Control.Torque_Control_P.TransmissionRatio1_Gain "" VALUE 0x0 SCALAR_FLOAT64_IEEE 3.5e+305 Torque_Control_CM_double -1.7e+308 1.7e+308 DISPLAY_IDENTIFIER Torque_Control.VDC.Vehicle_Dynamics_Control_Modes.Steering_TV_with_TC.Transmission_Ratio1.Gain /end CHARACTERISTIC
/begin CHARACTERISTIC Torque_Control.Torque_Control_P.TransmissionRatio_Gain "" VALUE 0x0 SCALAR_FLOAT64_IEEE 3.5e+305 Torque_Control_CM_double -1.7e+308 1.7e+308 DISPLAY_IDENTIFIER Torque_Control.VDC.Vehicle_Dynamics_Control_Modes.Steering_TV_with_TC.Transmission_Ratio.Gain /end CHARACTERISTIC
/begin CHARACTERISTIC Torque_Control.Torque_Control_P.Wheelbasem_Value "" VALUE 0x0 SCALAR_FLOAT64_IEEE 3.5e+305 Torque_Control_CM_double -1.7e+308 1.7e+308 DISPLAY_IDENTIFIER Torque_Control.VDC.Vehicle_Dynamics_Control_Modes.VDC_Complete.Lateral_Dynamics.Yaw_Rate_Reference.Wheelbase_[m].Value /end CHARACTERISTIC
/begin CHARACTERISTIC Torque_Control.Torque_Control_P.Yaw_Inertiakgm3_Value "" VALUE 0x0 SCALAR_FLOAT64_IEEE 3.5e+305 Torque_Control_CM_double -1.7e+308 1.7e+308 DISPLAY_IDENTIFIER Torque_Control.VDC.Vehicle_Dynamics_Control_Modes.VDC_Complete.Lateral_Dynamics.Yaw_Inertia__kg__m_3_.Value /end CHARACTERISTIC
/begin CHARACTERISTIC Torque_Control.Torque_Control_P.Zero_Value "" VALUE 0x0 SCALAR_FLOAT64_IEEE 3.5e+305 Torque_Control_CM_double -1.7e+308 1.7e+308 DISPLAY_IDENTIFIER Torque_Control.VDC.Regeneration_Enable.Zero.Value /end CHARACTERISTIC
/begin CHARACTERISTIC Torque_Control.Torque_Control_P.ct_Value "" VALUE 0x0 SCALAR_FLOAT64_IEEE 3.5e+305 Torque_Control_CM_double -1.7e+308 1.7e+308 DISPLAY_IDENTIFIER Torque_Control.Steering_Data_Conv.Low_Pass.ct.Value /end CHARACTERISTIC
/begin CHARACTERISTIC Torque_Control.Torque_Control_P.exptcycletau1_Value "" VALUE 0x0 SCALAR_FLOAT64_IEEE 3.5e+305 Torque_Control_CM_double -1.7e+308 1.7e+308 DISPLAY_IDENTIFIER Torque_Control.Steering_Data_Conv.Low_Pass.exp__tcycle__tau_1.Value /end CHARACTERISTIC
/begin CHARACTERISTIC Torque_Control.Torque_Control_P.halfrange_Value "" VALUE 0x0 SCALAR_FLOAT64_IEEE 3.5e+305 Torque_Control_CM_double -1.7e+308 1.7e+308 DISPLAY_IDENTIFIER Torque_Control.Steering_Data_Conv.half_range.Value /end CHARACTERISTIC
/begin CHARACTERISTIC Torque_Control.Torque_Control_P.inchtom1_Gain "" VALUE 0x0 SCALAR_FLOAT64_IEEE 3.5e+305 Torque_Control_CM_double -1.7e+308 1.7e+308 DISPLAY_IDENTIFIER Torque_Control.VDC.Vehicle_Dynamics_Control_Modes.VDC_Complete.In_Numbers.inch_to_m1.Gain /end CHARACTERISTIC
/begin CHARACTERISTIC Torque_Control.Torque_Control_P.inchtom_Gain "" VALUE 0x0 SCALAR_FLOAT64_IEEE 3.5e+305 Torque_Control_CM_double -1.7e+308 1.7e+308 DISPLAY_IDENTIFIER Torque_Control.VDC.Vehicle_Dynamics_Control_Modes.VDC_without_Longitudinal.In_Numbers.inch_to_m.Gain /end CHARACTERISTIC
/begin CHARACTERISTIC Torque_Control.Torque_Control_P.initial_limitation_Value "" VALUE 0x0 SCALAR_FLOAT64_IEEE 3.5e+305 Torque_Control_CM_double -1.7e+308 1.7e+308 DISPLAY_IDENTIFIER Torque_Control.Controls_Temperature_by_limiting_Torque.initial_limitation.Value /end CHARACTERISTIC
/begin CHARACTERISTIC Torque_Control.Torque_Control_P.initial_limitation_Value_k "" VALUE 0x0 SCALAR_FLOAT64_IEEE 3.5e+305 Torque_Control_CM_double -1.7e+308 1.7e+308 DISPLAY_IDENTIFIER Torque_Control.power_limitation1.initial_limitation.Value /end CHARACTERISTIC
/begin CHARACTERISTIC Torque_Control.Torque_Control_P.range_Value "" VALUE 0x0 SCALAR_FLOAT64_IEEE 3.5e+305 Torque_Control_CM_double -1.7e+308 1.7e+308 DISPLAY_IDENTIFIER Torque_Control.Steering_Data_Conv.range.Value /end CHARACTERISTIC
/begin CHARACTERISTIC Torque_Control.Torque_Control_P.rpm_Value "" VALUE 0x0 SCALAR_FLOAT64_IEEE 3.5e+305 Torque_Control_CM_double -1.7e+308 1.7e+308 DISPLAY_IDENTIFIER Torque_Control.VDC.Vehicle_Dynamics_Control_Modes.VDC_Complete.Constraints_and_motor_to_wheel_Tq.Acelerating_and_braking_without_Regenerative.rpm.Value /end CHARACTERISTIC
/begin CHARACTERISTIC Torque_Control.Torque_Control_P.rpm_Value_k "" VALUE 0x0 SCALAR_FLOAT64_IEEE 3.5e+305 Torque_Control_CM_double -1.7e+308 1.7e+308 DISPLAY_IDENTIFIER Torque_Control.VDC.Vehicle_Dynamics_Control_Modes.VDC_without_Longitudinal.Constraints.Acelerating_and_braking_without_Regenerative.rpm.Value /end CHARACTERISTIC
/begin CHARACTERISTIC Torque_Control.Torque_Control_P.u602pi_Gain "" VALUE 0x0 SCALAR_FLOAT64_IEEE 3.5e+305 Torque_Control_CM_double -1.7e+308 1.7e+308 DISPLAY_IDENTIFIER Torque_Control.VDC.Vehicle_Dynamics_Control_Modes.VDC_Complete.Lateral_Dynamics.Yaw_Rate_Reference.360___2_pi_.Gain /end CHARACTERISTIC
/begin CHARACTERISTIC Torque_Control.Torque_Control_P.u602pi_Gain_g "" VALUE 0x0 SCALAR_FLOAT64_IEEE 3.5e+305 Torque_Control_CM_double -1.7e+308 1.7e+308 DISPLAY_IDENTIFIER Torque_Control.VDC.Vehicle_Dynamics_Control_Modes.VDC_Complete.Lateral_Dynamics.Yaw_Rate_Reference.360___2pi_.Gain /end CHARACTERISTIC
/begin CHARACTERISTIC Torque_Control.Torque_Control_P.udifference1_Gain "" VALUE 0x0 SCALAR_FLOAT64_IEEE 3.5e+305 Torque_Control_CM_double -1.7e+308 1.7e+308 DISPLAY_IDENTIFIER Torque_Control.VDC.Vehicle_Dynamics_Control_Modes.VDC_Complete.In_Numbers.3__difference1.Gain /end CHARACTERISTIC
/begin CHARACTERISTIC Torque_Control.Torque_Control_P.udifference_Gain "" VALUE 0x0 SCALAR_FLOAT64_IEEE 3.5e+305 Torque_Control_CM_double -1.7e+308 1.7e+308 DISPLAY_IDENTIFIER Torque_Control.VDC.Vehicle_Dynamics_Control_Modes.VDC_without_Longitudinal.In_Numbers.3__difference.Gain /end CHARACTERISTIC
/begin CHARACTERISTIC Torque_Control.Torque_Control_P.zero_Value "" VALUE 0x0 SCALAR_FLOAT64_IEEE 3.5e+305 Torque_Control_CM_double -1.7e+308 1.7e+308 DISPLAY_IDENTIFIER Torque_Control.Steering_Data_Conv.zero.Value /end CHARACTERISTIC
/begin COMPU_METHOD Torque_Control_CM_double "Q = V" RAT_FUNC "%9.6" "NO_PHYSICAL_QTY" COEFFS 0.0 1.0 0.0 0.0 0.0 1.0 /end COMPU_METHOD
/begin COMPU_METHOD Torque_Control_CM_boolean "Q = V" RAT_FUNC "%9.6" "NO_PHYSICAL_QTY" COEFFS 0.0 1.0 0.0 0.0 0.0 1.0 /end COMPU_METHOD
/begin RECORD_LAYOUT SCALAR_FLOAT64_IEEE FNC_VALUES 1 FLOAT64_IEEE COLUMN_DIR DIRECT /end RECORD_LAYOUT
/begin RECORD_LAYOUT SCALAR_UBYTE FNC_VALUES 1 UBYTE COLUMN_DIR DIRECT /end RECORD_LAYOUT
/begin GROUP Torque_Control "" ROOT
 /begin REF_MEASUREMENT Torque_Control.Torque_Control_B.Abs Torque_Control.Torque_Control_B.BrakingwithRegenerative.sf_MATLABFunction.RegTq_RL Torque_Control.Torque_Control_B.BrakingwithRegenerative.sf_MATLABFunction.RegTq_RR Torque_Control.Torque_Control_B.BrakingwithRegenerative_b.sf_MATLABFunction.RegTq_RL Torque_Control.Torque_Control_B.BrakingwithRegenerative_b.sf_MATLABFunction.RegTq_RR Torque_Control.Torque_Control_B.Compare Torque_Control.Torque_Control_B.Compare_d Torque_Control.Torque_Control_B.Compare_g Torque_Control.Torque_Control_B.Constant Torque_Control.Torque_Control_B.Constant1 Torque_Control.Torque_Control_B.Constant14 Torque_Control.Torque_Control_B.Constant1_a Torque_Control.Torque_Control_B.Constant1_b Torque_Control.Torque_Control_B.Constant1_c Torque_Control.Torque_Control_B.Constant1_d Torque_Control.Torque_Control_B.Constant1_h Torque_Control.Torque_Control_B.Constant1_i Torque_Control.Torque_Control_B.Constant1_j Torque_Control.Torque_Control_B.Constant1_k Torque_Control.Torque_Control_B.Constant1_l Torque_Control.Torque_Control_B.Constant2 Torque_Control.Torque_Control_B.Constant2_k Torque_Control.Torque_Control_B.Constant2_m Torque_Control.Torque_Control_B.Constant2_n Torque_Control.Torque_Control_B.Constant2_p Torque_Control.Torque_Control_B.Constant2_pf Torque_Control.Torque_Control_B.Constant3 Torque_Control.Torque_Control_B.Constant3_b Torque_Control.Torque_Control_B.Constant3_e Torque_Control.Torque_Control_B.Constant3_f Torque_Control.Torque_Control_B.Constant3_i Torque_Control.Torque_Control_B.Constant3_it Torque_Control.Torque_Control_B.Constant3_n Torque_Control.Torque_Control_B.Constant3_o Torque_Control.Torque_Control_B.Constant4 Torque_Control.Torque_Control_B.Constant4_m Torque_Control.Torque_Control_B.Constant7 Torque_Control.Torque_Control_B.Constant8 Torque_Control.Torque_Control_B.Constant_a Torque_Control.Torque_Control_B.Constant_aq Torque_Control.Torque_Control_B.Constant_b Torque_Control.Torque_Control_B.Constant_bb Torque_Control.Torque_Control_B.Constant_bc Torque_Control.Torque_Control_B.Constant_c Torque_Control.Torque_Control_B.Constant_d Torque_Control.Torque_Control_B.Constant_dd Torque_Control.Torque_Control_B.Constant_do Torque_Control.Torque_Control_B.Constant_du Torque_Control.Torque_Control_B.Constant_dw Torque_Control.Torque_Control_B.Constant_e Torque_Control.Torque_Control_B.Constant_f Torque_Control.Torque_Control_B.Constant_g Torque_Control.Torque_Control_B.Constant_i Torque_Control.Torque_Control_B.Constant_j Torque_Control.Torque_Control_B.Constant_j3 Torque_Control.Torque_Control_B.Constant_jv Torque_Control.Torque_Control_B.Constant_k Torque_Control.Torque_Control_B.Constant_kc Torque_Control.Torque_Control_B.Constant_m Torque_Control.Torque_Control_B.Constant_mf Torque_Control.Torque_Control_B.Constant_mu Torque_Control.Torque_Control_B.Constant_n Torque_Control.Torque_Control_B.Constant_o Torque_Control.Torque_Control_B.Constant_o4 Torque_Control.Torque_Control_B.Constant_ob Torque_Control.Torque_Control_B.Constant_p Torque_Control.Torque_Control_B.Divide Torque_Control.Torque_Control_B.Divide1 Torque_Control.Torque_Control_B.Divide_i Torque_Control.Torque_Control_B.Enabled_a Torque_Control.Torque_Control_B.Gain Torque_Control.Torque_Control_B.GearRatio Torque_Control.Torque_Control_B.LogicalOperator Torque_Control.Torque_Control_B.LogicalOperator1 Torque_Control.Torque_Control_B.Lookup_SoC_SoP_chg Torque_Control.Torque_Control_B.Lookup_SoC_SoP_chg_j Torque_Control.Torque_Control_B.Lookup_SoC_SoP_dischg Torque_Control.Torque_Control_B.Lookup_SoC_SoP_dischg_k Torque_Control.Torque_Control_B.MaxTqpermotorNm Torque_Control.Torque_Control_B.Max_Power_chargekW Torque_Control.Torque_Control_B.Max_Power_dischargekW Torque_Control.Torque_Control_B.Max_Tq_per_motor Torque_Control.Torque_Control_B.MaximumTorqueperengineNm Torque_Control.Torque_Control_B.MaximumTransmissionTorqueDynami Torque_Control.Torque_Control_B.MaximumTransmissionTorqueStatic Torque_Control.Torque_Control_B.Merge Torque_Control.Torque_Control_B.Merge1 Torque_Control.Torque_Control_B.Merge1_a Torque_Control.Torque_Control_B.Merge1_a0 Torque_Control.Torque_Control_B.Merge1_b Torque_Control.Torque_Control_B.Merge1_l Torque_Control.Torque_Control_B.Merge1_n Torque_Control.Torque_Control_B.Merge1_p Torque_Control.Torque_Control_B.Merge1_pg Torque_Control.Torque_Control_B.Merge2 Torque_Control.Torque_Control_B.Merge2_e Torque_Control.Torque_Control_B.Merge2_j Torque_Control.Torque_Control_B.Merge2_l Torque_Control.Torque_Control_B.Merge2_lx Torque_Control.Torque_Control_B.Merge2_o Torque_Control.Torque_Control_B.Merge3 Torque_Control.Torque_Control_B.Merge3_c Torque_Control.Torque_Control_B.Merge3_e Torque_Control.Torque_Control_B.Merge4 Torque_Control.Torque_Control_B.Merge5 Torque_Control.Torque_Control_B.Merge5_e Torque_Control.Torque_Control_B.Merge6 Torque_Control.Torque_Control_B.Merge7 Torque_Control.Torque_Control_B.MergeTq_RL Torque_Control.Torque_Control_B.MergeTq_RR Torque_Control.Torque_Control_B.Merge_c Torque_Control.Torque_Control_B.Merge_d Torque_Control.Torque_Control_B.Merge_g Torque_Control.Torque_Control_B.Merge_i Torque_Control.Torque_Control_B.Merge_j Torque_Control.Torque_Control_B.Merge_k Torque_Control.Torque_Control_B.Merge_kj Torque_Control.Torque_Control_B.Merge_kt Torque_Control.Torque_Control_B.Merge_l Torque_Control.Torque_Control_B.Merge_li Torque_Control.Torque_Control_B.Merge_m Torque_Control.Torque_Control_B.OutportBufferForFlag_Power Torque_Control.Torque_Control_B.OutportBufferForFlags_num5 Torque_Control.Torque_Control_B.Product Torque_Control.Torque_Control_B.RT_L Torque_Control.Torque_Control_B.RT_R Torque_Control.Torque_Control_B.Saturation Torque_Control.Torque_Control_B.Saturation_f Torque_Control.Torque_Control_B.Saturation_i Torque_Control.Torque_Control_B.Saturation_k Torque_Control.Torque_Control_B.SteeringWheelMaximumAngle Torque_Control.Torque_Control_B.SteeringWheelMaximumAngle_m Torque_Control.Torque_Control_B.SteeringWheelMaximumAngle_p Torque_Control.Torque_Control_B.SteeringWheelSaturationpersited Torque_Control.Torque_Control_B.Steering_Ratio Torque_Control.Torque_Control_B.Subtract Torque_Control.Torque_Control_B.Throttle Torque_Control.Torque_Control_B.TowheelTqdynamic Torque_Control.Torque_Control_B.TowheelTqstatic Torque_Control.Torque_Control_B.Tq_diff_Max Torque_Control.Torque_Control_B.Tq_diff_maxNm Torque_Control.Torque_Control_B.Tq_max_motorNm Torque_Control.Torque_Control_B.TransmisionRatio Torque_Control.Torque_Control_B.Wheelbasem Torque_Control.Torque_Control_B.Yaw_Inertiakgm3 Torque_Control.Torque_Control_B.Zero Torque_Control.Torque_Control_B.approx2095 Torque_Control.Torque_Control_B.approx2095_h Torque_Control.Torque_Control_B.exptcycletau1 Torque_Control.Torque_Control_B.initial_limitation Torque_Control.Torque_Control_B.initial_limitation_m Torque_Control.Torque_Control_B.sf_Acceleratorbehaviour.throttle Torque_Control.Torque_Control_B.sf_Acceleratorbehaviour_b.throttle Torque_Control.Torque_Control_B.sf_Acceleratorbehaviour_br.throttle Torque_Control.Torque_Control_B.sf_Acceleratorbehaviour_o.throttle Torque_Control.Torque_Control_B.sf_MATLABFunction1_b.CKF_act0 Torque_Control.Torque_Control_B.sf_MATLABFunction1_f.value Torque_Control.Torque_Control_B.sf_MATLABFunction1_g.value Torque_Control.Torque_Control_B.sf_MATLABFunction1_gm.value Torque_Control.Torque_Control_B.sf_MATLABFunction1_h.RegTq_RL Torque_Control.Torque_Control_B.sf_MATLABFunction1_h.RegTq_RR Torque_Control.Torque_Control_B.sf_MATLABFunction1_m.value Torque_Control.Torque_Control_B.sf_MATLABFunction1_mk.value Torque_Control.Torque_Control_B.sf_MATLABFunction1_ny.value Torque_Control.Torque_Control_B.sf_MATLABFunction2.value Torque_Control.Torque_Control_B.sf_MATLABFunction2_b.value Torque_Control.Torque_Control_B.sf_MATLABFunction2_e.value Torque_Control.Torque_Control_B.sf_MATLABFunction2_l.value Torque_Control.Torque_Control_B.sf_MATLABFunction2_m.value Torque_Control.Torque_Control_B.sf_MATLABFunction_a.CKF_act0 Torque_Control.Torque_Control_B.sf_MATLABFunction_ab.RPM Torque_Control.Torque_Control_B.sf_MATLABFunction_d.value Torque_Control.Torque_Control_B.sf_MATLABFunction_e.SKF_act0 Torque_Control.Torque_Control_B.sf_MATLABFunction_fa.RPM Torque_Control.Torque_Control_B.sf_MATLABFunction_fq.SKF_act0 Torque_Control.Torque_Control_B.sf_MATLABFunction_i1.CKF_act1 Torque_Control.Torque_Control_B.sf_MATLABFunction_k2.CKF_act0 Torque_Control.Torque_Control_B.sf_MATLABFunction_mt.CKF_act1 Torque_Control.Torque_Control_B.sf_MATLABFunction_n.RPM Torque_Control.Torque_Control_B.u602pi Torque_Control.Torque_Control_B.u602pi_e Torque_Control.Torque_Control_B.udifference Torque_Control.Torque_Control_B.udifference1 Torque_Control.Torque_Control_DW.A Torque_Control.Torque_Control_DW.AA Torque_Control.Torque_Control_DW.A_b Torque_Control.Torque_Control_DW.A_i Torque_Control.Torque_Control_DW.B Torque_Control.Torque_Control_DW.B_i Torque_Control.Torque_Control_DW.B_k Torque_Control.Torque_Control_DW.Previous_IN Torque_Control.Torque_Control_DW.Previous_OUT Torque_Control.Torque_Control_U.ACCEL_F_X_SI Torque_Control.Torque_Control_U.ACCEL_F_Y_SI Torque_Control.Torque_Control_U.ACCEL_F_Z_SI Torque_Control.Torque_Control_U.ACCEL_R_X_SI Torque_Control.Torque_Control_U.ACCEL_R_Y_SI Torque_Control.Torque_Control_U.ACCEL_R_Z_SI Torque_Control.Torque_Control_U.APPS1_Value Torque_Control.Torque_Control_U.APPS2_Value Torque_Control.Torque_Control_U.Accumulator_Current Torque_Control.Torque_Control_U.Accumulator_Voltage Torque_Control.Torque_Control_U.BrakeSensor_Value Torque_Control.Torque_Control_U.Car_State Torque_Control.Torque_Control_U.CriticalDisconnection Torque_Control.Torque_Control_U.Gyro_F_Z_Deg Torque_Control.Torque_Control_U.Highest_CellTemp Torque_Control.Torque_Control_U.RL_rads Torque_Control.Torque_Control_U.RR_rads Torque_Control.Torque_Control_U.ShutdownClosed Torque_Control.Torque_Control_U.SteeringSensor_Bits Torque_Control.Torque_Control_U.Susp_F_L Torque_Control.Torque_Control_U.Susp_F_R Torque_Control.Torque_Control_U.Susp_R_L Torque_Control.Torque_Control_U.Susp_R_R Torque_Control.Torque_Control_U.TV_Mode Torque_Control.Torque_Control_U.Temp_IGBT Torque_Control.Torque_Control_U.Temp_Motors Torque_Control.Torque_Control_U.TorqueEnable Torque_Control.Torque_Control_U.VDC_Apps_Sat_Down Torque_Control.Torque_Control_U.VDC_Apps_Sat_Up Torque_Control.Torque_Control_U.VDC_CKF_Initial Torque_Control.Torque_Control_U.VDC_Cte_CKF Torque_Control.Torque_Control_U.VDC_Cte_SKF Torque_Control.Torque_Control_U.VDC_K_Reduction_P Torque_Control.Torque_Control_U.VDC_K_Reduction_Temperature Torque_Control.Torque_Control_U.VDC_Max_Regenerative_Torque Torque_Control.Torque_Control_U.VDC_Power_Limit Torque_Control.Torque_Control_U.VDC_SKF_Initial Torque_Control.Torque_Control_U.Vel_RL_kmh Torque_Control.Torque_Control_U.Vel_RR_kmh Torque_Control.Torque_Control_U.Workshop_Mode_Enable Torque_Control.Torque_Control_Y.APPS_Implausibility Torque_Control.Torque_Control_Y.Brake_Implausibility Torque_Control.Torque_Control_Y.CKF_actual Torque_Control.Torque_Control_Y.Dash_Speed Torque_Control.Torque_Control_Y.Fy_R Torque_Control.Torque_Control_Y.Handling Torque_Control.Torque_Control_Y.Mass Torque_Control.Torque_Control_Y.Max_Fx_RL Torque_Control.Torque_Control_Y.Max_Fx_RR Torque_Control.Torque_Control_Y.Max_Torque_RL Torque_Control.Torque_Control_Y.Max_Torque_RR Torque_Control.Torque_Control_Y.MeasVDCTorque_L Torque_Control.Torque_Control_Y.MeasVDCTorque_R Torque_Control.Torque_Control_Y.Power Torque_Control.Torque_Control_Y.PowerLimitReached Torque_Control.Torque_Control_Y.PowerMean500ms Torque_Control.Torque_Control_Y.Pumps_Control Torque_Control.Torque_Control_Y.Regenerative_Enable Torque_Control.Torque_Control_Y.SKF_actual Torque_Control.Torque_Control_Y.SteeringSensor_Value Torque_Control.Torque_Control_Y.TV_Flag_CarBehaviour Torque_Control.Torque_Control_Y.TV_Flag_Power Torque_Control.Torque_Control_Y.TV_Flag_Temperature Torque_Control.Torque_Control_Y.TV_Flag_WheelSpinRL Torque_Control.Torque_Control_Y.TV_Flag_WheelSpinRR Torque_Control.Torque_Control_Y.Throttle Torque_Control.Torque_Control_Y.Torque_L Torque_Control.Torque_Control_Y.Torque_OK Torque_Control.Torque_Control_Y.Torque_R Torque_Control.Torque_Control_Y.Torque_RLwc Torque_Control.Torque_Control_Y.Torque_RRwc Torque_Control.Torque_Control_Y.current_L Torque_Control.Torque_Control_Y.current_R /end REF_MEASUREMENT
 /begin REF_CHARACTERISTIC Torque_Control.Torque_Control_P.Constant_Value_l Torque_Control.Torque_Control_P.Constant_Value_m Torque_Control.Torque_Control_P.Constant_Value_n Torque_Control.Torque_Control_P.Constant_Value_n5 Torque_Control.Torque_Control_P.Cornering_Stiffness_FN_Value Torque_Control.Torque_Control_P.Cornering_Stiffness_RN_Value Torque_Control.Torque_Control_P.DataStoreMemory10_InitialValue Torque_Control.Torque_Control_P.DataStoreMemory1_InitialValu_fl Torque_Control.Torque_Control_P.DataStoreMemory1_InitialValue Torque_Control.Torque_Control_P.DataStoreMemory1_InitialValue_f Torque_Control.Torque_Control_P.DataStoreMemory1_InitialValue_i Torque_Control.Torque_Control_P.DataStoreMemory1_InitialValue_m Torque_Control.Torque_Control_P.DataStoreMemory_InitialValue Torque_Control.Torque_Control_P.DataStoreMemory_InitialValue_c Torque_Control.Torque_Control_P.DataStoreMemory_InitialValue_m Torque_Control.Torque_Control_P.DiametertoRadius_Gain Torque_Control.Torque_Control_P.DiametertoRadius_Gain_h Torque_Control.Torque_Control_P.EffectiveRollingDiameterinch_Va Torque_Control.Torque_Control_P.EffectiveRollingDiameterinch__b Torque_Control.Torque_Control_P.Enabled_Value Torque_Control.Torque_Control_P.Flag_Accu_const Torque_Control.Torque_Control_P.Flag_Accu_const_h Torque_Control.Torque_Control_P.Flag_Inv_const Torque_Control.Torque_Control_P.Flag_Inv_const_e Torque_Control.Torque_Control_P.Flag_Mot_const Torque_Control.Torque_Control_P.Flag_Mot_const_n Torque_Control.Torque_Control_P.Flags_num5_Y0 Torque_Control.Torque_Control_P.Fy_RN0inf_Y0 Torque_Control.Torque_Control_P.Fyperwheel_Gain Torque_Control.Torque_Control_P.Fyperwheel_Gain_e Torque_Control.Torque_Control_P.Gain1_Gain Torque_Control.Torque_Control_P.Gain1_Gain_m Torque_Control.Torque_Control_P.Gain1_Gain_o Torque_Control.Torque_Control_P.Gain5_Gain Torque_Control.Torque_Control_P.Gain5_Gain_n Torque_Control.Torque_Control_P.Gain6_Gain Torque_Control.Torque_Control_P.Gain6_Gain_f Torque_Control.Torque_Control_P.Gain_Gain Torque_Control.Torque_Control_P.Gain_Gain_b Torque_Control.Torque_Control_P.Gain_Gain_c Torque_Control.Torque_Control_P.Gain_Gain_co Torque_Control.Torque_Control_P.Gain_Gain_cv Torque_Control.Torque_Control_P.Gain_Gain_f Torque_Control.Torque_Control_P.Gain_Gain_g Torque_Control.Torque_Control_P.Gain_Gain_k Torque_Control.Torque_Control_P.Gain_Gain_o Torque_Control.Torque_Control_P.GearRatio_Value Torque_Control.Torque_Control_P.Gravity1_Gain Torque_Control.Torque_Control_P.Gravity1_Gain_g Torque_Control.Torque_Control_P.Gravity_Gain Torque_Control.Torque_Control_P.Handlinginfinf_Y0 Torque_Control.Torque_Control_P.Integrator_IC Torque_Control.Torque_Control_P.Inverters_Temperature_Limitatio Torque_Control.Torque_Control_P.Lookup_SoC_SoP_chg_bp01Data Torque_Control.Torque_Control_P.Lookup_SoC_SoP_chg_bp01Data_b Torque_Control.Torque_Control_P.Lookup_SoC_SoP_chg_tableData Torque_Control.Torque_Control_P.Lookup_SoC_SoP_chg_tableData_p Torque_Control.Torque_Control_P.Lookup_SoC_SoP_dischg_bp01Dat_m Torque_Control.Torque_Control_P.Lookup_SoC_SoP_dischg_bp01Data Torque_Control.Torque_Control_P.Lookup_SoC_SoP_dischg_tableDa_g Torque_Control.Torque_Control_P.Lookup_SoC_SoP_dischg_tableData Torque_Control.Torque_Control_P.Lookup_Temp_SoP_chg_bp01Data Torque_Control.Torque_Control_P.Lookup_Temp_SoP_chg_bp01Data_i Torque_Control.Torque_Control_P.Lookup_Temp_SoP_chg_tableData Torque_Control.Torque_Control_P.Lookup_Temp_SoP_chg_tableData_m Torque_Control.Torque_Control_P.Masskg0inf_Y0 Torque_Control.Torque_Control_P.MaxFx_RLN0inf_Y0 Torque_Control.Torque_Control_P.MaxFx_RRN0inf_Y0 Torque_Control.Torque_Control_P.MaxTq_RLNm0inf_Y0 Torque_Control.Torque_Control_P.MaxTq_RLNm0inf_Y0_d Torque_Control.Torque_Control_P.MaxTq_RRNm0inf_Y0 Torque_Control.Torque_Control_P.MaxTq_RRNm0inf_Y0_o Torque_Control.Torque_Control_P.MaxTqpermotorNm_Value Torque_Control.Torque_Control_P.Max_Power_chargekW_Value Torque_Control.Torque_Control_P.Max_Power_dischargekW_Value Torque_Control.Torque_Control_P.Max_Tq_per_motor_Value Torque_Control.Torque_Control_P.MaximumTorqueperengineNm_Value Torque_Control.Torque_Control_P.MaximumTorquepermotorNm_Value Torque_Control.Torque_Control_P.MaximumTransmissionTorqueDyna_a Torque_Control.Torque_Control_P.MaximumTransmissionTorqueDynami Torque_Control.Torque_Control_P.MaximumTransmissionTorqueStat_n Torque_Control.Torque_Control_P.MaximumTransmissionTorqueStatic Torque_Control.Torque_Control_P.Merge1_InitialOutput Torque_Control.Torque_Control_P.Merge1_InitialOutput_e Torque_Control.Torque_Control_P.Merge1_InitialOutput_k Torque_Control.Torque_Control_P.Merge2_InitialOutput Torque_Control.Torque_Control_P.Merge2_InitialOutput_o Torque_Control.Torque_Control_P.Merge3_InitialOutput Torque_Control.Torque_Control_P.Merge3_InitialOutput_n Torque_Control.Torque_Control_P.Merge4_InitialOutput Torque_Control.Torque_Control_P.Merge5_InitialOutput Torque_Control.Torque_Control_P.Merge6_InitialOutput Torque_Control.Torque_Control_P.Merge7_InitialOutput Torque_Control.Torque_Control_P.MergeTq_RL_InitialOutput Torque_Control.Torque_Control_P.MergeTq_RR_InitialOutput Torque_Control.Torque_Control_P.Merge_InitialOutput Torque_Control.Torque_Control_P.Merge_InitialOutput_a Torque_Control.Torque_Control_P.Merge_InitialOutput_e Torque_Control.Torque_Control_P.Merge_InitialOutput_h Torque_Control.Torque_Control_P.Merge_InitialOutput_i Torque_Control.Torque_Control_P.Merge_InitialOutput_j Torque_Control.Torque_Control_P.Merge_InitialOutput_l Torque_Control.Torque_Control_P.Merge_InitialOutput_p Torque_Control.Torque_Control_P.Motors_Temperature_Limitation_F Torque_Control.Torque_Control_P.Out1_Y0 Torque_Control.Torque_Control_P.Out_Throttle_Y0 Torque_Control.Torque_Control_P.Out_Throttle_Y0_a Torque_Control.Torque_Control_P.RT_L_Gain Torque_Control.Torque_Control_P.RT_R_Gain Torque_Control.Torque_Control_P.Rear_Trackwidthm_Value Torque_Control.Torque_Control_P.SKF_act_Y0 Torque_Control.Torque_Control_P.SKF_act_Y0_l Torque_Control.Torque_Control_P.Saturation1_LowerSat Torque_Control.Torque_Control_P.Saturation1_LowerSat_a Torque_Control.Torque_Control_P.Saturation1_LowerSat_b Torque_Control.Torque_Control_P.Saturation1_LowerSat_j Torque_Control.Torque_Control_P.Saturation1_LowerSat_k Torque_Control.Torque_Control_P.Saturation1_LowerSat_ko Torque_Control.Torque_Control_P.Saturation1_LowerSat_l Torque_Control.Torque_Control_P.Saturation1_LowerSat_lw Torque_Control.Torque_Control_P.Saturation1_LowerSat_m Torque_Control.Torque_Control_P.Saturation1_LowerSat_o Torque_Control.Torque_Control_P.Saturation1_UpperSat Torque_Control.Torque_Control_P.Saturation1_UpperSat_a Torque_Control.Torque_Control_P.Saturation1_UpperSat_b Torque_Control.Torque_Control_P.Saturation1_UpperSat_d Torque_Control.Torque_Control_P.Saturation1_UpperSat_e Torque_Control.Torque_Control_P.Saturation1_UpperSat_g Torque_Control.Torque_Control_P.Saturation1_UpperSat_i Torque_Control.Torque_Control_P.Saturation1_UpperSat_is Torque_Control.Torque_Control_P.Saturation1_UpperSat_k Torque_Control.Torque_Control_P.Saturation1_UpperSat_m Torque_Control.Torque_Control_P.Saturation_LowerSat Torque_Control.Torque_Control_P.Saturation_LowerSat_c Torque_Control.Torque_Control_P.Saturation_LowerSat_e Torque_Control.Torque_Control_P.Saturation_LowerSat_ey Torque_Control.Torque_Control_P.Saturation_LowerSat_f Torque_Control.Torque_Control_P.Saturation_LowerSat_f3 Torque_Control.Torque_Control_P.Saturation_LowerSat_fi Torque_Control.Torque_Control_P.Saturation_LowerSat_h Torque_Control.Torque_Control_P.Saturation_LowerSat_j Torque_Control.Torque_Control_P.Saturation_UpperSat Torque_Control.Torque_Control_P.Saturation_UpperSat_c Torque_Control.Torque_Control_P.Saturation_UpperSat_d Torque_Control.Torque_Control_P.Saturation_UpperSat_f Torque_Control.Torque_Control_P.Saturation_UpperSat_fg Torque_Control.Torque_Control_P.Saturation_UpperSat_g Torque_Control.Torque_Control_P.Saturation_UpperSat_h Torque_Control.Torque_Control_P.Saturation_UpperSat_i Torque_Control.Torque_Control_P.Saturation_UpperSat_k Torque_Control.Torque_Control_P.SteeringWheelMaximumAngle_Val_i Torque_Control.Torque_Control_P.SteeringWheelMaximumAngle_Val_o Torque_Control.Torque_Control_P.SteeringWheelMaximumAngle_Value Torque_Control.Torque_Control_P.SteeringWheelSaturationpersited Torque_Control.Torque_Control_P.Steering_Ratio_Value Torque_Control.Torque_Control_P.Switch1_Threshold Torque_Control.Torque_Control_P.Switch1_Threshold_b Torque_Control.Torque_Control_P.Switch1_Threshold_c Torque_Control.Torque_Control_P.Switch1_Threshold_f Torque_Control.Torque_Control_P.Switch1_Threshold_h Torque_Control.Torque_Control_P.Switch1_Threshold_j Torque_Control.Torque_Control_P.Switch1_Threshold_k Torque_Control.Torque_Control_P.Switch1_Threshold_p Torque_Control.Torque_Control_P.Switch_Threshold Torque_Control.Torque_Control_P.Switch_Threshold_a Torque_Control.Torque_Control_P.Switch_Threshold_b Torque_Control.Torque_Control_P.Switch_Threshold_d Torque_Control.Torque_Control_P.Switch_Threshold_e Torque_Control.Torque_Control_P.Switch_Threshold_f Torque_Control.Torque_Control_P.Switch_Threshold_i Torque_Control.Torque_Control_P.Temphigherthan110_const Torque_Control.Torque_Control_P.Temphigherthan110_const_c Torque_Control.Torque_Control_P.Temphigherthan50_const Torque_Control.Torque_Control_P.Temphigherthan50_const_g Torque_Control.Torque_Control_P.Temphigherthan50_const_k Torque_Control.Torque_Control_P.Temphigherthan50_const_l Torque_Control.Torque_Control_P.TomotorTqRT_Gain Torque_Control.Torque_Control_P.Torque_RLNm_Value Torque_Control.Torque_Control_P.Torque_RRNm_Value Torque_Control.Torque_Control_P.Tq_diff_Max_Value Torque_Control.Torque_Control_P.Tq_diff_maxNm_Value Torque_Control.Torque_Control_P.Tq_max_motorNm_Value Torque_Control.Torque_Control_P.TransmisionRatio_Value Torque_Control.Torque_Control_P.TransmisionRatio_Value_j Torque_Control.Torque_Control_P.TransmissionGearRatio_Gain Torque_Control.Torque_Control_P.TransmissionRatio1_Gain Torque_Control.Torque_Control_P.TransmissionRatio_Gain Torque_Control.Torque_Control_P.Wheelbasem_Value Torque_Control.Torque_Control_P.Yaw_Inertiakgm3_Value Torque_Control.Torque_Control_P.Zero_Value Torque_Control.Torque_Control_P.ct_Value Torque_Control.Torque_Control_P.exptcycletau1_Value Torque_Control.Torque_Control_P.halfrange_Value Torque_Control.Torque_Control_P.inchtom1_Gain Torque_Control.Torque_Control_P.inchtom_Gain Torque_Control.Torque_Control_P.initial_limitation_Value Torque_Control.Torque_Control_P.initial_limitation_Value_k Torque_Control.Torque_Control_P.range_Value Torque_Control.Torque_Control_P.rpm_Value Torque_Control.Torque_Control_P.rpm_Value_k Torque_Control.Torque_Control_P.u602pi_Gain Torque_Control.Torque_Control_P.u602pi_Gain_g Torque_Control.Torque_Control_P.udifference1_Gain Torque_Control.Torque_Control_P.udifference_Gain Torque_Control.Torque_Control_P.zero_Value /end REF_CHARACTERISTIC
/end GROUP
/begin GROUP Torque_Control.Torque_Control_B ""
 /begin REF_MEASUREMENT Torque_Control.Torque_Control_B.Abs Torque_Control.Torque_Control_B.BrakingwithRegenerative.sf_MATLABFunction.RegTq_RL Torque_Control.Torque_Control_B.BrakingwithRegenerative.sf_MATLABFunction.RegTq_RR Torque_Control.Torque_Control_B.BrakingwithRegenerative_b.sf_MATLABFunction.RegTq_RL Torque_Control.Torque_Control_B.BrakingwithRegenerative_b.sf_MATLABFunction.RegTq_RR Torque_Control.Torque_Control_B.Compare Torque_Control.Torque_Control_B.Compare_d Torque_Control.Torque_Control_B.Compare_g Torque_Control.Torque_Control_B.Constant Torque_Control.Torque_Control_B.Constant1 Torque_Control.Torque_Control_B.Constant14 Torque_Control.Torque_Control_B.Constant1_a Torque_Control.Torque_Control_B.Constant1_b Torque_Control.Torque_Control_B.Constant1_c Torque_Control.Torque_Control_B.Constant1_d Torque_Control.Torque_Control_B.Constant1_h Torque_Control.Torque_Control_B.Constant1_i Torque_Control.Torque_Control_B.Constant1_j Torque_Control.Torque_Control_B.Constant1_k Torque_Control.Torque_Control_B.Constant1_l Torque_Control.Torque_Control_B.Constant2 Torque_Control.Torque_Control_B.Constant2_k Torque_Control.Torque_Control_B.Constant2_m Torque_Control.Torque_Control_B.Constant2_n Torque_Control.Torque_Control_B.Constant2_p Torque_Control.Torque_Control_B.Constant2_pf Torque_Control.Torque_Control_B.Constant3 Torque_Control.Torque_Control_B.Constant3_b Torque_Control.Torque_Control_B.Constant3_e Torque_Control.Torque_Control_B.Constant3_f Torque_Control.Torque_Control_B.Constant3_i Torque_Control.Torque_Control_B.Constant3_it Torque_Control.Torque_Control_B.Constant3_n Torque_Control.Torque_Control_B.Constant3_o Torque_Control.Torque_Control_B.Constant4 Torque_Control.Torque_Control_B.Constant4_m Torque_Control.Torque_Control_B.Constant7 Torque_Control.Torque_Control_B.Constant8 Torque_Control.Torque_Control_B.Constant_a Torque_Control.Torque_Control_B.Constant_aq Torque_Control.Torque_Control_B.Constant_b Torque_Control.Torque_Control_B.Constant_bb Torque_Control.Torque_Control_B.Constant_bc Torque_Control.Torque_Control_B.Constant_c Torque_Control.Torque_Control_B.Constant_d Torque_Control.Torque_Control_B.Constant_dd Torque_Control.Torque_Control_B.Constant_do Torque_Control.Torque_Control_B.Constant_du Torque_Control.Torque_Control_B.Constant_dw Torque_Control.Torque_Control_B.Constant_e Torque_Control.Torque_Control_B.Constant_f Torque_Control.Torque_Control_B.Constant_g Torque_Control.Torque_Control_B.Constant_i Torque_Control.Torque_Control_B.Constant_j Torque_Control.Torque_Control_B.Constant_j3 Torque_Control.Torque_Control_B.Constant_jv Torque_Control.Torque_Control_B.Constant_k Torque_Control.Torque_Control_B.Constant_kc Torque_Control.Torque_Control_B.Constant_m Torque_Control.Torque_Control_B.Constant_mf Torque_Control.Torque_Control_B.Constant_mu Torque_Control.Torque_Control_B.Constant_n Torque_Control.Torque_Control_B.Constant_o Torque_Control.Torque_Control_B.Constant_o4 Torque_Control.Torque_Control_B.Constant_ob Torque_Control.Torque_Control_B.Constant_p Torque_Control.Torque_Control_B.Divide Torque_Control.Torque_Control_B.Divide1 Torque_Control.Torque_Control_B.Divide_i Torque_Control.Torque_Control_B.Enabled_a Torque_Control.Torque_Control_B.Gain Torque_Control.Torque_Control_B.GearRatio Torque_Control.Torque_Control_B.LogicalOperator Torque_Control.Torque_Control_B.LogicalOperator1 Torque_Control.Torque_Control_B.Lookup_SoC_SoP_chg Torque_Control.Torque_Control_B.Lookup_SoC_SoP_chg_j Torque_Control.Torque_Control_B.Lookup_SoC_SoP_dischg Torque_Control.Torque_Control_B.Lookup_SoC_SoP_dischg_k Torque_Control.Torque_Control_B.MaxTqpermotorNm Torque_Control.Torque_Control_B.Max_Power_chargekW Torque_Control.Torque_Control_B.Max_Power_dischargekW Torque_Control.Torque_Control_B.Max_Tq_per_motor Torque_Control.Torque_Control_B.MaximumTorqueperengineNm Torque_Control.Torque_Control_B.MaximumTransmissionTorqueDynami Torque_Control.Torque_Control_B.MaximumTransmissionTorqueStatic Torque_Control.Torque_Control_B.Merge Torque_Control.Torque_Control_B.Merge1 Torque_Control.Torque_Control_B.Merge1_a Torque_Control.Torque_Control_B.Merge1_a0 Torque_Control.Torque_Control_B.Merge1_b Torque_Control.Torque_Control_B.Merge1_l Torque_Control.Torque_Control_B.Merge1_n Torque_Control.Torque_Control_B.Merge1_p Torque_Control.Torque_Control_B.Merge1_pg Torque_Control.Torque_Control_B.Merge2 Torque_Control.Torque_Control_B.Merge2_e Torque_Control.Torque_Control_B.Merge2_j Torque_Control.Torque_Control_B.Merge2_l Torque_Control.Torque_Control_B.Merge2_lx Torque_Control.Torque_Control_B.Merge2_o Torque_Control.Torque_Control_B.Merge3 Torque_Control.Torque_Control_B.Merge3_c Torque_Control.Torque_Control_B.Merge3_e Torque_Control.Torque_Control_B.Merge4 Torque_Control.Torque_Control_B.Merge5 Torque_Control.Torque_Control_B.Merge5_e Torque_Control.Torque_Control_B.Merge6 Torque_Control.Torque_Control_B.Merge7 Torque_Control.Torque_Control_B.MergeTq_RL Torque_Control.Torque_Control_B.MergeTq_RR Torque_Control.Torque_Control_B.Merge_c Torque_Control.Torque_Control_B.Merge_d Torque_Control.Torque_Control_B.Merge_g Torque_Control.Torque_Control_B.Merge_i Torque_Control.Torque_Control_B.Merge_j Torque_Control.Torque_Control_B.Merge_k Torque_Control.Torque_Control_B.Merge_kj Torque_Control.Torque_Control_B.Merge_kt Torque_Control.Torque_Control_B.Merge_l Torque_Control.Torque_Control_B.Merge_li Torque_Control.Torque_Control_B.Merge_m Torque_Control.Torque_Control_B.OutportBufferForFlag_Power Torque_Control.Torque_Control_B.OutportBufferForFlags_num5 Torque_Control.Torque_Control_B.Product Torque_Control.Torque_Control_B.RT_L Torque_Control.Torque_Control_B.RT_R Torque_Control.Torque_Control_B.Saturation Torque_Control.Torque_Control_B.Saturation_f Torque_Control.Torque_Control_B.Saturation_i Torque_Control.Torque_Control_B.Saturation_k Torque_Control.Torque_Control_B.SteeringWheelMaximumAngle Torque_Control.Torque_Control_B.SteeringWheelMaximumAngle_m Torque_Control.Torque_Control_B.SteeringWheelMaximumAngle_p Torque_Control.Torque_Control_B.SteeringWheelSaturationpersited Torque_Control.Torque_Control_B.Steering_Ratio Torque_Control.Torque_Control_B.Subtract Torque_Control.Torque_Control_B.Throttle Torque_Control.Torque_Control_B.TowheelTqdynamic Torque_Control.Torque_Control_B.TowheelTqstatic Torque_Control.Torque_Control_B.Tq_diff_Max Torque_Control.Torque_Control_B.Tq_diff_maxNm Torque_Control.Torque_Control_B.Tq_max_motorNm Torque_Control.Torque_Control_B.TransmisionRatio Torque_Control.Torque_Control_B.Wheelbasem Torque_Control.Torque_Control_B.Yaw_Inertiakgm3 Torque_Control.Torque_Control_B.Zero Torque_Control.Torque_Control_B.approx2095 Torque_Control.Torque_Control_B.approx2095_h Torque_Control.Torque_Control_B.exptcycletau1 Torque_Control.Torque_Control_B.initial_limitation Torque_Control.Torque_Control_B.initial_limitation_m Torque_Control.Torque_Control_B.sf_Acceleratorbehaviour.throttle Torque_Control.Torque_Control_B.sf_Acceleratorbehaviour_b.throttle Torque_Control.Torque_Control_B.sf_Acceleratorbehaviour_br.throttle Torque_Control.Torque_Control_B.sf_Acceleratorbehaviour_o.throttle Torque_Control.Torque_Control_B.sf_MATLABFunction1_b.CKF_act0 Torque_Control.Torque_Control_B.sf_MATLABFunction1_f.value Torque_Control.Torque_Control_B.sf_MATLABFunction1_g.value Torque_Control.Torque_Control_B.sf_MATLABFunction1_gm.value Torque_Control.Torque_Control_B.sf_MATLABFunction1_h.RegTq_RL Torque_Control.Torque_Control_B.sf_MATLABFunction1_h.RegTq_RR Torque_Control.Torque_Control_B.sf_MATLABFunction1_m.value Torque_Control.Torque_Control_B.sf_MATLABFunction1_mk.value Torque_Control.Torque_Control_B.sf_MATLABFunction1_ny.value Torque_Control.Torque_Control_B.sf_MATLABFunction2.value Torque_Control.Torque_Control_B.sf_MATLABFunction2_b.value Torque_Control.Torque_Control_B.sf_MATLABFunction2_e.value Torque_Control.Torque_Control_B.sf_MATLABFunction2_l.value Torque_Control.Torque_Control_B.sf_MATLABFunction2_m.value Torque_Control.Torque_Control_B.sf_MATLABFunction_a.CKF_act0 Torque_Control.Torque_Control_B.sf_MATLABFunction_ab.RPM Torque_Control.Torque_Control_B.sf_MATLABFunction_d.value Torque_Control.Torque_Control_B.sf_MATLABFunction_e.SKF_act0 Torque_Control.Torque_Control_B.sf_MATLABFunction_fa.RPM Torque_Control.Torque_Control_B.sf_MATLABFunction_fq.SKF_act0 Torque_Control.Torque_Control_B.sf_MATLABFunction_i1.CKF_act1 Torque_Control.Torque_Control_B.sf_MATLABFunction_k2.CKF_act0 Torque_Control.Torque_Control_B.sf_MATLABFunction_mt.CKF_act1 Torque_Control.Torque_Control_B.sf_MATLABFunction_n.RPM Torque_Control.Torque_Control_B.u602pi Torque_Control.Torque_Control_B.u602pi_e Torque_Control.Torque_Control_B.udifference Torque_Control.Torque_Control_B.udifference1 /end REF_MEASUREMENT
/end GROUP
/begin GROUP Torque_Control.Torque_Control_B.BrakingwithRegenerative ""
 /begin REF_MEASUREMENT Torque_Control.Torque_Control_B.BrakingwithRegenerative.sf_MATLABFunction.RegTq_RL Torque_Control.Torque_Control_B.BrakingwithRegenerative.sf_MATLABFunction.RegTq_RR /end REF_MEASUREMENT
/end GROUP
/begin GROUP Torque_Control.Torque_Control_B.BrakingwithRegenerative.sf_MATLABFunction ""
 /begin REF_MEASUREMENT Torque_Control.Torque_Control_B.BrakingwithRegenerative.sf_MATLABFunction.RegTq_RL Torque_Control.Torque_Control_B.BrakingwithRegenerative.sf_MATLABFunction.RegTq_RR /end REF_MEASUREMENT
/end GROUP
/begin GROUP Torque_Control.Torque_Control_B.BrakingwithRegenerative_b ""
 /begin REF_MEASUREMENT Torque_Control.Torque_Control_B.BrakingwithRegenerative_b.sf_MATLABFunction.RegTq_RL Torque_Control.Torque_Control_B.BrakingwithRegenerative_b.sf_MATLABFunction.RegTq_RR /end REF_MEASUREMENT
/end GROUP
/begin GROUP Torque_Control.Torque_Control_B.BrakingwithRegenerative_b.sf_MATLABFunction ""
 /begin REF_MEASUREMENT Torque_Control.Torque_Control_B.BrakingwithRegenerative_b.sf_MATLABFunction.RegTq_RL Torque_Control.Torque_Control_B.BrakingwithRegenerative_b.sf_MATLABFunction.RegTq_RR /end REF_MEASUREMENT
/end GROUP
/begin GROUP Torque_Control.Torque_Control_B.sf_Acceleratorbehaviour ""
 /begin REF_MEASUREMENT Torque_Control.Torque_Control_B.sf_Acceleratorbehaviour.throttle /end REF_MEASUREMENT
/end GROUP
/begin GROUP Torque_Control.Torque_Control_B.sf_Acceleratorbehaviour_b ""
 /begin REF_MEASUREMENT Torque_Control.Torque_Control_B.sf_Acceleratorbehaviour_b.throttle /end REF_MEASUREMENT
/end GROUP
/begin GROUP Torque_Control.Torque_Control_B.sf_Acceleratorbehaviour_br ""
 /begin REF_MEASUREMENT Torque_Control.Torque_Control_B.sf_Acceleratorbehaviour_br.throttle /end REF_MEASUREMENT
/end GROUP
/begin GROUP Torque_Control.Torque_Control_B.sf_Acceleratorbehaviour_o ""
 /begin REF_MEASUREMENT Torque_Control.Torque_Control_B.sf_Acceleratorbehaviour_o.throttle /end REF_MEASUREMENT
/end GROUP
/begin GROUP Torque_Control.Torque_Control_B.sf_MATLABFunction1_b ""
 /begin REF_MEASUREMENT Torque_Control.Torque_Control_B.sf_MATLABFunction1_b.CKF_act0 /end REF_MEASUREMENT
/end GROUP
/begin GROUP Torque_Control.Torque_Control_B.sf_MATLABFunction1_f "" /begin REF_MEASUREMENT Torque_Control.Torque_Control_B.sf_MATLABFunction1_f.value /end REF_MEASUREMENT /end GROUP
/begin GROUP Torque_Control.Torque_Control_B.sf_MATLABFunction1_g "" /begin REF_MEASUREMENT Torque_Control.Torque_Control_B.sf_MATLABFunction1_g.value /end REF_MEASUREMENT /end GROUP
/begin GROUP Torque_Control.Torque_Control_B.sf_MATLABFunction1_gm ""
 /begin REF_MEASUREMENT Torque_Control.Torque_Control_B.sf_MATLABFunction1_gm.value /end REF_MEASUREMENT
/end GROUP
/begin GROUP Torque_Control.Torque_Control_B.sf_MATLABFunction1_h ""
 /begin REF_MEASUREMENT Torque_Control.Torque_Control_B.sf_MATLABFunction1_h.RegTq_RL Torque_Control.Torque_Control_B.sf_MATLABFunction1_h.RegTq_RR /end REF_MEASUREMENT
/end GROUP
/begin GROUP Torque_Control.Torque_Control_B.sf_MATLABFunction1_m "" /begin REF_MEASUREMENT Torque_Control.Torque_Control_B.sf_MATLABFunction1_m.value /end REF_MEASUREMENT /end GROUP
/begin GROUP Torque_Control.Torque_Control_B.sf_MATLABFunction1_mk ""
 /begin REF_MEASUREMENT Torque_Control.Torque_Control_B.sf_MATLABFunction1_mk.value /end REF_MEASUREMENT
/end GROUP
/begin GROUP Torque_Control.Torque_Control_B.sf_MATLABFunction1_ny ""
 /begin REF_MEASUREMENT Torque_Control.Torque_Control_B.sf_MATLABFunction1_ny.value /end REF_MEASUREMENT
/end GROUP
/begin GROUP Torque_Control.Torque_Control_B.sf_MATLABFunction2 "" /begin REF_MEASUREMENT Torque_Control.Torque_Control_B.sf_MATLABFunction2.value /end REF_MEASUREMENT /end GROUP
/begin GROUP Torque_Control.Torque_Control_B.sf_MATLABFunction2_b "" /begin REF_MEASUREMENT Torque_Control.Torque_Control_B.sf_MATLABFunction2_b.value /end REF_MEASUREMENT /end GROUP
/begin GROUP Torque_Control.Torque_Control_B.sf_MATLABFunction2_e "" /begin REF_MEASUREMENT Torque_Control.Torque_Control_B.sf_MATLABFunction2_e.value /end REF_MEASUREMENT /end GROUP
/begin GROUP Torque_Control.Torque_Control_B.sf_MATLABFunction2_l "" /begin REF_MEASUREMENT Torque_Control.Torque_Control_B.sf_MATLABFunction2_l.value /end REF_MEASUREMENT /end GROUP
/begin GROUP Torque_Control.Torque_Control_B.sf_MATLABFunction2_m "" /begin REF_MEASUREMENT Torque_Control.Torque_Control_B.sf_MATLABFunction2_m.value /end REF_MEASUREMENT /end GROUP
/begin GROUP Torque_Control.Torque_Control_B.sf_MATLABFunction_a ""
 /begin REF_MEASUREMENT Torque_Control.Torque_Control_B.sf_MATLABFunction_a.CKF_act0 /end REF_MEASUREMENT
/end GROUP
/begin GROUP Torque_Control.Torque_Control_B.sf_MATLABFunction_ab "" /begin REF_MEASUREMENT Torque_Control.Torque_Control_B.sf_MATLABFunction_ab.RPM /end REF_MEASUREMENT /end GROUP
/begin GROUP Torque_Control.Torque_Control_B.sf_MATLABFunction_d "" /begin REF_MEASUREMENT Torque_Control.Torque_Control_B.sf_MATLABFunction_d.value /end REF_MEASUREMENT /end GROUP
/begin GROUP Torque_Control.Torque_Control_B.sf_MATLABFunction_e ""
 /begin REF_MEASUREMENT Torque_Control.Torque_Control_B.sf_MATLABFunction_e.SKF_act0 /end REF_MEASUREMENT
/end GROUP
/begin GROUP Torque_Control.Torque_Control_B.sf_MATLABFunction_fa "" /begin REF_MEASUREMENT Torque_Control.Torque_Control_B.sf_MATLABFunction_fa.RPM /end REF_MEASUREMENT /end GROUP
/begin GROUP Torque_Control.Torque_Control_B.sf_MATLABFunction_fq ""
 /begin REF_MEASUREMENT Torque_Control.Torque_Control_B.sf_MATLABFunction_fq.SKF_act0 /end REF_MEASUREMENT
/end GROUP
/begin GROUP Torque_Control.Torque_Control_B.sf_MATLABFunction_i1 ""
 /begin REF_MEASUREMENT Torque_Control.Torque_Control_B.sf_MATLABFunction_i1.CKF_act1 /end REF_MEASUREMENT
/end GROUP
/begin GROUP Torque_Control.Torque_Control_B.sf_MATLABFunction_k2 ""
 /begin REF_MEASUREMENT Torque_Control.Torque_Control_B.sf_MATLABFunction_k2.CKF_act0 /end REF_MEASUREMENT
/end GROUP
/begin GROUP Torque_Control.Torque_Control_B.sf_MATLABFunction_mt ""
 /begin REF_MEASUREMENT Torque_Control.Torque_Control_B.sf_MATLABFunction_mt.CKF_act1 /end REF_MEASUREMENT
/end GROUP
/begin GROUP Torque_Control.Torque_Control_B.sf_MATLABFunction_n "" /begin REF_MEASUREMENT Torque_Control.Torque_Control_B.sf_MATLABFunction_n.RPM /end REF_MEASUREMENT /end GROUP
/begin GROUP Torque_Control.Torque_Control_DW ""
 /begin REF_MEASUREMENT Torque_Control.Torque_Control_DW.A Torque_Control.Torque_Control_DW.AA Torque_Control.Torque_Control_DW.A_b Torque_Control.Torque_Control_DW.A_i Torque_Control.Torque_Control_DW.B Torque_Control.Torque_Control_DW.B_i Torque_Control.Torque_Control_DW.B_k Torque_Control.Torque_Control_DW.Previous_IN Torque_Control.Torque_Control_DW.Previous_OUT /end REF_MEASUREMENT
/end GROUP
/begin GROUP Torque_Control.Torque_Control_U ""
 /begin REF_MEASUREMENT Torque_Control.Torque_Control_U.ACCEL_F_X_SI Torque_Control.Torque_Control_U.ACCEL_F_Y_SI Torque_Control.Torque_Control_U.ACCEL_F_Z_SI Torque_Control.Torque_Control_U.ACCEL_R_X_SI Torque_Control.Torque_Control_U.ACCEL_R_Y_SI Torque_Control.Torque_Control_U.ACCEL_R_Z_SI Torque_Control.Torque_Control_U.APPS1_Value Torque_Control.Torque_Control_U.APPS2_Value Torque_Control.Torque_Control_U.Accumulator_Current Torque_Control.Torque_Control_U.Accumulator_Voltage Torque_Control.Torque_Control_U.BrakeSensor_Value Torque_Control.Torque_Control_U.Car_State Torque_Control.Torque_Control_U.CriticalDisconnection Torque_Control.Torque_Control_U.Gyro_F_Z_Deg Torque_Control.Torque_Control_U.Highest_CellTemp Torque_Control.Torque_Control_U.RL_rads Torque_Control.Torque_Control_U.RR_rads Torque_Control.Torque_Control_U.ShutdownClosed Torque_Control.Torque_Control_U.SteeringSensor_Bits Torque_Control.Torque_Control_U.Susp_F_L Torque_Control.Torque_Control_U.Susp_F_R Torque_Control.Torque_Control_U.Susp_R_L Torque_Control.Torque_Control_U.Susp_R_R Torque_Control.Torque_Control_U.TV_Mode Torque_Control.Torque_Control_U.Temp_IGBT Torque_Control.Torque_Control_U.Temp_Motors Torque_Control.Torque_Control_U.TorqueEnable Torque_Control.Torque_Control_U.VDC_Apps_Sat_Down Torque_Control.Torque_Control_U.VDC_Apps_Sat_Up Torque_Control.Torque_Control_U.VDC_CKF_Initial Torque_Control.Torque_Control_U.VDC_Cte_CKF Torque_Control.Torque_Control_U.VDC_Cte_SKF Torque_Control.Torque_Control_U.VDC_K_Reduction_P Torque_Control.Torque_Control_U.VDC_K_Reduction_Temperature Torque_Control.Torque_Control_U.VDC_Max_Regenerative_Torque Torque_Control.Torque_Control_U.VDC_Power_Limit Torque_Control.Torque_Control_U.VDC_SKF_Initial Torque_Control.Torque_Control_U.Vel_RL_kmh Torque_Control.Torque_Control_U.Vel_RR_kmh Torque_Control.Torque_Control_U.Workshop_Mode_Enable /end REF_MEASUREMENT
/end GROUP
/begin GROUP Torque_Control.Torque_Control_Y ""
 /begin REF_MEASUREMENT Torque_Control.Torque_Control_Y.APPS_Implausibility Torque_Control.Torque_Control_Y.Brake_Implausibility Torque_Control.Torque_Control_Y.CKF_actual Torque_Control.Torque_Control_Y.Dash_Speed Torque_Control.Torque_Control_Y.Fy_R Torque_Control.Torque_Control_Y.Handling Torque_Control.Torque_Control_Y.Mass Torque_Control.Torque_Control_Y.Max_Fx_RL Torque_Control.Torque_Control_Y.Max_Fx_RR Torque_Control.Torque_Control_Y.Max_Torque_RL Torque_Control.Torque_Control_Y.Max_Torque_RR Torque_Control.Torque_Control_Y.MeasVDCTorque_L Torque_Control.Torque_Control_Y.MeasVDCTorque_R Torque_Control.Torque_Control_Y.Power Torque_Control.Torque_Control_Y.PowerLimitReached Torque_Control.Torque_Control_Y.PowerMean500ms Torque_Control.Torque_Control_Y.Pumps_Control Torque_Control.Torque_Control_Y.Regenerative_Enable Torque_Control.Torque_Control_Y.SKF_actual Torque_Control.Torque_Control_Y.SteeringSensor_Value Torque_Control.Torque_Control_Y.TV_Flag_CarBehaviour Torque_Control.Torque_Control_Y.TV_Flag_Power Torque_Control.Torque_Control_Y.TV_Flag_Temperature Torque_Control.Torque_Control_Y.TV_Flag_WheelSpinRL Torque_Control.Torque_Control_Y.TV_Flag_WheelSpinRR Torque_Control.Torque_Control_Y.Throttle Torque_Control.Torque_Control_Y.Torque_L Torque_Control.Torque_Control_Y.Torque_OK Torque_Control.Torque_Control_Y.Torque_R Torque_Control.Torque_Control_Y.Torque_RLwc Torque_Control.Torque_Control_Y.Torque_RRwc Torque_Control.Torque_Control_Y.current_L Torque_Control.Torque_Control_Y.current_R /end REF_MEASUREMENT
/end GROUP
/begin GROUP Torque_Control.Torque_Control_P ""
 /begin REF_CHARACTERISTIC Torque_Control.Torque_Control_P.Constant_Value_l Torque_Control.Torque_Control_P.Constant_Value_m Torque_Control.Torque_Control_P.Constant_Value_n Torque_Control.Torque_Control_P.Constant_Value_n5 Torque_Control.Torque_Control_P.Cornering_Stiffness_FN_Value Torque_Control.Torque_Control_P.Cornering_Stiffness_RN_Value Torque_Control.Torque_Control_P.DataStoreMemory10_InitialValue Torque_Control.Torque_Control_P.DataStoreMemory1_InitialValu_fl Torque_Control.Torque_Control_P.DataStoreMemory1_InitialValue Torque_Control.Torque_Control_P.DataStoreMemory1_InitialValue_f Torque_Control.Torque_Control_P.DataStoreMemory1_InitialValue_i Torque_Control.Torque_Control_P.DataStoreMemory1_InitialValue_m Torque_Control.Torque_Control_P.DataStoreMemory_InitialValue Torque_Control.Torque_Control_P.DataStoreMemory_InitialValue_c Torque_Control.Torque_Control_P.DataStoreMemory_InitialValue_m Torque_Control.Torque_Control_P.DiametertoRadius_Gain Torque_Control.Torque_Control_P.DiametertoRadius_Gain_h Torque_Control.Torque_Control_P.EffectiveRollingDiameterinch_Va Torque_Control.Torque_Control_P.EffectiveRollingDiameterinch__b Torque_Control.Torque_Control_P.Enabled_Value Torque_Control.Torque_Control_P.Flag_Accu_const Torque_Control.Torque_Control_P.Flag_Accu_const_h Torque_Control.Torque_Control_P.Flag_Inv_const Torque_Control.Torque_Control_P.Flag_Inv_const_e Torque_Control.Torque_Control_P.Flag_Mot_const Torque_Control.Torque_Control_P.Flag_Mot_const_n Torque_Control.Torque_Control_P.Flags_num5_Y0 Torque_Control.Torque_Control_P.Fy_RN0inf_Y0 Torque_Control.Torque_Control_P.Fyperwheel_Gain Torque_Control.Torque_Control_P.Fyperwheel_Gain_e Torque_Control.Torque_Control_P.Gain1_Gain Torque_Control.Torque_Control_P.Gain1_Gain_m Torque_Control.Torque_Control_P.Gain1_Gain_o Torque_Control.Torque_Control_P.Gain5_Gain Torque_Control.Torque_Control_P.Gain5_Gain_n Torque_Control.Torque_Control_P.Gain6_Gain Torque_Control.Torque_Control_P.Gain6_Gain_f Torque_Control.Torque_Control_P.Gain_Gain Torque_Control.Torque_Control_P.Gain_Gain_b Torque_Control.Torque_Control_P.Gain_Gain_c Torque_Control.Torque_Control_P.Gain_Gain_co Torque_Control.Torque_Control_P.Gain_Gain_cv Torque_Control.Torque_Control_P.Gain_Gain_f Torque_Control.Torque_Control_P.Gain_Gain_g Torque_Control.Torque_Control_P.Gain_Gain_k Torque_Control.Torque_Control_P.Gain_Gain_o Torque_Control.Torque_Control_P.GearRatio_Value Torque_Control.Torque_Control_P.Gravity1_Gain Torque_Control.Torque_Control_P.Gravity1_Gain_g Torque_Control.Torque_Control_P.Gravity_Gain Torque_Control.Torque_Control_P.Handlinginfinf_Y0 Torque_Control.Torque_Control_P.Integrator_IC Torque_Control.Torque_Control_P.Inverters_Temperature_Limitatio Torque_Control.Torque_Control_P.Lookup_SoC_SoP_chg_bp01Data Torque_Control.Torque_Control_P.Lookup_SoC_SoP_chg_bp01Data_b Torque_Control.Torque_Control_P.Lookup_SoC_SoP_chg_tableData Torque_Control.Torque_Control_P.Lookup_SoC_SoP_chg_tableData_p Torque_Control.Torque_Control_P.Lookup_SoC_SoP_dischg_bp01Dat_m Torque_Control.Torque_Control_P.Lookup_SoC_SoP_dischg_bp01Data Torque_Control.Torque_Control_P.Lookup_SoC_SoP_dischg_tableDa_g Torque_Control.Torque_Control_P.Lookup_SoC_SoP_dischg_tableData Torque_Control.Torque_Control_P.Lookup_Temp_SoP_chg_bp01Data Torque_Control.Torque_Control_P.Lookup_Temp_SoP_chg_bp01Data_i Torque_Control.Torque_Control_P.Lookup_Temp_SoP_chg_tableData Torque_Control.Torque_Control_P.Lookup_Temp_SoP_chg_tableData_m Torque_Control.Torque_Control_P.Masskg0inf_Y0 Torque_Control.Torque_Control_P.MaxFx_RLN0inf_Y0 Torque_Control.Torque_Control_P.MaxFx_RRN0inf_Y0 Torque_Control.Torque_Control_P.MaxTq_RLNm0inf_Y0 Torque_Control.Torque_Control_P.MaxTq_RLNm0inf_Y0_d Torque_Control.Torque_Control_P.MaxTq_RRNm0inf_Y0 Torque_Control.Torque_Control_P.MaxTq_RRNm0inf_Y0_o Torque_Control.Torque_Control_P.MaxTqpermotorNm_Value Torque_Control.Torque_Control_P.Max_Power_chargekW_Value Torque_Control.Torque_Control_P.Max_Power_dischargekW_Value Torque_Control.Torque_Control_P.Max_Tq_per_motor_Value Torque_Control.Torque_Control_P.MaximumTorqueperengineNm_Value Torque_Control.Torque_Control_P.MaximumTorquepermotorNm_Value Torque_Control.Torque_Control_P.MaximumTransmissionTorqueDyna_a Torque_Control.Torque_Control_P.MaximumTransmissionTorqueDynami Torque_Control.Torque_Control_P.MaximumTransmissionTorqueStat_n Torque_Control.Torque_Control_P.MaximumTransmissionTorqueStatic Torque_Control.Torque_Control_P.Merge1_InitialOutput Torque_Control.Torque_Control_P.Merge1_InitialOutput_e Torque_Control.Torque_Control_P.Merge1_InitialOutput_k Torque_Control.Torque_Control_P.Merge2_InitialOutput Torque_Control.Torque_Control_P.Merge2_InitialOutput_o Torque_Control.Torque_Control_P.Merge3_InitialOutput Torque_Control.Torque_Control_P.Merge3_InitialOutput_n Torque_Control.Torque_Control_P.Merge4_InitialOutput Torque_Control.Torque_Control_P.Merge5_InitialOutput Torque_Control.Torque_Control_P.Merge6_InitialOutput Torque_Control.Torque_Control_P.Merge7_InitialOutput Torque_Control.Torque_Control_P.MergeTq_RL_InitialOutput Torque_Control.Torque_Control_P.MergeTq_RR_InitialOutput Torque_Control.Torque_Control_P.Merge_InitialOutput Torque_Control.Torque_Control_P.Merge_InitialOutput_a Torque_Control.Torque_Control_P.Merge_InitialOutput_e Torque_Control.Torque_Control_P.Merge_InitialOutput_h Torque_Control.Torque_Control_P.Merge_InitialOutput_i Torque_Control.Torque_Control_P.Merge_InitialOutput_j Torque_Control.Torque_Control_P.Merge_InitialOutput_l Torque_Control.Torque_Control_P.Merge_InitialOutput_p Torque_Control.Torque_Control_P.Motors_Temperature_Limitation_F Torque_Control.Torque_Control_P.Out1_Y0 Torque_Control.Torque_Control_P.Out_Throttle_Y0 Torque_Control.Torque_Control_P.Out_Throttle_Y0_a Torque_Control.Torque_Control_P.RT_L_Gain Torque_Control.Torque_Control_P.RT_R_Gain Torque_Control.Torque_Control_P.Rear_Trackwidthm_Value Torque_Control.Torque_Control_P.SKF_act_Y0 Torque_Control.Torque_Control_P.SKF_act_Y0_l Torque_Control.Torque_Control_P.Saturation1_LowerSat Torque_Control.Torque_Control_P.Saturation1_LowerSat_a Torque_Control.Torque_Control_P.Saturation1_LowerSat_b Torque_Control.Torque_Control_P.Saturation1_LowerSat_j Torque_Control.Torque_Control_P.Saturation1_LowerSat_k Torque_Control.Torque_Control_P.Saturation1_LowerSat_ko Torque_Control.Torque_Control_P.Saturation1_LowerSat_l Torque_Control.Torque_Control_P.Saturation1_LowerSat_lw Torque_Control.Torque_Control_P.Saturation1_LowerSat_m Torque_Control.Torque_Control_P.Saturation1_LowerSat_o Torque_Control.Torque_Control_P.Saturation1_UpperSat Torque_Control.Torque_Control_P.Saturation1_UpperSat_a Torque_Control.Torque_Control_P.Saturation1_UpperSat_b Torque_Control.Torque_Control_P.Saturation1_UpperSat_d Torque_Control.Torque_Control_P.Saturation1_UpperSat_e Torque_Control.Torque_Control_P.Saturation1_UpperSat_g Torque_Control.Torque_Control_P.Saturation1_UpperSat_i Torque_Control.Torque_Control_P.Saturation1_UpperSat_is Torque_Control.Torque_Control_P.Saturation1_UpperSat_k Torque_Control.Torque_Control_P.Saturation1_UpperSat_m Torque_Control.Torque_Control_P.Saturation_LowerSat Torque_Control.Torque_Control_P.Saturation_LowerSat_c Torque_Control.Torque_Control_P.Saturation_LowerSat_e Torque_Control.Torque_Control_P.Saturation_LowerSat_ey Torque_Control.Torque_Control_P.Saturation_LowerSat_f Torque_Control.Torque_Control_P.Saturation_LowerSat_f3 Torque_Control.Torque_Control_P.Saturation_LowerSat_fi Torque_Control.Torque_Control_P.Saturation_LowerSat_h Torque_Control.Torque_Control_P.Saturation_LowerSat_j Torque_Control.Torque_Control_P.Saturation_UpperSat Torque_Control.Torque_Control_P.Saturation_UpperSat_c Torque_Control.Torque_Control_P.Saturation_UpperSat_d Torque_Control.Torque_Control_P.Saturation_UpperSat_f Torque_Control.Torque_Control_P.Saturation_UpperSat_fg Torque_Control.Torque_Control_P.Saturation_UpperSat_g Torque_Control.Torque_Control_P.Saturation_UpperSat_h Torque_Control.Torque_Control_P.Saturation_UpperSat_i Torque_Control.Torque_Control_P.Saturation_UpperSat_k Torque_Control.Torque_Control_P.SteeringWheelMaximumAngle_Val_i Torque_Control.Torque_Control_P.SteeringWheelMaximumAngle_Val_o Torque_Control.Torque_Control_P.SteeringWheelMaximumAngle_Value Torque_Control.Torque_Control_P.SteeringWheelSaturationpersited Torque_Control.Torque_Control_P.Steering_Ratio_Value Torque_Control.Torque_Control_P.Switch1_Threshold Torque_Control.Torque_Control_P.Switch1_Threshold_b Torque_Control.Torque_Control_P.Switch1_Threshold_c Torque_Control.Torque_Control_P.Switch1_Threshold_f Torque_Control.Torque_Control_P.Switch1_Threshold_h Torque_Control.Torque_Control_P.Switch1_Threshold_j Torque_Control.Torque_Control_P.Switch1_Threshold_k Torque_Control.Torque_Control_P.Switch1_Threshold_p Torque_Control.Torque_Control_P.Switch_Threshold Torque_Control.Torque_Control_P.Switch_Threshold_a Torque_Control.Torque_Control_P.Switch_Threshold_b Torque_Control.Torque_Control_P.Switch_Threshold_d Torque_Control.Torque_Control_P.Switch_Threshold_e Torque_Control.Torque_Control_P.Switch_Threshold_f Torque_Control.Torque_Control_P.Switch_Threshold_i Torque_Control.Torque_Control_P.Temphigherthan110_const Torque_Control.Torque_Control_P.Temphigherthan110_const_c Torque_Control.Torque_Control_P.Temphigherthan50_const Torque_Control.Torque_Control_P.Temphigherthan50_const_g Torque_Control.Torque_Control_P.Temphigherthan50_const_k Torque_Control.Torque_Control_P.Temphigherthan50_const_l Torque_Control.Torque_Control_P.TomotorTqRT_Gain Torque_Control.Torque_Control_P.Torque_RLNm_Value Torque_Control.Torque_Control_P.Torque_RRNm_Value Torque_Control.Torque_Control_P.Tq_diff_Max_Value Torque_Control.Torque_Control_P.Tq_diff_maxNm_Value Torque_Control.Torque_Control_P.Tq_max_motorNm_Value Torque_Control.Torque_Control_P.TransmisionRatio_Value Torque_Control.Torque_Control_P.TransmisionRatio_Value_j Torque_Control.Torque_Control_P.TransmissionGearRatio_Gain Torque_Control.Torque_Control_P.TransmissionRatio1_Gain Torque_Control.Torque_Control_P.TransmissionRatio_Gain Torque_Control.Torque_Control_P.Wheelbasem_Value Torque_Control.Torque_Control_P.Yaw_Inertiakgm3_Value Torque_Control.Torque_Control_P.Zero_Value Torque_Control.Torque_Control_P.ct_Value Torque_Control.Torque_Control_P.exptcycletau1_Value Torque_Control.Torque_Control_P.halfrange_Value Torque_Control.Torque_Control_P.inchtom1_Gain Torque_Control.Torque_Control_P.inchtom_Gain Torque_Control.Torque_Control_P.initial_limitation_Value Torque_Control.Torque_Control_P.initial_limitation_Value_k Torque_Control.Torque_Control_P.range_Value Torque_Control.Torque_Control_P.rpm_Value Torque_Control.Torque_Control_P.rpm_Value_k Torque_Control.Torque_Control_P.u602pi_Gain Torque_Control.Torque_Control_P.u602pi_Gain_g Torque_Control.Torque_Control_P.udifference1_Gain Torque_Control.Torque_Control_P.udifference_Gain Torque_Control.Torque_Control_P.zero_Value /end REF_CHARACTERISTIC
/end GROUP
/end MODULE
/end PROJECT
