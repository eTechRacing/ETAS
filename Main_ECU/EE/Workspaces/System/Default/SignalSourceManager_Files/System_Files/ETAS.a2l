ASAP2_VERSION 1 41
/begin PROJECT ETAS "Generated by ETAS from INTECRIO V4.7.0.1005 integration project"
/begin HEADER "" VERSION "" PROJECT_NO Y /end HEADER
/begin MODULE INTECRIO_MERGED "Generated by ETAS INTECRIO V4.7.0.1005 for M/C interface ETARGET"
/begin MOD_PAR "" VERSION "" ADDR_EPK 0x0 EPK "" SUPPLIER "ETAS GmbH" CUSTOMER "" CUSTOMER_NO "" USER "" PHONE_NO "" ECU "NO_ECU" CPU_TYPE "MPC750" NO_OF_INTERFACES 1 /end MOD_PAR
/begin MOD_COMMON "Common definitions" BYTE_ORDER MSB_FIRST ALIGNMENT_BYTE 1 ALIGNMENT_WORD 2 ALIGNMENT_LONG 4 ALIGNMENT_FLOAT32_IEEE 4 ALIGNMENT_FLOAT64_IEEE 8 /end MOD_COMMON
/begin IF_DATA E_TARGET
 /begin SOURCE "Timer_Inv" 0 3000 QP_BLOB 33 /end SOURCE
 /begin SOURCE "SWT_CAN1_AP_BMS_AIRs_State" 0 1000 QP_BLOB 1 /end SOURCE
 /begin SOURCE "SWT_CAN1_AP_BMS_BatteryTemperatures" 0 1000 QP_BLOB 2 /end SOURCE
 /begin SOURCE "SWT_CAN1_AP_BMS_ChargerParameters" 0 1000 QP_BLOB 3 /end SOURCE
 /begin SOURCE "SWT_CAN1_AP_BMS_Current_SOC_SOH" 0 1000 QP_BLOB 4 /end SOURCE
 /begin SOURCE "SWT_CAN1_AP_BMS_OnBoardTemperatures" 0 1000 QP_BLOB 5 /end SOURCE
 /begin SOURCE "SWT_CAN1_AP_BMS_StateAndFailReport" 0 1000 QP_BLOB 6 /end SOURCE
 /begin SOURCE "SWT_CAN1_AP_BMS_Voltages" 0 1000 QP_BLOB 7 /end SOURCE
 /begin SOURCE "SWT_CAN1_AP_DASH_CustomMode" 0 1000 QP_BLOB 8 /end SOURCE
 /begin SOURCE "SWT_CAN1_AP_DASH_EnableDrive" 0 1000 QP_BLOB 9 /end SOURCE
 /begin SOURCE "SWT_CAN1_AP_DASH_Mode" 0 1000 QP_BLOB 10 /end SOURCE
 /begin SOURCE "SWT_CAN1_AP_DASH_PrechargeRequest" 0 1000 QP_BLOB 11 /end SOURCE
 /begin SOURCE "SWT_CAN1_AP_DASH_TorqueLockOn" 0 1000 QP_BLOB 12 /end SOURCE
 /begin SOURCE "SWT_CAN1_AP_Inverter_L_Tx" 0 1000 QP_BLOB 13 /end SOURCE
 /begin SOURCE "SWT_CAN1_AP_Inverter_R_Tx" 0 1000 QP_BLOB 14 /end SOURCE
 /begin SOURCE "SWT_CAN1_AP_SHUTDOWN_State" 0 1000 QP_BLOB 15 /end SOURCE
 /begin SOURCE "SWT_CAN1_NM_BMS_Keep_Alive" 0 1000 QP_BLOB 16 /end SOURCE
 /begin SOURCE "SWT_CAN1_NM_DASH_Keep_Alive" 0 1000 QP_BLOB 17 /end SOURCE
 /begin SOURCE "SWT_CAN1_NM_SHUTDOWN_Keep_Alive" 0 1000 QP_BLOB 18 /end SOURCE
 /begin SOURCE "SWT_CAN2_AP_ACCEL_F_Data" 0 1000 QP_BLOB 19 /end SOURCE
 /begin SOURCE "SWT_CAN2_AP_ACCEL_R_Data2" 0 1000 QP_BLOB 21 /end SOURCE
 /begin SOURCE "SWT_CAN2_AP_ACCEL_R_Data" 0 1000 QP_BLOB 20 /end SOURCE
 /begin SOURCE "SWT_CAN2_AP_ADCAN_Data1" 0 1000 QP_BLOB 22 /end SOURCE
 /begin SOURCE "SWT_CAN2_AP_ADCAN_Data2" 0 1000 QP_BLOB 23 /end SOURCE
 /begin SOURCE "SWT_CAN2_AP_LV_Derivation_LVData" 0 1000 QP_BLOB 24 /end SOURCE
 /begin SOURCE "SWT_CAN2_NM_ACCEL_F_Keep_Alive" 0 1000 QP_BLOB 25 /end SOURCE
 /begin SOURCE "SWT_CAN2_NM_ACCEL_R_Keep_Alive" 0 1000 QP_BLOB 26 /end SOURCE
 /begin SOURCE "SWT_CAN2_NM_ADCAN_Keep_Alive" 0 1000 QP_BLOB 27 /end SOURCE
 /begin SOURCE "SWT_CAN2_NM_LV_Derivation_Keep_Alive" 0 1000 QP_BLOB 28 /end SOURCE
 /begin SOURCE "Sync_25ms" 0 25000 QP_BLOB 29 /end SOURCE
 /begin SOURCE "Timer_1000ms" 0 1000000 QP_BLOB 30 /end SOURCE
 /begin SOURCE "Timer_100ms" 0 100000 QP_BLOB 31 /end SOURCE
 /begin SOURCE "Timer_25ms" 0 25000 QP_BLOB 32 /end SOURCE
 /begin TP_BLOB /* Program identifier */ 542891285 /* HW target identifier */ 0x6 /* Skip flag */ 0 /* Skip to link */ 2 /* Loader identifier */ 0x02000001 /end TP_BLOB
/end IF_DATA
/begin MEASUREMENT Car_State.Car_State_B.Merge "" FLOAT64_IEEE Car_State_CM_double 0 0 -1.7e+308 1.7e+308 ECU_ADDRESS 0x0 DISPLAY_IDENTIFIER Car_State.AIRS_Request.Merge.Merge /end MEASUREMENT
/begin MEASUREMENT Car_State.Car_State_DW.A "" FLOAT64_IEEE Car_State_CM_double 0 0 -1.7e+308 1.7e+308 ECU_ADDRESS 0x0 DISPLAY_IDENTIFIER Car_State.CurrentPathDisconnection_Detection.Data_Store_Memory.A /end MEASUREMENT
/begin MEASUREMENT Car_State.Car_State_U.AIRs_State "" FLOAT64_IEEE Car_State_CM_double 0 0 -1.7e+308 1.7e+308 ECU_ADDRESS 0x0 DISPLAY_IDENTIFIER Car_State.AIRs_State /end MEASUREMENT
/begin MEASUREMENT Car_State.Car_State_U.Accumulator_Voltage "" FLOAT64_IEEE Car_State_CM_double 0 0 -1.7e+308 1.7e+308 ECU_ADDRESS 0x0 DISPLAY_IDENTIFIER Car_State.Accumulator_Voltage /end MEASUREMENT
/begin MEASUREMENT Car_State.Car_State_U.BMSerror_CANDisconnection "" FLOAT64_IEEE Car_State_CM_double 0 0 -1.7e+308 1.7e+308 ECU_ADDRESS 0x0 DISPLAY_IDENTIFIER Car_State.BMSerror_CANDisconnection /end MEASUREMENT
/begin MEASUREMENT Car_State.Car_State_U.BMSerror_CurrentSensDisc "" FLOAT64_IEEE Car_State_CM_double 0 0 -1.7e+308 1.7e+308 ECU_ADDRESS 0x0 DISPLAY_IDENTIFIER Car_State.BMSerror_CurrentSensDisc /end MEASUREMENT
/begin MEASUREMENT Car_State.Car_State_U.BMSerror_NTCDisconnection "" FLOAT64_IEEE Car_State_CM_double 0 0 -1.7e+308 1.7e+308 ECU_ADDRESS 0x0 DISPLAY_IDENTIFIER Car_State.BMSerror_NTCDisconnection /end MEASUREMENT
/begin MEASUREMENT Car_State.Car_State_U.BMSerror_OverTemperature "" FLOAT64_IEEE Car_State_CM_double 0 0 -1.7e+308 1.7e+308 ECU_ADDRESS 0x0 DISPLAY_IDENTIFIER Car_State.BMSerror_OverTemperature /end MEASUREMENT
/begin MEASUREMENT Car_State.Car_State_U.BMSerror_OverVoltage "" FLOAT64_IEEE Car_State_CM_double 0 0 -1.7e+308 1.7e+308 ECU_ADDRESS 0x0 DISPLAY_IDENTIFIER Car_State.BMSerror_OverVoltage /end MEASUREMENT
/begin MEASUREMENT Car_State.Car_State_U.BMSerror_UnderTemperature "" FLOAT64_IEEE Car_State_CM_double 0 0 -1.7e+308 1.7e+308 ECU_ADDRESS 0x0 DISPLAY_IDENTIFIER Car_State.BMSerror_UnderTemperature /end MEASUREMENT
/begin MEASUREMENT Car_State.Car_State_U.BMSerror_UnderVoltage "" FLOAT64_IEEE Car_State_CM_double 0 0 -1.7e+308 1.7e+308 ECU_ADDRESS 0x0 DISPLAY_IDENTIFIER Car_State.BMSerror_UnderVoltage /end MEASUREMENT
/begin MEASUREMENT Car_State.Car_State_U.Critical_CAN_Disconnection "" FLOAT64_IEEE Car_State_CM_double 0 0 -1.7e+308 1.7e+308 ECU_ADDRESS 0x0 DISPLAY_IDENTIFIER Car_State.Critical_CAN_Disconnection /end MEASUREMENT
/begin MEASUREMENT Car_State.Car_State_U.DashPrechargeRequest "" FLOAT64_IEEE Car_State_CM_double 0 0 -1.7e+308 1.7e+308 ECU_ADDRESS 0x0 DISPLAY_IDENTIFIER Car_State.PrechargeRequest /end MEASUREMENT
/begin MEASUREMENT Car_State.Car_State_U.EnableDrive "" FLOAT64_IEEE Car_State_CM_double 0 0 -1.7e+308 1.7e+308 ECU_ADDRESS 0x0 DISPLAY_IDENTIFIER Car_State.EnableDrive_Order /end MEASUREMENT
/begin MEASUREMENT Car_State.Car_State_U.InvertersMinDCBus "" FLOAT64_IEEE Car_State_CM_double 0 0 -1.7e+308 1.7e+308 ECU_ADDRESS 0x0 DISPLAY_IDENTIFIER Car_State.InvertersMinDCBus /end MEASUREMENT
/begin MEASUREMENT Car_State.Car_State_U.InvertersSubscribed "" FLOAT64_IEEE Car_State_CM_double 0 0 -1.7e+308 1.7e+308 ECU_ADDRESS 0x0 DISPLAY_IDENTIFIER Car_State.InvertersSubscribed /end MEASUREMENT
/begin MEASUREMENT Car_State.Car_State_U.Lock "" FLOAT64_IEEE Car_State_CM_double 0 0 -1.7e+308 1.7e+308 ECU_ADDRESS 0x0 DISPLAY_IDENTIFIER Car_State.Torque_LockON /end MEASUREMENT
/begin MEASUREMENT Car_State.Car_State_U.Shutdown_BMS "" FLOAT64_IEEE Car_State_CM_double 0 0 -1.7e+308 1.7e+308 ECU_ADDRESS 0x0 DISPLAY_IDENTIFIER Car_State.Shutdown_BMS /end MEASUREMENT
/begin MEASUREMENT Car_State.Car_State_U.Shutdown_BOTS "" FLOAT64_IEEE Car_State_CM_double 0 0 -1.7e+308 1.7e+308 ECU_ADDRESS 0x0 DISPLAY_IDENTIFIER Car_State.Shutdown_BOTS /end MEASUREMENT
/begin MEASUREMENT Car_State.Car_State_U.Shutdown_BSPD "" FLOAT64_IEEE Car_State_CM_double 0 0 -1.7e+308 1.7e+308 ECU_ADDRESS 0x0 DISPLAY_IDENTIFIER Car_State.Shutdown_BSPD /end MEASUREMENT
/begin MEASUREMENT Car_State.Car_State_U.Shutdown_HVBOX "" FLOAT64_IEEE Car_State_CM_double 0 0 -1.7e+308 1.7e+308 ECU_ADDRESS 0x0 DISPLAY_IDENTIFIER Car_State.Shutdown_HVBOX /end MEASUREMENT
/begin MEASUREMENT Car_State.Car_State_U.Shutdown_HVD "" FLOAT64_IEEE Car_State_CM_double 0 0 -1.7e+308 1.7e+308 ECU_ADDRESS 0x0 DISPLAY_IDENTIFIER Car_State.Shutdown_HVD /end MEASUREMENT
/begin MEASUREMENT Car_State.Car_State_U.Shutdown_Inertia "" FLOAT64_IEEE Car_State_CM_double 0 0 -1.7e+308 1.7e+308 ECU_ADDRESS 0x0 DISPLAY_IDENTIFIER Car_State.Shutdown_Inertia /end MEASUREMENT
/begin MEASUREMENT Car_State.Car_State_U.Shutdown_InverterLIntck "" FLOAT64_IEEE Car_State_CM_double 0 0 -1.7e+308 1.7e+308 ECU_ADDRESS 0x0 DISPLAY_IDENTIFIER Car_State.Shutdown_InverterLIntck /end MEASUREMENT
/begin MEASUREMENT Car_State.Car_State_U.Shutdown_InverterRIntck "" FLOAT64_IEEE Car_State_CM_double 0 0 -1.7e+308 1.7e+308 ECU_ADDRESS 0x0 DISPLAY_IDENTIFIER Car_State.Shutdown_InverterRIntck /end MEASUREMENT
/begin MEASUREMENT Car_State.Car_State_U.Shutdown_PackageIntck "" FLOAT64_IEEE Car_State_CM_double 0 0 -1.7e+308 1.7e+308 ECU_ADDRESS 0x0 DISPLAY_IDENTIFIER Car_State.Shutdown_PackageIntck /end MEASUREMENT
/begin MEASUREMENT Car_State.Car_State_U.Shutdown_SetaCockpit "" FLOAT64_IEEE Car_State_CM_double 0 0 -1.7e+308 1.7e+308 ECU_ADDRESS 0x0 DISPLAY_IDENTIFIER Car_State.Shutdown_SetaCockpit /end MEASUREMENT
/begin MEASUREMENT Car_State.Car_State_U.Shutdown_SetaLeft "" FLOAT64_IEEE Car_State_CM_double 0 0 -1.7e+308 1.7e+308 ECU_ADDRESS 0x0 DISPLAY_IDENTIFIER Car_State.Shutdown_SetaLeft /end MEASUREMENT
/begin MEASUREMENT Car_State.Car_State_U.Shutdown_SetaRight "" FLOAT64_IEEE Car_State_CM_double 0 0 -1.7e+308 1.7e+308 ECU_ADDRESS 0x0 DISPLAY_IDENTIFIER Car_State.Shutdown_SetaRight /end MEASUREMENT
/begin MEASUREMENT Car_State.Car_State_U.Shutdown_TSMPIntck "" FLOAT64_IEEE Car_State_CM_double 0 0 -1.7e+308 1.7e+308 ECU_ADDRESS 0x0 DISPLAY_IDENTIFIER Car_State.Shutdown_TSMPIntck /end MEASUREMENT
/begin MEASUREMENT Car_State.Car_State_U.Shutdown_TSMS "" FLOAT64_IEEE Car_State_CM_double 0 0 -1.7e+308 1.7e+308 ECU_ADDRESS 0x0 DISPLAY_IDENTIFIER Car_State.Shutdown_TSMS /end MEASUREMENT
/begin MEASUREMENT Car_State.Car_State_Y.AIRs_Request "" FLOAT64_IEEE Car_State_CM_double 0 0 -1.7e+308 1.7e+308 ECU_ADDRESS 0x0 DISPLAY_IDENTIFIER Car_State.AIRs_Request /end MEASUREMENT
/begin MEASUREMENT Car_State.Car_State_Y.Car_OK "" UBYTE Car_State_CM_boolean 0 0 0 1 ECU_ADDRESS 0x0 DISPLAY_IDENTIFIER Car_State.Car_OK /end MEASUREMENT
/begin MEASUREMENT Car_State.Car_State_Y.Car_State_f "" FLOAT64_IEEE Car_State_CM_double 0 0 -1.7e+308 1.7e+308 ECU_ADDRESS 0x0 DISPLAY_IDENTIFIER Car_State.Car_State /end MEASUREMENT
/begin MEASUREMENT Car_State.Car_State_Y.CurrentPathDisconnectionFlag "" FLOAT64_IEEE Car_State_CM_double 0 0 -1.7e+308 1.7e+308 ECU_ADDRESS 0x0 DISPLAY_IDENTIFIER Car_State.CurrentPathDisconnectionFlag /end MEASUREMENT
/begin MEASUREMENT Car_State.Car_State_Y.InvertersAction "" FLOAT64_IEEE Car_State_CM_double 0 0 -1.7e+308 1.7e+308 ECU_ADDRESS 0x0 DISPLAY_IDENTIFIER Car_State.InvertersAction /end MEASUREMENT
/begin MEASUREMENT Car_State.Car_State_Y.PrechargeAssert "" FLOAT64_IEEE Car_State_CM_double 0 0 -1.7e+308 1.7e+308 ECU_ADDRESS 0x0 DISPLAY_IDENTIFIER Car_State.PrechargeAssert /end MEASUREMENT
/begin MEASUREMENT Car_State.Car_State_Y.Precharge_Percentage "" FLOAT64_IEEE Car_State_CM_double 0 0 -1.7e+308 1.7e+308 ECU_ADDRESS 0x0 DISPLAY_IDENTIFIER Car_State.Precharge_Percentage /end MEASUREMENT
/begin MEASUREMENT Car_State.Car_State_Y.Precharge_Voltage "" FLOAT64_IEEE Car_State_CM_double 0 0 -1.7e+308 1.7e+308 ECU_ADDRESS 0x0 DISPLAY_IDENTIFIER Car_State.Precharge_Voltage /end MEASUREMENT
/begin MEASUREMENT Car_State.Car_State_Y.ShutdownClosed "" FLOAT64_IEEE Car_State_CM_double 0 0 -1.7e+308 1.7e+308 ECU_ADDRESS 0x0 DISPLAY_IDENTIFIER Car_State.ShutdownClosed /end MEASUREMENT
/begin MEASUREMENT Car_State.Car_State_Y.TorqueEnable "" FLOAT64_IEEE Car_State_CM_double 0 0 -1.7e+308 1.7e+308 ECU_ADDRESS 0x0 DISPLAY_IDENTIFIER Car_State.TorqueEnable /end MEASUREMENT
/begin MEASUREMENT Car_State.Car_State_Y.errors "" FLOAT64_IEEE Car_State_CM_double 0 0 -1.7e+308 1.7e+308 ECU_ADDRESS 0x0 DISPLAY_IDENTIFIER Car_State.errors /end MEASUREMENT
/begin MEASUREMENT Accel_Data.Accel_Data_B.AccDataConversionFX.Gain "" FLOAT64_IEEE Accel_Data_CM_double 0 0 -1.7e+308 1.7e+308 ECU_ADDRESS 0x0 DISPLAY_IDENTIFIER Accel_Data.Acc_Data_Conversion_F_X.Gain.Gain /end MEASUREMENT
/begin MEASUREMENT Accel_Data.Accel_Data_B.AccDataConversionFY.Gain "" FLOAT64_IEEE Accel_Data_CM_double 0 0 -1.7e+308 1.7e+308 ECU_ADDRESS 0x0 DISPLAY_IDENTIFIER Accel_Data.Acc_Data_Conversion_F_Y.Gain.Gain /end MEASUREMENT
/begin MEASUREMENT Accel_Data.Accel_Data_B.AccDataConversionFZ.Gain "" FLOAT64_IEEE Accel_Data_CM_double 0 0 -1.7e+308 1.7e+308 ECU_ADDRESS 0x0 DISPLAY_IDENTIFIER Accel_Data.Acc_Data_Conversion_F_Z.Gain.Gain /end MEASUREMENT
/begin MEASUREMENT Accel_Data.Accel_Data_B.AccDataConversionRX.Gain "" FLOAT64_IEEE Accel_Data_CM_double 0 0 -1.7e+308 1.7e+308 ECU_ADDRESS 0x0 DISPLAY_IDENTIFIER Accel_Data.Acc_Data_Conversion_R_X.Gain.Gain /end MEASUREMENT
/begin MEASUREMENT Accel_Data.Accel_Data_B.AccDataConversionRY.Gain "" FLOAT64_IEEE Accel_Data_CM_double 0 0 -1.7e+308 1.7e+308 ECU_ADDRESS 0x0 DISPLAY_IDENTIFIER Accel_Data.Acc_Data_Conversion_R_Y.Gain.Gain /end MEASUREMENT
/begin MEASUREMENT Accel_Data.Accel_Data_B.AccDataConversionRZ.Gain "" FLOAT64_IEEE Accel_Data_CM_double 0 0 -1.7e+308 1.7e+308 ECU_ADDRESS 0x0 DISPLAY_IDENTIFIER Accel_Data.Acc_Data_Conversion_R_Z.Gain.Gain /end MEASUREMENT
/begin MEASUREMENT Accel_Data.Accel_Data_B.LowPass.Gain "" FLOAT64_IEEE Accel_Data_CM_double 0 0 -1.7e+308 1.7e+308 ECU_ADDRESS 0x0 DISPLAY_IDENTIFIER Accel_Data.Low_Pass.Gain.Gain /end MEASUREMENT
/begin MEASUREMENT Accel_Data.Accel_Data_B.LowPass1.Gain "" FLOAT64_IEEE Accel_Data_CM_double 0 0 -1.7e+308 1.7e+308 ECU_ADDRESS 0x0 DISPLAY_IDENTIFIER Accel_Data.Low_Pass1.Gain.Gain /end MEASUREMENT
/begin MEASUREMENT Accel_Data.Accel_Data_B.LowPass2.Gain "" FLOAT64_IEEE Accel_Data_CM_double 0 0 -1.7e+308 1.7e+308 ECU_ADDRESS 0x0 DISPLAY_IDENTIFIER Accel_Data.Low_Pass2.Gain.Gain /end MEASUREMENT
/begin MEASUREMENT Accel_Data.Accel_Data_DW.A "" FLOAT64_IEEE Accel_Data_CM_double 0 0 -1.7e+308 1.7e+308 ECU_ADDRESS 0x0 DISPLAY_IDENTIFIER Accel_Data.Gyro_Data_Conversion_R_Z.Data_Store_Memory.A /end MEASUREMENT
/begin MEASUREMENT Accel_Data.Accel_Data_DW.A_f "" FLOAT64_IEEE Accel_Data_CM_double 0 0 -1.7e+308 1.7e+308 ECU_ADDRESS 0x0 DISPLAY_IDENTIFIER Accel_Data.Gyro_Data_Conversion_F_Z.Data_Store_Memory.A_f /end MEASUREMENT
/begin MEASUREMENT Accel_Data.Accel_Data_U.ACCEL_F_X "" FLOAT64_IEEE Accel_Data_CM_double 0 0 -1.7e+308 1.7e+308 ECU_ADDRESS 0x0 DISPLAY_IDENTIFIER Accel_Data.ACCEL_F_X /end MEASUREMENT
/begin MEASUREMENT Accel_Data.Accel_Data_U.ACCEL_F_Y "" FLOAT64_IEEE Accel_Data_CM_double 0 0 -1.7e+308 1.7e+308 ECU_ADDRESS 0x0 DISPLAY_IDENTIFIER Accel_Data.ACCEL_F_Y /end MEASUREMENT
/begin MEASUREMENT Accel_Data.Accel_Data_U.ACCEL_F_Z "" FLOAT64_IEEE Accel_Data_CM_double 0 0 -1.7e+308 1.7e+308 ECU_ADDRESS 0x0 DISPLAY_IDENTIFIER Accel_Data.ACCEL_F_Z /end MEASUREMENT
/begin MEASUREMENT Accel_Data.Accel_Data_U.ACCEL_R_X "" FLOAT64_IEEE Accel_Data_CM_double 0 0 -1.7e+308 1.7e+308 ECU_ADDRESS 0x0 DISPLAY_IDENTIFIER Accel_Data.ACCEL_R_X /end MEASUREMENT
/begin MEASUREMENT Accel_Data.Accel_Data_U.ACCEL_R_Y "" FLOAT64_IEEE Accel_Data_CM_double 0 0 -1.7e+308 1.7e+308 ECU_ADDRESS 0x0 DISPLAY_IDENTIFIER Accel_Data.ACCEL_R_Y /end MEASUREMENT
/begin MEASUREMENT Accel_Data.Accel_Data_U.ACCEL_R_Z "" FLOAT64_IEEE Accel_Data_CM_double 0 0 -1.7e+308 1.7e+308 ECU_ADDRESS 0x0 DISPLAY_IDENTIFIER Accel_Data.ACCEL_R_Z /end MEASUREMENT
/begin MEASUREMENT Accel_Data.Accel_Data_U.Gyroscope_F "" FLOAT64_IEEE Accel_Data_CM_double 0 0 -1.7e+308 1.7e+308 ECU_ADDRESS 0x0 DISPLAY_IDENTIFIER Accel_Data.Gyroscope_F /end MEASUREMENT
/begin MEASUREMENT Accel_Data.Accel_Data_U.Gyroscope_R "" FLOAT64_IEEE Accel_Data_CM_double 0 0 -1.7e+308 1.7e+308 ECU_ADDRESS 0x0 DISPLAY_IDENTIFIER Accel_Data.Gyroscope_R /end MEASUREMENT
/begin MEASUREMENT Accel_Data.Accel_Data_Y.Accel_F_X_SI "" FLOAT64_IEEE Accel_Data_CM_double 0 0 -1.7e+308 1.7e+308 ECU_ADDRESS 0x0 DISPLAY_IDENTIFIER Accel_Data.Accel_F_X_SI /end MEASUREMENT
/begin MEASUREMENT Accel_Data.Accel_Data_Y.Accel_F_Y_SI "" FLOAT64_IEEE Accel_Data_CM_double 0 0 -1.7e+308 1.7e+308 ECU_ADDRESS 0x0 DISPLAY_IDENTIFIER Accel_Data.Accel_F_Y_SI /end MEASUREMENT
/begin MEASUREMENT Accel_Data.Accel_Data_Y.Accel_F_Z_SI "" FLOAT64_IEEE Accel_Data_CM_double 0 0 -1.7e+308 1.7e+308 ECU_ADDRESS 0x0 DISPLAY_IDENTIFIER Accel_Data.Accel_F_Z_SI /end MEASUREMENT
/begin MEASUREMENT Accel_Data.Accel_Data_Y.Accel_R_X_SI "" FLOAT64_IEEE Accel_Data_CM_double 0 0 -1.7e+308 1.7e+308 ECU_ADDRESS 0x0 DISPLAY_IDENTIFIER Accel_Data.Accel_R_X_SI /end MEASUREMENT
/begin MEASUREMENT Accel_Data.Accel_Data_Y.Accel_R_Y_SI "" FLOAT64_IEEE Accel_Data_CM_double 0 0 -1.7e+308 1.7e+308 ECU_ADDRESS 0x0 DISPLAY_IDENTIFIER Accel_Data.Accel_R_Y_SI /end MEASUREMENT
/begin MEASUREMENT Accel_Data.Accel_Data_Y.Accel_R_Z_SI "" FLOAT64_IEEE Accel_Data_CM_double 0 0 -1.7e+308 1.7e+308 ECU_ADDRESS 0x0 DISPLAY_IDENTIFIER Accel_Data.Accel_R_Z_SI /end MEASUREMENT
/begin MEASUREMENT Accel_Data.Accel_Data_Y.Gyro_F_Z_Deg "" FLOAT64_IEEE Accel_Data_CM_double 0 0 -1.7e+308 1.7e+308 ECU_ADDRESS 0x0 DISPLAY_IDENTIFIER Accel_Data.Gyro_F_Z_Deg /end MEASUREMENT
/begin MEASUREMENT Accel_Data.Accel_Data_Y.Gyro_R_Z_Deg "" FLOAT64_IEEE Accel_Data_CM_double 0 0 -1.7e+308 1.7e+308 ECU_ADDRESS 0x0 DISPLAY_IDENTIFIER Accel_Data.Gyro_R_Z_Deg /end MEASUREMENT
/begin MEASUREMENT Accel_Data.Accel_Data_Y.Rate_F_Z_Degs2 "" FLOAT64_IEEE Accel_Data_CM_double 0 0 -1.7e+308 1.7e+308 ECU_ADDRESS 0x0 DISPLAY_IDENTIFIER Accel_Data.Rate_F_Z_Deg_s2 /end MEASUREMENT
/begin MEASUREMENT Accel_Data.Accel_Data_Y.Rate_R_Z_Degs "" FLOAT64_IEEE Accel_Data_CM_double 0 0 -1.7e+308 1.7e+308 ECU_ADDRESS 0x0 DISPLAY_IDENTIFIER Accel_Data.Rate_R_Z_Deg_s /end MEASUREMENT
/begin MEASUREMENT Disconnections.Disconnections_B.Merge "" FLOAT64_IEEE Disconnections_CM_double 0 0 -1.7e+308 1.7e+308 ECU_ADDRESS 0x0 DISPLAY_IDENTIFIER Disconnections.ECU_Disconections.LifeCheck_BMS.Merge.Merge /end MEASUREMENT
/begin MEASUREMENT Disconnections.Disconnections_B.Merge_b "" FLOAT64_IEEE Disconnections_CM_double 0 0 -1.7e+308 1.7e+308 ECU_ADDRESS 0x0 DISPLAY_IDENTIFIER Disconnections.ECU_Disconections.LifeCheck_AccFront.Merge.Merge_b /end MEASUREMENT
/begin MEASUREMENT Disconnections.Disconnections_B.Merge_d "" FLOAT64_IEEE Disconnections_CM_double 0 0 -1.7e+308 1.7e+308 ECU_ADDRESS 0x0 DISPLAY_IDENTIFIER Disconnections.ECU_Disconections.LifeCheck_AccRear.Merge.Merge_d /end MEASUREMENT
/begin MEASUREMENT Disconnections.Disconnections_B.Merge_f "" FLOAT64_IEEE Disconnections_CM_double 0 0 -1.7e+308 1.7e+308 ECU_ADDRESS 0x0 DISPLAY_IDENTIFIER Disconnections.ECU_Disconections.Life_check4.Merge.Merge_f /end MEASUREMENT
/begin MEASUREMENT Disconnections.Disconnections_B.Merge_h "" FLOAT64_IEEE Disconnections_CM_double 0 0 -1.7e+308 1.7e+308 ECU_ADDRESS 0x0 DISPLAY_IDENTIFIER Disconnections.ECU_Disconections.LifeCheck_Dash.Merge.Merge_h /end MEASUREMENT
/begin MEASUREMENT Disconnections.Disconnections_B.Merge_he "" FLOAT64_IEEE Disconnections_CM_double 0 0 -1.7e+308 1.7e+308 ECU_ADDRESS 0x0 DISPLAY_IDENTIFIER Disconnections.ECU_Disconections.LifeCheck_ADCAN.Merge.Merge_he /end MEASUREMENT
/begin MEASUREMENT Disconnections.Disconnections_B.Merge_j "" FLOAT64_IEEE Disconnections_CM_double 0 0 -1.7e+308 1.7e+308 ECU_ADDRESS 0x0 DISPLAY_IDENTIFIER Disconnections.ECU_Disconections.LifeCheck_Shutdown.Merge.Merge_j /end MEASUREMENT
/begin MEASUREMENT Disconnections.Disconnections_DW.A "" FLOAT64_IEEE Disconnections_CM_double 0 0 -1.7e+308 1.7e+308 ECU_ADDRESS 0x0 DISPLAY_IDENTIFIER Disconnections.Counter.Data_Store_Memory.A /end MEASUREMENT
/begin MEASUREMENT Disconnections.Disconnections_DW.Last_alive "" FLOAT64_IEEE Disconnections_CM_double 0 0 -1.7e+308 1.7e+308 ECU_ADDRESS 0x0 DISPLAY_IDENTIFIER Disconnections.Pedal_Box_Disconnections__Noise_.Life_check3.Data_Store_Memory.Last_alive /end MEASUREMENT
/begin MEASUREMENT Disconnections.Disconnections_DW.Last_alive_a "" FLOAT64_IEEE Disconnections_CM_double 0 0 -1.7e+308 1.7e+308 ECU_ADDRESS 0x0 DISPLAY_IDENTIFIER Disconnections.ECU_Disconections.LifeCheck_AccFront.Data_Store_Memory.Last_alive_a /end MEASUREMENT
/begin MEASUREMENT Disconnections.Disconnections_DW.Last_alive_ar "" FLOAT64_IEEE Disconnections_CM_double 0 0 -1.7e+308 1.7e+308 ECU_ADDRESS 0x0 DISPLAY_IDENTIFIER Disconnections.ECU_Disconections.LifeCheck_ADCAN.Data_Store_Memory.Last_alive_ar /end MEASUREMENT
/begin MEASUREMENT Disconnections.Disconnections_DW.Last_alive_c "" FLOAT64_IEEE Disconnections_CM_double 0 0 -1.7e+308 1.7e+308 ECU_ADDRESS 0x0 DISPLAY_IDENTIFIER Disconnections.Pedal_Box_Disconnections__Noise_.Life_check2.Data_Store_Memory.Last_alive_c /end MEASUREMENT
/begin MEASUREMENT Disconnections.Disconnections_DW.Last_alive_c0 "" FLOAT64_IEEE Disconnections_CM_double 0 0 -1.7e+308 1.7e+308 ECU_ADDRESS 0x0 DISPLAY_IDENTIFIER Disconnections.ECU_Disconections.LifeCheck_BMS.Data_Store_Memory.Last_alive_c0 /end MEASUREMENT
/begin MEASUREMENT Disconnections.Disconnections_DW.Last_alive_g "" FLOAT64_IEEE Disconnections_CM_double 0 0 -1.7e+308 1.7e+308 ECU_ADDRESS 0x0 DISPLAY_IDENTIFIER Disconnections.Pedal_Box_Disconnections__Noise_.Life_check1.Data_Store_Memory.Last_alive_g /end MEASUREMENT
/begin MEASUREMENT Disconnections.Disconnections_DW.Last_alive_gx "" FLOAT64_IEEE Disconnections_CM_double 0 0 -1.7e+308 1.7e+308 ECU_ADDRESS 0x0 DISPLAY_IDENTIFIER Disconnections.ECU_Disconections.LifeCheck_AccRear.Data_Store_Memory.Last_alive_gx /end MEASUREMENT
/begin MEASUREMENT Disconnections.Disconnections_DW.Last_alive_j "" FLOAT64_IEEE Disconnections_CM_double 0 0 -1.7e+308 1.7e+308 ECU_ADDRESS 0x0 DISPLAY_IDENTIFIER Disconnections.ECU_Disconections.LifeCheck_Shutdown.Data_Store_Memory.Last_alive_j /end MEASUREMENT
/begin MEASUREMENT Disconnections.Disconnections_DW.Last_alive_je "" FLOAT64_IEEE Disconnections_CM_double 0 0 -1.7e+308 1.7e+308 ECU_ADDRESS 0x0 DISPLAY_IDENTIFIER Disconnections.ECU_Disconections.Life_check4.Data_Store_Memory.Last_alive_je /end MEASUREMENT
/begin MEASUREMENT Disconnections.Disconnections_DW.Last_alive_l "" FLOAT64_IEEE Disconnections_CM_double 0 0 -1.7e+308 1.7e+308 ECU_ADDRESS 0x0 DISPLAY_IDENTIFIER Disconnections.Gyro_Disconnections__Noise_.Life_check6.Data_Store_Memory.Last_alive_l /end MEASUREMENT
/begin MEASUREMENT Disconnections.Disconnections_DW.Last_alive_m "" FLOAT64_IEEE Disconnections_CM_double 0 0 -1.7e+308 1.7e+308 ECU_ADDRESS 0x0 DISPLAY_IDENTIFIER Disconnections.Gyro_Disconnections__Noise_.Life_check8.Data_Store_Memory.Last_alive_m /end MEASUREMENT
/begin MEASUREMENT Disconnections.Disconnections_DW.Last_alive_o "" FLOAT64_IEEE Disconnections_CM_double 0 0 -1.7e+308 1.7e+308 ECU_ADDRESS 0x0 DISPLAY_IDENTIFIER Disconnections.ECU_Disconections.LifeCheck_Dash.Data_Store_Memory.Last_alive_o /end MEASUREMENT
/begin MEASUREMENT Disconnections.Disconnections_DW.Tot_Errors "" FLOAT64_IEEE Disconnections_CM_double 0 0 -1.7e+308 1.7e+308 ECU_ADDRESS 0x0 DISPLAY_IDENTIFIER Disconnections.Pedal_Box_Disconnections__Noise_.Life_check3.Data_Store_Memory1.Tot_Errors /end MEASUREMENT
/begin MEASUREMENT Disconnections.Disconnections_DW.Tot_Errors_h "" FLOAT64_IEEE Disconnections_CM_double 0 0 -1.7e+308 1.7e+308 ECU_ADDRESS 0x0 DISPLAY_IDENTIFIER Disconnections.Gyro_Disconnections__Noise_.Life_check6.Data_Store_Memory1.Tot_Errors_h /end MEASUREMENT
/begin MEASUREMENT Disconnections.Disconnections_DW.Tot_Errors_j "" FLOAT64_IEEE Disconnections_CM_double 0 0 -1.7e+308 1.7e+308 ECU_ADDRESS 0x0 DISPLAY_IDENTIFIER Disconnections.Pedal_Box_Disconnections__Noise_.Life_check2.Data_Store_Memory1.Tot_Errors_j /end MEASUREMENT
/begin MEASUREMENT Disconnections.Disconnections_DW.Tot_Errors_k "" FLOAT64_IEEE Disconnections_CM_double 0 0 -1.7e+308 1.7e+308 ECU_ADDRESS 0x0 DISPLAY_IDENTIFIER Disconnections.Pedal_Box_Disconnections__Noise_.Life_check1.Data_Store_Memory1.Tot_Errors_k /end MEASUREMENT
/begin MEASUREMENT Disconnections.Disconnections_DW.Tot_Errors_m "" FLOAT64_IEEE Disconnections_CM_double 0 0 -1.7e+308 1.7e+308 ECU_ADDRESS 0x0 DISPLAY_IDENTIFIER Disconnections.Gyro_Disconnections__Noise_.Life_check8.Data_Store_Memory1.Tot_Errors_m /end MEASUREMENT
/begin MEASUREMENT Disconnections.Disconnections_U.ADCAN_Alive "" FLOAT64_IEEE Disconnections_CM_double 0 0 -1.7e+308 1.7e+308 ECU_ADDRESS 0x0 DISPLAY_IDENTIFIER Disconnections.ADCAN_Alive /end MEASUREMENT
/begin MEASUREMENT Disconnections.Disconnections_U.APPS1_Bits "" FLOAT64_IEEE Disconnections_CM_double 0 0 -1.7e+308 1.7e+308 ECU_ADDRESS 0x0 DISPLAY_IDENTIFIER Disconnections.APPS1_Bits /end MEASUREMENT
/begin MEASUREMENT Disconnections.Disconnections_U.APPS2_Bits "" FLOAT64_IEEE Disconnections_CM_double 0 0 -1.7e+308 1.7e+308 ECU_ADDRESS 0x0 DISPLAY_IDENTIFIER Disconnections.APPS2_Bits /end MEASUREMENT
/begin MEASUREMENT Disconnections.Disconnections_U.Accel_F_Alive "" FLOAT64_IEEE Disconnections_CM_double 0 0 -1.7e+308 1.7e+308 ECU_ADDRESS 0x0 DISPLAY_IDENTIFIER Disconnections.Accel_F_Alive /end MEASUREMENT
/begin MEASUREMENT Disconnections.Disconnections_U.Accel_R_Alive "" FLOAT64_IEEE Disconnections_CM_double 0 0 -1.7e+308 1.7e+308 ECU_ADDRESS 0x0 DISPLAY_IDENTIFIER Disconnections.Accel_R_Alive /end MEASUREMENT
/begin MEASUREMENT Disconnections.Disconnections_U.BMS_Alive "" FLOAT64_IEEE Disconnections_CM_double 0 0 -1.7e+308 1.7e+308 ECU_ADDRESS 0x0 DISPLAY_IDENTIFIER Disconnections.BMS_Alive /end MEASUREMENT
/begin MEASUREMENT Disconnections.Disconnections_U.BrakeSensor_Bits "" FLOAT64_IEEE Disconnections_CM_double 0 0 -1.7e+308 1.7e+308 ECU_ADDRESS 0x0 DISPLAY_IDENTIFIER Disconnections.BrakeSensor_Bits /end MEASUREMENT
/begin MEASUREMENT Disconnections.Disconnections_U.Dash_Alive "" FLOAT64_IEEE Disconnections_CM_double 0 0 -1.7e+308 1.7e+308 ECU_ADDRESS 0x0 DISPLAY_IDENTIFIER Disconnections.Dash_Alive /end MEASUREMENT
/begin MEASUREMENT Disconnections.Disconnections_U.Gyroscope_F "" FLOAT64_IEEE Disconnections_CM_double 0 0 -1.7e+308 1.7e+308 ECU_ADDRESS 0x0 DISPLAY_IDENTIFIER Disconnections.Gyroscope_F /end MEASUREMENT
/begin MEASUREMENT Disconnections.Disconnections_U.Gyroscope_R "" FLOAT64_IEEE Disconnections_CM_double 0 0 -1.7e+308 1.7e+308 ECU_ADDRESS 0x0 DISPLAY_IDENTIFIER Disconnections.Gyroscope_R /end MEASUREMENT
/begin MEASUREMENT Disconnections.Disconnections_U.LV_Derivation_Alive "" FLOAT64_IEEE Disconnections_CM_double 0 0 -1.7e+308 1.7e+308 ECU_ADDRESS 0x0 DISPLAY_IDENTIFIER Disconnections.LV_Derivation_Alive /end MEASUREMENT
/begin MEASUREMENT Disconnections.Disconnections_U.Shutdown_Alive "" FLOAT64_IEEE Disconnections_CM_double 0 0 -1.7e+308 1.7e+308 ECU_ADDRESS 0x0 DISPLAY_IDENTIFIER Disconnections.Shutdown_Alive /end MEASUREMENT
/begin MEASUREMENT Disconnections.Disconnections_U.SteeringSensor_Bits "" FLOAT64_IEEE Disconnections_CM_double 0 0 -1.7e+308 1.7e+308 ECU_ADDRESS 0x0 DISPLAY_IDENTIFIER Disconnections.SteeringSensor_Bits /end MEASUREMENT
/begin MEASUREMENT Disconnections.Disconnections_U.Susp_F_L_Bits "" FLOAT64_IEEE Disconnections_CM_double 0 0 -1.7e+308 1.7e+308 ECU_ADDRESS 0x0 DISPLAY_IDENTIFIER Disconnections.Susp_F_L_Bits /end MEASUREMENT
/begin MEASUREMENT Disconnections.Disconnections_U.Susp_F_R_Bits "" FLOAT64_IEEE Disconnections_CM_double 0 0 -1.7e+308 1.7e+308 ECU_ADDRESS 0x0 DISPLAY_IDENTIFIER Disconnections.Susp_F_R_Bits /end MEASUREMENT
/begin MEASUREMENT Disconnections.Disconnections_U.Susp_R_L_Bits "" FLOAT64_IEEE Disconnections_CM_double 0 0 -1.7e+308 1.7e+308 ECU_ADDRESS 0x0 DISPLAY_IDENTIFIER Disconnections.Susp_R_L_Bits /end MEASUREMENT
/begin MEASUREMENT Disconnections.Disconnections_U.Susp_R_R_Bits "" FLOAT64_IEEE Disconnections_CM_double 0 0 -1.7e+308 1.7e+308 ECU_ADDRESS 0x0 DISPLAY_IDENTIFIER Disconnections.Susp_R_R_Bits /end MEASUREMENT
/begin MEASUREMENT Disconnections.Disconnections_Y.CounterOut "" FLOAT64_IEEE Disconnections_CM_double 0 0 -1.7e+308 1.7e+308 ECU_ADDRESS 0x0 DISPLAY_IDENTIFIER Disconnections.CounterOut /end MEASUREMENT
/begin MEASUREMENT Disconnections.Disconnections_Y.CriticalDisconnection "" UBYTE Disconnections_CM_uint8 0 0 0.0 255.0 ECU_ADDRESS 0x0 DISPLAY_IDENTIFIER Disconnections.CriticalDisconnection /end MEASUREMENT
/begin MEASUREMENT Disconnections.Disconnections_Y.Critical_CAN_Disconnection "" UBYTE Disconnections_CM_boolean 0 0 0 1 ECU_ADDRESS 0x0 DISPLAY_IDENTIFIER Disconnections.Critical_CAN_Disconnection /end MEASUREMENT
/begin MEASUREMENT Disconnections.Disconnections_Y.Critical_Signal_Disconnection "" UBYTE Disconnections_CM_boolean 0 0 0 1 ECU_ADDRESS 0x0 DISPLAY_IDENTIFIER Disconnections.Critical_Signal_Disconnection /end MEASUREMENT
/begin MEASUREMENT Disconnections.Disconnections_Y.Disconnection_ADCAN "" FLOAT64_IEEE Disconnections_CM_double 0 0 -1.7e+308 1.7e+308 ECU_ADDRESS 0x0 DISPLAY_IDENTIFIER Disconnections.Disconnection_ADCAN /end MEASUREMENT
/begin MEASUREMENT Disconnections.Disconnections_Y.Disconnection_APPS1 "" FLOAT64_IEEE Disconnections_CM_double 0 0 -1.7e+308 1.7e+308 ECU_ADDRESS 0x0 DISPLAY_IDENTIFIER Disconnections.Disconnection_APPS1 /end MEASUREMENT
/begin MEASUREMENT Disconnections.Disconnections_Y.Disconnection_APPS2 "" FLOAT64_IEEE Disconnections_CM_double 0 0 -1.7e+308 1.7e+308 ECU_ADDRESS 0x0 DISPLAY_IDENTIFIER Disconnections.Disconnection_APPS2 /end MEASUREMENT
/begin MEASUREMENT Disconnections.Disconnections_Y.Disconnection_Accel_F "" FLOAT64_IEEE Disconnections_CM_double 0 0 -1.7e+308 1.7e+308 ECU_ADDRESS 0x0 DISPLAY_IDENTIFIER Disconnections.Disconnection_Accel_F /end MEASUREMENT
/begin MEASUREMENT Disconnections.Disconnections_Y.Disconnection_Accel_R "" FLOAT64_IEEE Disconnections_CM_double 0 0 -1.7e+308 1.7e+308 ECU_ADDRESS 0x0 DISPLAY_IDENTIFIER Disconnections.Disconnection_Accel_R /end MEASUREMENT
/begin MEASUREMENT Disconnections.Disconnections_Y.Disconnection_BMS "" FLOAT64_IEEE Disconnections_CM_double 0 0 -1.7e+308 1.7e+308 ECU_ADDRESS 0x0 DISPLAY_IDENTIFIER Disconnections.Disconnection_BMS /end MEASUREMENT
/begin MEASUREMENT Disconnections.Disconnections_Y.Disconnection_Brake_Sensor "" FLOAT64_IEEE Disconnections_CM_double 0 0 -1.7e+308 1.7e+308 ECU_ADDRESS 0x0 DISPLAY_IDENTIFIER Disconnections.Disconnection_Brake_Sensor /end MEASUREMENT
/begin MEASUREMENT Disconnections.Disconnections_Y.Disconnection_DashBoard "" FLOAT64_IEEE Disconnections_CM_double 0 0 -1.7e+308 1.7e+308 ECU_ADDRESS 0x0 DISPLAY_IDENTIFIER Disconnections.Disconnection_DashBoard /end MEASUREMENT
/begin MEASUREMENT Disconnections.Disconnections_Y.Disconnection_Gyroscope_F "" FLOAT64_IEEE Disconnections_CM_double 0 0 -1.7e+308 1.7e+308 ECU_ADDRESS 0x0 DISPLAY_IDENTIFIER Disconnections.Disconnection_Gyroscope_F /end MEASUREMENT
/begin MEASUREMENT Disconnections.Disconnections_Y.Disconnection_Gyroscope_R "" FLOAT64_IEEE Disconnections_CM_double 0 0 -1.7e+308 1.7e+308 ECU_ADDRESS 0x0 DISPLAY_IDENTIFIER Disconnections.Disconnection_Gyroscope_R /end MEASUREMENT
/begin MEASUREMENT Disconnections.Disconnections_Y.Disconnection_LV_Derivation "" FLOAT64_IEEE Disconnections_CM_double 0 0 -1.7e+308 1.7e+308 ECU_ADDRESS 0x0 DISPLAY_IDENTIFIER Disconnections.Disconnection_LV_Derivation /end MEASUREMENT
/begin MEASUREMENT Disconnections.Disconnections_Y.Disconnection_Shutdown "" FLOAT64_IEEE Disconnections_CM_double 0 0 -1.7e+308 1.7e+308 ECU_ADDRESS 0x0 DISPLAY_IDENTIFIER Disconnections.Disconnection_Shutdown /end MEASUREMENT
/begin MEASUREMENT Disconnections.Disconnections_Y.Disconnection_SteeringSensor "" UBYTE Disconnections_CM_uint8 0 0 0.0 255.0 ECU_ADDRESS 0x0 DISPLAY_IDENTIFIER Disconnections.Disconnection_SteeringSensor /end MEASUREMENT
/begin MEASUREMENT Disconnections.Disconnections_Y.Disconnection_Susp_F_L "" UBYTE Disconnections_CM_uint8 0 0 0.0 255.0 ECU_ADDRESS 0x0 DISPLAY_IDENTIFIER Disconnections.Disconnection_Susp_F_L /end MEASUREMENT
/begin MEASUREMENT Disconnections.Disconnections_Y.Disconnection_Susp_F_R "" UBYTE Disconnections_CM_uint8 0 0 0.0 255.0 ECU_ADDRESS 0x0 DISPLAY_IDENTIFIER Disconnections.Disconnection_Susp_F_R /end MEASUREMENT
/begin MEASUREMENT Disconnections.Disconnections_Y.Disconnection_Susp_R_L "" UBYTE Disconnections_CM_uint8 0 0 0.0 255.0 ECU_ADDRESS 0x0 DISPLAY_IDENTIFIER Disconnections.Disconnection_Susp_R_L /end MEASUREMENT
/begin MEASUREMENT Disconnections.Disconnections_Y.Disconnection_Susp_R_R "" UBYTE Disconnections_CM_uint8 0 0 0.0 255.0 ECU_ADDRESS 0x0 DISPLAY_IDENTIFIER Disconnections.Disconnection_Susp_R_R /end MEASUREMENT
/begin MEASUREMENT Disconnections.Disconnections_Y.TV_mode "" FLOAT64_IEEE Disconnections_CM_double 0 0 -1.7e+308 1.7e+308 ECU_ADDRESS 0x0 DISPLAY_IDENTIFIER Disconnections.TV_mode /end MEASUREMENT
/begin MEASUREMENT Inverters_Action.Inverters_Action_B.Merge "" UBYTE Inverters_Action_CM_boolean 0 0 0 1 ECU_ADDRESS 0x0 DISPLAY_IDENTIFIER Inverters_Action.Merge.Merge /end MEASUREMENT
/begin MEASUREMENT Inverters_Action.Inverters_Action_B.Merge2 "" UBYTE Inverters_Action_CM_uint8 0 0 0.0 255.0 ECU_ADDRESS 0x0 DISPLAY_IDENTIFIER Inverters_Action.Subsystem9.Merge2.Merge2 /end MEASUREMENT
/begin MEASUREMENT Inverters_Action.Inverters_Action_B.Merge2_p "" UBYTE Inverters_Action_CM_uint8 0 0 0.0 255.0 ECU_ADDRESS 0x0 DISPLAY_IDENTIFIER Inverters_Action.Subsystem10.Merge2.Merge2_p /end MEASUREMENT
/begin MEASUREMENT Inverters_Action.Inverters_Action_B.subscribed "" UBYTE Inverters_Action_CM_boolean 0 0 0 1 ECU_ADDRESS 0x0 DISPLAY_IDENTIFIER Inverters_Action.Subsystem9.Unsubscribe__Subscribe.subscribed_.subscribed /end MEASUREMENT
/begin MEASUREMENT Inverters_Action.Inverters_Action_B.subscribed_b "" UBYTE Inverters_Action_CM_boolean 0 0 0 1 ECU_ADDRESS 0x0 DISPLAY_IDENTIFIER Inverters_Action.Subsystem10.Unsubscribe__Subscribe.subscribed_.subscribed_b /end MEASUREMENT
/begin MEASUREMENT Inverters_Action.Inverters_Action_DW.EnumerationCounter "" FLOAT64_IEEE Inverters_Action_CM_double 0 0 -1.7e+308 1.7e+308 ECU_ADDRESS 0x0 DISPLAY_IDENTIFIER Inverters_Action.Subsystem10.Data_Store_Memory2.EnumerationCounter /end MEASUREMENT
/begin MEASUREMENT Inverters_Action.Inverters_Action_DW.EnumerationCounter_m "" FLOAT64_IEEE Inverters_Action_CM_double 0 0 -1.7e+308 1.7e+308 ECU_ADDRESS 0x0 DISPLAY_IDENTIFIER Inverters_Action.Subsystem9.Data_Store_Memory2.EnumerationCounter_m /end MEASUREMENT
/begin MEASUREMENT Inverters_Action.Inverters_Action_DW.LastAction "" FLOAT64_IEEE Inverters_Action_CM_double 0 0 -1.7e+308 1.7e+308 ECU_ADDRESS 0x0 DISPLAY_IDENTIFIER Inverters_Action.Subsystem10.Data_Store_Memory1.LastAction /end MEASUREMENT
/begin MEASUREMENT Inverters_Action.Inverters_Action_DW.LastAction_k "" FLOAT64_IEEE Inverters_Action_CM_double 0 0 -1.7e+308 1.7e+308 ECU_ADDRESS 0x0 DISPLAY_IDENTIFIER Inverters_Action.Subsystem9.Data_Store_Memory1.LastAction_k /end MEASUREMENT
/begin MEASUREMENT Inverters_Action.Inverters_Action_U.InvertersAction "" FLOAT64_IEEE Inverters_Action_CM_double 0 0 -1.7e+308 1.7e+308 ECU_ADDRESS 0x0 DISPLAY_IDENTIFIER Inverters_Action.InvertersAction /end MEASUREMENT
/begin MEASUREMENT Inverters_Action.Inverters_Action_U.current_L "" FLOAT64_IEEE Inverters_Action_CM_double 0 0 -1.7e+308 1.7e+308 ECU_ADDRESS 0x0 DISPLAY_IDENTIFIER Inverters_Action.current_L /end MEASUREMENT
/begin MEASUREMENT Inverters_Action.Inverters_Action_U.current_R "" FLOAT64_IEEE Inverters_Action_CM_double 0 0 -1.7e+308 1.7e+308 ECU_ADDRESS 0x0 DISPLAY_IDENTIFIER Inverters_Action.current_R /end MEASUREMENT
/begin MEASUREMENT Inverters_Action.Inverters_Action_Y.Inverter_L_RegID "" UBYTE Inverters_Action_CM_uint8 0 0 0.0 255.0 ECU_ADDRESS 0x0 DISPLAY_IDENTIFIER Inverters_Action.Inverter_L_RegID /end MEASUREMENT
/begin MEASUREMENT Inverters_Action.Inverters_Action_Y.Inverter_L_b15tob8 "" UBYTE Inverters_Action_CM_uint8 0 0 0.0 255.0 ECU_ADDRESS 0x0 DISPLAY_IDENTIFIER Inverters_Action.Inverter_L_b15tob8 /end MEASUREMENT
/begin MEASUREMENT Inverters_Action.Inverters_Action_Y.Inverter_L_b7tob0 "" UBYTE Inverters_Action_CM_uint8 0 0 0.0 255.0 ECU_ADDRESS 0x0 DISPLAY_IDENTIFIER Inverters_Action.Inverter_L_b7tob0 /end MEASUREMENT
/begin MEASUREMENT Inverters_Action.Inverters_Action_Y.Inverter_R_RegID "" UBYTE Inverters_Action_CM_uint8 0 0 0.0 255.0 ECU_ADDRESS 0x0 DISPLAY_IDENTIFIER Inverters_Action.Inverter_R_RegID /end MEASUREMENT
/begin MEASUREMENT Inverters_Action.Inverters_Action_Y.Inverter_R_b15tob8 "" UBYTE Inverters_Action_CM_uint8 0 0 0.0 255.0 ECU_ADDRESS 0x0 DISPLAY_IDENTIFIER Inverters_Action.Inverter_R_b15tob8 /end MEASUREMENT
/begin MEASUREMENT Inverters_Action.Inverters_Action_Y.Inverter_R_b7tob0 "" UBYTE Inverters_Action_CM_uint8 0 0 0.0 255.0 ECU_ADDRESS 0x0 DISPLAY_IDENTIFIER Inverters_Action.Inverter_R_b7tob0 /end MEASUREMENT
/begin MEASUREMENT Inverters_Action.Inverters_Action_Y.InvertersSubscribed "" UBYTE Inverters_Action_CM_boolean 0 0 0 1 ECU_ADDRESS 0x0 DISPLAY_IDENTIFIER Inverters_Action.InvertersSubscribed /end MEASUREMENT
/begin MEASUREMENT Inverters_Data.Inverters_Data_U.Inv_L_RegID_M235_Inv_L_DCBus "" FLOAT64_IEEE Inverters_Data_CM_double 0 0 -1.7e+308 1.7e+308 ECU_ADDRESS 0x0 DISPLAY_IDENTIFIER Inverters_Data.Inv_L_RegID_M235_Inv_L_DCBus /end MEASUREMENT
/begin MEASUREMENT Inverters_Data.Inverters_Data_U.Inv_L_RegID_M32_Inv_L_Iactual "" FLOAT64_IEEE Inverters_Data_CM_double 0 0 -1.7e+308 1.7e+308 ECU_ADDRESS 0x0 DISPLAY_IDENTIFIER Inverters_Data.Inv_L_RegID_M32_Inv_L_Iactual /end MEASUREMENT
/begin MEASUREMENT Inverters_Data.Inverters_Data_U.Inv_L_RegID_M38_Inv_L_Icommand "" FLOAT64_IEEE Inverters_Data_CM_double 0 0 -1.7e+308 1.7e+308 ECU_ADDRESS 0x0 DISPLAY_IDENTIFIER Inverters_Data.Inv_L_RegID_M38_Inv_L_Icommand /end MEASUREMENT
/begin MEASUREMENT Inverters_Data.Inverters_Data_U.Inv_L_RegID_M39_Inv_L_Iq "" FLOAT64_IEEE Inverters_Data_CM_double 0 0 -1.7e+308 1.7e+308 ECU_ADDRESS 0x0 DISPLAY_IDENTIFIER Inverters_Data.Inv_L_RegID_M39_Inv_L_Iq /end MEASUREMENT
/begin MEASUREMENT Inverters_Data.Inverters_Data_U.Inv_L_RegID_M48_Inv_L_Speed "" FLOAT64_IEEE Inverters_Data_CM_double 0 0 -1.7e+308 1.7e+308 ECU_ADDRESS 0x0 DISPLAY_IDENTIFIER Inverters_Data.Inv_L_RegID_M48_Inv_L_Speed /end MEASUREMENT
/begin MEASUREMENT Inverters_Data.Inverters_Data_U.Inv_L_RegID_M73_Inv_L_TempMotor "" FLOAT64_IEEE Inverters_Data_CM_double 0 0 -1.7e+308 1.7e+308 ECU_ADDRESS 0x0 DISPLAY_IDENTIFIER Inverters_Data.Inv_L_RegID_M73_Inv_L_TempMotor /end MEASUREMENT
/begin MEASUREMENT Inverters_Data.Inverters_Data_U.Inv_L_RegID_M74_Inv_L_TempIGBT "" FLOAT64_IEEE Inverters_Data_CM_double 0 0 -1.7e+308 1.7e+308 ECU_ADDRESS 0x0 DISPLAY_IDENTIFIER Inverters_Data.Inv_L_RegID_M74_Inv_L_TempIGBT /end MEASUREMENT
/begin MEASUREMENT Inverters_Data.Inverters_Data_U.Inv_R_RegID_M235_Inv_R_DCBus "" FLOAT64_IEEE Inverters_Data_CM_double 0 0 -1.7e+308 1.7e+308 ECU_ADDRESS 0x0 DISPLAY_IDENTIFIER Inverters_Data.Inv_R_RegID_M235_Inv_R_DCBus /end MEASUREMENT
/begin MEASUREMENT Inverters_Data.Inverters_Data_U.Inv_R_RegID_M32_Inv_R_Iactual "" FLOAT64_IEEE Inverters_Data_CM_double 0 0 -1.7e+308 1.7e+308 ECU_ADDRESS 0x0 DISPLAY_IDENTIFIER Inverters_Data.Inv_R_RegID_M32_Inv_R_Iactual /end MEASUREMENT
/begin MEASUREMENT Inverters_Data.Inverters_Data_U.Inv_R_RegID_M38_Inv_R_Icommand "" FLOAT64_IEEE Inverters_Data_CM_double 0 0 -1.7e+308 1.7e+308 ECU_ADDRESS 0x0 DISPLAY_IDENTIFIER Inverters_Data.Inv_R_RegID_M38_Inv_R_Icommand /end MEASUREMENT
/begin MEASUREMENT Inverters_Data.Inverters_Data_U.Inv_R_RegID_M39_Inv_R_Iq "" FLOAT64_IEEE Inverters_Data_CM_double 0 0 -1.7e+308 1.7e+308 ECU_ADDRESS 0x0 DISPLAY_IDENTIFIER Inverters_Data.Inv_R_RegID_M39_Inv_R_Iq /end MEASUREMENT
/begin MEASUREMENT Inverters_Data.Inverters_Data_U.Inv_R_RegID_M48_Inv_R_Speed "" FLOAT64_IEEE Inverters_Data_CM_double 0 0 -1.7e+308 1.7e+308 ECU_ADDRESS 0x0 DISPLAY_IDENTIFIER Inverters_Data.Inv_R_RegID_M48_Inv_R_Speed /end MEASUREMENT
/begin MEASUREMENT Inverters_Data.Inverters_Data_U.Inv_R_RegID_M73_Inv_R_TempMotor "" FLOAT64_IEEE Inverters_Data_CM_double 0 0 -1.7e+308 1.7e+308 ECU_ADDRESS 0x0 DISPLAY_IDENTIFIER Inverters_Data.Inv_R_RegID_M73_Inv_R_TempMotor /end MEASUREMENT
/begin MEASUREMENT Inverters_Data.Inverters_Data_U.Inv_R_RegID_M74_Inv_R_TempIGBT "" FLOAT64_IEEE Inverters_Data_CM_double 0 0 -1.7e+308 1.7e+308 ECU_ADDRESS 0x0 DISPLAY_IDENTIFIER Inverters_Data.Inv_R_RegID_M74_Inv_R_TempIGBT /end MEASUREMENT
/begin MEASUREMENT Inverters_Data.Inverters_Data_U.Torque_L "" FLOAT64_IEEE Inverters_Data_CM_double 0 0 -1.7e+308 1.7e+308 ECU_ADDRESS 0x0 DISPLAY_IDENTIFIER Inverters_Data.Torque_L /end MEASUREMENT
/begin MEASUREMENT Inverters_Data.Inverters_Data_U.Torque_R "" FLOAT64_IEEE Inverters_Data_CM_double 0 0 -1.7e+308 1.7e+308 ECU_ADDRESS 0x0 DISPLAY_IDENTIFIER Inverters_Data.Torque_R /end MEASUREMENT
/begin MEASUREMENT Inverters_Data.Inverters_Data_Y.Inv_L_Iactual "" FLOAT64_IEEE Inverters_Data_CM_double 0 0 -1.7e+308 1.7e+308 ECU_ADDRESS 0x0 DISPLAY_IDENTIFIER Inverters_Data.Inv_L_Iactual /end MEASUREMENT
/begin MEASUREMENT Inverters_Data.Inverters_Data_Y.Inv_L_Icommand "" FLOAT64_IEEE Inverters_Data_CM_double 0 0 -1.7e+308 1.7e+308 ECU_ADDRESS 0x0 DISPLAY_IDENTIFIER Inverters_Data.Inv_L_Icommand /end MEASUREMENT
/begin MEASUREMENT Inverters_Data.Inverters_Data_Y.Inv_L_Iq "" FLOAT64_IEEE Inverters_Data_CM_double 0 0 -1.7e+308 1.7e+308 ECU_ADDRESS 0x0 DISPLAY_IDENTIFIER Inverters_Data.Inv_L_Iq /end MEASUREMENT
/begin MEASUREMENT Inverters_Data.Inverters_Data_Y.Inv_L_Speed "" FLOAT64_IEEE Inverters_Data_CM_double 0 0 -1.7e+308 1.7e+308 ECU_ADDRESS 0x0 DISPLAY_IDENTIFIER Inverters_Data.Inv_L_Speed /end MEASUREMENT
/begin MEASUREMENT Inverters_Data.Inverters_Data_Y.Inv_L_TempIGBT "" FLOAT64_IEEE Inverters_Data_CM_double 0 0 -1.7e+308 1.7e+308 ECU_ADDRESS 0x0 DISPLAY_IDENTIFIER Inverters_Data.Inv_L_TempIGBT /end MEASUREMENT
/begin MEASUREMENT Inverters_Data.Inverters_Data_Y.Inv_L_TempMotor "" FLOAT64_IEEE Inverters_Data_CM_double 0 0 -1.7e+308 1.7e+308 ECU_ADDRESS 0x0 DISPLAY_IDENTIFIER Inverters_Data.Inv_L_TempMotor /end MEASUREMENT
/begin MEASUREMENT Inverters_Data.Inverters_Data_Y.Inv_L_VdcBus "" FLOAT64_IEEE Inverters_Data_CM_double 0 0 -1.7e+308 1.7e+308 ECU_ADDRESS 0x0 DISPLAY_IDENTIFIER Inverters_Data.Inv_L_VdcBus /end MEASUREMENT
/begin MEASUREMENT Inverters_Data.Inverters_Data_Y.Inv_R_Iactual "" FLOAT64_IEEE Inverters_Data_CM_double 0 0 -1.7e+308 1.7e+308 ECU_ADDRESS 0x0 DISPLAY_IDENTIFIER Inverters_Data.Inv_R_Iactual /end MEASUREMENT
/begin MEASUREMENT Inverters_Data.Inverters_Data_Y.Inv_R_Icommand "" FLOAT64_IEEE Inverters_Data_CM_double 0 0 -1.7e+308 1.7e+308 ECU_ADDRESS 0x0 DISPLAY_IDENTIFIER Inverters_Data.Inv_R_Icommand /end MEASUREMENT
/begin MEASUREMENT Inverters_Data.Inverters_Data_Y.Inv_R_Iq "" FLOAT64_IEEE Inverters_Data_CM_double 0 0 -1.7e+308 1.7e+308 ECU_ADDRESS 0x0 DISPLAY_IDENTIFIER Inverters_Data.Inv_R_Iq /end MEASUREMENT
/begin MEASUREMENT Inverters_Data.Inverters_Data_Y.Inv_R_Speed "" FLOAT64_IEEE Inverters_Data_CM_double 0 0 -1.7e+308 1.7e+308 ECU_ADDRESS 0x0 DISPLAY_IDENTIFIER Inverters_Data.Inv_R_Speed /end MEASUREMENT
/begin MEASUREMENT Inverters_Data.Inverters_Data_Y.Inv_R_TempIGBT "" FLOAT64_IEEE Inverters_Data_CM_double 0 0 -1.7e+308 1.7e+308 ECU_ADDRESS 0x0 DISPLAY_IDENTIFIER Inverters_Data.Inv_R_TempIGBT /end MEASUREMENT
/begin MEASUREMENT Inverters_Data.Inverters_Data_Y.Inv_R_TempMotor "" FLOAT64_IEEE Inverters_Data_CM_double 0 0 -1.7e+308 1.7e+308 ECU_ADDRESS 0x0 DISPLAY_IDENTIFIER Inverters_Data.Inv_R_TempMotor /end MEASUREMENT
/begin MEASUREMENT Inverters_Data.Inverters_Data_Y.Inv_R_VdcBus "" FLOAT64_IEEE Inverters_Data_CM_double 0 0 -1.7e+308 1.7e+308 ECU_ADDRESS 0x0 DISPLAY_IDENTIFIER Inverters_Data.Inv_R_VdcBus /end MEASUREMENT
/begin MEASUREMENT Inverters_Data.Inverters_Data_Y.InvertersMinDCBus "" FLOAT64_IEEE Inverters_Data_CM_double 0 0 -1.7e+308 1.7e+308 ECU_ADDRESS 0x0 DISPLAY_IDENTIFIER Inverters_Data.InvertersMinDCBus /end MEASUREMENT
/begin MEASUREMENT Inverters_Data.Inverters_Data_Y.Mech_Power "" FLOAT64_IEEE Inverters_Data_CM_double 0 0 -1.7e+308 1.7e+308 ECU_ADDRESS 0x0 DISPLAY_IDENTIFIER Inverters_Data.Mech_Power /end MEASUREMENT
/begin MEASUREMENT Inverters_Data.Inverters_Data_Y.RL_rads "" FLOAT64_IEEE Inverters_Data_CM_double 0 0 -1.7e+308 1.7e+308 ECU_ADDRESS 0x0 DISPLAY_IDENTIFIER Inverters_Data.RL_rads /end MEASUREMENT
/begin MEASUREMENT Inverters_Data.Inverters_Data_Y.RR_rads "" FLOAT64_IEEE Inverters_Data_CM_double 0 0 -1.7e+308 1.7e+308 ECU_ADDRESS 0x0 DISPLAY_IDENTIFIER Inverters_Data.RR_rads /end MEASUREMENT
/begin MEASUREMENT Inverters_Data.Inverters_Data_Y.Speed "" FLOAT64_IEEE Inverters_Data_CM_double 0 0 -1.7e+308 1.7e+308 ECU_ADDRESS 0x0 DISPLAY_IDENTIFIER Inverters_Data.Speed /end MEASUREMENT
/begin MEASUREMENT Inverters_Data.Inverters_Data_Y.Temp_IGBT "" FLOAT64_IEEE Inverters_Data_CM_double 0 0 -1.7e+308 1.7e+308 ECU_ADDRESS 0x0 DISPLAY_IDENTIFIER Inverters_Data.Temp_IGBT /end MEASUREMENT
/begin MEASUREMENT Inverters_Data.Inverters_Data_Y.Temp_Motors "" FLOAT64_IEEE Inverters_Data_CM_double 0 0 -1.7e+308 1.7e+308 ECU_ADDRESS 0x0 DISPLAY_IDENTIFIER Inverters_Data.Temp_Motors /end MEASUREMENT
/begin MEASUREMENT Inverters_Data.Inverters_Data_Y.Vel_RL_kmh "" FLOAT64_IEEE Inverters_Data_CM_double 0 0 -1.7e+308 1.7e+308 ECU_ADDRESS 0x0 DISPLAY_IDENTIFIER Inverters_Data.Vel_RL_kmh /end MEASUREMENT
/begin MEASUREMENT Inverters_Data.Inverters_Data_Y.Vel_RR_kmh "" FLOAT64_IEEE Inverters_Data_CM_double 0 0 -1.7e+308 1.7e+308 ECU_ADDRESS 0x0 DISPLAY_IDENTIFIER Inverters_Data.Vel_RR_kmh /end MEASUREMENT
/begin MEASUREMENT LVD_Data.LVD_Data_DW.Previous_IN "" FLOAT64_IEEE LVD_Data_CM_double 0 0 -1.7e+308 1.7e+308 ECU_ADDRESS 0x0 DISPLAY_IDENTIFIER LVD_Data.Low_Pass.Data_Store_Memory.Previous_IN /end MEASUREMENT
/begin MEASUREMENT LVD_Data.LVD_Data_DW.Previous_OUT "" FLOAT64_IEEE LVD_Data_CM_double 0 0 -1.7e+308 1.7e+308 ECU_ADDRESS 0x0 DISPLAY_IDENTIFIER LVD_Data.Low_Pass.Data_Store_Memory1.Previous_OUT /end MEASUREMENT
/begin MEASUREMENT LVD_Data.LVD_Data_U.LVBattery_Voltage_Bits "" FLOAT64_IEEE LVD_Data_CM_double 0 0 -1.7e+308 1.7e+308 ECU_ADDRESS 0x0 DISPLAY_IDENTIFIER LVD_Data.LVBattery_Voltage_Bits /end MEASUREMENT
/begin MEASUREMENT LVD_Data.LVD_Data_Y.LVbattery_Voltage "" FLOAT64_IEEE LVD_Data_CM_double 0 0 -1.7e+308 1.7e+308 ECU_ADDRESS 0x0 DISPLAY_IDENTIFIER LVD_Data.LVbattery_Voltage /end MEASUREMENT
/begin MEASUREMENT Pedals_Susp_Sensors.Pedals_Susp_Sensors_B.bitsmax "" FLOAT64_IEEE Pedals_Susp_Sensors_CM_double 0 0 -1.7e+308 1.7e+308 ECU_ADDRESS 0x0 DISPLAY_IDENTIFIER Pedals_Susp_Sensors.Suspension_FL_Data_Conv.bitsmax.bitsmax /end MEASUREMENT
/begin MEASUREMENT Pedals_Susp_Sensors.Pedals_Susp_Sensors_B.bitsmax_n "" FLOAT64_IEEE Pedals_Susp_Sensors_CM_double 0 0 -1.7e+308 1.7e+308 ECU_ADDRESS 0x0 DISPLAY_IDENTIFIER Pedals_Susp_Sensors.Suspension_RR_Data_Conv.bitsmax.bitsmax_n /end MEASUREMENT
/begin MEASUREMENT Pedals_Susp_Sensors.Pedals_Susp_Sensors_B.bitsmax_o "" FLOAT64_IEEE Pedals_Susp_Sensors_CM_double 0 0 -1.7e+308 1.7e+308 ECU_ADDRESS 0x0 DISPLAY_IDENTIFIER Pedals_Susp_Sensors.Suspension_RL_Data_Conv.bitsmax.bitsmax_o /end MEASUREMENT
/begin MEASUREMENT Pedals_Susp_Sensors.Pedals_Susp_Sensors_B.bitsmax_p "" FLOAT64_IEEE Pedals_Susp_Sensors_CM_double 0 0 -1.7e+308 1.7e+308 ECU_ADDRESS 0x0 DISPLAY_IDENTIFIER Pedals_Susp_Sensors.Suspension_FR_Data_Conv.bitsmax.bitsmax_p /end MEASUREMENT
/begin MEASUREMENT Pedals_Susp_Sensors.Pedals_Susp_Sensors_B.sf_MATLABFunction.ZeroExperimental "" FLOAT64_IEEE Pedals_Susp_Sensors_CM_double 0 0 -1.7e+308 1.7e+308 ECU_ADDRESS 0x0 DISPLAY_IDENTIFIER Pedals_Susp_Sensors.Suspension_FL_Data_Conv.MATLAB_Function.ZeroExperimental /end MEASUREMENT
/begin MEASUREMENT Pedals_Susp_Sensors.Pedals_Susp_Sensors_B.sf_MATLABFunction_b.ZeroExperimental "" FLOAT64_IEEE Pedals_Susp_Sensors_CM_double 0 0 -1.7e+308 1.7e+308 ECU_ADDRESS 0x0 DISPLAY_IDENTIFIER Pedals_Susp_Sensors.Suspension_RL_Data_Conv.MATLAB_Function.ZeroExperimental /end MEASUREMENT
/begin MEASUREMENT Pedals_Susp_Sensors.Pedals_Susp_Sensors_B.sf_MATLABFunction_h.ZeroExperimental "" FLOAT64_IEEE Pedals_Susp_Sensors_CM_double 0 0 -1.7e+308 1.7e+308 ECU_ADDRESS 0x0 DISPLAY_IDENTIFIER Pedals_Susp_Sensors.Suspension_RR_Data_Conv.MATLAB_Function.ZeroExperimental /end MEASUREMENT
/begin MEASUREMENT Pedals_Susp_Sensors.Pedals_Susp_Sensors_B.sf_MATLABFunction_k.ZeroExperimental "" FLOAT64_IEEE Pedals_Susp_Sensors_CM_double 0 0 -1.7e+308 1.7e+308 ECU_ADDRESS 0x0 DISPLAY_IDENTIFIER Pedals_Susp_Sensors.Suspension_FR_Data_Conv.MATLAB_Function.ZeroExperimental /end MEASUREMENT
/begin MEASUREMENT Pedals_Susp_Sensors.Pedals_Susp_Sensors_DW.Z_E "" FLOAT64_IEEE Pedals_Susp_Sensors_CM_double 0 0 -1.7e+308 1.7e+308 ECU_ADDRESS 0x0 DISPLAY_IDENTIFIER Pedals_Susp_Sensors.Suspension_FL_Data_Conv.Data_Store_Memory.Z_E /end MEASUREMENT
/begin MEASUREMENT Pedals_Susp_Sensors.Pedals_Susp_Sensors_DW.Z_E_d "" FLOAT64_IEEE Pedals_Susp_Sensors_CM_double 0 0 -1.7e+308 1.7e+308 ECU_ADDRESS 0x0 DISPLAY_IDENTIFIER Pedals_Susp_Sensors.Suspension_FR_Data_Conv.Data_Store_Memory.Z_E_d /end MEASUREMENT
/begin MEASUREMENT Pedals_Susp_Sensors.Pedals_Susp_Sensors_DW.Z_E_h "" FLOAT64_IEEE Pedals_Susp_Sensors_CM_double 0 0 -1.7e+308 1.7e+308 ECU_ADDRESS 0x0 DISPLAY_IDENTIFIER Pedals_Susp_Sensors.Suspension_RL_Data_Conv.Data_Store_Memory.Z_E_h /end MEASUREMENT
/begin MEASUREMENT Pedals_Susp_Sensors.Pedals_Susp_Sensors_DW.Z_E_p "" FLOAT64_IEEE Pedals_Susp_Sensors_CM_double 0 0 -1.7e+308 1.7e+308 ECU_ADDRESS 0x0 DISPLAY_IDENTIFIER Pedals_Susp_Sensors.Suspension_RR_Data_Conv.Data_Store_Memory.Z_E_p /end MEASUREMENT
/begin MEASUREMENT Pedals_Susp_Sensors.Pedals_Susp_Sensors_U.APPS1_Bits "" FLOAT64_IEEE Pedals_Susp_Sensors_CM_double 0 0 -1.7e+308 1.7e+308 ECU_ADDRESS 0x0 DISPLAY_IDENTIFIER Pedals_Susp_Sensors.APPS1_Bits /end MEASUREMENT
/begin MEASUREMENT Pedals_Susp_Sensors.Pedals_Susp_Sensors_U.APPS2_Bits "" FLOAT64_IEEE Pedals_Susp_Sensors_CM_double 0 0 -1.7e+308 1.7e+308 ECU_ADDRESS 0x0 DISPLAY_IDENTIFIER Pedals_Susp_Sensors.APPS2_Bits /end MEASUREMENT
/begin MEASUREMENT Pedals_Susp_Sensors.Pedals_Susp_Sensors_U.BrakeSensor_Bits "" FLOAT64_IEEE Pedals_Susp_Sensors_CM_double 0 0 -1.7e+308 1.7e+308 ECU_ADDRESS 0x0 DISPLAY_IDENTIFIER Pedals_Susp_Sensors.BrakeSensor_Bits /end MEASUREMENT
/begin MEASUREMENT Pedals_Susp_Sensors.Pedals_Susp_Sensors_U.Susp_F_L_Bits "" FLOAT64_IEEE Pedals_Susp_Sensors_CM_double 0 0 -1.7e+308 1.7e+308 ECU_ADDRESS 0x0 DISPLAY_IDENTIFIER Pedals_Susp_Sensors.Susp_F_L_Bits /end MEASUREMENT
/begin MEASUREMENT Pedals_Susp_Sensors.Pedals_Susp_Sensors_U.Susp_F_R_Bits "" FLOAT64_IEEE Pedals_Susp_Sensors_CM_double 0 0 -1.7e+308 1.7e+308 ECU_ADDRESS 0x0 DISPLAY_IDENTIFIER Pedals_Susp_Sensors.Susp_F_R_Bits /end MEASUREMENT
/begin MEASUREMENT Pedals_Susp_Sensors.Pedals_Susp_Sensors_U.Susp_R_L_Bits "" FLOAT64_IEEE Pedals_Susp_Sensors_CM_double 0 0 -1.7e+308 1.7e+308 ECU_ADDRESS 0x0 DISPLAY_IDENTIFIER Pedals_Susp_Sensors.Susp_R_L_Bits /end MEASUREMENT
/begin MEASUREMENT Pedals_Susp_Sensors.Pedals_Susp_Sensors_U.Susp_R_R_Bits "" FLOAT64_IEEE Pedals_Susp_Sensors_CM_double 0 0 -1.7e+308 1.7e+308 ECU_ADDRESS 0x0 DISPLAY_IDENTIFIER Pedals_Susp_Sensors.Susp_R_R_Bits /end MEASUREMENT
/begin MEASUREMENT Pedals_Susp_Sensors.Pedals_Susp_Sensors_Y.APPS1_Value "" FLOAT64_IEEE Pedals_Susp_Sensors_CM_double 0 0 -1.7e+308 1.7e+308 ECU_ADDRESS 0x0 DISPLAY_IDENTIFIER Pedals_Susp_Sensors.APPS1_Value /end MEASUREMENT
/begin MEASUREMENT Pedals_Susp_Sensors.Pedals_Susp_Sensors_Y.APPS2_Value "" FLOAT64_IEEE Pedals_Susp_Sensors_CM_double 0 0 -1.7e+308 1.7e+308 ECU_ADDRESS 0x0 DISPLAY_IDENTIFIER Pedals_Susp_Sensors.APPS2_Value /end MEASUREMENT
/begin MEASUREMENT Pedals_Susp_Sensors.Pedals_Susp_Sensors_Y.BrakeLight_Control "" FLOAT64_IEEE Pedals_Susp_Sensors_CM_double 0 0 -1.7e+308 1.7e+308 ECU_ADDRESS 0x0 DISPLAY_IDENTIFIER Pedals_Susp_Sensors.BrakeLight_Control /end MEASUREMENT
/begin MEASUREMENT Pedals_Susp_Sensors.Pedals_Susp_Sensors_Y.BrakeSensor_Value "" FLOAT64_IEEE Pedals_Susp_Sensors_CM_double 0 0 -1.7e+308 1.7e+308 ECU_ADDRESS 0x0 DISPLAY_IDENTIFIER Pedals_Susp_Sensors.BrakeSensor_Value /end MEASUREMENT
/begin MEASUREMENT Pedals_Susp_Sensors.Pedals_Susp_Sensors_Y.SUSP_F_L "" FLOAT64_IEEE Pedals_Susp_Sensors_CM_double 0 0 -1.7e+308 1.7e+308 ECU_ADDRESS 0x0 DISPLAY_IDENTIFIER Pedals_Susp_Sensors.SUSP_F_L /end MEASUREMENT
/begin MEASUREMENT Pedals_Susp_Sensors.Pedals_Susp_Sensors_Y.SUSP_F_R "" FLOAT64_IEEE Pedals_Susp_Sensors_CM_double 0 0 -1.7e+308 1.7e+308 ECU_ADDRESS 0x0 DISPLAY_IDENTIFIER Pedals_Susp_Sensors.SUSP_F_R /end MEASUREMENT
/begin MEASUREMENT Pedals_Susp_Sensors.Pedals_Susp_Sensors_Y.SUSP_R_L "" FLOAT64_IEEE Pedals_Susp_Sensors_CM_double 0 0 -1.7e+308 1.7e+308 ECU_ADDRESS 0x0 DISPLAY_IDENTIFIER Pedals_Susp_Sensors.SUSP_R_L /end MEASUREMENT
/begin MEASUREMENT Pedals_Susp_Sensors.Pedals_Susp_Sensors_Y.SUSP_R_R "" FLOAT64_IEEE Pedals_Susp_Sensors_CM_double 0 0 -1.7e+308 1.7e+308 ECU_ADDRESS 0x0 DISPLAY_IDENTIFIER Pedals_Susp_Sensors.SUSP_R_R /end MEASUREMENT
/begin MEASUREMENT Racing_Mode.Racing_Mode_B.Apps_Sat_Dwn.Gain "" FLOAT64_IEEE Racing_Mode_CM_double 0 0 -1.7e+308 1.7e+308 ECU_ADDRESS 0x0 DISPLAY_IDENTIFIER Racing_Mode.Custom_Dash__11_.Apps_Sat_Dwn.Gain.Gain /end MEASUREMENT
/begin MEASUREMENT Racing_Mode.Racing_Mode_B.Apps_Sat_Up.Gain "" FLOAT64_IEEE Racing_Mode_CM_double 0 0 -1.7e+308 1.7e+308 ECU_ADDRESS 0x0 DISPLAY_IDENTIFIER Racing_Mode.Custom_Dash__11_.Apps_Sat_Up.Gain.Gain /end MEASUREMENT
/begin MEASUREMENT Racing_Mode.Racing_Mode_B.CKF_Initial.Gain "" FLOAT64_IEEE Racing_Mode_CM_double 0 0 -1.7e+308 1.7e+308 ECU_ADDRESS 0x0 DISPLAY_IDENTIFIER Racing_Mode.Custom_Dash__11_.CKF_Initial.Gain.Gain /end MEASUREMENT
/begin MEASUREMENT Racing_Mode.Racing_Mode_B.Cte_CKF.Gain "" FLOAT64_IEEE Racing_Mode_CM_double 0 0 -1.7e+308 1.7e+308 ECU_ADDRESS 0x0 DISPLAY_IDENTIFIER Racing_Mode.Custom_Dash__11_.Cte_CKF.Gain.Gain /end MEASUREMENT
/begin MEASUREMENT Racing_Mode.Racing_Mode_B.Cte_SKF.Gain "" FLOAT64_IEEE Racing_Mode_CM_double 0 0 -1.7e+308 1.7e+308 ECU_ADDRESS 0x0 DISPLAY_IDENTIFIER Racing_Mode.Custom_Dash__11_.Cte_SKF.Gain.Gain /end MEASUREMENT
/begin MEASUREMENT Racing_Mode.Racing_Mode_B.K_Reduction_P.Gain "" FLOAT64_IEEE Racing_Mode_CM_double 0 0 -1.7e+308 1.7e+308 ECU_ADDRESS 0x0 DISPLAY_IDENTIFIER Racing_Mode.Custom_Dash__11_.K_Reduction_P.Gain.Gain /end MEASUREMENT
/begin MEASUREMENT Racing_Mode.Racing_Mode_B.K_Reduction_Temperature.Gain "" FLOAT64_IEEE Racing_Mode_CM_double 0 0 -1.7e+308 1.7e+308 ECU_ADDRESS 0x0 DISPLAY_IDENTIFIER Racing_Mode.Custom_Dash__11_.K_Reduction_Temperature.Gain.Gain /end MEASUREMENT
/begin MEASUREMENT Racing_Mode.Racing_Mode_B.Max_Regenerative_Torque.In1 "" FLOAT64_IEEE Racing_Mode_CM_double 0 0 -1.7e+308 1.7e+308 ECU_ADDRESS 0x0 DISPLAY_IDENTIFIER Racing_Mode.Custom_Dash__11_.Max_Regenerative_Torque.In1.In1 /end MEASUREMENT
/begin MEASUREMENT Racing_Mode.Racing_Mode_B.Merge "" FLOAT64_IEEE Racing_Mode_CM_double 0 0 -1.7e+308 1.7e+308 ECU_ADDRESS 0x0 DISPLAY_IDENTIFIER Racing_Mode.Merge.Merge ARRAY_SIZE 10 /end MEASUREMENT
/begin MEASUREMENT Racing_Mode.Racing_Mode_B.Power_Limit.In1 "" FLOAT64_IEEE Racing_Mode_CM_double 0 0 -1.7e+308 1.7e+308 ECU_ADDRESS 0x0 DISPLAY_IDENTIFIER Racing_Mode.Custom_Dash__11_.Power_Limit.In1.In1 /end MEASUREMENT
/begin MEASUREMENT Racing_Mode.Racing_Mode_B.SKF_Initial.Gain "" FLOAT64_IEEE Racing_Mode_CM_double 0 0 -1.7e+308 1.7e+308 ECU_ADDRESS 0x0 DISPLAY_IDENTIFIER Racing_Mode.Custom_Dash__11_.SKF_Initial.Gain.Gain /end MEASUREMENT
/begin MEASUREMENT Racing_Mode.Racing_Mode_U.CustomMode_Data "" FLOAT64_IEEE Racing_Mode_CM_double 0 0 -1.7e+308 1.7e+308 ECU_ADDRESS 0x0 DISPLAY_IDENTIFIER Racing_Mode.CustomMode_Data /end MEASUREMENT
/begin MEASUREMENT Racing_Mode.Racing_Mode_U.CustomMode_Identifier "" FLOAT64_IEEE Racing_Mode_CM_double 0 0 -1.7e+308 1.7e+308 ECU_ADDRESS 0x0 DISPLAY_IDENTIFIER Racing_Mode.CustomMode_Identifier /end MEASUREMENT
/begin MEASUREMENT Racing_Mode.Racing_Mode_U.RacingMode "" UBYTE Racing_Mode_CM_uint8 0 0 0.0 255.0 ECU_ADDRESS 0x0 DISPLAY_IDENTIFIER Racing_Mode.RacingMode /end MEASUREMENT
/begin MEASUREMENT Racing_Mode.Racing_Mode_Y.VDC_Apps_Sat_Down "" FLOAT64_IEEE Racing_Mode_CM_double 0 0 -1.7e+308 1.7e+308 ECU_ADDRESS 0x0 DISPLAY_IDENTIFIER Racing_Mode.VDC_Apps_Sat_Down /end MEASUREMENT
/begin MEASUREMENT Racing_Mode.Racing_Mode_Y.VDC_Apps_Sat_Up "" FLOAT64_IEEE Racing_Mode_CM_double 0 0 -1.7e+308 1.7e+308 ECU_ADDRESS 0x0 DISPLAY_IDENTIFIER Racing_Mode.VDC_Apps_Sat_Up /end MEASUREMENT
/begin MEASUREMENT Racing_Mode.Racing_Mode_Y.VDC_CKF_Initial "" FLOAT64_IEEE Racing_Mode_CM_double 0 0 -1.7e+308 1.7e+308 ECU_ADDRESS 0x0 DISPLAY_IDENTIFIER Racing_Mode.VDC_CKF_Initial /end MEASUREMENT
/begin MEASUREMENT Racing_Mode.Racing_Mode_Y.VDC_Cte_CKF "" FLOAT64_IEEE Racing_Mode_CM_double 0 0 -1.7e+308 1.7e+308 ECU_ADDRESS 0x0 DISPLAY_IDENTIFIER Racing_Mode.VDC_Cte_CKF /end MEASUREMENT
/begin MEASUREMENT Racing_Mode.Racing_Mode_Y.VDC_Cte_SKF "" FLOAT64_IEEE Racing_Mode_CM_double 0 0 -1.7e+308 1.7e+308 ECU_ADDRESS 0x0 DISPLAY_IDENTIFIER Racing_Mode.VDC_Cte_SKF /end MEASUREMENT
/begin MEASUREMENT Racing_Mode.Racing_Mode_Y.VDC_K_Reduction_P "" FLOAT64_IEEE Racing_Mode_CM_double 0 0 -1.7e+308 1.7e+308 ECU_ADDRESS 0x0 DISPLAY_IDENTIFIER Racing_Mode.VDC_K_Reduction_P /end MEASUREMENT
/begin MEASUREMENT Racing_Mode.Racing_Mode_Y.VDC_K_Reduction_Temperature "" FLOAT64_IEEE Racing_Mode_CM_double 0 0 -1.7e+308 1.7e+308 ECU_ADDRESS 0x0 DISPLAY_IDENTIFIER Racing_Mode.VDC_K_Reduction_Temperature /end MEASUREMENT
/begin MEASUREMENT Racing_Mode.Racing_Mode_Y.VDC_Max_Regenerative_Torque "" FLOAT64_IEEE Racing_Mode_CM_double 0 0 -1.7e+308 1.7e+308 ECU_ADDRESS 0x0 DISPLAY_IDENTIFIER Racing_Mode.VDC_Max_Regenerative_Torque /end MEASUREMENT
/begin MEASUREMENT Racing_Mode.Racing_Mode_Y.VDC_Power_Limit "" FLOAT64_IEEE Racing_Mode_CM_double 0 0 -1.7e+308 1.7e+308 ECU_ADDRESS 0x0 DISPLAY_IDENTIFIER Racing_Mode.VDC_Power_Limit /end MEASUREMENT
/begin MEASUREMENT Racing_Mode.Racing_Mode_Y.VDC_SKF_Initial "" FLOAT64_IEEE Racing_Mode_CM_double 0 0 -1.7e+308 1.7e+308 ECU_ADDRESS 0x0 DISPLAY_IDENTIFIER Racing_Mode.VDC_SKF_Initial /end MEASUREMENT
/begin MEASUREMENT Racing_Mode.Racing_Mode_Y.Workshop_Mode_Enable "" UBYTE Racing_Mode_CM_boolean 0 0 0 1 ECU_ADDRESS 0x0 DISPLAY_IDENTIFIER Racing_Mode.Workshop_Mode_Enable /end MEASUREMENT
/begin MEASUREMENT Synchronism.Synchronism_DW.counter "" FLOAT64_IEEE Synchronism_CM_double 0 0 -1.7e+308 1.7e+308 ECU_ADDRESS 0x0 DISPLAY_IDENTIFIER Synchronism.Counter.Data_Store_Memory.counter /end MEASUREMENT
/begin MEASUREMENT Synchronism.Synchronism_Y.Sync_CAN1 "" FLOAT64_IEEE Synchronism_CM_double 0 0 -1.7e+308 1.7e+308 ECU_ADDRESS 0x0 DISPLAY_IDENTIFIER Synchronism.Sync_CAN1 /end MEASUREMENT
/begin MEASUREMENT Synchronism.Synchronism_Y.Sync_CAN2 "" FLOAT64_IEEE Synchronism_CM_double 0 0 -1.7e+308 1.7e+308 ECU_ADDRESS 0x0 DISPLAY_IDENTIFIER Synchronism.Sync_CAN2 /end MEASUREMENT
/begin CHARACTERISTIC Car_State.Car_State_P.CompareToConstant_const "" VALUE 0x0 SCALAR_FLOAT64_IEEE 3.5e+305 Car_State_CM_double -1.7e+308 1.7e+308 DISPLAY_IDENTIFIER Car_State.CarOK_Checks.Compare_To_Constant.Constant.Value /end CHARACTERISTIC
/begin CHARACTERISTIC Car_State.Car_State_P.Constant_Value "" VALUE 0x0 SCALAR_FLOAT64_IEEE 3.5e+305 Car_State_CM_double -1.7e+308 1.7e+308 DISPLAY_IDENTIFIER Car_State.AIRS_Request.Precharge.Constant.Value /end CHARACTERISTIC
/begin CHARACTERISTIC Car_State.Car_State_P.Constant_Value_f "" VALUE 0x0 SCALAR_FLOAT64_IEEE 3.5e+305 Car_State_CM_double -1.7e+308 1.7e+308 DISPLAY_IDENTIFIER Car_State.CurrentPathDisconnection_Detection.OK_or_latch.OK.Constant.Value /end CHARACTERISTIC
/begin CHARACTERISTIC Car_State.Car_State_P.Constant_Value_fl "" VALUE 0x0 SCALAR_FLOAT64_IEEE 3.5e+305 Car_State_CM_double -1.7e+308 1.7e+308 DISPLAY_IDENTIFIER Car_State.CarOK_Checks.Compare_To_Zero2.Constant.Value /end CHARACTERISTIC
/begin CHARACTERISTIC Car_State.Car_State_P.Constant_Value_k "" VALUE 0x0 SCALAR_FLOAT64_IEEE 3.5e+305 Car_State_CM_double -1.7e+308 1.7e+308 DISPLAY_IDENTIFIER Car_State.AIRS_Request.Tancar_Airs.Constant.Value /end CHARACTERISTIC
/begin CHARACTERISTIC Car_State.Car_State_P.Constant_Value_kb "" VALUE 0x0 SCALAR_FLOAT64_IEEE 3.5e+305 Car_State_CM_double -1.7e+308 1.7e+308 DISPLAY_IDENTIFIER Car_State.CarOK_Checks.Compare_To_Zero1.Constant.Value /end CHARACTERISTIC
/begin CHARACTERISTIC Car_State.Car_State_P.DataStoreMemory_InitialValue "" VALUE 0x0 SCALAR_FLOAT64_IEEE 3.5e+305 Car_State_CM_double -1.7e+308 1.7e+308 DISPLAY_IDENTIFIER Car_State.CurrentPathDisconnection_Detection.Data_Store_Memory.InitialValue /end CHARACTERISTIC
/begin CHARACTERISTIC Car_State.Car_State_P.Gain_Gain "" VALUE 0x0 SCALAR_FLOAT64_IEEE 3.5e+305 Car_State_CM_double -1.7e+308 1.7e+308 DISPLAY_IDENTIFIER Car_State.PrechargeAssert_Conditions.Gain.Gain /end CHARACTERISTIC
/begin CHARACTERISTIC Car_State.Car_State_P.IfDCBUSnotbits_Gain "" VALUE 0x0 SCALAR_FLOAT64_IEEE 3.5e+305 Car_State_CM_double -1.7e+308 1.7e+308 DISPLAY_IDENTIFIER Car_State.Precharge_Info.If_DC_BUS_not_bits.Gain /end CHARACTERISTIC
/begin CHARACTERISTIC Car_State.Car_State_P.Merge_InitialOutput "" VALUE 0x0 SCALAR_FLOAT64_IEEE 3.5e+305 Car_State_CM_double -1.7e+308 1.7e+308 DISPLAY_IDENTIFIER Car_State.AIRS_Request.Merge.InitialOutput /end CHARACTERISTIC
/begin CHARACTERISTIC Car_State.Car_State_P.Saturation_LowerSat "" VALUE 0x0 SCALAR_FLOAT64_IEEE 3.5e+305 Car_State_CM_double -1.7e+308 1.7e+308 DISPLAY_IDENTIFIER Car_State.Precharge_Info.Saturation.LowerLimit /end CHARACTERISTIC
/begin CHARACTERISTIC Car_State.Car_State_P.Saturation_UpperSat "" VALUE 0x0 SCALAR_FLOAT64_IEEE 3.5e+305 Car_State_CM_double -1.7e+308 1.7e+308 DISPLAY_IDENTIFIER Car_State.Precharge_Info.Saturation.UpperLimit /end CHARACTERISTIC
/begin CHARACTERISTIC Accel_Data.Accel_Data_P.CycleTime_Gain "" VALUE 0x0 SCALAR_FLOAT64_IEEE 3.5e+305 Accel_Data_CM_double -1.7e+308 1.7e+308 DISPLAY_IDENTIFIER Accel_Data.Gyro_Data_Conversion_F_Z.Cycle_Time.Gain /end CHARACTERISTIC
/begin CHARACTERISTIC Accel_Data.Accel_Data_P.CycleTime_Gain_h "" VALUE 0x0 SCALAR_FLOAT64_IEEE 3.5e+305 Accel_Data_CM_double -1.7e+308 1.7e+308 DISPLAY_IDENTIFIER Accel_Data.Gyro_Data_Conversion_R_Z.Cycle_Time.Gain /end CHARACTERISTIC
/begin CHARACTERISTIC Accel_Data.Accel_Data_P.DataStoreMemory_InitialValue "" VALUE 0x0 SCALAR_FLOAT64_IEEE 3.5e+305 Accel_Data_CM_double -1.7e+308 1.7e+308 DISPLAY_IDENTIFIER Accel_Data.Gyro_Data_Conversion_F_Z.Data_Store_Memory.InitialValue /end CHARACTERISTIC
/begin CHARACTERISTIC Accel_Data.Accel_Data_P.DataStoreMemory_InitialValue_m "" VALUE 0x0 SCALAR_FLOAT64_IEEE 3.5e+305 Accel_Data_CM_double -1.7e+308 1.7e+308 DISPLAY_IDENTIFIER Accel_Data.Gyro_Data_Conversion_R_Z.Data_Store_Memory.InitialValue /end CHARACTERISTIC
/begin CHARACTERISTIC Accel_Data.Accel_Data_P.ExperimentalOffset_Value "" VALUE 0x0 SCALAR_FLOAT64_IEEE 3.5e+305 Accel_Data_CM_double -1.7e+308 1.7e+308 DISPLAY_IDENTIFIER Accel_Data.Gyro_Data_Conversion_F_Z.Experimental_Offset.Value /end CHARACTERISTIC
/begin CHARACTERISTIC Accel_Data.Accel_Data_P.ExperimentalOffset_Value_e "" VALUE 0x0 SCALAR_FLOAT64_IEEE 3.5e+305 Accel_Data_CM_double -1.7e+308 1.7e+308 DISPLAY_IDENTIFIER Accel_Data.Gyro_Data_Conversion_R_Z.Experimental_Offset.Value /end CHARACTERISTIC
/begin CHARACTERISTIC Accel_Data.Accel_Data_P.Gain2_Gain "" VALUE 0x0 SCALAR_FLOAT64_IEEE 3.5e+305 Accel_Data_CM_double -1.7e+308 1.7e+308 DISPLAY_IDENTIFIER Accel_Data.Gain2.Gain /end CHARACTERISTIC
/begin CHARACTERISTIC Accel_Data.Accel_Data_P.Gain4_Gain "" VALUE 0x0 SCALAR_FLOAT64_IEEE 3.5e+305 Accel_Data_CM_double -1.7e+308 1.7e+308 DISPLAY_IDENTIFIER Accel_Data.Gain4.Gain /end CHARACTERISTIC
/begin CHARACTERISTIC Accel_Data.Accel_Data_P.RpsLSB_Value "" VALUE 0x0 SCALAR_FLOAT64_IEEE 3.5e+305 Accel_Data_CM_double -1.7e+308 1.7e+308 DISPLAY_IDENTIFIER Accel_Data.Gyro_Data_Conversion_R_Z.Rps__LSB.Value /end CHARACTERISTIC
/begin CHARACTERISTIC Accel_Data.Accel_Data_P.sbit_Value "" VALUE 0x0 SCALAR_FLOAT64_IEEE 3.5e+305 Accel_Data_CM_double -1.7e+308 1.7e+308 DISPLAY_IDENTIFIER Accel_Data.Gyro_Data_Conversion_F_Z.___s___bit.Value /end CHARACTERISTIC
/begin CHARACTERISTIC Disconnections.Disconnections_P.Constant_Value "" VALUE 0x0 SCALAR_FLOAT64_IEEE 3.5e+305 Disconnections_CM_double -1.7e+308 1.7e+308 DISPLAY_IDENTIFIER Disconnections.Subsystem.VDC_2018_Complete.Constant.Value /end CHARACTERISTIC
/begin CHARACTERISTIC Disconnections.Disconnections_P.Constant_Value_c "" VALUE 0x0 SCALAR_FLOAT64_IEEE 3.5e+305 Disconnections_CM_double -1.7e+308 1.7e+308 DISPLAY_IDENTIFIER Disconnections.Counter.Constant.Value /end CHARACTERISTIC
/begin CHARACTERISTIC Disconnections.Disconnections_P.Constant_Value_d "" VALUE 0x0 SCALAR_FLOAT64_IEEE 3.5e+305 Disconnections_CM_double -1.7e+308 1.7e+308 DISPLAY_IDENTIFIER Disconnections.Signal_Disconnections.Compare_To_Zero2.Constant.Value /end CHARACTERISTIC
/begin CHARACTERISTIC Disconnections.Disconnections_P.Constant_Value_e "" VALUE 0x0 SCALAR_FLOAT64_IEEE 3.5e+305 Disconnections_CM_double -1.7e+308 1.7e+308 DISPLAY_IDENTIFIER Disconnections.Subsystem.Rigid_Axle.Constant.Value /end CHARACTERISTIC
/begin CHARACTERISTIC Disconnections.Disconnections_P.Constant_Value_h "" VALUE 0x0 SCALAR_FLOAT64_IEEE 3.5e+305 Disconnections_CM_double -1.7e+308 1.7e+308 DISPLAY_IDENTIFIER Disconnections.Subsystem.VDC_without_Longitudinal.Constant.Value /end CHARACTERISTIC
/begin CHARACTERISTIC Disconnections.Disconnections_P.Constant_Value_i "" VALUE 0x0 SCALAR_FLOAT64_IEEE 3.5e+305 Disconnections_CM_double -1.7e+308 1.7e+308 DISPLAY_IDENTIFIER Disconnections.Constant.Value /end CHARACTERISTIC
/begin CHARACTERISTIC Disconnections.Disconnections_P.Constant_Value_ic "" VALUE 0x0 SCALAR_FLOAT64_IEEE 3.5e+305 Disconnections_CM_double -1.7e+308 1.7e+308 DISPLAY_IDENTIFIER Disconnections.Signal_Disconnections.Compare_To_Zero.Constant.Value /end CHARACTERISTIC
/begin CHARACTERISTIC Disconnections.Disconnections_P.Constant_Value_j "" VALUE 0x0 SCALAR_FLOAT64_IEEE 3.5e+305 Disconnections_CM_double -1.7e+308 1.7e+308 DISPLAY_IDENTIFIER Disconnections.Signal_Disconnections.Compare_To_Zero3.Constant.Value /end CHARACTERISTIC
/begin CHARACTERISTIC Disconnections.Disconnections_P.Constant_Value_l "" VALUE 0x0 SCALAR_FLOAT64_IEEE 3.5e+305 Disconnections_CM_double -1.7e+308 1.7e+308 DISPLAY_IDENTIFIER Disconnections.Signal_Disconnections.Compare_To_Zero1.Constant.Value /end CHARACTERISTIC
/begin CHARACTERISTIC Disconnections.Disconnections_P.Constant_Value_m "" VALUE 0x0 SCALAR_FLOAT64_IEEE 3.5e+305 Disconnections_CM_double -1.7e+308 1.7e+308 DISPLAY_IDENTIFIER Disconnections.Subsystem.Steering_TV_2017_without_TC.Constant.Value /end CHARACTERISTIC
/begin CHARACTERISTIC Disconnections.Disconnections_P.Constant_Value_o "" VALUE 0x0 SCALAR_FLOAT64_IEEE 3.5e+305 Disconnections_CM_double -1.7e+308 1.7e+308 DISPLAY_IDENTIFIER Disconnections.Signal_Disconnections.Compare_To_Zero4.Constant.Value /end CHARACTERISTIC
/begin CHARACTERISTIC Disconnections.Disconnections_P.DataStoreMemory1_InitialValue "" VALUE 0x0 SCALAR_FLOAT64_IEEE 3.5e+305 Disconnections_CM_double -1.7e+308 1.7e+308 DISPLAY_IDENTIFIER Disconnections.Pedal_Box_Disconnections__Noise_.Life_check3.Data_Store_Memory1.InitialValue /end CHARACTERISTIC
/begin CHARACTERISTIC Disconnections.Disconnections_P.DataStoreMemory1_InitialValue_b "" VALUE 0x0 SCALAR_FLOAT64_IEEE 3.5e+305 Disconnections_CM_double -1.7e+308 1.7e+308 DISPLAY_IDENTIFIER Disconnections.Pedal_Box_Disconnections__Noise_.Life_check1.Data_Store_Memory1.InitialValue /end CHARACTERISTIC
/begin CHARACTERISTIC Disconnections.Disconnections_P.DataStoreMemory1_InitialValue_c "" VALUE 0x0 SCALAR_FLOAT64_IEEE 3.5e+305 Disconnections_CM_double -1.7e+308 1.7e+308 DISPLAY_IDENTIFIER Disconnections.Gyro_Disconnections__Noise_.Life_check8.Data_Store_Memory1.InitialValue /end CHARACTERISTIC
/begin CHARACTERISTIC Disconnections.Disconnections_P.DataStoreMemory1_InitialValue_d "" VALUE 0x0 SCALAR_FLOAT64_IEEE 3.5e+305 Disconnections_CM_double -1.7e+308 1.7e+308 DISPLAY_IDENTIFIER Disconnections.Pedal_Box_Disconnections__Noise_.Life_check2.Data_Store_Memory1.InitialValue /end CHARACTERISTIC
/begin CHARACTERISTIC Disconnections.Disconnections_P.DataStoreMemory1_InitialValue_m "" VALUE 0x0 SCALAR_FLOAT64_IEEE 3.5e+305 Disconnections_CM_double -1.7e+308 1.7e+308 DISPLAY_IDENTIFIER Disconnections.Gyro_Disconnections__Noise_.Life_check6.Data_Store_Memory1.InitialValue /end CHARACTERISTIC
/begin CHARACTERISTIC Disconnections.Disconnections_P.DataStoreMemory_InitialValue "" VALUE 0x0 SCALAR_FLOAT64_IEEE 3.5e+305 Disconnections_CM_double -1.7e+308 1.7e+308 DISPLAY_IDENTIFIER Disconnections.ECU_Disconections.LifeCheck_BMS.Data_Store_Memory.InitialValue /end CHARACTERISTIC
/begin CHARACTERISTIC Disconnections.Disconnections_P.DataStoreMemory_InitialValue_b "" VALUE 0x0 SCALAR_FLOAT64_IEEE 3.5e+305 Disconnections_CM_double -1.7e+308 1.7e+308 DISPLAY_IDENTIFIER Disconnections.ECU_Disconections.LifeCheck_ADCAN.Data_Store_Memory.InitialValue /end CHARACTERISTIC
/begin CHARACTERISTIC Disconnections.Disconnections_P.DataStoreMemory_InitialValue_ba "" VALUE 0x0 SCALAR_FLOAT64_IEEE 3.5e+305 Disconnections_CM_double -1.7e+308 1.7e+308 DISPLAY_IDENTIFIER Disconnections.Gyro_Disconnections__Noise_.Life_check8.Data_Store_Memory.InitialValue /end CHARACTERISTIC
/begin CHARACTERISTIC Disconnections.Disconnections_P.DataStoreMemory_InitialValue_c "" VALUE 0x0 SCALAR_FLOAT64_IEEE 3.5e+305 Disconnections_CM_double -1.7e+308 1.7e+308 DISPLAY_IDENTIFIER Disconnections.Pedal_Box_Disconnections__Noise_.Life_check3.Data_Store_Memory.InitialValue /end CHARACTERISTIC
/begin CHARACTERISTIC Disconnections.Disconnections_P.DataStoreMemory_InitialValue_d "" VALUE 0x0 SCALAR_FLOAT64_IEEE 3.5e+305 Disconnections_CM_double -1.7e+308 1.7e+308 DISPLAY_IDENTIFIER Disconnections.ECU_Disconections.LifeCheck_AccFront.Data_Store_Memory.InitialValue /end CHARACTERISTIC
/begin CHARACTERISTIC Disconnections.Disconnections_P.DataStoreMemory_InitialValue_f "" VALUE 0x0 SCALAR_FLOAT64_IEEE 3.5e+305 Disconnections_CM_double -1.7e+308 1.7e+308 DISPLAY_IDENTIFIER Disconnections.ECU_Disconections.LifeCheck_AccRear.Data_Store_Memory.InitialValue /end CHARACTERISTIC
/begin CHARACTERISTIC Disconnections.Disconnections_P.DataStoreMemory_InitialValue_j "" VALUE 0x0 SCALAR_FLOAT64_IEEE 3.5e+305 Disconnections_CM_double -1.7e+308 1.7e+308 DISPLAY_IDENTIFIER Disconnections.Counter.Data_Store_Memory.InitialValue /end CHARACTERISTIC
/begin CHARACTERISTIC Disconnections.Disconnections_P.DataStoreMemory_InitialValue_jc "" VALUE 0x0 SCALAR_FLOAT64_IEEE 3.5e+305 Disconnections_CM_double -1.7e+308 1.7e+308 DISPLAY_IDENTIFIER Disconnections.Pedal_Box_Disconnections__Noise_.Life_check1.Data_Store_Memory.InitialValue /end CHARACTERISTIC
/begin CHARACTERISTIC Disconnections.Disconnections_P.DataStoreMemory_InitialValue_k "" VALUE 0x0 SCALAR_FLOAT64_IEEE 3.5e+305 Disconnections_CM_double -1.7e+308 1.7e+308 DISPLAY_IDENTIFIER Disconnections.ECU_Disconections.LifeCheck_Dash.Data_Store_Memory.InitialValue /end CHARACTERISTIC
/begin CHARACTERISTIC Disconnections.Disconnections_P.DataStoreMemory_InitialValue_kg "" VALUE 0x0 SCALAR_FLOAT64_IEEE 3.5e+305 Disconnections_CM_double -1.7e+308 1.7e+308 DISPLAY_IDENTIFIER Disconnections.Pedal_Box_Disconnections__Noise_.Life_check2.Data_Store_Memory.InitialValue /end CHARACTERISTIC
/begin CHARACTERISTIC Disconnections.Disconnections_P.DataStoreMemory_InitialValue_ks "" VALUE 0x0 SCALAR_FLOAT64_IEEE 3.5e+305 Disconnections_CM_double -1.7e+308 1.7e+308 DISPLAY_IDENTIFIER Disconnections.ECU_Disconections.Life_check4.Data_Store_Memory.InitialValue /end CHARACTERISTIC
/begin CHARACTERISTIC Disconnections.Disconnections_P.DataStoreMemory_InitialValue_m "" VALUE 0x0 SCALAR_FLOAT64_IEEE 3.5e+305 Disconnections_CM_double -1.7e+308 1.7e+308 DISPLAY_IDENTIFIER Disconnections.Gyro_Disconnections__Noise_.Life_check6.Data_Store_Memory.InitialValue /end CHARACTERISTIC
/begin CHARACTERISTIC Disconnections.Disconnections_P.DataStoreMemory_InitialValue_o "" VALUE 0x0 SCALAR_FLOAT64_IEEE 3.5e+305 Disconnections_CM_double -1.7e+308 1.7e+308 DISPLAY_IDENTIFIER Disconnections.ECU_Disconections.LifeCheck_Shutdown.Data_Store_Memory.InitialValue /end CHARACTERISTIC
/begin CHARACTERISTIC Disconnections.Disconnections_P.Merge_InitialOutput "" VALUE 0x0 SCALAR_FLOAT64_IEEE 3.5e+305 Disconnections_CM_double -1.7e+308 1.7e+308 DISPLAY_IDENTIFIER Disconnections.ECU_Disconections.LifeCheck_BMS.Merge.InitialOutput /end CHARACTERISTIC
/begin CHARACTERISTIC Disconnections.Disconnections_P.Merge_InitialOutput_a "" VALUE 0x0 SCALAR_FLOAT64_IEEE 3.5e+305 Disconnections_CM_double -1.7e+308 1.7e+308 DISPLAY_IDENTIFIER Disconnections.ECU_Disconections.LifeCheck_ADCAN.Merge.InitialOutput /end CHARACTERISTIC
/begin CHARACTERISTIC Disconnections.Disconnections_P.Merge_InitialOutput_b "" VALUE 0x0 SCALAR_FLOAT64_IEEE 3.5e+305 Disconnections_CM_double -1.7e+308 1.7e+308 DISPLAY_IDENTIFIER Disconnections.ECU_Disconections.LifeCheck_Dash.Merge.InitialOutput /end CHARACTERISTIC
/begin CHARACTERISTIC Disconnections.Disconnections_P.Merge_InitialOutput_l "" VALUE 0x0 SCALAR_FLOAT64_IEEE 3.5e+305 Disconnections_CM_double -1.7e+308 1.7e+308 DISPLAY_IDENTIFIER Disconnections.ECU_Disconections.LifeCheck_Shutdown.Merge.InitialOutput /end CHARACTERISTIC
/begin CHARACTERISTIC Disconnections.Disconnections_P.Merge_InitialOutput_m "" VALUE 0x0 SCALAR_FLOAT64_IEEE 3.5e+305 Disconnections_CM_double -1.7e+308 1.7e+308 DISPLAY_IDENTIFIER Disconnections.ECU_Disconections.LifeCheck_AccFront.Merge.InitialOutput /end CHARACTERISTIC
/begin CHARACTERISTIC Disconnections.Disconnections_P.Merge_InitialOutput_o "" VALUE 0x0 SCALAR_FLOAT64_IEEE 3.5e+305 Disconnections_CM_double -1.7e+308 1.7e+308 DISPLAY_IDENTIFIER Disconnections.ECU_Disconections.Life_check4.Merge.InitialOutput /end CHARACTERISTIC
/begin CHARACTERISTIC Disconnections.Disconnections_P.Merge_InitialOutput_p "" VALUE 0x0 SCALAR_FLOAT64_IEEE 3.5e+305 Disconnections_CM_double -1.7e+308 1.7e+308 DISPLAY_IDENTIFIER Disconnections.ECU_Disconections.LifeCheck_AccRear.Merge.InitialOutput /end CHARACTERISTIC
/begin CHARACTERISTIC Inverters_Action.Inverters_Action_P.Constant_Value "" VALUE 0x0 SCALAR_UBYTE 255.0 Inverters_Action_CM_uint8 0.0 255.0 DISPLAY_IDENTIFIER Inverters_Action.Subsystem10.Unsubscribe__Subscribe.Constant.Value /end CHARACTERISTIC
/begin CHARACTERISTIC Inverters_Action.Inverters_Action_P.Constant_Value_m "" VALUE 0x0 SCALAR_UBYTE 255.0 Inverters_Action_CM_uint8 0.0 255.0 DISPLAY_IDENTIFIER Inverters_Action.Subsystem9.Unsubscribe__Subscribe.Constant.Value /end CHARACTERISTIC
/begin CHARACTERISTIC Inverters_Action.Inverters_Action_P.DataStoreMemory1_InitialValue "" VALUE 0x0 SCALAR_FLOAT64_IEEE 3.5e+305 Inverters_Action_CM_double -1.7e+308 1.7e+308 DISPLAY_IDENTIFIER Inverters_Action.Subsystem10.Data_Store_Memory1.InitialValue /end CHARACTERISTIC
/begin CHARACTERISTIC Inverters_Action.Inverters_Action_P.DataStoreMemory1_InitialValue_m "" VALUE 0x0 SCALAR_FLOAT64_IEEE 3.5e+305 Inverters_Action_CM_double -1.7e+308 1.7e+308 DISPLAY_IDENTIFIER Inverters_Action.Subsystem9.Data_Store_Memory1.InitialValue /end CHARACTERISTIC
/begin CHARACTERISTIC Inverters_Action.Inverters_Action_P.DataStoreMemory2_InitialValue "" VALUE 0x0 SCALAR_FLOAT64_IEEE 3.5e+305 Inverters_Action_CM_double -1.7e+308 1.7e+308 DISPLAY_IDENTIFIER Inverters_Action.Subsystem10.Data_Store_Memory2.InitialValue /end CHARACTERISTIC
/begin CHARACTERISTIC Inverters_Action.Inverters_Action_P.DataStoreMemory2_InitialValue_c "" VALUE 0x0 SCALAR_FLOAT64_IEEE 3.5e+305 Inverters_Action_CM_double -1.7e+308 1.7e+308 DISPLAY_IDENTIFIER Inverters_Action.Subsystem9.Data_Store_Memory2.InitialValue /end CHARACTERISTIC
/begin CHARACTERISTIC Inverters_Action.Inverters_Action_P.Delay_DelayLength "" VALUE 0x0 SCALAR_ULONG 4294967295.0 Inverters_Action_CM_uint32 0.0 4294967295.0 DISPLAY_IDENTIFIER Inverters_Action.Subsystem10.edge_detection.Delay.DelayLength /end CHARACTERISTIC
/begin CHARACTERISTIC Inverters_Action.Inverters_Action_P.Delay_DelayLength_h "" VALUE 0x0 SCALAR_ULONG 4294967295.0 Inverters_Action_CM_uint32 0.0 4294967295.0 DISPLAY_IDENTIFIER Inverters_Action.Subsystem9.edge_detection.Delay.DelayLength /end CHARACTERISTIC
/begin CHARACTERISTIC Inverters_Action.Inverters_Action_P.Delay_InitialCondition "" VALUE 0x0 SCALAR_FLOAT64_IEEE 3.5e+305 Inverters_Action_CM_double -1.7e+308 1.7e+308 DISPLAY_IDENTIFIER Inverters_Action.Subsystem10.edge_detection.Delay.InitialCondition /end CHARACTERISTIC
/begin CHARACTERISTIC Inverters_Action.Inverters_Action_P.Delay_InitialCondition_o "" VALUE 0x0 SCALAR_FLOAT64_IEEE 3.5e+305 Inverters_Action_CM_double -1.7e+308 1.7e+308 DISPLAY_IDENTIFIER Inverters_Action.Subsystem9.edge_detection.Delay.InitialCondition /end CHARACTERISTIC
/begin CHARACTERISTIC Inverters_Action.Inverters_Action_P.Merge_InitialOutput "" VALUE 0x0 SCALAR_UBYTE 1.0 Inverters_Action_CM_boolean 0 1 DISPLAY_IDENTIFIER Inverters_Action.Merge.InitialOutput /end CHARACTERISTIC
/begin CHARACTERISTIC Inverters_Action.Inverters_Action_P.TimeInterval_Value "" VALUE 0x0 SCALAR_UBYTE 255.0 Inverters_Action_CM_uint8 0.0 255.0 DISPLAY_IDENTIFIER Inverters_Action.Subsystem10.Unsubscribe__Subscribe.Subscribe.Time_Interval.Value /end CHARACTERISTIC
/begin CHARACTERISTIC Inverters_Action.Inverters_Action_P.TimeInterval_Value_d "" VALUE 0x0 SCALAR_UBYTE 255.0 Inverters_Action_CM_uint8 0.0 255.0 DISPLAY_IDENTIFIER Inverters_Action.Subsystem9.Unsubscribe__Subscribe.Subscribe.Time_Interval.Value /end CHARACTERISTIC
/begin CHARACTERISTIC Inverters_Action.Inverters_Action_P._Value "" VALUE 0x0 SCALAR_UBYTE 1.0 Inverters_Action_CM_boolean 0 1 DISPLAY_IDENTIFIER Inverters_Action.Subsystem10.Unsubscribe__Subscribe.Subscribe._.Value /end CHARACTERISTIC
/begin CHARACTERISTIC Inverters_Action.Inverters_Action_P.subscribed_InitialOutput "" VALUE 0x0 SCALAR_UBYTE 1.0 Inverters_Action_CM_boolean 0 1 DISPLAY_IDENTIFIER Inverters_Action.Subsystem10.Unsubscribe__Subscribe.subscribed_.InitialOutput /end CHARACTERISTIC
/begin CHARACTERISTIC Inverters_Action.Inverters_Action_P.subscribed_InitialOutput_k "" VALUE 0x0 SCALAR_UBYTE 1.0 Inverters_Action_CM_boolean 0 1 DISPLAY_IDENTIFIER Inverters_Action.Subsystem9.Unsubscribe__Subscribe.subscribed_.InitialOutput /end CHARACTERISTIC
/begin CHARACTERISTIC Inverters_Action.Inverters_Action_P.u_Value "" VALUE 0x0 SCALAR_UBYTE 1.0 Inverters_Action_CM_boolean 0 1 DISPLAY_IDENTIFIER Inverters_Action.Subsystem9.Unsubscribe__Subscribe.Subscribe.1.Value /end CHARACTERISTIC
/begin CHARACTERISTIC Inverters_Data.Inverters_Data_P.A1_Value "" VALUE 0x0 SCALAR_FLOAT64_IEEE 3.5e+305 Inverters_Data_CM_double -1.7e+308 1.7e+308 DISPLAY_IDENTIFIER Inverters_Data.Subsystem4.A1.Value /end CHARACTERISTIC
/begin CHARACTERISTIC Inverters_Data.Inverters_Data_P.A1_Value_e "" VALUE 0x0 SCALAR_FLOAT64_IEEE 3.5e+305 Inverters_Data_CM_double -1.7e+308 1.7e+308 DISPLAY_IDENTIFIER Inverters_Data.Subsystem5.A1.Value /end CHARACTERISTIC
/begin CHARACTERISTIC Inverters_Data.Inverters_Data_P.B1_Value "" VALUE 0x0 SCALAR_FLOAT64_IEEE 3.5e+305 Inverters_Data_CM_double -1.7e+308 1.7e+308 DISPLAY_IDENTIFIER Inverters_Data.Subsystem4.B1.Value /end CHARACTERISTIC
/begin CHARACTERISTIC Inverters_Data.Inverters_Data_P.B1_Value_i "" VALUE 0x0 SCALAR_FLOAT64_IEEE 3.5e+305 Inverters_Data_CM_double -1.7e+308 1.7e+308 DISPLAY_IDENTIFIER Inverters_Data.Subsystem5.B1.Value /end CHARACTERISTIC
/begin CHARACTERISTIC Inverters_Data.Inverters_Data_P.Bitct_Value "" VALUE 0x0 SCALAR_FLOAT64_IEEE 3.5e+305 Inverters_Data_CM_double -1.7e+308 1.7e+308 DISPLAY_IDENTIFIER Inverters_Data.IL1.Bit_ct.Value /end CHARACTERISTIC
/begin CHARACTERISTIC Inverters_Data.Inverters_Data_P.Bitct_Value_h "" VALUE 0x0 SCALAR_FLOAT64_IEEE 3.5e+305 Inverters_Data_CM_double -1.7e+308 1.7e+308 DISPLAY_IDENTIFIER Inverters_Data.IL.Bit_ct.Value /end CHARACTERISTIC
/begin CHARACTERISTIC Inverters_Data.Inverters_Data_P.C1_Value "" VALUE 0x0 SCALAR_FLOAT64_IEEE 3.5e+305 Inverters_Data_CM_double -1.7e+308 1.7e+308 DISPLAY_IDENTIFIER Inverters_Data.Subsystem4.C1.Value /end CHARACTERISTIC
/begin CHARACTERISTIC Inverters_Data.Inverters_Data_P.C1_Value_d "" VALUE 0x0 SCALAR_FLOAT64_IEEE 3.5e+305 Inverters_Data_CM_double -1.7e+308 1.7e+308 DISPLAY_IDENTIFIER Inverters_Data.Subsystem6.C1.Value /end CHARACTERISTIC
/begin CHARACTERISTIC Inverters_Data.Inverters_Data_P.C1_Value_n "" VALUE 0x0 SCALAR_FLOAT64_IEEE 3.5e+305 Inverters_Data_CM_double -1.7e+308 1.7e+308 DISPLAY_IDENTIFIER Inverters_Data.Subsystem5.C1.Value /end CHARACTERISTIC
/begin CHARACTERISTIC Inverters_Data.Inverters_Data_P.C1_Value_n0 "" VALUE 0x0 SCALAR_FLOAT64_IEEE 3.5e+305 Inverters_Data_CM_double -1.7e+308 1.7e+308 DISPLAY_IDENTIFIER Inverters_Data.Subsystem7.C1.Value /end CHARACTERISTIC
/begin CHARACTERISTIC Inverters_Data.Inverters_Data_P.Constant1_Value "" VALUE 0x0 SCALAR_FLOAT64_IEEE 3.5e+305 Inverters_Data_CM_double -1.7e+308 1.7e+308 DISPLAY_IDENTIFIER Inverters_Data.Subsystem4.Constant1.Value /end CHARACTERISTIC
/begin CHARACTERISTIC Inverters_Data.Inverters_Data_P.Constant1_Value_e "" VALUE 0x0 SCALAR_FLOAT64_IEEE 3.5e+305 Inverters_Data_CM_double -1.7e+308 1.7e+308 DISPLAY_IDENTIFIER Inverters_Data.Subsystem5.Constant1.Value /end CHARACTERISTIC
/begin CHARACTERISTIC Inverters_Data.Inverters_Data_P.D1_Value "" VALUE 0x0 SCALAR_FLOAT64_IEEE 3.5e+305 Inverters_Data_CM_double -1.7e+308 1.7e+308 DISPLAY_IDENTIFIER Inverters_Data.Subsystem4.D1.Value /end CHARACTERISTIC
/begin CHARACTERISTIC Inverters_Data.Inverters_Data_P.D1_Value_d "" VALUE 0x0 SCALAR_FLOAT64_IEEE 3.5e+305 Inverters_Data_CM_double -1.7e+308 1.7e+308 DISPLAY_IDENTIFIER Inverters_Data.Subsystem6.D1.Value /end CHARACTERISTIC
/begin CHARACTERISTIC Inverters_Data.Inverters_Data_P.D1_Value_f "" VALUE 0x0 SCALAR_FLOAT64_IEEE 3.5e+305 Inverters_Data_CM_double -1.7e+308 1.7e+308 DISPLAY_IDENTIFIER Inverters_Data.Subsystem5.D1.Value /end CHARACTERISTIC
/begin CHARACTERISTIC Inverters_Data.Inverters_Data_P.D1_Value_j "" VALUE 0x0 SCALAR_FLOAT64_IEEE 3.5e+305 Inverters_Data_CM_double -1.7e+308 1.7e+308 DISPLAY_IDENTIFIER Inverters_Data.Subsystem7.D1.Value /end CHARACTERISTIC
/begin CHARACTERISTIC Inverters_Data.Inverters_Data_P.Diameterm_Gain "" VALUE 0x0 SCALAR_FLOAT64_IEEE 3.5e+305 Inverters_Data_CM_double -1.7e+308 1.7e+308 DISPLAY_IDENTIFIER Inverters_Data.Subsystem2.Wheel.Diameter_[m].Gain /end CHARACTERISTIC
/begin CHARACTERISTIC Inverters_Data.Inverters_Data_P.Diameterm_Gain_p "" VALUE 0x0 SCALAR_FLOAT64_IEEE 3.5e+305 Inverters_Data_CM_double -1.7e+308 1.7e+308 DISPLAY_IDENTIFIER Inverters_Data.Subsystem1.Wheel.Diameter_[m].Gain /end CHARACTERISTIC
/begin CHARACTERISTIC Inverters_Data.Inverters_Data_P.Gain_Gain "" VALUE 0x0 SCALAR_FLOAT64_IEEE 3.5e+305 Inverters_Data_CM_double -1.7e+308 1.7e+308 DISPLAY_IDENTIFIER Inverters_Data.Subsystem2.Transmission.Gain.Gain /end CHARACTERISTIC
/begin CHARACTERISTIC Inverters_Data.Inverters_Data_P.Gain_Gain_a "" VALUE 0x0 SCALAR_FLOAT64_IEEE 3.5e+305 Inverters_Data_CM_double -1.7e+308 1.7e+308 DISPLAY_IDENTIFIER Inverters_Data.Subsystem1.Transmission.Gain.Gain /end CHARACTERISTIC
/begin CHARACTERISTIC Inverters_Data.Inverters_Data_P.Gain_Gain_e "" VALUE 0x0 SCALAR_FLOAT64_IEEE 3.5e+305 Inverters_Data_CM_double -1.7e+308 1.7e+308 DISPLAY_IDENTIFIER Inverters_Data.Subsystem.Gain.Gain /end CHARACTERISTIC
/begin CHARACTERISTIC Inverters_Data.Inverters_Data_P.Gain_Gain_f "" VALUE 0x0 SCALAR_FLOAT64_IEEE 3.5e+305 Inverters_Data_CM_double -1.7e+308 1.7e+308 DISPLAY_IDENTIFIER Inverters_Data.Subsystem3.Gain.Gain /end CHARACTERISTIC
/begin CHARACTERISTIC Inverters_Data.Inverters_Data_P.Gain_Gain_m "" VALUE 0x0 SCALAR_FLOAT64_IEEE 3.5e+305 Inverters_Data_CM_double -1.7e+308 1.7e+308 DISPLAY_IDENTIFIER Inverters_Data.Average.Gain.Gain /end CHARACTERISTIC
/begin CHARACTERISTIC Inverters_Data.Inverters_Data_P.MaxRPM_Value "" VALUE 0x0 SCALAR_FLOAT64_IEEE 3.5e+305 Inverters_Data_CM_double -1.7e+308 1.7e+308 DISPLAY_IDENTIFIER Inverters_Data.IL1.Max_RPM.Value /end CHARACTERISTIC
/begin CHARACTERISTIC Inverters_Data.Inverters_Data_P.MaxRPM_Value_m "" VALUE 0x0 SCALAR_FLOAT64_IEEE 3.5e+305 Inverters_Data_CM_double -1.7e+308 1.7e+308 DISPLAY_IDENTIFIER Inverters_Data.IL.Max_RPM.Value /end CHARACTERISTIC
/begin CHARACTERISTIC Inverters_Data.Inverters_Data_P.conversionratio1_Gain "" VALUE 0x0 SCALAR_FLOAT64_IEEE 3.5e+305 Inverters_Data_CM_double -1.7e+308 1.7e+308 DISPLAY_IDENTIFIER Inverters_Data.IL2.conversion_ratio1.Gain /end CHARACTERISTIC
/begin CHARACTERISTIC Inverters_Data.Inverters_Data_P.conversionratio_Gain "" VALUE 0x0 SCALAR_FLOAT64_IEEE 3.5e+305 Inverters_Data_CM_double -1.7e+308 1.7e+308 DISPLAY_IDENTIFIER Inverters_Data.IL_4.conversion_ratio.Gain /end CHARACTERISTIC
/begin CHARACTERISTIC Inverters_Data.Inverters_Data_P.conversionratio_Gain_c "" VALUE 0x0 SCALAR_FLOAT64_IEEE 3.5e+305 Inverters_Data_CM_double -1.7e+308 1.7e+308 DISPLAY_IDENTIFIER Inverters_Data.IL_2.conversion_ratio.Gain /end CHARACTERISTIC
/begin CHARACTERISTIC Inverters_Data.Inverters_Data_P.conversionratio_Gain_j "" VALUE 0x0 SCALAR_FLOAT64_IEEE 3.5e+305 Inverters_Data_CM_double -1.7e+308 1.7e+308 DISPLAY_IDENTIFIER Inverters_Data.IL_1.conversion_ratio.Gain /end CHARACTERISTIC
/begin CHARACTERISTIC Inverters_Data.Inverters_Data_P.conversionratio_Gain_k "" VALUE 0x0 SCALAR_FLOAT64_IEEE 3.5e+305 Inverters_Data_CM_double -1.7e+308 1.7e+308 DISPLAY_IDENTIFIER Inverters_Data.IL_3.conversion_ratio.Gain /end CHARACTERISTIC
/begin CHARACTERISTIC Inverters_Data.Inverters_Data_P.conversionratio_Gain_o "" VALUE 0x0 SCALAR_FLOAT64_IEEE 3.5e+305 Inverters_Data_CM_double -1.7e+308 1.7e+308 DISPLAY_IDENTIFIER Inverters_Data.IL_5.conversion_ratio.Gain /end CHARACTERISTIC
/begin CHARACTERISTIC Inverters_Data.Inverters_Data_P.direction_Gain "" VALUE 0x0 SCALAR_FLOAT64_IEEE 3.5e+305 Inverters_Data_CM_double -1.7e+308 1.7e+308 DISPLAY_IDENTIFIER Inverters_Data.IL1.direction.Gain /end CHARACTERISTIC
/begin CHARACTERISTIC Inverters_Data.Inverters_Data_P.direction_Gain_f "" VALUE 0x0 SCALAR_FLOAT64_IEEE 3.5e+305 Inverters_Data_CM_double -1.7e+308 1.7e+308 DISPLAY_IDENTIFIER Inverters_Data.IL.direction.Gain /end CHARACTERISTIC
/begin CHARACTERISTIC Inverters_Data.Inverters_Data_P.ratio_Gain "" VALUE 0x0 SCALAR_FLOAT64_IEEE 3.5e+305 Inverters_Data_CM_double -1.7e+308 1.7e+308 DISPLAY_IDENTIFIER Inverters_Data.Subsystem2.m__s_to_km__h.ratio.Gain /end CHARACTERISTIC
/begin CHARACTERISTIC Inverters_Data.Inverters_Data_P.ratio_Gain_k "" VALUE 0x0 SCALAR_FLOAT64_IEEE 3.5e+305 Inverters_Data_CM_double -1.7e+308 1.7e+308 DISPLAY_IDENTIFIER Inverters_Data.Subsystem1.m__s_to_km__h.ratio.Gain /end CHARACTERISTIC
/begin CHARACTERISTIC Inverters_Data.Inverters_Data_P.upi60_Gain "" VALUE 0x0 SCALAR_FLOAT64_IEEE 3.5e+305 Inverters_Data_CM_double -1.7e+308 1.7e+308 DISPLAY_IDENTIFIER Inverters_Data.Subsystem2.RPM_to_rad__s.2_pi__60.Gain /end CHARACTERISTIC
/begin CHARACTERISTIC Inverters_Data.Inverters_Data_P.upi60_Gain_i "" VALUE 0x0 SCALAR_FLOAT64_IEEE 3.5e+305 Inverters_Data_CM_double -1.7e+308 1.7e+308 DISPLAY_IDENTIFIER Inverters_Data.Subsystem1.RPM_to_rad__s.2_pi__60.Gain /end CHARACTERISTIC
/begin CHARACTERISTIC LVD_Data.LVD_Data_P.DataStoreMemory1_InitialValue "" VALUE 0x0 SCALAR_FLOAT64_IEEE 3.5e+305 LVD_Data_CM_double -1.7e+308 1.7e+308 DISPLAY_IDENTIFIER LVD_Data.Low_Pass.Data_Store_Memory1.InitialValue /end CHARACTERISTIC
/begin CHARACTERISTIC LVD_Data.LVD_Data_P.DataStoreMemory_InitialValue "" VALUE 0x0 SCALAR_FLOAT64_IEEE 3.5e+305 LVD_Data_CM_double -1.7e+308 1.7e+308 DISPLAY_IDENTIFIER LVD_Data.Low_Pass.Data_Store_Memory.InitialValue /end CHARACTERISTIC
/begin CHARACTERISTIC LVD_Data.LVD_Data_P.MaxBits2_Value "" VALUE 0x0 SCALAR_FLOAT64_IEEE 3.5e+305 LVD_Data_CM_double -1.7e+308 1.7e+308 DISPLAY_IDENTIFIER LVD_Data.MaxBits2.Value /end CHARACTERISTIC
/begin CHARACTERISTIC LVD_Data.LVD_Data_P.MaxBits_Value "" VALUE 0x0 SCALAR_FLOAT64_IEEE 3.5e+305 LVD_Data_CM_double -1.7e+308 1.7e+308 DISPLAY_IDENTIFIER LVD_Data.MaxBits.Value /end CHARACTERISTIC
/begin CHARACTERISTIC LVD_Data.LVD_Data_P.Vmax_Value "" VALUE 0x0 SCALAR_FLOAT64_IEEE 3.5e+305 LVD_Data_CM_double -1.7e+308 1.7e+308 DISPLAY_IDENTIFIER LVD_Data.Vmax.Value /end CHARACTERISTIC
/begin CHARACTERISTIC LVD_Data.LVD_Data_P.Vmin_Value "" VALUE 0x0 SCALAR_FLOAT64_IEEE 3.5e+305 LVD_Data_CM_double -1.7e+308 1.7e+308 DISPLAY_IDENTIFIER LVD_Data.Vmin.Value /end CHARACTERISTIC
/begin CHARACTERISTIC LVD_Data.LVD_Data_P.ct_Value "" VALUE 0x0 SCALAR_FLOAT64_IEEE 3.5e+305 LVD_Data_CM_double -1.7e+308 1.7e+308 DISPLAY_IDENTIFIER LVD_Data.Low_Pass.ct.Value /end CHARACTERISTIC
/begin CHARACTERISTIC LVD_Data.LVD_Data_P.exptcycletau1_Value "" VALUE 0x0 SCALAR_FLOAT64_IEEE 3.5e+305 LVD_Data_CM_double -1.7e+308 1.7e+308 DISPLAY_IDENTIFIER LVD_Data.Low_Pass.exp__tcycle__tau_1.Value /end CHARACTERISTIC
/begin CHARACTERISTIC Pedals_Susp_Sensors.Pedals_Susp_Sensors_P.Brake_Light_Threshold_Value "" VALUE 0x0 SCALAR_FLOAT64_IEEE 3.5e+305 Pedals_Susp_Sensors_CM_double -1.7e+308 1.7e+308 DISPLAY_IDENTIFIER Pedals_Susp_Sensors.Brake_Light.Brake_Light_Threshold.Value /end CHARACTERISTIC
/begin CHARACTERISTIC Pedals_Susp_Sensors.Pedals_Susp_Sensors_P.Ctemuelles_Gain "" VALUE 0x0 SCALAR_FLOAT64_IEEE 3.5e+305 Pedals_Susp_Sensors_CM_double -1.7e+308 1.7e+308 DISPLAY_IDENTIFIER Pedals_Susp_Sensors.Suspension_FL_Data_Conv.Cte_muelles.Gain /end CHARACTERISTIC
/begin CHARACTERISTIC Pedals_Susp_Sensors.Pedals_Susp_Sensors_P.Ctemuelles_Gain_a "" VALUE 0x0 SCALAR_FLOAT64_IEEE 3.5e+305 Pedals_Susp_Sensors_CM_double -1.7e+308 1.7e+308 DISPLAY_IDENTIFIER Pedals_Susp_Sensors.Suspension_RL_Data_Conv.Cte_muelles.Gain /end CHARACTERISTIC
/begin CHARACTERISTIC Pedals_Susp_Sensors.Pedals_Susp_Sensors_P.Ctemuelles_Gain_e "" VALUE 0x0 SCALAR_FLOAT64_IEEE 3.5e+305 Pedals_Susp_Sensors_CM_double -1.7e+308 1.7e+308 DISPLAY_IDENTIFIER Pedals_Susp_Sensors.Suspension_FR_Data_Conv.Cte_muelles.Gain /end CHARACTERISTIC
/begin CHARACTERISTIC Pedals_Susp_Sensors.Pedals_Susp_Sensors_P.Ctemuelles_Gain_g "" VALUE 0x0 SCALAR_FLOAT64_IEEE 3.5e+305 Pedals_Susp_Sensors_CM_double -1.7e+308 1.7e+308 DISPLAY_IDENTIFIER Pedals_Susp_Sensors.Suspension_RR_Data_Conv.Cte_muelles.Gain /end CHARACTERISTIC
/begin CHARACTERISTIC Pedals_Susp_Sensors.Pedals_Susp_Sensors_P.DataStoreMemory_InitialValue "" VALUE 0x0 SCALAR_FLOAT64_IEEE 3.5e+305 Pedals_Susp_Sensors_CM_double -1.7e+308 1.7e+308 DISPLAY_IDENTIFIER Pedals_Susp_Sensors.Suspension_FL_Data_Conv.Data_Store_Memory.InitialValue /end CHARACTERISTIC
/begin CHARACTERISTIC Pedals_Susp_Sensors.Pedals_Susp_Sensors_P.DataStoreMemory_InitialValue_b "" VALUE 0x0 SCALAR_FLOAT64_IEEE 3.5e+305 Pedals_Susp_Sensors_CM_double -1.7e+308 1.7e+308 DISPLAY_IDENTIFIER Pedals_Susp_Sensors.Suspension_RL_Data_Conv.Data_Store_Memory.InitialValue /end CHARACTERISTIC
/begin CHARACTERISTIC Pedals_Susp_Sensors.Pedals_Susp_Sensors_P.DataStoreMemory_InitialValue_l "" VALUE 0x0 SCALAR_FLOAT64_IEEE 3.5e+305 Pedals_Susp_Sensors_CM_double -1.7e+308 1.7e+308 DISPLAY_IDENTIFIER Pedals_Susp_Sensors.Suspension_RR_Data_Conv.Data_Store_Memory.InitialValue /end CHARACTERISTIC
/begin CHARACTERISTIC Pedals_Susp_Sensors.Pedals_Susp_Sensors_P.DataStoreMemory_InitialValue_m "" VALUE 0x0 SCALAR_FLOAT64_IEEE 3.5e+305 Pedals_Susp_Sensors_CM_double -1.7e+308 1.7e+308 DISPLAY_IDENTIFIER Pedals_Susp_Sensors.Suspension_FR_Data_Conv.Data_Store_Memory.InitialValue /end CHARACTERISTIC
/begin CHARACTERISTIC Pedals_Susp_Sensors.Pedals_Susp_Sensors_P.Ltotal_Gain "" VALUE 0x0 SCALAR_FLOAT64_IEEE 3.5e+305 Pedals_Susp_Sensors_CM_double -1.7e+308 1.7e+308 DISPLAY_IDENTIFIER Pedals_Susp_Sensors.Suspension_FL_Data_Conv.Ltotal.Gain /end CHARACTERISTIC
/begin CHARACTERISTIC Pedals_Susp_Sensors.Pedals_Susp_Sensors_P.Ltotal_Gain_c "" VALUE 0x0 SCALAR_FLOAT64_IEEE 3.5e+305 Pedals_Susp_Sensors_CM_double -1.7e+308 1.7e+308 DISPLAY_IDENTIFIER Pedals_Susp_Sensors.Suspension_FR_Data_Conv.Ltotal.Gain /end CHARACTERISTIC
/begin CHARACTERISTIC Pedals_Susp_Sensors.Pedals_Susp_Sensors_P.Ltotal_Gain_h "" VALUE 0x0 SCALAR_FLOAT64_IEEE 3.5e+305 Pedals_Susp_Sensors_CM_double -1.7e+308 1.7e+308 DISPLAY_IDENTIFIER Pedals_Susp_Sensors.Suspension_RL_Data_Conv.Ltotal.Gain /end CHARACTERISTIC
/begin CHARACTERISTIC Pedals_Susp_Sensors.Pedals_Susp_Sensors_P.Ltotal_Gain_j "" VALUE 0x0 SCALAR_FLOAT64_IEEE 3.5e+305 Pedals_Susp_Sensors_CM_double -1.7e+308 1.7e+308 DISPLAY_IDENTIFIER Pedals_Susp_Sensors.Suspension_RR_Data_Conv.Ltotal.Gain /end CHARACTERISTIC
/begin CHARACTERISTIC Pedals_Susp_Sensors.Pedals_Susp_Sensors_P.ON_Value "" VALUE 0x0 SCALAR_FLOAT64_IEEE 3.5e+305 Pedals_Susp_Sensors_CM_double -1.7e+308 1.7e+308 DISPLAY_IDENTIFIER Pedals_Susp_Sensors.Brake_Light.Brake_Light_ON.ON.Value /end CHARACTERISTIC
/begin CHARACTERISTIC Pedals_Susp_Sensors.Pedals_Susp_Sensors_P.Off_Value "" VALUE 0x0 SCALAR_FLOAT64_IEEE 3.5e+305 Pedals_Susp_Sensors_CM_double -1.7e+308 1.7e+308 DISPLAY_IDENTIFIER Pedals_Susp_Sensors.Brake_Light.Brake_Light_OFF.Off.Value /end CHARACTERISTIC
/begin CHARACTERISTIC Pedals_Susp_Sensors.Pedals_Susp_Sensors_P.bitsmax_Value "" VALUE 0x0 SCALAR_FLOAT64_IEEE 3.5e+305 Pedals_Susp_Sensors_CM_double -1.7e+308 1.7e+308 DISPLAY_IDENTIFIER Pedals_Susp_Sensors.Suspension_FL_Data_Conv.bitsmax.Value /end CHARACTERISTIC
/begin CHARACTERISTIC Pedals_Susp_Sensors.Pedals_Susp_Sensors_P.bitsmax_Value_b "" VALUE 0x0 SCALAR_FLOAT64_IEEE 3.5e+305 Pedals_Susp_Sensors_CM_double -1.7e+308 1.7e+308 DISPLAY_IDENTIFIER Pedals_Susp_Sensors.Suspension_RR_Data_Conv.bitsmax.Value /end CHARACTERISTIC
/begin CHARACTERISTIC Pedals_Susp_Sensors.Pedals_Susp_Sensors_P.bitsmax_Value_e "" VALUE 0x0 SCALAR_FLOAT64_IEEE 3.5e+305 Pedals_Susp_Sensors_CM_double -1.7e+308 1.7e+308 DISPLAY_IDENTIFIER Pedals_Susp_Sensors.Suspension_FR_Data_Conv.bitsmax.Value /end CHARACTERISTIC
/begin CHARACTERISTIC Pedals_Susp_Sensors.Pedals_Susp_Sensors_P.bitsmax_Value_o "" VALUE 0x0 SCALAR_FLOAT64_IEEE 3.5e+305 Pedals_Susp_Sensors_CM_double -1.7e+308 1.7e+308 DISPLAY_IDENTIFIER Pedals_Susp_Sensors.Suspension_RL_Data_Conv.bitsmax.Value /end CHARACTERISTIC
/begin CHARACTERISTIC Pedals_Susp_Sensors.Pedals_Susp_Sensors_P.max_Value "" VALUE 0x0 SCALAR_FLOAT64_IEEE 3.5e+305 Pedals_Susp_Sensors_CM_double -1.7e+308 1.7e+308 DISPLAY_IDENTIFIER Pedals_Susp_Sensors.BRS_Data_Conv.max.Value /end CHARACTERISTIC
/begin CHARACTERISTIC Pedals_Susp_Sensors.Pedals_Susp_Sensors_P.max_Value_a "" VALUE 0x0 SCALAR_FLOAT64_IEEE 3.5e+305 Pedals_Susp_Sensors_CM_double -1.7e+308 1.7e+308 DISPLAY_IDENTIFIER Pedals_Susp_Sensors.APPS2_Data_Conv.max.Value /end CHARACTERISTIC
/begin CHARACTERISTIC Pedals_Susp_Sensors.Pedals_Susp_Sensors_P.max_Value_f "" VALUE 0x0 SCALAR_FLOAT64_IEEE 3.5e+305 Pedals_Susp_Sensors_CM_double -1.7e+308 1.7e+308 DISPLAY_IDENTIFIER Pedals_Susp_Sensors.APPS1_Data_Conv.max.Value /end CHARACTERISTIC
/begin CHARACTERISTIC Pedals_Susp_Sensors.Pedals_Susp_Sensors_P.min_Value "" VALUE 0x0 SCALAR_FLOAT64_IEEE 3.5e+305 Pedals_Susp_Sensors_CM_double -1.7e+308 1.7e+308 DISPLAY_IDENTIFIER Pedals_Susp_Sensors.BRS_Data_Conv.min.Value /end CHARACTERISTIC
/begin CHARACTERISTIC Pedals_Susp_Sensors.Pedals_Susp_Sensors_P.min_Value_a "" VALUE 0x0 SCALAR_FLOAT64_IEEE 3.5e+305 Pedals_Susp_Sensors_CM_double -1.7e+308 1.7e+308 DISPLAY_IDENTIFIER Pedals_Susp_Sensors.APPS1_Data_Conv.min.Value /end CHARACTERISTIC
/begin CHARACTERISTIC Pedals_Susp_Sensors.Pedals_Susp_Sensors_P.min_Value_g "" VALUE 0x0 SCALAR_FLOAT64_IEEE 3.5e+305 Pedals_Susp_Sensors_CM_double -1.7e+308 1.7e+308 DISPLAY_IDENTIFIER Pedals_Susp_Sensors.APPS2_Data_Conv.min.Value /end CHARACTERISTIC
/begin CHARACTERISTIC Racing_Mode.Racing_Mode_P.Apps_Sat_DwnSaturation_LowerSat "" VALUE 0x0 SCALAR_FLOAT64_IEEE 3.5e+305 Racing_Mode_CM_double -1.7e+308 1.7e+308 DISPLAY_IDENTIFIER Racing_Mode.Apps_Sat_Dwn_Saturation.LowerLimit /end CHARACTERISTIC
/begin CHARACTERISTIC Racing_Mode.Racing_Mode_P.Apps_Sat_DwnSaturation_UpperSat "" VALUE 0x0 SCALAR_FLOAT64_IEEE 3.5e+305 Racing_Mode_CM_double -1.7e+308 1.7e+308 DISPLAY_IDENTIFIER Racing_Mode.Apps_Sat_Dwn_Saturation.UpperLimit /end CHARACTERISTIC
/begin CHARACTERISTIC Racing_Mode.Racing_Mode_P.Apps_Sat_UpSaturation_LowerSat "" VALUE 0x0 SCALAR_FLOAT64_IEEE 3.5e+305 Racing_Mode_CM_double -1.7e+308 1.7e+308 DISPLAY_IDENTIFIER Racing_Mode.Apps_Sat_Up_Saturation.LowerLimit /end CHARACTERISTIC
/begin CHARACTERISTIC Racing_Mode.Racing_Mode_P.Apps_Sat_UpSaturation_UpperSat "" VALUE 0x0 SCALAR_FLOAT64_IEEE 3.5e+305 Racing_Mode_CM_double -1.7e+308 1.7e+308 DISPLAY_IDENTIFIER Racing_Mode.Apps_Sat_Up_Saturation.UpperLimit /end CHARACTERISTIC
/begin CHARACTERISTIC Racing_Mode.Racing_Mode_P.CEE_Apps_Sat_Dwn_Value "" VALUE 0x0 SCALAR_FLOAT64_IEEE 3.5e+305 Racing_Mode_CM_double -1.7e+308 1.7e+308 DISPLAY_IDENTIFIER Racing_Mode.Tuning.CEE_Apps_Sat_Dwn.Value /end CHARACTERISTIC
/begin CHARACTERISTIC Racing_Mode.Racing_Mode_P.CEE_Apps_Sat_Up_Value "" VALUE 0x0 SCALAR_FLOAT64_IEEE 3.5e+305 Racing_Mode_CM_double -1.7e+308 1.7e+308 DISPLAY_IDENTIFIER Racing_Mode.Tuning.CEE_Apps_Sat_Up.Value /end CHARACTERISTIC
/begin CHARACTERISTIC Racing_Mode.Racing_Mode_P.CEE_CKF_Initial_Value "" VALUE 0x0 SCALAR_FLOAT64_IEEE 3.5e+305 Racing_Mode_CM_double -1.7e+308 1.7e+308 DISPLAY_IDENTIFIER Racing_Mode.Tuning.CEE_CKF_Initial.Value /end CHARACTERISTIC
/begin CHARACTERISTIC Racing_Mode.Racing_Mode_P.CEE_Cte_CKF_Value "" VALUE 0x0 SCALAR_FLOAT64_IEEE 3.5e+305 Racing_Mode_CM_double -1.7e+308 1.7e+308 DISPLAY_IDENTIFIER Racing_Mode.Tuning.CEE_Cte_CKF.Value /end CHARACTERISTIC
/begin CHARACTERISTIC Racing_Mode.Racing_Mode_P.CEE_Cte_SKF_Value "" VALUE 0x0 SCALAR_FLOAT64_IEEE 3.5e+305 Racing_Mode_CM_double -1.7e+308 1.7e+308 DISPLAY_IDENTIFIER Racing_Mode.Tuning.CEE_Cte_SKF.Value /end CHARACTERISTIC
/begin CHARACTERISTIC Racing_Mode.Racing_Mode_P.CEE_K_Reduction_P_Value "" VALUE 0x0 SCALAR_FLOAT64_IEEE 3.5e+305 Racing_Mode_CM_double -1.7e+308 1.7e+308 DISPLAY_IDENTIFIER Racing_Mode.Tuning.CEE_K_Reduction_P.Value /end CHARACTERISTIC
/begin CHARACTERISTIC Racing_Mode.Racing_Mode_P.CEE_K_Reduction_Temperature_Val "" VALUE 0x0 SCALAR_FLOAT64_IEEE 3.5e+305 Racing_Mode_CM_double -1.7e+308 1.7e+308 DISPLAY_IDENTIFIER Racing_Mode.Tuning.CEE_K_Reduction_Temperature.Value /end CHARACTERISTIC
/begin CHARACTERISTIC Racing_Mode.Racing_Mode_P.CEE_Max_Regenerative_Torque_Val "" VALUE 0x0 SCALAR_FLOAT64_IEEE 3.5e+305 Racing_Mode_CM_double -1.7e+308 1.7e+308 DISPLAY_IDENTIFIER Racing_Mode.Tuning.CEE_Max_Regenerative_Torque.Value /end CHARACTERISTIC
/begin CHARACTERISTIC Racing_Mode.Racing_Mode_P.CEE_Power_Limit_Value "" VALUE 0x0 SCALAR_FLOAT64_IEEE 3.5e+305 Racing_Mode_CM_double -1.7e+308 1.7e+308 DISPLAY_IDENTIFIER Racing_Mode.Tuning.CEE_Power_Limit.Value /end CHARACTERISTIC
/begin CHARACTERISTIC Racing_Mode.Racing_Mode_P.CEE_SKF_Initial_Value "" VALUE 0x0 SCALAR_FLOAT64_IEEE 3.5e+305 Racing_Mode_CM_double -1.7e+308 1.7e+308 DISPLAY_IDENTIFIER Racing_Mode.Tuning.CEE_SKF_Initial.Value /end CHARACTERISTIC
/begin CHARACTERISTIC Racing_Mode.Racing_Mode_P.CKF_InitialSaturation_LowerSat "" VALUE 0x0 SCALAR_FLOAT64_IEEE 3.5e+305 Racing_Mode_CM_double -1.7e+308 1.7e+308 DISPLAY_IDENTIFIER Racing_Mode.CKF_Initial_Saturation.LowerLimit /end CHARACTERISTIC
/begin CHARACTERISTIC Racing_Mode.Racing_Mode_P.CKF_InitialSaturation_UpperSat "" VALUE 0x0 SCALAR_FLOAT64_IEEE 3.5e+305 Racing_Mode_CM_double -1.7e+308 1.7e+308 DISPLAY_IDENTIFIER Racing_Mode.CKF_Initial_Saturation.UpperLimit /end CHARACTERISTIC
/begin CHARACTERISTIC Racing_Mode.Racing_Mode_P.CompareToConstant_const "" VALUE 0x0 SCALAR_UBYTE 255.0 Racing_Mode_CM_uint8 0.0 255.0 DISPLAY_IDENTIFIER Racing_Mode.Compare_To_Constant.Constant.Value /end CHARACTERISTIC
/begin CHARACTERISTIC Racing_Mode.Racing_Mode_P.Cte_CKFSaturation_LowerSat "" VALUE 0x0 SCALAR_FLOAT64_IEEE 3.5e+305 Racing_Mode_CM_double -1.7e+308 1.7e+308 DISPLAY_IDENTIFIER Racing_Mode.Cte_CKF_Saturation.LowerLimit /end CHARACTERISTIC
/begin CHARACTERISTIC Racing_Mode.Racing_Mode_P.Cte_CKFSaturation_UpperSat "" VALUE 0x0 SCALAR_FLOAT64_IEEE 3.5e+305 Racing_Mode_CM_double -1.7e+308 1.7e+308 DISPLAY_IDENTIFIER Racing_Mode.Cte_CKF_Saturation.UpperLimit /end CHARACTERISTIC
/begin CHARACTERISTIC Racing_Mode.Racing_Mode_P.Cte_SKFSaturation_LowerSat "" VALUE 0x0 SCALAR_FLOAT64_IEEE 3.5e+305 Racing_Mode_CM_double -1.7e+308 1.7e+308 DISPLAY_IDENTIFIER Racing_Mode.Cte_SKF_Saturation.LowerLimit /end CHARACTERISTIC
/begin CHARACTERISTIC Racing_Mode.Racing_Mode_P.Cte_SKFSaturation_UpperSat "" VALUE 0x0 SCALAR_FLOAT64_IEEE 3.5e+305 Racing_Mode_CM_double -1.7e+308 1.7e+308 DISPLAY_IDENTIFIER Racing_Mode.Cte_SKF_Saturation.UpperLimit /end CHARACTERISTIC
/begin CHARACTERISTIC Racing_Mode.Racing_Mode_P.K_Reduction_PSaturation_LowerSa "" VALUE 0x0 SCALAR_FLOAT64_IEEE 3.5e+305 Racing_Mode_CM_double -1.7e+308 1.7e+308 DISPLAY_IDENTIFIER Racing_Mode.K_Reduction_P_Saturation.LowerLimit /end CHARACTERISTIC
/begin CHARACTERISTIC Racing_Mode.Racing_Mode_P.K_Reduction_PSaturation_UpperSa "" VALUE 0x0 SCALAR_FLOAT64_IEEE 3.5e+305 Racing_Mode_CM_double -1.7e+308 1.7e+308 DISPLAY_IDENTIFIER Racing_Mode.K_Reduction_P_Saturation.UpperLimit /end CHARACTERISTIC
/begin CHARACTERISTIC Racing_Mode.Racing_Mode_P.K_Reduction_TemperatureSatura_m "" VALUE 0x0 SCALAR_FLOAT64_IEEE 3.5e+305 Racing_Mode_CM_double -1.7e+308 1.7e+308 DISPLAY_IDENTIFIER Racing_Mode.K_Reduction_Temperature_Saturation.LowerLimit /end CHARACTERISTIC
/begin CHARACTERISTIC Racing_Mode.Racing_Mode_P.K_Reduction_TemperatureSaturati "" VALUE 0x0 SCALAR_FLOAT64_IEEE 3.5e+305 Racing_Mode_CM_double -1.7e+308 1.7e+308 DISPLAY_IDENTIFIER Racing_Mode.K_Reduction_Temperature_Saturation.UpperLimit /end CHARACTERISTIC
/begin CHARACTERISTIC Racing_Mode.Racing_Mode_P.Max_Regenerative_TorqueSatura_o "" VALUE 0x0 SCALAR_FLOAT64_IEEE 3.5e+305 Racing_Mode_CM_double -1.7e+308 1.7e+308 DISPLAY_IDENTIFIER Racing_Mode.Max_Regenerative_Torque_Saturation.LowerLimit /end CHARACTERISTIC
/begin CHARACTERISTIC Racing_Mode.Racing_Mode_P.Max_Regenerative_TorqueSaturati "" VALUE 0x0 SCALAR_FLOAT64_IEEE 3.5e+305 Racing_Mode_CM_double -1.7e+308 1.7e+308 DISPLAY_IDENTIFIER Racing_Mode.Max_Regenerative_Torque_Saturation.UpperLimit /end CHARACTERISTIC
/begin CHARACTERISTIC Racing_Mode.Racing_Mode_P.Merge_InitialOutput "" VALUE 0x0 SCALAR_FLOAT64_IEEE 3.5e+305 Racing_Mode_CM_double -1.7e+308 1.7e+308 DISPLAY_IDENTIFIER Racing_Mode.Merge.InitialOutput /end CHARACTERISTIC
/begin CHARACTERISTIC Racing_Mode.Racing_Mode_P.Power_LimitSaturation_LowerSat "" VALUE 0x0 SCALAR_FLOAT64_IEEE 3.5e+305 Racing_Mode_CM_double -1.7e+308 1.7e+308 DISPLAY_IDENTIFIER Racing_Mode.Power_Limit_Saturation.LowerLimit /end CHARACTERISTIC
/begin CHARACTERISTIC Racing_Mode.Racing_Mode_P.Power_LimitSaturation_UpperSat "" VALUE 0x0 SCALAR_FLOAT64_IEEE 3.5e+305 Racing_Mode_CM_double -1.7e+308 1.7e+308 DISPLAY_IDENTIFIER Racing_Mode.Power_Limit_Saturation.UpperLimit /end CHARACTERISTIC
/begin CHARACTERISTIC Racing_Mode.Racing_Mode_P.SKF_InitialSaturation_LowerSat "" VALUE 0x0 SCALAR_FLOAT64_IEEE 3.5e+305 Racing_Mode_CM_double -1.7e+308 1.7e+308 DISPLAY_IDENTIFIER Racing_Mode.SKF_Initial_Saturation.LowerLimit /end CHARACTERISTIC
/begin CHARACTERISTIC Racing_Mode.Racing_Mode_P.SKF_InitialSaturation_UpperSat "" VALUE 0x0 SCALAR_FLOAT64_IEEE 3.5e+305 Racing_Mode_CM_double -1.7e+308 1.7e+308 DISPLAY_IDENTIFIER Racing_Mode.SKF_Initial_Saturation.UpperLimit /end CHARACTERISTIC
/begin CHARACTERISTIC Synchronism.Synchronism_P.Constant1_Value "" VALUE 0x0 SCALAR_FLOAT64_IEEE 3.5e+305 Synchronism_CM_double -1.7e+308 1.7e+308 DISPLAY_IDENTIFIER Synchronism.Constant1.Value /end CHARACTERISTIC
/begin CHARACTERISTIC Synchronism.Synchronism_P.Constant_Value "" VALUE 0x0 SCALAR_FLOAT64_IEEE 3.5e+305 Synchronism_CM_double -1.7e+308 1.7e+308 DISPLAY_IDENTIFIER Synchronism.Counter.Reset_counter.Constant.Value /end CHARACTERISTIC
/begin CHARACTERISTIC Synchronism.Synchronism_P.Constant_Value_e "" VALUE 0x0 SCALAR_FLOAT64_IEEE 3.5e+305 Synchronism_CM_double -1.7e+308 1.7e+308 DISPLAY_IDENTIFIER Synchronism.Counter.Constant.Value /end CHARACTERISTIC
/begin CHARACTERISTIC Synchronism.Synchronism_P.DataStoreMemory_InitialValue "" VALUE 0x0 SCALAR_FLOAT64_IEEE 3.5e+305 Synchronism_CM_double -1.7e+308 1.7e+308 DISPLAY_IDENTIFIER Synchronism.Counter.Data_Store_Memory.InitialValue /end CHARACTERISTIC
/begin CHARACTERISTIC Torque_Control.Torque_Control_P.ANm_Gain "" VALUE 0x0 SCALAR_FLOAT64_IEEE 3.5e+305 Torque_Control_CM_double -1.7e+308 1.7e+308 DISPLAY_IDENTIFIER Torque_Control.Calculate_Current_Conversion.KT_L_TORKY.A__Nm.Gain /end CHARACTERISTIC
/begin CHARACTERISTIC Torque_Control.Torque_Control_P.ANm_Gain_b "" VALUE 0x0 SCALAR_FLOAT64_IEEE 3.5e+305 Torque_Control_CM_double -1.7e+308 1.7e+308 DISPLAY_IDENTIFIER Torque_Control.Calculate_Current_Conversion.KT_R_EMY.A__Nm.Gain /end CHARACTERISTIC
/begin CHARACTERISTIC Torque_Control.Torque_Control_P.Accu_Temperature_Limitation_Fla "" VALUE 0x0 SCALAR_UBYTE 1.0 Torque_Control_CM_boolean 0 1 DISPLAY_IDENTIFIER Torque_Control.Controls_Temperature_by_limiting_Torque.Accu_Temperature_Limitation_Flag.InitialOutput /end CHARACTERISTIC
/begin CHARACTERISTIC Torque_Control.Torque_Control_P.CKF_act_Y0 "" VALUE 0x0 SCALAR_FLOAT64_IEEE 3.5e+305 Torque_Control_CM_double -1.7e+308 1.7e+308 DISPLAY_IDENTIFIER Torque_Control.VDC.Vehicle_Dynamics_Control_Modes.VDC_Complete.Optimization_SKF__amp__CKF.Subsystem.CKF.CKF_act.InitialOutput /end CHARACTERISTIC
/begin CHARACTERISTIC Torque_Control.Torque_Control_P.CKF_act_Y0_j "" VALUE 0x0 SCALAR_FLOAT64_IEEE 3.5e+305 Torque_Control_CM_double -1.7e+308 1.7e+308 DISPLAY_IDENTIFIER Torque_Control.VDC.Vehicle_Dynamics_Control_Modes.Steering_TV_with_TC.Optimization_SKF__amp__CKF.Subsystem.CKF.CKF_act.InitialOutput /end CHARACTERISTIC
/begin CHARACTERISTIC Torque_Control.Torque_Control_P.CompareToConstant1_const "" VALUE 0x0 SCALAR_FLOAT64_IEEE 3.5e+305 Torque_Control_CM_double -1.7e+308 1.7e+308 DISPLAY_IDENTIFIER Torque_Control.Pumps_Controller.Compare_To_Constant1.Constant.Value /end CHARACTERISTIC
/begin CHARACTERISTIC Torque_Control.Torque_Control_P.CompareToConstant_const "" VALUE 0x0 SCALAR_FLOAT64_IEEE 3.5e+305 Torque_Control_CM_double -1.7e+308 1.7e+308 DISPLAY_IDENTIFIER Torque_Control.SAFETY_BLOCK.Compare_To_Constant.Constant.Value /end CHARACTERISTIC
/begin CHARACTERISTIC Torque_Control.Torque_Control_P.CompareToConstant_const_p "" VALUE 0x0 SCALAR_FLOAT64_IEEE 3.5e+305 Torque_Control_CM_double -1.7e+308 1.7e+308 DISPLAY_IDENTIFIER Torque_Control.Pumps_Controller.Compare_To_Constant.Constant.Value /end CHARACTERISTIC
/begin CHARACTERISTIC Torque_Control.Torque_Control_P.Constant12_Value "" VALUE 0x0 SCALAR_FLOAT64_IEEE 3.5e+305 Torque_Control_CM_double -1.7e+308 1.7e+308 DISPLAY_IDENTIFIER Torque_Control.Constant12.Value /end CHARACTERISTIC
/begin CHARACTERISTIC Torque_Control.Torque_Control_P.Constant13_Value "" VALUE 0x0 SCALAR_FLOAT64_IEEE 3.5e+305 Torque_Control_CM_double -1.7e+308 1.7e+308 DISPLAY_IDENTIFIER Torque_Control.Constant13.Value /end CHARACTERISTIC
/begin CHARACTERISTIC Torque_Control.Torque_Control_P.Constant14_Value "" VALUE 0x0 SCALAR_FLOAT64_IEEE 3.5e+305 Torque_Control_CM_double -1.7e+308 1.7e+308 DISPLAY_IDENTIFIER Torque_Control.Constant14.Value /end CHARACTERISTIC
/begin CHARACTERISTIC Torque_Control.Torque_Control_P.Constant17_Value "" VALUE 0x0 SCALAR_FLOAT64_IEEE 3.5e+305 Torque_Control_CM_double -1.7e+308 1.7e+308 DISPLAY_IDENTIFIER Torque_Control.Constant17.Value /end CHARACTERISTIC
/begin CHARACTERISTIC Torque_Control.Torque_Control_P.Constant1_Value "" VALUE 0x0 SCALAR_FLOAT64_IEEE 3.5e+305 Torque_Control_CM_double -1.7e+308 1.7e+308 DISPLAY_IDENTIFIER Torque_Control.Controls_Temperature_by_limiting_Torque.temperature_SoP.temperature_rise_limitator_Accu.Constant1.Value /end CHARACTERISTIC
/begin CHARACTERISTIC Torque_Control.Torque_Control_P.Constant1_Value_a "" VALUE 0x0 SCALAR_FLOAT64_IEEE 3.5e+305 Torque_Control_CM_double -1.7e+308 1.7e+308 DISPLAY_IDENTIFIER Torque_Control.VDC.Vehicle_Dynamics_Control_Modes.VDC_Complete.Lateral_Dynamics.Constant1.Value /end CHARACTERISTIC
/begin CHARACTERISTIC Torque_Control.Torque_Control_P.Constant1_Value_ab "" VALUE 0x0 SCALAR_FLOAT64_IEEE 3.5e+305 Torque_Control_CM_double -1.7e+308 1.7e+308 DISPLAY_IDENTIFIER Torque_Control.VDC.Vehicle_Dynamics_Control_Modes.VDC_Complete.Wheel_to_motor.Constant1.Value /end CHARACTERISTIC
/begin CHARACTERISTIC Torque_Control.Torque_Control_P.Constant1_Value_b "" VALUE 0x0 SCALAR_FLOAT64_IEEE 3.5e+305 Torque_Control_CM_double -1.7e+308 1.7e+308 DISPLAY_IDENTIFIER Torque_Control.VDC.Vehicle_Dynamics_Control_Modes.VDC_Complete.In_Numbers.Constant1.Value /end CHARACTERISTIC
/begin CHARACTERISTIC Torque_Control.Torque_Control_P.Constant1_Value_c "" VALUE 0x0 SCALAR_FLOAT64_IEEE 3.5e+305 Torque_Control_CM_double -1.7e+308 1.7e+308 DISPLAY_IDENTIFIER Torque_Control.VDC.Vehicle_Dynamics_Control_Modes.VDC_without_Longitudinal.Kamm_Circle_Lateral.Constant1.Value /end CHARACTERISTIC
/begin CHARACTERISTIC Torque_Control.Torque_Control_P.Constant1_Value_e "" VALUE 0x0 SCALAR_FLOAT64_IEEE 3.5e+305 Torque_Control_CM_double -1.7e+308 1.7e+308 DISPLAY_IDENTIFIER Torque_Control.power_limitation1.temperature_SoP.temperature_rise_limitator_Accu.Constant1.Value /end CHARACTERISTIC
/begin CHARACTERISTIC Torque_Control.Torque_Control_P.Constant1_Value_f "" VALUE 0x0 SCALAR_FLOAT64_IEEE 3.5e+305 Torque_Control_CM_double -1.7e+308 1.7e+308 DISPLAY_IDENTIFIER Torque_Control.VDC.Vehicle_Dynamics_Control_Modes.VDC_Complete.Longitudinal_Dynamics.Constant1.Value /end CHARACTERISTIC
/begin CHARACTERISTIC Torque_Control.Torque_Control_P.Constant1_Value_fp "" VALUE 0x0 SCALAR_FLOAT64_IEEE 3.5e+305 Torque_Control_CM_double -1.7e+308 1.7e+308 DISPLAY_IDENTIFIER Torque_Control.power_limitation1.temperature_SoP.temperature_rise_limitator_Inverters.Constant1.Value /end CHARACTERISTIC
/begin CHARACTERISTIC Torque_Control.Torque_Control_P.Constant1_Value_l "" VALUE 0x0 SCALAR_FLOAT64_IEEE 3.5e+305 Torque_Control_CM_double -1.7e+308 1.7e+308 DISPLAY_IDENTIFIER Torque_Control.VDC.Vehicle_Dynamics_Control_Modes.VDC_without_Longitudinal.Force_to_Tq.Constant1.Value /end CHARACTERISTIC
/begin CHARACTERISTIC Torque_Control.Torque_Control_P.Constant1_Value_ln "" VALUE 0x0 SCALAR_FLOAT64_IEEE 3.5e+305 Torque_Control_CM_double -1.7e+308 1.7e+308 DISPLAY_IDENTIFIER Torque_Control.VDC.TEST_MODE_IN.TEST_CONSTANTS.Constant1.Value /end CHARACTERISTIC
/begin CHARACTERISTIC Torque_Control.Torque_Control_P.Constant1_Value_o "" VALUE 0x0 SCALAR_FLOAT64_IEEE 3.5e+305 Torque_Control_CM_double -1.7e+308 1.7e+308 DISPLAY_IDENTIFIER Torque_Control.Controls_Temperature_by_limiting_Torque.temperature_SoP.temperature_rise_limitator_Inverters.Constant1.Value /end CHARACTERISTIC
/begin CHARACTERISTIC Torque_Control.Torque_Control_P.Constant1_Value_p "" VALUE 0x0 SCALAR_FLOAT64_IEEE 3.5e+305 Torque_Control_CM_double -1.7e+308 1.7e+308 DISPLAY_IDENTIFIER Torque_Control.Controls_Temperature_by_limiting_Torque.temperature_SoP.temperature_rise_limitator_Motors.Constant1.Value /end CHARACTERISTIC
/begin CHARACTERISTIC Torque_Control.Torque_Control_P.Constant1_Value_p2 "" VALUE 0x0 SCALAR_FLOAT64_IEEE 3.5e+305 Torque_Control_CM_double -1.7e+308 1.7e+308 DISPLAY_IDENTIFIER Torque_Control.power_limitation1.temperature_SoP.temperature_rise_limitator_Motors.Constant1.Value /end CHARACTERISTIC
/begin CHARACTERISTIC Torque_Control.Torque_Control_P.Constant2_Value "" VALUE 0x0 SCALAR_FLOAT64_IEEE 3.5e+305 Torque_Control_CM_double -1.7e+308 1.7e+308 DISPLAY_IDENTIFIER Torque_Control.Controls_Temperature_by_limiting_Torque.temperature_SoP.temperature_rise_limitator_Accu.Constant2.Value /end CHARACTERISTIC
/begin CHARACTERISTIC Torque_Control.Torque_Control_P.Constant2_Value_b "" VALUE 0x0 SCALAR_FLOAT64_IEEE 3.5e+305 Torque_Control_CM_double -1.7e+308 1.7e+308 DISPLAY_IDENTIFIER Torque_Control.power_limitation1.temperature_SoP.temperature_rise_limitator_Inverters.Constant2.Value /end CHARACTERISTIC
/begin CHARACTERISTIC Torque_Control.Torque_Control_P.Constant2_Value_d "" VALUE 0x0 SCALAR_FLOAT64_IEEE 3.5e+305 Torque_Control_CM_double -1.7e+308 1.7e+308 DISPLAY_IDENTIFIER Torque_Control.VDC.Vehicle_Dynamics_Control_Modes.VDC_Complete.Longitudinal_Dynamics.Constant2.Value /end CHARACTERISTIC
/begin CHARACTERISTIC Torque_Control.Torque_Control_P.Constant2_Value_g "" VALUE 0x0 SCALAR_FLOAT64_IEEE 3.5e+305 Torque_Control_CM_double -1.7e+308 1.7e+308 DISPLAY_IDENTIFIER Torque_Control.VDC.Vehicle_Dynamics_Control_Modes.VDC_Complete.Lateral_Dynamics.Constant2.Value /end CHARACTERISTIC
/begin CHARACTERISTIC Torque_Control.Torque_Control_P.Constant2_Value_g1 "" VALUE 0x0 SCALAR_FLOAT64_IEEE 3.5e+305 Torque_Control_CM_double -1.7e+308 1.7e+308 DISPLAY_IDENTIFIER Torque_Control.VDC.TEST_MODE_IN.TEST_CONSTANTS.Constant2.Value /end CHARACTERISTIC
/begin CHARACTERISTIC Torque_Control.Torque_Control_P.Constant2_Value_h "" VALUE 0x0 SCALAR_FLOAT64_IEEE 3.5e+305 Torque_Control_CM_double -1.7e+308 1.7e+308 DISPLAY_IDENTIFIER Torque_Control.Controls_Temperature_by_limiting_Torque.temperature_SoP.temperature_rise_limitator_Inverters.Constant2.Value /end CHARACTERISTIC
/begin CHARACTERISTIC Torque_Control.Torque_Control_P.Constant2_Value_hv "" VALUE 0x0 SCALAR_FLOAT64_IEEE 3.5e+305 Torque_Control_CM_double -1.7e+308 1.7e+308 DISPLAY_IDENTIFIER Torque_Control.power_limitation1.temperature_SoP.temperature_rise_limitator_Motors.Constant2.Value /end CHARACTERISTIC
/begin CHARACTERISTIC Torque_Control.Torque_Control_P.Constant2_Value_m "" VALUE 0x0 SCALAR_FLOAT64_IEEE 3.5e+305 Torque_Control_CM_double -1.7e+308 1.7e+308 DISPLAY_IDENTIFIER Torque_Control.Controls_Temperature_by_limiting_Torque.temperature_SoP.temperature_rise_limitator_Motors.Constant2.Value /end CHARACTERISTIC
/begin CHARACTERISTIC Torque_Control.Torque_Control_P.Constant2_Value_mw "" VALUE 0x0 SCALAR_FLOAT64_IEEE 3.5e+305 Torque_Control_CM_double -1.7e+308 1.7e+308 DISPLAY_IDENTIFIER Torque_Control.power_limitation1.temperature_SoP.temperature_rise_limitator_Accu.Constant2.Value /end CHARACTERISTIC
/begin CHARACTERISTIC Torque_Control.Torque_Control_P.Constant3_Value "" VALUE 0x0 SCALAR_FLOAT64_IEEE 3.5e+305 Torque_Control_CM_double -1.7e+308 1.7e+308 DISPLAY_IDENTIFIER Torque_Control.Controls_Temperature_by_limiting_Torque.temperature_SoP.temperature_rise_limitator_Accu.Constant3.Value /end CHARACTERISTIC
/begin CHARACTERISTIC Torque_Control.Torque_Control_P.Constant3_Value_c "" VALUE 0x0 SCALAR_FLOAT64_IEEE 3.5e+305 Torque_Control_CM_double -1.7e+308 1.7e+308 DISPLAY_IDENTIFIER Torque_Control.power_limitation1.temperature_SoP.temperature_rise_limitator_Inverters.Constant3.Value /end CHARACTERISTIC
/begin CHARACTERISTIC Torque_Control.Torque_Control_P.Constant3_Value_d "" VALUE 0x0 SCALAR_FLOAT64_IEEE 3.5e+305 Torque_Control_CM_double -1.7e+308 1.7e+308 DISPLAY_IDENTIFIER Torque_Control.Controls_Temperature_by_limiting_Torque.temperature_SoP.temperature_rise_limitator_Inverters.Constant3.Value /end CHARACTERISTIC
/begin CHARACTERISTIC Torque_Control.Torque_Control_P.Constant3_Value_e "" VALUE 0x0 SCALAR_FLOAT64_IEEE 3.5e+305 Torque_Control_CM_double -1.7e+308 1.7e+308 DISPLAY_IDENTIFIER Torque_Control.Controls_Temperature_by_limiting_Torque.temperature_SoP.temperature_rise_limitator_Motors.Constant3.Value /end CHARACTERISTIC
/begin CHARACTERISTIC Torque_Control.Torque_Control_P.Constant3_Value_h "" VALUE 0x0 SCALAR_FLOAT64_IEEE 3.5e+305 Torque_Control_CM_double -1.7e+308 1.7e+308 DISPLAY_IDENTIFIER Torque_Control.power_limitation1.temperature_SoP.temperature_rise_limitator_Accu.Constant3.Value /end CHARACTERISTIC
/begin CHARACTERISTIC Torque_Control.Torque_Control_P.Constant3_Value_i "" VALUE 0x0 SCALAR_FLOAT64_IEEE 3.5e+305 Torque_Control_CM_double -1.7e+308 1.7e+308 DISPLAY_IDENTIFIER Torque_Control.power_limitation1.temperature_SoP.temperature_rise_limitator_Motors.Constant3.Value /end CHARACTERISTIC
/begin CHARACTERISTIC Torque_Control.Torque_Control_P.Constant3_Value_k "" VALUE 0x0 SCALAR_FLOAT64_IEEE 3.5e+305 Torque_Control_CM_double -1.7e+308 1.7e+308 DISPLAY_IDENTIFIER Torque_Control.VDC.Vehicle_Dynamics_Control_Modes.VDC_Complete.Longitudinal_Dynamics.Constant3.Value /end CHARACTERISTIC
/begin CHARACTERISTIC Torque_Control.Torque_Control_P.Constant3_Value_n "" VALUE 0x0 SCALAR_FLOAT64_IEEE 3.5e+305 Torque_Control_CM_double -1.7e+308 1.7e+308 DISPLAY_IDENTIFIER Torque_Control.VDC.TEST_MODE_IN.TEST_CONSTANTS.Constant3.Value /end CHARACTERISTIC
/begin CHARACTERISTIC Torque_Control.Torque_Control_P.Constant3_Value_o "" VALUE 0x0 SCALAR_FLOAT64_IEEE 3.5e+305 Torque_Control_CM_double -1.7e+308 1.7e+308 DISPLAY_IDENTIFIER Torque_Control.VDC.Vehicle_Dynamics_Control_Modes.VDC_Complete.Lateral_Dynamics.Constant3.Value /end CHARACTERISTIC
/begin CHARACTERISTIC Torque_Control.Torque_Control_P.Constant4_Value "" VALUE 0x0 SCALAR_FLOAT64_IEEE 3.5e+305 Torque_Control_CM_double -1.7e+308 1.7e+308 DISPLAY_IDENTIFIER Torque_Control.VDC.Vehicle_Dynamics_Control_Modes.VDC_Complete.Longitudinal_Dynamics.Constant4.Value /end CHARACTERISTIC
/begin CHARACTERISTIC Torque_Control.Torque_Control_P.Constant4_Value_p "" VALUE 0x0 SCALAR_FLOAT64_IEEE 3.5e+305 Torque_Control_CM_double -1.7e+308 1.7e+308 DISPLAY_IDENTIFIER Torque_Control.VDC.Vehicle_Dynamics_Control_Modes.VDC_Complete.Lateral_Dynamics.Constant4.Value /end CHARACTERISTIC
/begin CHARACTERISTIC Torque_Control.Torque_Control_P.Constant5_Value "" VALUE 0x0 SCALAR_FLOAT64_IEEE 3.5e+305 Torque_Control_CM_double -1.7e+308 1.7e+308 DISPLAY_IDENTIFIER Torque_Control.VDC.Vehicle_Dynamics_Control_Modes.VDC_Complete.Longitudinal_Dynamics.Constant5.Value /end CHARACTERISTIC
/begin CHARACTERISTIC Torque_Control.Torque_Control_P.Constant6_Value "" VALUE 0x0 SCALAR_FLOAT64_IEEE 3.5e+305 Torque_Control_CM_double -1.7e+308 1.7e+308 DISPLAY_IDENTIFIER Torque_Control.VDC.Vehicle_Dynamics_Control_Modes.VDC_Complete.Longitudinal_Dynamics.Constant6.Value /end CHARACTERISTIC
/begin CHARACTERISTIC Torque_Control.Torque_Control_P.Constant6_Value_p "" VALUE 0x0 SCALAR_FLOAT64_IEEE 3.5e+305 Torque_Control_CM_double -1.7e+308 1.7e+308 DISPLAY_IDENTIFIER Torque_Control.VDC.Vehicle_Dynamics_Control_Modes.VDC_Complete.Lateral_Dynamics.Constant6.Value /end CHARACTERISTIC
/begin CHARACTERISTIC Torque_Control.Torque_Control_P.Constant7_Value "" VALUE 0x0 SCALAR_FLOAT64_IEEE 3.5e+305 Torque_Control_CM_double -1.7e+308 1.7e+308 DISPLAY_IDENTIFIER Torque_Control.VDC.Vehicle_Dynamics_Control_Modes.VDC_Complete.Lateral_Dynamics.Yaw_Rate_Reference.Constant7.Value /end CHARACTERISTIC
/begin CHARACTERISTIC Torque_Control.Torque_Control_P.Constant8_Value "" VALUE 0x0 SCALAR_FLOAT64_IEEE 3.5e+305 Torque_Control_CM_double -1.7e+308 1.7e+308 DISPLAY_IDENTIFIER Torque_Control.VDC.Vehicle_Dynamics_Control_Modes.VDC_Complete.Lateral_Dynamics.Yaw_Rate_Reference.Constant8.Value /end CHARACTERISTIC
/begin CHARACTERISTIC Torque_Control.Torque_Control_P.Constant_Value "" VALUE 0x0 SCALAR_FLOAT64_IEEE 3.5e+305 Torque_Control_CM_double -1.7e+308 1.7e+308 DISPLAY_IDENTIFIER Torque_Control.Current_0.Constant.Value /end CHARACTERISTIC
/begin CHARACTERISTIC Torque_Control.Torque_Control_P.Constant_Value_a "" VALUE 0x0 SCALAR_FLOAT64_IEEE 3.5e+305 Torque_Control_CM_double -1.7e+308 1.7e+308 DISPLAY_IDENTIFIER Torque_Control.VDC.Vehicle_Dynamics_Control_Modes.VDC_Complete.Optimization_SKF__amp__CKF.Subsystem.SKF.Spin.Constant.Value /end CHARACTERISTIC
/begin CHARACTERISTIC Torque_Control.Torque_Control_P.Constant_Value_ad "" VALUE 0x0 SCALAR_FLOAT64_IEEE 3.5e+305 Torque_Control_CM_double -1.7e+308 1.7e+308 DISPLAY_IDENTIFIER Torque_Control.VDC.Vehicle_Dynamics_Control_Modes.VDC_Complete.Lateral_Dynamics.Tire_Longitudinal_Force_Difference.Momentum_Z_to_Longitudinal_Force_Difference.Constant.Value /end CHARACTERISTIC
/begin CHARACTERISTIC Torque_Control.Torque_Control_P.Constant_Value_ae "" VALUE 0x0 SCALAR_FLOAT64_IEEE 3.5e+305 Torque_Control_CM_double -1.7e+308 1.7e+308 DISPLAY_IDENTIFIER Torque_Control.VDC.Vehicle_Dynamics_Control_Modes.VDC_without_Longitudinal.Kamm_Circle_Lateral.Constant.Value /end CHARACTERISTIC
/begin CHARACTERISTIC Torque_Control.Torque_Control_P.Constant_Value_b "" VALUE 0x0 SCALAR_FLOAT64_IEEE 3.5e+305 Torque_Control_CM_double -1.7e+308 1.7e+308 DISPLAY_IDENTIFIER Torque_Control.VDC.Vehicle_Dynamics_Control_Modes.VDC_Complete.Constant.Value /end CHARACTERISTIC
/begin CHARACTERISTIC Torque_Control.Torque_Control_P.Constant_Value_d "" VALUE 0x0 SCALAR_FLOAT64_IEEE 3.5e+305 Torque_Control_CM_double -1.7e+308 1.7e+308 DISPLAY_IDENTIFIER Torque_Control.VDC.Vehicle_Dynamics_Control_Modes.VDC_without_Longitudinal.Optimization_SKF__amp__CKF.Subsystem.CKF.Spin.Constant.Value /end CHARACTERISTIC
/begin CHARACTERISTIC Torque_Control.Torque_Control_P.Constant_Value_dl "" VALUE 0x0 SCALAR_FLOAT64_IEEE 3.5e+305 Torque_Control_CM_double -1.7e+308 1.7e+308 DISPLAY_IDENTIFIER Torque_Control.VDC.Vehicle_Dynamics_Control_Modes.Steering_TV_with_TC.Optimization_SKF__amp__CKF.Subsystem.CKF.Spin.Constant.Value /end CHARACTERISTIC
/begin CHARACTERISTIC Torque_Control.Torque_Control_P.Constant_Value_dm "" VALUE 0x0 SCALAR_FLOAT64_IEEE 3.5e+305 Torque_Control_CM_double -1.7e+308 1.7e+308 DISPLAY_IDENTIFIER Torque_Control.VDC.WORKSHOP_MODE_RESTRICTIONS.Torque_Reduction.Constant.Value /end CHARACTERISTIC
/begin CHARACTERISTIC Torque_Control.Torque_Control_P.Constant_Value_dx "" VALUE 0x0 SCALAR_FLOAT64_IEEE 3.5e+305 Torque_Control_CM_double -1.7e+308 1.7e+308 DISPLAY_IDENTIFIER Torque_Control.Constant.Value /end CHARACTERISTIC
/begin CHARACTERISTIC Torque_Control.Torque_Control_P.Constant_Value_f "" VALUE 0x0 SCALAR_FLOAT64_IEEE 3.5e+305 Torque_Control_CM_double -1.7e+308 1.7e+308 DISPLAY_IDENTIFIER Torque_Control.VDC.Vehicle_Dynamics_Control_Modes.VDC_Complete.Optimization_SKF__amp__CKF.Subsystem.CKF.Spin.Constant.Value /end CHARACTERISTIC
/begin CHARACTERISTIC Torque_Control.Torque_Control_P.Constant_Value_f0 "" VALUE 0x0 SCALAR_FLOAT64_IEEE 3.5e+305 Torque_Control_CM_double -1.7e+308 1.7e+308 DISPLAY_IDENTIFIER Torque_Control.VDC.Vehicle_Dynamics_Control_Modes.VDC_Complete.Longitudinal_Dynamics.Constant.Value /end CHARACTERISTIC
/begin CHARACTERISTIC Torque_Control.Torque_Control_P.Constant_Value_h "" VALUE 0x0 SCALAR_FLOAT64_IEEE 3.5e+305 Torque_Control_CM_double -1.7e+308 1.7e+308 DISPLAY_IDENTIFIER Torque_Control.VDC.Vehicle_Dynamics_Control_Modes.VDC_Complete.Constraints_and_motor_to_wheel_Tq.Acelerating_and_braking_without_Regenerative.Constant.Value /end CHARACTERISTIC
/begin CHARACTERISTIC Torque_Control.Torque_Control_P.Constant_Value_i "" VALUE 0x0 SCALAR_FLOAT64_IEEE 3.5e+305 Torque_Control_CM_double -1.7e+308 1.7e+308 DISPLAY_IDENTIFIER Torque_Control.Pumps_Controller.Pumps_Control_ON.Constant.Value /end CHARACTERISTIC
/begin CHARACTERISTIC Torque_Control.Torque_Control_P.Constant_Value_ib "" VALUE 0x0 SCALAR_FLOAT64_IEEE 3.5e+305 Torque_Control_CM_double -1.7e+308 1.7e+308 DISPLAY_IDENTIFIER Torque_Control.VDC.Vehicle_Dynamics_Control_Modes.VDC_without_Longitudinal.Force_to_Tq.Constant.Value /end CHARACTERISTIC
/begin CHARACTERISTIC Torque_Control.Torque_Control_P.Constant_Value_k "" VALUE 0x0 SCALAR_FLOAT64_IEEE 3.5e+305 Torque_Control_CM_double -1.7e+308 1.7e+308 DISPLAY_IDENTIFIER Torque_Control.VDC.Vehicle_Dynamics_Control_Modes.Constant.Value /end CHARACTERISTIC
/begin CHARACTERISTIC Torque_Control.Torque_Control_P.Constant_Value_k4 "" VALUE 0x0 SCALAR_FLOAT64_IEEE 3.5e+305 Torque_Control_CM_double -1.7e+308 1.7e+308 DISPLAY_IDENTIFIER Torque_Control.VDC.TEST_MODE_IN.TEST_CONSTANTS.Constant.Value /end CHARACTERISTIC
/begin COMPU_METHOD Car_State_CM_double "Q = V" RAT_FUNC "%9.6" "NO_PHYSICAL_QTY" COEFFS 0.0 1.0 0.0 0.0 0.0 1.0 /end COMPU_METHOD
/begin COMPU_METHOD Car_State_CM_boolean "Q = V" RAT_FUNC "%9.6" "NO_PHYSICAL_QTY" COEFFS 0.0 1.0 0.0 0.0 0.0 1.0 /end COMPU_METHOD
/begin COMPU_METHOD Accel_Data_CM_double "Q = V" RAT_FUNC "%9.6" "NO_PHYSICAL_QTY" COEFFS 0.0 1.0 0.0 0.0 0.0 1.0 /end COMPU_METHOD
/begin COMPU_METHOD Disconnections_CM_double "Q = V" RAT_FUNC "%9.6" "NO_PHYSICAL_QTY" COEFFS 0.0 1.0 0.0 0.0 0.0 1.0 /end COMPU_METHOD
/begin COMPU_METHOD Disconnections_CM_uint8 "Q = V" RAT_FUNC "%9.6" "NO_PHYSICAL_QTY" COEFFS 0.0 1.0 0.0 0.0 0.0 1.0 /end COMPU_METHOD
/begin COMPU_METHOD Disconnections_CM_boolean "Q = V" RAT_FUNC "%9.6" "NO_PHYSICAL_QTY" COEFFS 0.0 1.0 0.0 0.0 0.0 1.0 /end COMPU_METHOD
/begin COMPU_METHOD Inverters_Action_CM_boolean "Q = V" RAT_FUNC "%9.6" "NO_PHYSICAL_QTY" COEFFS 0.0 1.0 0.0 0.0 0.0 1.0 /end COMPU_METHOD
/begin COMPU_METHOD Inverters_Action_CM_uint8 "Q = V" RAT_FUNC "%9.6" "NO_PHYSICAL_QTY" COEFFS 0.0 1.0 0.0 0.0 0.0 1.0 /end COMPU_METHOD
/begin COMPU_METHOD Inverters_Action_CM_double "Q = V" RAT_FUNC "%9.6" "NO_PHYSICAL_QTY" COEFFS 0.0 1.0 0.0 0.0 0.0 1.0 /end COMPU_METHOD
/begin COMPU_METHOD Inverters_Action_CM_uint32 "Q = V" RAT_FUNC "%9.6" "NO_PHYSICAL_QTY" COEFFS 0.0 1.0 0.0 0.0 0.0 1.0 /end COMPU_METHOD
/begin COMPU_METHOD Inverters_Data_CM_double "Q = V" RAT_FUNC "%9.6" "NO_PHYSICAL_QTY" COEFFS 0.0 1.0 0.0 0.0 0.0 1.0 /end COMPU_METHOD
/begin COMPU_METHOD LVD_Data_CM_double "Q = V" RAT_FUNC "%9.6" "NO_PHYSICAL_QTY" COEFFS 0.0 1.0 0.0 0.0 0.0 1.0 /end COMPU_METHOD
/begin COMPU_METHOD Pedals_Susp_Sensors_CM_double "Q = V" RAT_FUNC "%9.6" "NO_PHYSICAL_QTY" COEFFS 0.0 1.0 0.0 0.0 0.0 1.0 /end COMPU_METHOD
/begin COMPU_METHOD Racing_Mode_CM_double "Q = V" RAT_FUNC "%9.6" "NO_PHYSICAL_QTY" COEFFS 0.0 1.0 0.0 0.0 0.0 1.0 /end COMPU_METHOD
/begin COMPU_METHOD Racing_Mode_CM_uint8 "Q = V" RAT_FUNC "%9.6" "NO_PHYSICAL_QTY" COEFFS 0.0 1.0 0.0 0.0 0.0 1.0 /end COMPU_METHOD
/begin COMPU_METHOD Racing_Mode_CM_boolean "Q = V" RAT_FUNC "%9.6" "NO_PHYSICAL_QTY" COEFFS 0.0 1.0 0.0 0.0 0.0 1.0 /end COMPU_METHOD
/begin COMPU_METHOD Synchronism_CM_double "Q = V" RAT_FUNC "%9.6" "NO_PHYSICAL_QTY" COEFFS 0.0 1.0 0.0 0.0 0.0 1.0 /end COMPU_METHOD
/begin COMPU_METHOD Torque_Control_CM_double "Q = V" RAT_FUNC "%9.6" "NO_PHYSICAL_QTY" COEFFS 0.0 1.0 0.0 0.0 0.0 1.0 /end COMPU_METHOD
/begin COMPU_METHOD Torque_Control_CM_boolean "Q = V" RAT_FUNC "%9.6" "NO_PHYSICAL_QTY" COEFFS 0.0 1.0 0.0 0.0 0.0 1.0 /end COMPU_METHOD
/begin RECORD_LAYOUT SCALAR_FLOAT64_IEEE FNC_VALUES 1 FLOAT64_IEEE COLUMN_DIR DIRECT /end RECORD_LAYOUT
/begin RECORD_LAYOUT SCALAR_UBYTE FNC_VALUES 1 UBYTE COLUMN_DIR DIRECT /end RECORD_LAYOUT
/begin RECORD_LAYOUT SCALAR_ULONG FNC_VALUES 1 ULONG COLUMN_DIR DIRECT /end RECORD_LAYOUT
/begin GROUP Car_State "" ROOT
 /begin REF_MEASUREMENT Car_State.Car_State_B.Merge Car_State.Car_State_DW.A Car_State.Car_State_U.AIRs_State Car_State.Car_State_U.Accumulator_Voltage Car_State.Car_State_U.BMSerror_CANDisconnection Car_State.Car_State_U.BMSerror_CurrentSensDisc Car_State.Car_State_U.BMSerror_NTCDisconnection Car_State.Car_State_U.BMSerror_OverTemperature Car_State.Car_State_U.BMSerror_OverVoltage Car_State.Car_State_U.BMSerror_UnderTemperature Car_State.Car_State_U.BMSerror_UnderVoltage Car_State.Car_State_U.Critical_CAN_Disconnection Car_State.Car_State_U.DashPrechargeRequest Car_State.Car_State_U.EnableDrive Car_State.Car_State_U.InvertersMinDCBus Car_State.Car_State_U.InvertersSubscribed Car_State.Car_State_U.Lock Car_State.Car_State_U.Shutdown_BMS Car_State.Car_State_U.Shutdown_BOTS Car_State.Car_State_U.Shutdown_BSPD Car_State.Car_State_U.Shutdown_HVBOX Car_State.Car_State_U.Shutdown_HVD Car_State.Car_State_U.Shutdown_Inertia Car_State.Car_State_U.Shutdown_InverterLIntck Car_State.Car_State_U.Shutdown_InverterRIntck Car_State.Car_State_U.Shutdown_PackageIntck Car_State.Car_State_U.Shutdown_SetaCockpit Car_State.Car_State_U.Shutdown_SetaLeft Car_State.Car_State_U.Shutdown_SetaRight Car_State.Car_State_U.Shutdown_TSMPIntck Car_State.Car_State_U.Shutdown_TSMS Car_State.Car_State_Y.AIRs_Request Car_State.Car_State_Y.Car_OK Car_State.Car_State_Y.Car_State_f Car_State.Car_State_Y.CurrentPathDisconnectionFlag Car_State.Car_State_Y.InvertersAction Car_State.Car_State_Y.PrechargeAssert Car_State.Car_State_Y.Precharge_Percentage Car_State.Car_State_Y.Precharge_Voltage Car_State.Car_State_Y.ShutdownClosed Car_State.Car_State_Y.TorqueEnable Car_State.Car_State_Y.errors /end REF_MEASUREMENT
 /begin REF_CHARACTERISTIC Car_State.Car_State_P.CompareToConstant_const Car_State.Car_State_P.Constant_Value Car_State.Car_State_P.Constant_Value_f Car_State.Car_State_P.Constant_Value_fl Car_State.Car_State_P.Constant_Value_k Car_State.Car_State_P.Constant_Value_kb Car_State.Car_State_P.DataStoreMemory_InitialValue Car_State.Car_State_P.Gain_Gain Car_State.Car_State_P.IfDCBUSnotbits_Gain Car_State.Car_State_P.Merge_InitialOutput Car_State.Car_State_P.Saturation_LowerSat Car_State.Car_State_P.Saturation_UpperSat /end REF_CHARACTERISTIC
 /begin SUB_GROUP Car_State.Car_State_B Car_State.Car_State_DW Car_State.Car_State_U Car_State.Car_State_Y Car_State.Car_State_P /end SUB_GROUP
/end GROUP
/begin GROUP Car_State.Car_State_B "" /begin REF_MEASUREMENT Car_State.Car_State_B.Merge /end REF_MEASUREMENT /end GROUP
/begin GROUP Car_State.Car_State_DW "" /begin REF_MEASUREMENT Car_State.Car_State_DW.A /end REF_MEASUREMENT /end GROUP
/begin GROUP Car_State.Car_State_U ""
 /begin REF_MEASUREMENT Car_State.Car_State_U.AIRs_State Car_State.Car_State_U.Accumulator_Voltage Car_State.Car_State_U.BMSerror_CANDisconnection Car_State.Car_State_U.BMSerror_CurrentSensDisc Car_State.Car_State_U.BMSerror_NTCDisconnection Car_State.Car_State_U.BMSerror_OverTemperature Car_State.Car_State_U.BMSerror_OverVoltage Car_State.Car_State_U.BMSerror_UnderTemperature Car_State.Car_State_U.BMSerror_UnderVoltage Car_State.Car_State_U.Critical_CAN_Disconnection Car_State.Car_State_U.DashPrechargeRequest Car_State.Car_State_U.EnableDrive Car_State.Car_State_U.InvertersMinDCBus Car_State.Car_State_U.InvertersSubscribed Car_State.Car_State_U.Lock Car_State.Car_State_U.Shutdown_BMS Car_State.Car_State_U.Shutdown_BOTS Car_State.Car_State_U.Shutdown_BSPD Car_State.Car_State_U.Shutdown_HVBOX Car_State.Car_State_U.Shutdown_HVD Car_State.Car_State_U.Shutdown_Inertia Car_State.Car_State_U.Shutdown_InverterLIntck Car_State.Car_State_U.Shutdown_InverterRIntck Car_State.Car_State_U.Shutdown_PackageIntck Car_State.Car_State_U.Shutdown_SetaCockpit Car_State.Car_State_U.Shutdown_SetaLeft Car_State.Car_State_U.Shutdown_SetaRight Car_State.Car_State_U.Shutdown_TSMPIntck Car_State.Car_State_U.Shutdown_TSMS /end REF_MEASUREMENT
/end GROUP
/begin GROUP Car_State.Car_State_Y ""
 /begin REF_MEASUREMENT Car_State.Car_State_Y.AIRs_Request Car_State.Car_State_Y.Car_OK Car_State.Car_State_Y.Car_State_f Car_State.Car_State_Y.CurrentPathDisconnectionFlag Car_State.Car_State_Y.InvertersAction Car_State.Car_State_Y.PrechargeAssert Car_State.Car_State_Y.Precharge_Percentage Car_State.Car_State_Y.Precharge_Voltage Car_State.Car_State_Y.ShutdownClosed Car_State.Car_State_Y.TorqueEnable Car_State.Car_State_Y.errors /end REF_MEASUREMENT
/end GROUP
/begin GROUP Car_State.Car_State_P ""
 /begin REF_CHARACTERISTIC Car_State.Car_State_P.CompareToConstant_const Car_State.Car_State_P.Constant_Value Car_State.Car_State_P.Constant_Value_f Car_State.Car_State_P.Constant_Value_fl Car_State.Car_State_P.Constant_Value_k Car_State.Car_State_P.Constant_Value_kb Car_State.Car_State_P.DataStoreMemory_InitialValue Car_State.Car_State_P.Gain_Gain Car_State.Car_State_P.IfDCBUSnotbits_Gain Car_State.Car_State_P.Merge_InitialOutput Car_State.Car_State_P.Saturation_LowerSat Car_State.Car_State_P.Saturation_UpperSat /end REF_CHARACTERISTIC
/end GROUP
/begin GROUP Accel_Data "" ROOT
 /begin REF_MEASUREMENT Accel_Data.Accel_Data_B.AccDataConversionFX.Gain Accel_Data.Accel_Data_B.AccDataConversionFY.Gain Accel_Data.Accel_Data_B.AccDataConversionFZ.Gain Accel_Data.Accel_Data_B.AccDataConversionRX.Gain Accel_Data.Accel_Data_B.AccDataConversionRY.Gain Accel_Data.Accel_Data_B.AccDataConversionRZ.Gain Accel_Data.Accel_Data_B.LowPass.Gain Accel_Data.Accel_Data_B.LowPass1.Gain Accel_Data.Accel_Data_B.LowPass2.Gain Accel_Data.Accel_Data_DW.A Accel_Data.Accel_Data_DW.A_f Accel_Data.Accel_Data_U.ACCEL_F_X Accel_Data.Accel_Data_U.ACCEL_F_Y Accel_Data.Accel_Data_U.ACCEL_F_Z Accel_Data.Accel_Data_U.ACCEL_R_X Accel_Data.Accel_Data_U.ACCEL_R_Y Accel_Data.Accel_Data_U.ACCEL_R_Z Accel_Data.Accel_Data_U.Gyroscope_F Accel_Data.Accel_Data_U.Gyroscope_R Accel_Data.Accel_Data_Y.Accel_F_X_SI Accel_Data.Accel_Data_Y.Accel_F_Y_SI Accel_Data.Accel_Data_Y.Accel_F_Z_SI Accel_Data.Accel_Data_Y.Accel_R_X_SI Accel_Data.Accel_Data_Y.Accel_R_Y_SI Accel_Data.Accel_Data_Y.Accel_R_Z_SI Accel_Data.Accel_Data_Y.Gyro_F_Z_Deg Accel_Data.Accel_Data_Y.Gyro_R_Z_Deg Accel_Data.Accel_Data_Y.Rate_F_Z_Degs2 Accel_Data.Accel_Data_Y.Rate_R_Z_Degs /end REF_MEASUREMENT
 /begin REF_CHARACTERISTIC Accel_Data.Accel_Data_P.CycleTime_Gain Accel_Data.Accel_Data_P.CycleTime_Gain_h Accel_Data.Accel_Data_P.DataStoreMemory_InitialValue Accel_Data.Accel_Data_P.DataStoreMemory_InitialValue_m Accel_Data.Accel_Data_P.ExperimentalOffset_Value Accel_Data.Accel_Data_P.ExperimentalOffset_Value_e Accel_Data.Accel_Data_P.Gain2_Gain Accel_Data.Accel_Data_P.Gain4_Gain Accel_Data.Accel_Data_P.RpsLSB_Value Accel_Data.Accel_Data_P.sbit_Value /end REF_CHARACTERISTIC
 /begin SUB_GROUP Accel_Data.Accel_Data_B Accel_Data.Accel_Data_B.AccDataConversionFX Accel_Data.Accel_Data_B.AccDataConversionFY Accel_Data.Accel_Data_B.AccDataConversionFZ Accel_Data.Accel_Data_B.AccDataConversionRX Accel_Data.Accel_Data_B.AccDataConversionRY Accel_Data.Accel_Data_B.AccDataConversionRZ Accel_Data.Accel_Data_B.LowPass Accel_Data.Accel_Data_B.LowPass1 Accel_Data.Accel_Data_B.LowPass2 Accel_Data.Accel_Data_DW Accel_Data.Accel_Data_U Accel_Data.Accel_Data_Y Accel_Data.Accel_Data_P /end SUB_GROUP
/end GROUP
/begin GROUP Accel_Data.Accel_Data_B ""
 /begin REF_MEASUREMENT Accel_Data.Accel_Data_B.AccDataConversionFX.Gain Accel_Data.Accel_Data_B.AccDataConversionFY.Gain Accel_Data.Accel_Data_B.AccDataConversionFZ.Gain Accel_Data.Accel_Data_B.AccDataConversionRX.Gain Accel_Data.Accel_Data_B.AccDataConversionRY.Gain Accel_Data.Accel_Data_B.AccDataConversionRZ.Gain Accel_Data.Accel_Data_B.LowPass.Gain Accel_Data.Accel_Data_B.LowPass1.Gain Accel_Data.Accel_Data_B.LowPass2.Gain /end REF_MEASUREMENT
/end GROUP
/begin GROUP Accel_Data.Accel_Data_B.AccDataConversionFX "" /begin REF_MEASUREMENT Accel_Data.Accel_Data_B.AccDataConversionFX.Gain /end REF_MEASUREMENT /end GROUP
/begin GROUP Accel_Data.Accel_Data_B.AccDataConversionFY "" /begin REF_MEASUREMENT Accel_Data.Accel_Data_B.AccDataConversionFY.Gain /end REF_MEASUREMENT /end GROUP
/begin GROUP Accel_Data.Accel_Data_B.AccDataConversionFZ "" /begin REF_MEASUREMENT Accel_Data.Accel_Data_B.AccDataConversionFZ.Gain /end REF_MEASUREMENT /end GROUP
/begin GROUP Accel_Data.Accel_Data_B.AccDataConversionRX "" /begin REF_MEASUREMENT Accel_Data.Accel_Data_B.AccDataConversionRX.Gain /end REF_MEASUREMENT /end GROUP
/begin GROUP Accel_Data.Accel_Data_B.AccDataConversionRY "" /begin REF_MEASUREMENT Accel_Data.Accel_Data_B.AccDataConversionRY.Gain /end REF_MEASUREMENT /end GROUP
/begin GROUP Accel_Data.Accel_Data_B.AccDataConversionRZ "" /begin REF_MEASUREMENT Accel_Data.Accel_Data_B.AccDataConversionRZ.Gain /end REF_MEASUREMENT /end GROUP
/begin GROUP Accel_Data.Accel_Data_B.LowPass "" /begin REF_MEASUREMENT Accel_Data.Accel_Data_B.LowPass.Gain /end REF_MEASUREMENT /end GROUP
/begin GROUP Accel_Data.Accel_Data_B.LowPass1 "" /begin REF_MEASUREMENT Accel_Data.Accel_Data_B.LowPass1.Gain /end REF_MEASUREMENT /end GROUP
/begin GROUP Accel_Data.Accel_Data_B.LowPass2 "" /begin REF_MEASUREMENT Accel_Data.Accel_Data_B.LowPass2.Gain /end REF_MEASUREMENT /end GROUP
/begin GROUP Accel_Data.Accel_Data_DW "" /begin REF_MEASUREMENT Accel_Data.Accel_Data_DW.A Accel_Data.Accel_Data_DW.A_f /end REF_MEASUREMENT /end GROUP
/begin GROUP Accel_Data.Accel_Data_U ""
 /begin REF_MEASUREMENT Accel_Data.Accel_Data_U.ACCEL_F_X Accel_Data.Accel_Data_U.ACCEL_F_Y Accel_Data.Accel_Data_U.ACCEL_F_Z Accel_Data.Accel_Data_U.ACCEL_R_X Accel_Data.Accel_Data_U.ACCEL_R_Y Accel_Data.Accel_Data_U.ACCEL_R_Z Accel_Data.Accel_Data_U.Gyroscope_F Accel_Data.Accel_Data_U.Gyroscope_R /end REF_MEASUREMENT
/end GROUP
/begin GROUP Accel_Data.Accel_Data_Y ""
 /begin REF_MEASUREMENT Accel_Data.Accel_Data_Y.Accel_F_X_SI Accel_Data.Accel_Data_Y.Accel_F_Y_SI Accel_Data.Accel_Data_Y.Accel_F_Z_SI Accel_Data.Accel_Data_Y.Accel_R_X_SI Accel_Data.Accel_Data_Y.Accel_R_Y_SI Accel_Data.Accel_Data_Y.Accel_R_Z_SI Accel_Data.Accel_Data_Y.Gyro_F_Z_Deg Accel_Data.Accel_Data_Y.Gyro_R_Z_Deg Accel_Data.Accel_Data_Y.Rate_F_Z_Degs2 Accel_Data.Accel_Data_Y.Rate_R_Z_Degs /end REF_MEASUREMENT
/end GROUP
/begin GROUP Accel_Data.Accel_Data_P ""
 /begin REF_CHARACTERISTIC Accel_Data.Accel_Data_P.CycleTime_Gain Accel_Data.Accel_Data_P.CycleTime_Gain_h Accel_Data.Accel_Data_P.DataStoreMemory_InitialValue Accel_Data.Accel_Data_P.DataStoreMemory_InitialValue_m Accel_Data.Accel_Data_P.ExperimentalOffset_Value Accel_Data.Accel_Data_P.ExperimentalOffset_Value_e Accel_Data.Accel_Data_P.Gain2_Gain Accel_Data.Accel_Data_P.Gain4_Gain Accel_Data.Accel_Data_P.RpsLSB_Value Accel_Data.Accel_Data_P.sbit_Value /end REF_CHARACTERISTIC
/end GROUP
/begin GROUP Disconnections "" ROOT
 /begin REF_MEASUREMENT Disconnections.Disconnections_B.Merge Disconnections.Disconnections_B.Merge_b Disconnections.Disconnections_B.Merge_d Disconnections.Disconnections_B.Merge_f Disconnections.Disconnections_B.Merge_h Disconnections.Disconnections_B.Merge_he Disconnections.Disconnections_B.Merge_j Disconnections.Disconnections_DW.A Disconnections.Disconnections_DW.Last_alive Disconnections.Disconnections_DW.Last_alive_a Disconnections.Disconnections_DW.Last_alive_ar Disconnections.Disconnections_DW.Last_alive_c Disconnections.Disconnections_DW.Last_alive_c0 Disconnections.Disconnections_DW.Last_alive_g Disconnections.Disconnections_DW.Last_alive_gx Disconnections.Disconnections_DW.Last_alive_j Disconnections.Disconnections_DW.Last_alive_je Disconnections.Disconnections_DW.Last_alive_l Disconnections.Disconnections_DW.Last_alive_m Disconnections.Disconnections_DW.Last_alive_o Disconnections.Disconnections_DW.Tot_Errors Disconnections.Disconnections_DW.Tot_Errors_h Disconnections.Disconnections_DW.Tot_Errors_j Disconnections.Disconnections_DW.Tot_Errors_k Disconnections.Disconnections_DW.Tot_Errors_m Disconnections.Disconnections_U.ADCAN_Alive Disconnections.Disconnections_U.APPS1_Bits Disconnections.Disconnections_U.APPS2_Bits Disconnections.Disconnections_U.Accel_F_Alive Disconnections.Disconnections_U.Accel_R_Alive Disconnections.Disconnections_U.BMS_Alive Disconnections.Disconnections_U.BrakeSensor_Bits Disconnections.Disconnections_U.Dash_Alive Disconnections.Disconnections_U.Gyroscope_F Disconnections.Disconnections_U.Gyroscope_R Disconnections.Disconnections_U.LV_Derivation_Alive Disconnections.Disconnections_U.Shutdown_Alive Disconnections.Disconnections_U.SteeringSensor_Bits Disconnections.Disconnections_U.Susp_F_L_Bits Disconnections.Disconnections_U.Susp_F_R_Bits Disconnections.Disconnections_U.Susp_R_L_Bits Disconnections.Disconnections_U.Susp_R_R_Bits Disconnections.Disconnections_Y.CounterOut Disconnections.Disconnections_Y.CriticalDisconnection Disconnections.Disconnections_Y.Critical_CAN_Disconnection Disconnections.Disconnections_Y.Critical_Signal_Disconnection Disconnections.Disconnections_Y.Disconnection_ADCAN Disconnections.Disconnections_Y.Disconnection_APPS1 Disconnections.Disconnections_Y.Disconnection_APPS2 Disconnections.Disconnections_Y.Disconnection_Accel_F Disconnections.Disconnections_Y.Disconnection_Accel_R Disconnections.Disconnections_Y.Disconnection_BMS Disconnections.Disconnections_Y.Disconnection_Brake_Sensor Disconnections.Disconnections_Y.Disconnection_DashBoard Disconnections.Disconnections_Y.Disconnection_Gyroscope_F Disconnections.Disconnections_Y.Disconnection_Gyroscope_R Disconnections.Disconnections_Y.Disconnection_LV_Derivation Disconnections.Disconnections_Y.Disconnection_Shutdown Disconnections.Disconnections_Y.Disconnection_SteeringSensor Disconnections.Disconnections_Y.Disconnection_Susp_F_L Disconnections.Disconnections_Y.Disconnection_Susp_F_R Disconnections.Disconnections_Y.Disconnection_Susp_R_L Disconnections.Disconnections_Y.Disconnection_Susp_R_R Disconnections.Disconnections_Y.TV_mode /end REF_MEASUREMENT
 /begin REF_CHARACTERISTIC Disconnections.Disconnections_P.Constant_Value Disconnections.Disconnections_P.Constant_Value_c Disconnections.Disconnections_P.Constant_Value_d Disconnections.Disconnections_P.Constant_Value_e Disconnections.Disconnections_P.Constant_Value_h Disconnections.Disconnections_P.Constant_Value_i Disconnections.Disconnections_P.Constant_Value_ic Disconnections.Disconnections_P.Constant_Value_j Disconnections.Disconnections_P.Constant_Value_l Disconnections.Disconnections_P.Constant_Value_m Disconnections.Disconnections_P.Constant_Value_o Disconnections.Disconnections_P.DataStoreMemory1_InitialValue Disconnections.Disconnections_P.DataStoreMemory1_InitialValue_b Disconnections.Disconnections_P.DataStoreMemory1_InitialValue_c Disconnections.Disconnections_P.DataStoreMemory1_InitialValue_d Disconnections.Disconnections_P.DataStoreMemory1_InitialValue_m Disconnections.Disconnections_P.DataStoreMemory_InitialValue Disconnections.Disconnections_P.DataStoreMemory_InitialValue_b Disconnections.Disconnections_P.DataStoreMemory_InitialValue_ba Disconnections.Disconnections_P.DataStoreMemory_InitialValue_c Disconnections.Disconnections_P.DataStoreMemory_InitialValue_d Disconnections.Disconnections_P.DataStoreMemory_InitialValue_f Disconnections.Disconnections_P.DataStoreMemory_InitialValue_j Disconnections.Disconnections_P.DataStoreMemory_InitialValue_jc Disconnections.Disconnections_P.DataStoreMemory_InitialValue_k Disconnections.Disconnections_P.DataStoreMemory_InitialValue_kg Disconnections.Disconnections_P.DataStoreMemory_InitialValue_ks Disconnections.Disconnections_P.DataStoreMemory_InitialValue_m Disconnections.Disconnections_P.DataStoreMemory_InitialValue_o Disconnections.Disconnections_P.Merge_InitialOutput Disconnections.Disconnections_P.Merge_InitialOutput_a Disconnections.Disconnections_P.Merge_InitialOutput_b Disconnections.Disconnections_P.Merge_InitialOutput_l Disconnections.Disconnections_P.Merge_InitialOutput_m Disconnections.Disconnections_P.Merge_InitialOutput_o Disconnections.Disconnections_P.Merge_InitialOutput_p /end REF_CHARACTERISTIC
 /begin SUB_GROUP Disconnections.Disconnections_B Disconnections.Disconnections_DW Disconnections.Disconnections_U Disconnections.Disconnections_Y Disconnections.Disconnections_P /end SUB_GROUP
/end GROUP
/begin GROUP Disconnections.Disconnections_B ""
 /begin REF_MEASUREMENT Disconnections.Disconnections_B.Merge Disconnections.Disconnections_B.Merge_b Disconnections.Disconnections_B.Merge_d Disconnections.Disconnections_B.Merge_f Disconnections.Disconnections_B.Merge_h Disconnections.Disconnections_B.Merge_he Disconnections.Disconnections_B.Merge_j /end REF_MEASUREMENT
/end GROUP
/begin GROUP Disconnections.Disconnections_DW ""
 /begin REF_MEASUREMENT Disconnections.Disconnections_DW.A Disconnections.Disconnections_DW.Last_alive Disconnections.Disconnections_DW.Last_alive_a Disconnections.Disconnections_DW.Last_alive_ar Disconnections.Disconnections_DW.Last_alive_c Disconnections.Disconnections_DW.Last_alive_c0 Disconnections.Disconnections_DW.Last_alive_g Disconnections.Disconnections_DW.Last_alive_gx Disconnections.Disconnections_DW.Last_alive_j Disconnections.Disconnections_DW.Last_alive_je Disconnections.Disconnections_DW.Last_alive_l Disconnections.Disconnections_DW.Last_alive_m Disconnections.Disconnections_DW.Last_alive_o Disconnections.Disconnections_DW.Tot_Errors Disconnections.Disconnections_DW.Tot_Errors_h Disconnections.Disconnections_DW.Tot_Errors_j Disconnections.Disconnections_DW.Tot_Errors_k Disconnections.Disconnections_DW.Tot_Errors_m /end REF_MEASUREMENT
/end GROUP
/begin GROUP Disconnections.Disconnections_U ""
 /begin REF_MEASUREMENT Disconnections.Disconnections_U.ADCAN_Alive Disconnections.Disconnections_U.APPS1_Bits Disconnections.Disconnections_U.APPS2_Bits Disconnections.Disconnections_U.Accel_F_Alive Disconnections.Disconnections_U.Accel_R_Alive Disconnections.Disconnections_U.BMS_Alive Disconnections.Disconnections_U.BrakeSensor_Bits Disconnections.Disconnections_U.Dash_Alive Disconnections.Disconnections_U.Gyroscope_F Disconnections.Disconnections_U.Gyroscope_R Disconnections.Disconnections_U.LV_Derivation_Alive Disconnections.Disconnections_U.Shutdown_Alive Disconnections.Disconnections_U.SteeringSensor_Bits Disconnections.Disconnections_U.Susp_F_L_Bits Disconnections.Disconnections_U.Susp_F_R_Bits Disconnections.Disconnections_U.Susp_R_L_Bits Disconnections.Disconnections_U.Susp_R_R_Bits /end REF_MEASUREMENT
/end GROUP
/begin GROUP Disconnections.Disconnections_Y ""
 /begin REF_MEASUREMENT Disconnections.Disconnections_Y.CounterOut Disconnections.Disconnections_Y.CriticalDisconnection Disconnections.Disconnections_Y.Critical_CAN_Disconnection Disconnections.Disconnections_Y.Critical_Signal_Disconnection Disconnections.Disconnections_Y.Disconnection_ADCAN Disconnections.Disconnections_Y.Disconnection_APPS1 Disconnections.Disconnections_Y.Disconnection_APPS2 Disconnections.Disconnections_Y.Disconnection_Accel_F Disconnections.Disconnections_Y.Disconnection_Accel_R Disconnections.Disconnections_Y.Disconnection_BMS Disconnections.Disconnections_Y.Disconnection_Brake_Sensor Disconnections.Disconnections_Y.Disconnection_DashBoard Disconnections.Disconnections_Y.Disconnection_Gyroscope_F Disconnections.Disconnections_Y.Disconnection_Gyroscope_R Disconnections.Disconnections_Y.Disconnection_LV_Derivation Disconnections.Disconnections_Y.Disconnection_Shutdown Disconnections.Disconnections_Y.Disconnection_SteeringSensor Disconnections.Disconnections_Y.Disconnection_Susp_F_L Disconnections.Disconnections_Y.Disconnection_Susp_F_R Disconnections.Disconnections_Y.Disconnection_Susp_R_L Disconnections.Disconnections_Y.Disconnection_Susp_R_R Disconnections.Disconnections_Y.TV_mode /end REF_MEASUREMENT
/end GROUP
/begin GROUP Disconnections.Disconnections_P ""
 /begin REF_CHARACTERISTIC Disconnections.Disconnections_P.Constant_Value Disconnections.Disconnections_P.Constant_Value_c Disconnections.Disconnections_P.Constant_Value_d Disconnections.Disconnections_P.Constant_Value_e Disconnections.Disconnections_P.Constant_Value_h Disconnections.Disconnections_P.Constant_Value_i Disconnections.Disconnections_P.Constant_Value_ic Disconnections.Disconnections_P.Constant_Value_j Disconnections.Disconnections_P.Constant_Value_l Disconnections.Disconnections_P.Constant_Value_m Disconnections.Disconnections_P.Constant_Value_o Disconnections.Disconnections_P.DataStoreMemory1_InitialValue Disconnections.Disconnections_P.DataStoreMemory1_InitialValue_b Disconnections.Disconnections_P.DataStoreMemory1_InitialValue_c Disconnections.Disconnections_P.DataStoreMemory1_InitialValue_d Disconnections.Disconnections_P.DataStoreMemory1_InitialValue_m Disconnections.Disconnections_P.DataStoreMemory_InitialValue Disconnections.Disconnections_P.DataStoreMemory_InitialValue_b Disconnections.Disconnections_P.DataStoreMemory_InitialValue_ba Disconnections.Disconnections_P.DataStoreMemory_InitialValue_c Disconnections.Disconnections_P.DataStoreMemory_InitialValue_d Disconnections.Disconnections_P.DataStoreMemory_InitialValue_f Disconnections.Disconnections_P.DataStoreMemory_InitialValue_j Disconnections.Disconnections_P.DataStoreMemory_InitialValue_jc Disconnections.Disconnections_P.DataStoreMemory_InitialValue_k Disconnections.Disconnections_P.DataStoreMemory_InitialValue_kg Disconnections.Disconnections_P.DataStoreMemory_InitialValue_ks Disconnections.Disconnections_P.DataStoreMemory_InitialValue_m Disconnections.Disconnections_P.DataStoreMemory_InitialValue_o Disconnections.Disconnections_P.Merge_InitialOutput Disconnections.Disconnections_P.Merge_InitialOutput_a Disconnections.Disconnections_P.Merge_InitialOutput_b Disconnections.Disconnections_P.Merge_InitialOutput_l Disconnections.Disconnections_P.Merge_InitialOutput_m Disconnections.Disconnections_P.Merge_InitialOutput_o Disconnections.Disconnections_P.Merge_InitialOutput_p /end REF_CHARACTERISTIC
/end GROUP
/begin GROUP Inverters_Action "" ROOT
 /begin REF_MEASUREMENT Inverters_Action.Inverters_Action_B.Merge Inverters_Action.Inverters_Action_B.Merge2 Inverters_Action.Inverters_Action_B.Merge2_p Inverters_Action.Inverters_Action_B.subscribed Inverters_Action.Inverters_Action_B.subscribed_b Inverters_Action.Inverters_Action_DW.EnumerationCounter Inverters_Action.Inverters_Action_DW.EnumerationCounter_m Inverters_Action.Inverters_Action_DW.LastAction Inverters_Action.Inverters_Action_DW.LastAction_k Inverters_Action.Inverters_Action_U.InvertersAction Inverters_Action.Inverters_Action_U.current_L Inverters_Action.Inverters_Action_U.current_R Inverters_Action.Inverters_Action_Y.Inverter_L_RegID Inverters_Action.Inverters_Action_Y.Inverter_L_b15tob8 Inverters_Action.Inverters_Action_Y.Inverter_L_b7tob0 Inverters_Action.Inverters_Action_Y.Inverter_R_RegID Inverters_Action.Inverters_Action_Y.Inverter_R_b15tob8 Inverters_Action.Inverters_Action_Y.Inverter_R_b7tob0 Inverters_Action.Inverters_Action_Y.InvertersSubscribed /end REF_MEASUREMENT
 /begin REF_CHARACTERISTIC Inverters_Action.Inverters_Action_P.Constant_Value Inverters_Action.Inverters_Action_P.Constant_Value_m Inverters_Action.Inverters_Action_P.DataStoreMemory1_InitialValue Inverters_Action.Inverters_Action_P.DataStoreMemory1_InitialValue_m Inverters_Action.Inverters_Action_P.DataStoreMemory2_InitialValue Inverters_Action.Inverters_Action_P.DataStoreMemory2_InitialValue_c Inverters_Action.Inverters_Action_P.Delay_DelayLength Inverters_Action.Inverters_Action_P.Delay_DelayLength_h Inverters_Action.Inverters_Action_P.Delay_InitialCondition Inverters_Action.Inverters_Action_P.Delay_InitialCondition_o Inverters_Action.Inverters_Action_P.Merge_InitialOutput Inverters_Action.Inverters_Action_P.TimeInterval_Value Inverters_Action.Inverters_Action_P.TimeInterval_Value_d Inverters_Action.Inverters_Action_P._Value Inverters_Action.Inverters_Action_P.subscribed_InitialOutput Inverters_Action.Inverters_Action_P.subscribed_InitialOutput_k Inverters_Action.Inverters_Action_P.u_Value /end REF_CHARACTERISTIC
 /begin SUB_GROUP Inverters_Action.Inverters_Action_B Inverters_Action.Inverters_Action_DW Inverters_Action.Inverters_Action_U Inverters_Action.Inverters_Action_Y Inverters_Action.Inverters_Action_P /end SUB_GROUP
/end GROUP
/begin GROUP Inverters_Action.Inverters_Action_B ""
 /begin REF_MEASUREMENT Inverters_Action.Inverters_Action_B.Merge Inverters_Action.Inverters_Action_B.Merge2 Inverters_Action.Inverters_Action_B.Merge2_p Inverters_Action.Inverters_Action_B.subscribed Inverters_Action.Inverters_Action_B.subscribed_b /end REF_MEASUREMENT
/end GROUP
/begin GROUP Inverters_Action.Inverters_Action_DW ""
 /begin REF_MEASUREMENT Inverters_Action.Inverters_Action_DW.EnumerationCounter Inverters_Action.Inverters_Action_DW.EnumerationCounter_m Inverters_Action.Inverters_Action_DW.LastAction Inverters_Action.Inverters_Action_DW.LastAction_k /end REF_MEASUREMENT
/end GROUP
/begin GROUP Inverters_Action.Inverters_Action_U ""
 /begin REF_MEASUREMENT Inverters_Action.Inverters_Action_U.InvertersAction Inverters_Action.Inverters_Action_U.current_L Inverters_Action.Inverters_Action_U.current_R /end REF_MEASUREMENT
/end GROUP
/begin GROUP Inverters_Action.Inverters_Action_Y ""
 /begin REF_MEASUREMENT Inverters_Action.Inverters_Action_Y.Inverter_L_RegID Inverters_Action.Inverters_Action_Y.Inverter_L_b15tob8 Inverters_Action.Inverters_Action_Y.Inverter_L_b7tob0 Inverters_Action.Inverters_Action_Y.Inverter_R_RegID Inverters_Action.Inverters_Action_Y.Inverter_R_b15tob8 Inverters_Action.Inverters_Action_Y.Inverter_R_b7tob0 Inverters_Action.Inverters_Action_Y.InvertersSubscribed /end REF_MEASUREMENT
/end GROUP
/begin GROUP Inverters_Action.Inverters_Action_P ""
 /begin REF_CHARACTERISTIC Inverters_Action.Inverters_Action_P.Constant_Value Inverters_Action.Inverters_Action_P.Constant_Value_m Inverters_Action.Inverters_Action_P.DataStoreMemory1_InitialValue Inverters_Action.Inverters_Action_P.DataStoreMemory1_InitialValue_m Inverters_Action.Inverters_Action_P.DataStoreMemory2_InitialValue Inverters_Action.Inverters_Action_P.DataStoreMemory2_InitialValue_c Inverters_Action.Inverters_Action_P.Delay_DelayLength Inverters_Action.Inverters_Action_P.Delay_DelayLength_h Inverters_Action.Inverters_Action_P.Delay_InitialCondition Inverters_Action.Inverters_Action_P.Delay_InitialCondition_o Inverters_Action.Inverters_Action_P.Merge_InitialOutput Inverters_Action.Inverters_Action_P.TimeInterval_Value Inverters_Action.Inverters_Action_P.TimeInterval_Value_d Inverters_Action.Inverters_Action_P._Value Inverters_Action.Inverters_Action_P.subscribed_InitialOutput Inverters_Action.Inverters_Action_P.subscribed_InitialOutput_k Inverters_Action.Inverters_Action_P.u_Value /end REF_CHARACTERISTIC
/end GROUP
/begin GROUP Inverters_Data "" ROOT
 /begin REF_MEASUREMENT Inverters_Data.Inverters_Data_U.Inv_L_RegID_M235_Inv_L_DCBus Inverters_Data.Inverters_Data_U.Inv_L_RegID_M32_Inv_L_Iactual Inverters_Data.Inverters_Data_U.Inv_L_RegID_M38_Inv_L_Icommand Inverters_Data.Inverters_Data_U.Inv_L_RegID_M39_Inv_L_Iq Inverters_Data.Inverters_Data_U.Inv_L_RegID_M48_Inv_L_Speed Inverters_Data.Inverters_Data_U.Inv_L_RegID_M73_Inv_L_TempMotor Inverters_Data.Inverters_Data_U.Inv_L_RegID_M74_Inv_L_TempIGBT Inverters_Data.Inverters_Data_U.Inv_R_RegID_M235_Inv_R_DCBus Inverters_Data.Inverters_Data_U.Inv_R_RegID_M32_Inv_R_Iactual Inverters_Data.Inverters_Data_U.Inv_R_RegID_M38_Inv_R_Icommand Inverters_Data.Inverters_Data_U.Inv_R_RegID_M39_Inv_R_Iq Inverters_Data.Inverters_Data_U.Inv_R_RegID_M48_Inv_R_Speed Inverters_Data.Inverters_Data_U.Inv_R_RegID_M73_Inv_R_TempMotor Inverters_Data.Inverters_Data_U.Inv_R_RegID_M74_Inv_R_TempIGBT Inverters_Data.Inverters_Data_U.Torque_L Inverters_Data.Inverters_Data_U.Torque_R Inverters_Data.Inverters_Data_Y.Inv_L_Iactual Inverters_Data.Inverters_Data_Y.Inv_L_Icommand Inverters_Data.Inverters_Data_Y.Inv_L_Iq Inverters_Data.Inverters_Data_Y.Inv_L_Speed Inverters_Data.Inverters_Data_Y.Inv_L_TempIGBT Inverters_Data.Inverters_Data_Y.Inv_L_TempMotor Inverters_Data.Inverters_Data_Y.Inv_L_VdcBus Inverters_Data.Inverters_Data_Y.Inv_R_Iactual Inverters_Data.Inverters_Data_Y.Inv_R_Icommand Inverters_Data.Inverters_Data_Y.Inv_R_Iq Inverters_Data.Inverters_Data_Y.Inv_R_Speed Inverters_Data.Inverters_Data_Y.Inv_R_TempIGBT Inverters_Data.Inverters_Data_Y.Inv_R_TempMotor Inverters_Data.Inverters_Data_Y.Inv_R_VdcBus Inverters_Data.Inverters_Data_Y.InvertersMinDCBus Inverters_Data.Inverters_Data_Y.Mech_Power Inverters_Data.Inverters_Data_Y.RL_rads Inverters_Data.Inverters_Data_Y.RR_rads Inverters_Data.Inverters_Data_Y.Speed Inverters_Data.Inverters_Data_Y.Temp_IGBT Inverters_Data.Inverters_Data_Y.Temp_Motors Inverters_Data.Inverters_Data_Y.Vel_RL_kmh Inverters_Data.Inverters_Data_Y.Vel_RR_kmh /end REF_MEASUREMENT
 /begin REF_CHARACTERISTIC Inverters_Data.Inverters_Data_P.A1_Value Inverters_Data.Inverters_Data_P.A1_Value_e Inverters_Data.Inverters_Data_P.B1_Value Inverters_Data.Inverters_Data_P.B1_Value_i Inverters_Data.Inverters_Data_P.Bitct_Value Inverters_Data.Inverters_Data_P.Bitct_Value_h Inverters_Data.Inverters_Data_P.C1_Value Inverters_Data.Inverters_Data_P.C1_Value_d Inverters_Data.Inverters_Data_P.C1_Value_n Inverters_Data.Inverters_Data_P.C1_Value_n0 Inverters_Data.Inverters_Data_P.Constant1_Value Inverters_Data.Inverters_Data_P.Constant1_Value_e Inverters_Data.Inverters_Data_P.D1_Value Inverters_Data.Inverters_Data_P.D1_Value_d Inverters_Data.Inverters_Data_P.D1_Value_f Inverters_Data.Inverters_Data_P.D1_Value_j Inverters_Data.Inverters_Data_P.Diameterm_Gain Inverters_Data.Inverters_Data_P.Diameterm_Gain_p Inverters_Data.Inverters_Data_P.Gain_Gain Inverters_Data.Inverters_Data_P.Gain_Gain_a Inverters_Data.Inverters_Data_P.Gain_Gain_e Inverters_Data.Inverters_Data_P.Gain_Gain_f Inverters_Data.Inverters_Data_P.Gain_Gain_m Inverters_Data.Inverters_Data_P.MaxRPM_Value Inverters_Data.Inverters_Data_P.MaxRPM_Value_m Inverters_Data.Inverters_Data_P.conversionratio1_Gain Inverters_Data.Inverters_Data_P.conversionratio_Gain Inverters_Data.Inverters_Data_P.conversionratio_Gain_c Inverters_Data.Inverters_Data_P.conversionratio_Gain_j Inverters_Data.Inverters_Data_P.conversionratio_Gain_k Inverters_Data.Inverters_Data_P.conversionratio_Gain_o Inverters_Data.Inverters_Data_P.direction_Gain Inverters_Data.Inverters_Data_P.direction_Gain_f Inverters_Data.Inverters_Data_P.ratio_Gain Inverters_Data.Inverters_Data_P.ratio_Gain_k Inverters_Data.Inverters_Data_P.upi60_Gain Inverters_Data.Inverters_Data_P.upi60_Gain_i /end REF_CHARACTERISTIC
 /begin SUB_GROUP Inverters_Data.Inverters_Data_U Inverters_Data.Inverters_Data_Y Inverters_Data.Inverters_Data_P /end SUB_GROUP
/end GROUP
/begin GROUP Inverters_Data.Inverters_Data_U ""
 /begin REF_MEASUREMENT Inverters_Data.Inverters_Data_U.Inv_L_RegID_M235_Inv_L_DCBus Inverters_Data.Inverters_Data_U.Inv_L_RegID_M32_Inv_L_Iactual Inverters_Data.Inverters_Data_U.Inv_L_RegID_M38_Inv_L_Icommand Inverters_Data.Inverters_Data_U.Inv_L_RegID_M39_Inv_L_Iq Inverters_Data.Inverters_Data_U.Inv_L_RegID_M48_Inv_L_Speed Inverters_Data.Inverters_Data_U.Inv_L_RegID_M73_Inv_L_TempMotor Inverters_Data.Inverters_Data_U.Inv_L_RegID_M74_Inv_L_TempIGBT Inverters_Data.Inverters_Data_U.Inv_R_RegID_M235_Inv_R_DCBus Inverters_Data.Inverters_Data_U.Inv_R_RegID_M32_Inv_R_Iactual Inverters_Data.Inverters_Data_U.Inv_R_RegID_M38_Inv_R_Icommand Inverters_Data.Inverters_Data_U.Inv_R_RegID_M39_Inv_R_Iq Inverters_Data.Inverters_Data_U.Inv_R_RegID_M48_Inv_R_Speed Inverters_Data.Inverters_Data_U.Inv_R_RegID_M73_Inv_R_TempMotor Inverters_Data.Inverters_Data_U.Inv_R_RegID_M74_Inv_R_TempIGBT Inverters_Data.Inverters_Data_U.Torque_L Inverters_Data.Inverters_Data_U.Torque_R /end REF_MEASUREMENT
/end GROUP
/begin GROUP Inverters_Data.Inverters_Data_Y ""
 /begin REF_MEASUREMENT Inverters_Data.Inverters_Data_Y.Inv_L_Iactual Inverters_Data.Inverters_Data_Y.Inv_L_Icommand Inverters_Data.Inverters_Data_Y.Inv_L_Iq Inverters_Data.Inverters_Data_Y.Inv_L_Speed Inverters_Data.Inverters_Data_Y.Inv_L_TempIGBT Inverters_Data.Inverters_Data_Y.Inv_L_TempMotor Inverters_Data.Inverters_Data_Y.Inv_L_VdcBus Inverters_Data.Inverters_Data_Y.Inv_R_Iactual Inverters_Data.Inverters_Data_Y.Inv_R_Icommand Inverters_Data.Inverters_Data_Y.Inv_R_Iq Inverters_Data.Inverters_Data_Y.Inv_R_Speed Inverters_Data.Inverters_Data_Y.Inv_R_TempIGBT Inverters_Data.Inverters_Data_Y.Inv_R_TempMotor Inverters_Data.Inverters_Data_Y.Inv_R_VdcBus Inverters_Data.Inverters_Data_Y.InvertersMinDCBus Inverters_Data.Inverters_Data_Y.Mech_Power Inverters_Data.Inverters_Data_Y.RL_rads Inverters_Data.Inverters_Data_Y.RR_rads Inverters_Data.Inverters_Data_Y.Speed Inverters_Data.Inverters_Data_Y.Temp_IGBT Inverters_Data.Inverters_Data_Y.Temp_Motors Inverters_Data.Inverters_Data_Y.Vel_RL_kmh Inverters_Data.Inverters_Data_Y.Vel_RR_kmh /end REF_MEASUREMENT
/end GROUP
/begin GROUP Inverters_Data.Inverters_Data_P ""
 /begin REF_CHARACTERISTIC Inverters_Data.Inverters_Data_P.A1_Value Inverters_Data.Inverters_Data_P.A1_Value_e Inverters_Data.Inverters_Data_P.B1_Value Inverters_Data.Inverters_Data_P.B1_Value_i Inverters_Data.Inverters_Data_P.Bitct_Value Inverters_Data.Inverters_Data_P.Bitct_Value_h Inverters_Data.Inverters_Data_P.C1_Value Inverters_Data.Inverters_Data_P.C1_Value_d Inverters_Data.Inverters_Data_P.C1_Value_n Inverters_Data.Inverters_Data_P.C1_Value_n0 Inverters_Data.Inverters_Data_P.Constant1_Value Inverters_Data.Inverters_Data_P.Constant1_Value_e Inverters_Data.Inverters_Data_P.D1_Value Inverters_Data.Inverters_Data_P.D1_Value_d Inverters_Data.Inverters_Data_P.D1_Value_f Inverters_Data.Inverters_Data_P.D1_Value_j Inverters_Data.Inverters_Data_P.Diameterm_Gain Inverters_Data.Inverters_Data_P.Diameterm_Gain_p Inverters_Data.Inverters_Data_P.Gain_Gain Inverters_Data.Inverters_Data_P.Gain_Gain_a Inverters_Data.Inverters_Data_P.Gain_Gain_e Inverters_Data.Inverters_Data_P.Gain_Gain_f Inverters_Data.Inverters_Data_P.Gain_Gain_m Inverters_Data.Inverters_Data_P.MaxRPM_Value Inverters_Data.Inverters_Data_P.MaxRPM_Value_m Inverters_Data.Inverters_Data_P.conversionratio1_Gain Inverters_Data.Inverters_Data_P.conversionratio_Gain Inverters_Data.Inverters_Data_P.conversionratio_Gain_c Inverters_Data.Inverters_Data_P.conversionratio_Gain_j Inverters_Data.Inverters_Data_P.conversionratio_Gain_k Inverters_Data.Inverters_Data_P.conversionratio_Gain_o Inverters_Data.Inverters_Data_P.direction_Gain Inverters_Data.Inverters_Data_P.direction_Gain_f Inverters_Data.Inverters_Data_P.ratio_Gain Inverters_Data.Inverters_Data_P.ratio_Gain_k Inverters_Data.Inverters_Data_P.upi60_Gain Inverters_Data.Inverters_Data_P.upi60_Gain_i /end REF_CHARACTERISTIC
/end GROUP
/begin GROUP LVD_Data "" ROOT
 /begin REF_MEASUREMENT LVD_Data.LVD_Data_DW.Previous_IN LVD_Data.LVD_Data_DW.Previous_OUT LVD_Data.LVD_Data_U.LVBattery_Voltage_Bits LVD_Data.LVD_Data_Y.LVbattery_Voltage /end REF_MEASUREMENT
 /begin REF_CHARACTERISTIC LVD_Data.LVD_Data_P.DataStoreMemory1_InitialValue LVD_Data.LVD_Data_P.DataStoreMemory_InitialValue LVD_Data.LVD_Data_P.MaxBits2_Value LVD_Data.LVD_Data_P.MaxBits_Value LVD_Data.LVD_Data_P.Vmax_Value LVD_Data.LVD_Data_P.Vmin_Value LVD_Data.LVD_Data_P.ct_Value LVD_Data.LVD_Data_P.exptcycletau1_Value /end REF_CHARACTERISTIC
 /begin SUB_GROUP LVD_Data.LVD_Data_DW LVD_Data.LVD_Data_U LVD_Data.LVD_Data_Y LVD_Data.LVD_Data_P /end SUB_GROUP
/end GROUP
/begin GROUP LVD_Data.LVD_Data_DW ""
 /begin REF_MEASUREMENT LVD_Data.LVD_Data_DW.Previous_IN LVD_Data.LVD_Data_DW.Previous_OUT /end REF_MEASUREMENT
/end GROUP
/begin GROUP LVD_Data.LVD_Data_U "" /begin REF_MEASUREMENT LVD_Data.LVD_Data_U.LVBattery_Voltage_Bits /end REF_MEASUREMENT /end GROUP
/begin GROUP LVD_Data.LVD_Data_Y "" /begin REF_MEASUREMENT LVD_Data.LVD_Data_Y.LVbattery_Voltage /end REF_MEASUREMENT /end GROUP
/begin GROUP LVD_Data.LVD_Data_P ""
 /begin REF_CHARACTERISTIC LVD_Data.LVD_Data_P.DataStoreMemory1_InitialValue LVD_Data.LVD_Data_P.DataStoreMemory_InitialValue LVD_Data.LVD_Data_P.MaxBits2_Value LVD_Data.LVD_Data_P.MaxBits_Value LVD_Data.LVD_Data_P.Vmax_Value LVD_Data.LVD_Data_P.Vmin_Value LVD_Data.LVD_Data_P.ct_Value LVD_Data.LVD_Data_P.exptcycletau1_Value /end REF_CHARACTERISTIC
/end GROUP
/begin GROUP Pedals_Susp_Sensors "" ROOT
 /begin REF_MEASUREMENT Pedals_Susp_Sensors.Pedals_Susp_Sensors_B.bitsmax Pedals_Susp_Sensors.Pedals_Susp_Sensors_B.bitsmax_n Pedals_Susp_Sensors.Pedals_Susp_Sensors_B.bitsmax_o Pedals_Susp_Sensors.Pedals_Susp_Sensors_B.bitsmax_p Pedals_Susp_Sensors.Pedals_Susp_Sensors_B.sf_MATLABFunction.ZeroExperimental Pedals_Susp_Sensors.Pedals_Susp_Sensors_B.sf_MATLABFunction_b.ZeroExperimental Pedals_Susp_Sensors.Pedals_Susp_Sensors_B.sf_MATLABFunction_h.ZeroExperimental Pedals_Susp_Sensors.Pedals_Susp_Sensors_B.sf_MATLABFunction_k.ZeroExperimental Pedals_Susp_Sensors.Pedals_Susp_Sensors_DW.Z_E Pedals_Susp_Sensors.Pedals_Susp_Sensors_DW.Z_E_d Pedals_Susp_Sensors.Pedals_Susp_Sensors_DW.Z_E_h Pedals_Susp_Sensors.Pedals_Susp_Sensors_DW.Z_E_p Pedals_Susp_Sensors.Pedals_Susp_Sensors_U.APPS1_Bits Pedals_Susp_Sensors.Pedals_Susp_Sensors_U.APPS2_Bits Pedals_Susp_Sensors.Pedals_Susp_Sensors_U.BrakeSensor_Bits Pedals_Susp_Sensors.Pedals_Susp_Sensors_U.Susp_F_L_Bits Pedals_Susp_Sensors.Pedals_Susp_Sensors_U.Susp_F_R_Bits Pedals_Susp_Sensors.Pedals_Susp_Sensors_U.Susp_R_L_Bits Pedals_Susp_Sensors.Pedals_Susp_Sensors_U.Susp_R_R_Bits Pedals_Susp_Sensors.Pedals_Susp_Sensors_Y.APPS1_Value Pedals_Susp_Sensors.Pedals_Susp_Sensors_Y.APPS2_Value Pedals_Susp_Sensors.Pedals_Susp_Sensors_Y.BrakeLight_Control Pedals_Susp_Sensors.Pedals_Susp_Sensors_Y.BrakeSensor_Value Pedals_Susp_Sensors.Pedals_Susp_Sensors_Y.SUSP_F_L Pedals_Susp_Sensors.Pedals_Susp_Sensors_Y.SUSP_F_R Pedals_Susp_Sensors.Pedals_Susp_Sensors_Y.SUSP_R_L Pedals_Susp_Sensors.Pedals_Susp_Sensors_Y.SUSP_R_R /end REF_MEASUREMENT
 /begin REF_CHARACTERISTIC Pedals_Susp_Sensors.Pedals_Susp_Sensors_P.Brake_Light_Threshold_Value Pedals_Susp_Sensors.Pedals_Susp_Sensors_P.Ctemuelles_Gain Pedals_Susp_Sensors.Pedals_Susp_Sensors_P.Ctemuelles_Gain_a Pedals_Susp_Sensors.Pedals_Susp_Sensors_P.Ctemuelles_Gain_e Pedals_Susp_Sensors.Pedals_Susp_Sensors_P.Ctemuelles_Gain_g Pedals_Susp_Sensors.Pedals_Susp_Sensors_P.DataStoreMemory_InitialValue Pedals_Susp_Sensors.Pedals_Susp_Sensors_P.DataStoreMemory_InitialValue_b Pedals_Susp_Sensors.Pedals_Susp_Sensors_P.DataStoreMemory_InitialValue_l Pedals_Susp_Sensors.Pedals_Susp_Sensors_P.DataStoreMemory_InitialValue_m Pedals_Susp_Sensors.Pedals_Susp_Sensors_P.Ltotal_Gain Pedals_Susp_Sensors.Pedals_Susp_Sensors_P.Ltotal_Gain_c Pedals_Susp_Sensors.Pedals_Susp_Sensors_P.Ltotal_Gain_h Pedals_Susp_Sensors.Pedals_Susp_Sensors_P.Ltotal_Gain_j Pedals_Susp_Sensors.Pedals_Susp_Sensors_P.ON_Value Pedals_Susp_Sensors.Pedals_Susp_Sensors_P.Off_Value Pedals_Susp_Sensors.Pedals_Susp_Sensors_P.bitsmax_Value Pedals_Susp_Sensors.Pedals_Susp_Sensors_P.bitsmax_Value_b Pedals_Susp_Sensors.Pedals_Susp_Sensors_P.bitsmax_Value_e Pedals_Susp_Sensors.Pedals_Susp_Sensors_P.bitsmax_Value_o Pedals_Susp_Sensors.Pedals_Susp_Sensors_P.max_Value Pedals_Susp_Sensors.Pedals_Susp_Sensors_P.max_Value_a Pedals_Susp_Sensors.Pedals_Susp_Sensors_P.max_Value_f Pedals_Susp_Sensors.Pedals_Susp_Sensors_P.min_Value Pedals_Susp_Sensors.Pedals_Susp_Sensors_P.min_Value_a Pedals_Susp_Sensors.Pedals_Susp_Sensors_P.min_Value_g /end REF_CHARACTERISTIC
 /begin SUB_GROUP Pedals_Susp_Sensors.Pedals_Susp_Sensors_B Pedals_Susp_Sensors.Pedals_Susp_Sensors_B.sf_MATLABFunction Pedals_Susp_Sensors.Pedals_Susp_Sensors_B.sf_MATLABFunction_b Pedals_Susp_Sensors.Pedals_Susp_Sensors_B.sf_MATLABFunction_h Pedals_Susp_Sensors.Pedals_Susp_Sensors_B.sf_MATLABFunction_k Pedals_Susp_Sensors.Pedals_Susp_Sensors_DW Pedals_Susp_Sensors.Pedals_Susp_Sensors_U Pedals_Susp_Sensors.Pedals_Susp_Sensors_Y Pedals_Susp_Sensors.Pedals_Susp_Sensors_P /end SUB_GROUP
/end GROUP
/begin GROUP Pedals_Susp_Sensors.Pedals_Susp_Sensors_B ""
 /begin REF_MEASUREMENT Pedals_Susp_Sensors.Pedals_Susp_Sensors_B.bitsmax Pedals_Susp_Sensors.Pedals_Susp_Sensors_B.bitsmax_n Pedals_Susp_Sensors.Pedals_Susp_Sensors_B.bitsmax_o Pedals_Susp_Sensors.Pedals_Susp_Sensors_B.bitsmax_p Pedals_Susp_Sensors.Pedals_Susp_Sensors_B.sf_MATLABFunction.ZeroExperimental Pedals_Susp_Sensors.Pedals_Susp_Sensors_B.sf_MATLABFunction_b.ZeroExperimental Pedals_Susp_Sensors.Pedals_Susp_Sensors_B.sf_MATLABFunction_h.ZeroExperimental Pedals_Susp_Sensors.Pedals_Susp_Sensors_B.sf_MATLABFunction_k.ZeroExperimental /end REF_MEASUREMENT
/end GROUP
/begin GROUP Pedals_Susp_Sensors.Pedals_Susp_Sensors_B.sf_MATLABFunction ""
 /begin REF_MEASUREMENT Pedals_Susp_Sensors.Pedals_Susp_Sensors_B.sf_MATLABFunction.ZeroExperimental /end REF_MEASUREMENT
/end GROUP
/begin GROUP Pedals_Susp_Sensors.Pedals_Susp_Sensors_B.sf_MATLABFunction_b ""
 /begin REF_MEASUREMENT Pedals_Susp_Sensors.Pedals_Susp_Sensors_B.sf_MATLABFunction_b.ZeroExperimental /end REF_MEASUREMENT
/end GROUP
/begin GROUP Pedals_Susp_Sensors.Pedals_Susp_Sensors_B.sf_MATLABFunction_h ""
 /begin REF_MEASUREMENT Pedals_Susp_Sensors.Pedals_Susp_Sensors_B.sf_MATLABFunction_h.ZeroExperimental /end REF_MEASUREMENT
/end GROUP
/begin GROUP Pedals_Susp_Sensors.Pedals_Susp_Sensors_B.sf_MATLABFunction_k ""
 /begin REF_MEASUREMENT Pedals_Susp_Sensors.Pedals_Susp_Sensors_B.sf_MATLABFunction_k.ZeroExperimental /end REF_MEASUREMENT
/end GROUP
/begin GROUP Pedals_Susp_Sensors.Pedals_Susp_Sensors_DW ""
 /begin REF_MEASUREMENT Pedals_Susp_Sensors.Pedals_Susp_Sensors_DW.Z_E Pedals_Susp_Sensors.Pedals_Susp_Sensors_DW.Z_E_d Pedals_Susp_Sensors.Pedals_Susp_Sensors_DW.Z_E_h Pedals_Susp_Sensors.Pedals_Susp_Sensors_DW.Z_E_p /end REF_MEASUREMENT
/end GROUP
/begin GROUP Pedals_Susp_Sensors.Pedals_Susp_Sensors_U ""
 /begin REF_MEASUREMENT Pedals_Susp_Sensors.Pedals_Susp_Sensors_U.APPS1_Bits Pedals_Susp_Sensors.Pedals_Susp_Sensors_U.APPS2_Bits Pedals_Susp_Sensors.Pedals_Susp_Sensors_U.BrakeSensor_Bits Pedals_Susp_Sensors.Pedals_Susp_Sensors_U.Susp_F_L_Bits Pedals_Susp_Sensors.Pedals_Susp_Sensors_U.Susp_F_R_Bits Pedals_Susp_Sensors.Pedals_Susp_Sensors_U.Susp_R_L_Bits Pedals_Susp_Sensors.Pedals_Susp_Sensors_U.Susp_R_R_Bits /end REF_MEASUREMENT
/end GROUP
/begin GROUP Pedals_Susp_Sensors.Pedals_Susp_Sensors_Y ""
 /begin REF_MEASUREMENT Pedals_Susp_Sensors.Pedals_Susp_Sensors_Y.APPS1_Value Pedals_Susp_Sensors.Pedals_Susp_Sensors_Y.APPS2_Value Pedals_Susp_Sensors.Pedals_Susp_Sensors_Y.BrakeLight_Control Pedals_Susp_Sensors.Pedals_Susp_Sensors_Y.BrakeSensor_Value Pedals_Susp_Sensors.Pedals_Susp_Sensors_Y.SUSP_F_L Pedals_Susp_Sensors.Pedals_Susp_Sensors_Y.SUSP_F_R Pedals_Susp_Sensors.Pedals_Susp_Sensors_Y.SUSP_R_L Pedals_Susp_Sensors.Pedals_Susp_Sensors_Y.SUSP_R_R /end REF_MEASUREMENT
/end GROUP
/begin GROUP Pedals_Susp_Sensors.Pedals_Susp_Sensors_P ""
 /begin REF_CHARACTERISTIC Pedals_Susp_Sensors.Pedals_Susp_Sensors_P.Brake_Light_Threshold_Value Pedals_Susp_Sensors.Pedals_Susp_Sensors_P.Ctemuelles_Gain Pedals_Susp_Sensors.Pedals_Susp_Sensors_P.Ctemuelles_Gain_a Pedals_Susp_Sensors.Pedals_Susp_Sensors_P.Ctemuelles_Gain_e Pedals_Susp_Sensors.Pedals_Susp_Sensors_P.Ctemuelles_Gain_g Pedals_Susp_Sensors.Pedals_Susp_Sensors_P.DataStoreMemory_InitialValue Pedals_Susp_Sensors.Pedals_Susp_Sensors_P.DataStoreMemory_InitialValue_b Pedals_Susp_Sensors.Pedals_Susp_Sensors_P.DataStoreMemory_InitialValue_l Pedals_Susp_Sensors.Pedals_Susp_Sensors_P.DataStoreMemory_InitialValue_m Pedals_Susp_Sensors.Pedals_Susp_Sensors_P.Ltotal_Gain Pedals_Susp_Sensors.Pedals_Susp_Sensors_P.Ltotal_Gain_c Pedals_Susp_Sensors.Pedals_Susp_Sensors_P.Ltotal_Gain_h Pedals_Susp_Sensors.Pedals_Susp_Sensors_P.Ltotal_Gain_j Pedals_Susp_Sensors.Pedals_Susp_Sensors_P.ON_Value Pedals_Susp_Sensors.Pedals_Susp_Sensors_P.Off_Value Pedals_Susp_Sensors.Pedals_Susp_Sensors_P.bitsmax_Value Pedals_Susp_Sensors.Pedals_Susp_Sensors_P.bitsmax_Value_b Pedals_Susp_Sensors.Pedals_Susp_Sensors_P.bitsmax_Value_e Pedals_Susp_Sensors.Pedals_Susp_Sensors_P.bitsmax_Value_o Pedals_Susp_Sensors.Pedals_Susp_Sensors_P.max_Value Pedals_Susp_Sensors.Pedals_Susp_Sensors_P.max_Value_a Pedals_Susp_Sensors.Pedals_Susp_Sensors_P.max_Value_f Pedals_Susp_Sensors.Pedals_Susp_Sensors_P.min_Value Pedals_Susp_Sensors.Pedals_Susp_Sensors_P.min_Value_a Pedals_Susp_Sensors.Pedals_Susp_Sensors_P.min_Value_g /end REF_CHARACTERISTIC
/end GROUP
/begin GROUP Racing_Mode "" ROOT
 /begin REF_MEASUREMENT Racing_Mode.Racing_Mode_B.Apps_Sat_Dwn.Gain Racing_Mode.Racing_Mode_B.Apps_Sat_Up.Gain Racing_Mode.Racing_Mode_B.CKF_Initial.Gain Racing_Mode.Racing_Mode_B.Cte_CKF.Gain Racing_Mode.Racing_Mode_B.Cte_SKF.Gain Racing_Mode.Racing_Mode_B.K_Reduction_P.Gain Racing_Mode.Racing_Mode_B.K_Reduction_Temperature.Gain Racing_Mode.Racing_Mode_B.Max_Regenerative_Torque.In1 Racing_Mode.Racing_Mode_B.Merge Racing_Mode.Racing_Mode_B.Power_Limit.In1 Racing_Mode.Racing_Mode_B.SKF_Initial.Gain Racing_Mode.Racing_Mode_U.CustomMode_Data Racing_Mode.Racing_Mode_U.CustomMode_Identifier Racing_Mode.Racing_Mode_U.RacingMode Racing_Mode.Racing_Mode_Y.VDC_Apps_Sat_Down Racing_Mode.Racing_Mode_Y.VDC_Apps_Sat_Up Racing_Mode.Racing_Mode_Y.VDC_CKF_Initial Racing_Mode.Racing_Mode_Y.VDC_Cte_CKF Racing_Mode.Racing_Mode_Y.VDC_Cte_SKF Racing_Mode.Racing_Mode_Y.VDC_K_Reduction_P Racing_Mode.Racing_Mode_Y.VDC_K_Reduction_Temperature Racing_Mode.Racing_Mode_Y.VDC_Max_Regenerative_Torque Racing_Mode.Racing_Mode_Y.VDC_Power_Limit Racing_Mode.Racing_Mode_Y.VDC_SKF_Initial Racing_Mode.Racing_Mode_Y.Workshop_Mode_Enable /end REF_MEASUREMENT
 /begin REF_CHARACTERISTIC Racing_Mode.Racing_Mode_P.Apps_Sat_DwnSaturation_LowerSat Racing_Mode.Racing_Mode_P.Apps_Sat_DwnSaturation_UpperSat Racing_Mode.Racing_Mode_P.Apps_Sat_UpSaturation_LowerSat Racing_Mode.Racing_Mode_P.Apps_Sat_UpSaturation_UpperSat Racing_Mode.Racing_Mode_P.CEE_Apps_Sat_Dwn_Value Racing_Mode.Racing_Mode_P.CEE_Apps_Sat_Up_Value Racing_Mode.Racing_Mode_P.CEE_CKF_Initial_Value Racing_Mode.Racing_Mode_P.CEE_Cte_CKF_Value Racing_Mode.Racing_Mode_P.CEE_Cte_SKF_Value Racing_Mode.Racing_Mode_P.CEE_K_Reduction_P_Value Racing_Mode.Racing_Mode_P.CEE_K_Reduction_Temperature_Val Racing_Mode.Racing_Mode_P.CEE_Max_Regenerative_Torque_Val Racing_Mode.Racing_Mode_P.CEE_Power_Limit_Value Racing_Mode.Racing_Mode_P.CEE_SKF_Initial_Value Racing_Mode.Racing_Mode_P.CKF_InitialSaturation_LowerSat Racing_Mode.Racing_Mode_P.CKF_InitialSaturation_UpperSat Racing_Mode.Racing_Mode_P.CompareToConstant_const Racing_Mode.Racing_Mode_P.Cte_CKFSaturation_LowerSat Racing_Mode.Racing_Mode_P.Cte_CKFSaturation_UpperSat Racing_Mode.Racing_Mode_P.Cte_SKFSaturation_LowerSat Racing_Mode.Racing_Mode_P.Cte_SKFSaturation_UpperSat Racing_Mode.Racing_Mode_P.K_Reduction_PSaturation_LowerSa Racing_Mode.Racing_Mode_P.K_Reduction_PSaturation_UpperSa Racing_Mode.Racing_Mode_P.K_Reduction_TemperatureSatura_m Racing_Mode.Racing_Mode_P.K_Reduction_TemperatureSaturati Racing_Mode.Racing_Mode_P.Max_Regenerative_TorqueSatura_o Racing_Mode.Racing_Mode_P.Max_Regenerative_TorqueSaturati Racing_Mode.Racing_Mode_P.Merge_InitialOutput Racing_Mode.Racing_Mode_P.Power_LimitSaturation_LowerSat Racing_Mode.Racing_Mode_P.Power_LimitSaturation_UpperSat Racing_Mode.Racing_Mode_P.SKF_InitialSaturation_LowerSat Racing_Mode.Racing_Mode_P.SKF_InitialSaturation_UpperSat /end REF_CHARACTERISTIC
 /begin SUB_GROUP Racing_Mode.Racing_Mode_B Racing_Mode.Racing_Mode_B.Apps_Sat_Dwn Racing_Mode.Racing_Mode_B.Apps_Sat_Up Racing_Mode.Racing_Mode_B.CKF_Initial Racing_Mode.Racing_Mode_B.Cte_CKF Racing_Mode.Racing_Mode_B.Cte_SKF Racing_Mode.Racing_Mode_B.K_Reduction_P Racing_Mode.Racing_Mode_B.K_Reduction_Temperature Racing_Mode.Racing_Mode_B.Max_Regenerative_Torque Racing_Mode.Racing_Mode_B.Power_Limit Racing_Mode.Racing_Mode_B.SKF_Initial Racing_Mode.Racing_Mode_U Racing_Mode.Racing_Mode_Y Racing_Mode.Racing_Mode_P /end SUB_GROUP
/end GROUP
/begin GROUP Racing_Mode.Racing_Mode_B ""
 /begin REF_MEASUREMENT Racing_Mode.Racing_Mode_B.Apps_Sat_Dwn.Gain Racing_Mode.Racing_Mode_B.Apps_Sat_Up.Gain Racing_Mode.Racing_Mode_B.CKF_Initial.Gain Racing_Mode.Racing_Mode_B.Cte_CKF.Gain Racing_Mode.Racing_Mode_B.Cte_SKF.Gain Racing_Mode.Racing_Mode_B.K_Reduction_P.Gain Racing_Mode.Racing_Mode_B.K_Reduction_Temperature.Gain Racing_Mode.Racing_Mode_B.Max_Regenerative_Torque.In1 Racing_Mode.Racing_Mode_B.Merge Racing_Mode.Racing_Mode_B.Power_Limit.In1 Racing_Mode.Racing_Mode_B.SKF_Initial.Gain /end REF_MEASUREMENT
/end GROUP
/begin GROUP Racing_Mode.Racing_Mode_B.Apps_Sat_Dwn "" /begin REF_MEASUREMENT Racing_Mode.Racing_Mode_B.Apps_Sat_Dwn.Gain /end REF_MEASUREMENT /end GROUP
/begin GROUP Racing_Mode.Racing_Mode_B.Apps_Sat_Up "" /begin REF_MEASUREMENT Racing_Mode.Racing_Mode_B.Apps_Sat_Up.Gain /end REF_MEASUREMENT /end GROUP
/begin GROUP Racing_Mode.Racing_Mode_B.CKF_Initial "" /begin REF_MEASUREMENT Racing_Mode.Racing_Mode_B.CKF_Initial.Gain /end REF_MEASUREMENT /end GROUP
/begin GROUP Racing_Mode.Racing_Mode_B.Cte_CKF "" /begin REF_MEASUREMENT Racing_Mode.Racing_Mode_B.Cte_CKF.Gain /end REF_MEASUREMENT /end GROUP
/begin GROUP Racing_Mode.Racing_Mode_B.Cte_SKF "" /begin REF_MEASUREMENT Racing_Mode.Racing_Mode_B.Cte_SKF.Gain /end REF_MEASUREMENT /end GROUP
/begin GROUP Racing_Mode.Racing_Mode_B.K_Reduction_P "" /begin REF_MEASUREMENT Racing_Mode.Racing_Mode_B.K_Reduction_P.Gain /end REF_MEASUREMENT /end GROUP
/begin GROUP Racing_Mode.Racing_Mode_B.K_Reduction_Temperature "" /begin REF_MEASUREMENT Racing_Mode.Racing_Mode_B.K_Reduction_Temperature.Gain /end REF_MEASUREMENT /end GROUP
/begin GROUP Racing_Mode.Racing_Mode_B.Max_Regenerative_Torque "" /begin REF_MEASUREMENT Racing_Mode.Racing_Mode_B.Max_Regenerative_Torque.In1 /end REF_MEASUREMENT /end GROUP
/begin GROUP Racing_Mode.Racing_Mode_B.Power_Limit "" /begin REF_MEASUREMENT Racing_Mode.Racing_Mode_B.Power_Limit.In1 /end REF_MEASUREMENT /end GROUP
/begin GROUP Racing_Mode.Racing_Mode_B.SKF_Initial "" /begin REF_MEASUREMENT Racing_Mode.Racing_Mode_B.SKF_Initial.Gain /end REF_MEASUREMENT /end GROUP
/begin GROUP Racing_Mode.Racing_Mode_U ""
 /begin REF_MEASUREMENT Racing_Mode.Racing_Mode_U.CustomMode_Data Racing_Mode.Racing_Mode_U.CustomMode_Identifier Racing_Mode.Racing_Mode_U.RacingMode /end REF_MEASUREMENT
/end GROUP
/begin GROUP Racing_Mode.Racing_Mode_Y ""
 /begin REF_MEASUREMENT Racing_Mode.Racing_Mode_Y.VDC_Apps_Sat_Down Racing_Mode.Racing_Mode_Y.VDC_Apps_Sat_Up Racing_Mode.Racing_Mode_Y.VDC_CKF_Initial Racing_Mode.Racing_Mode_Y.VDC_Cte_CKF Racing_Mode.Racing_Mode_Y.VDC_Cte_SKF Racing_Mode.Racing_Mode_Y.VDC_K_Reduction_P Racing_Mode.Racing_Mode_Y.VDC_K_Reduction_Temperature Racing_Mode.Racing_Mode_Y.VDC_Max_Regenerative_Torque Racing_Mode.Racing_Mode_Y.VDC_Power_Limit Racing_Mode.Racing_Mode_Y.VDC_SKF_Initial Racing_Mode.Racing_Mode_Y.Workshop_Mode_Enable /end REF_MEASUREMENT
/end GROUP
/begin GROUP Racing_Mode.Racing_Mode_P ""
 /begin REF_CHARACTERISTIC Racing_Mode.Racing_Mode_P.Apps_Sat_DwnSaturation_LowerSat Racing_Mode.Racing_Mode_P.Apps_Sat_DwnSaturation_UpperSat Racing_Mode.Racing_Mode_P.Apps_Sat_UpSaturation_LowerSat Racing_Mode.Racing_Mode_P.Apps_Sat_UpSaturation_UpperSat Racing_Mode.Racing_Mode_P.CEE_Apps_Sat_Dwn_Value Racing_Mode.Racing_Mode_P.CEE_Apps_Sat_Up_Value Racing_Mode.Racing_Mode_P.CEE_CKF_Initial_Value Racing_Mode.Racing_Mode_P.CEE_Cte_CKF_Value Racing_Mode.Racing_Mode_P.CEE_Cte_SKF_Value Racing_Mode.Racing_Mode_P.CEE_K_Reduction_P_Value Racing_Mode.Racing_Mode_P.CEE_K_Reduction_Temperature_Val Racing_Mode.Racing_Mode_P.CEE_Max_Regenerative_Torque_Val Racing_Mode.Racing_Mode_P.CEE_Power_Limit_Value Racing_Mode.Racing_Mode_P.CEE_SKF_Initial_Value Racing_Mode.Racing_Mode_P.CKF_InitialSaturation_LowerSat Racing_Mode.Racing_Mode_P.CKF_InitialSaturation_UpperSat Racing_Mode.Racing_Mode_P.CompareToConstant_const Racing_Mode.Racing_Mode_P.Cte_CKFSaturation_LowerSat Racing_Mode.Racing_Mode_P.Cte_CKFSaturation_UpperSat Racing_Mode.Racing_Mode_P.Cte_SKFSaturation_LowerSat Racing_Mode.Racing_Mode_P.Cte_SKFSaturation_UpperSat Racing_Mode.Racing_Mode_P.K_Reduction_PSaturation_LowerSa Racing_Mode.Racing_Mode_P.K_Reduction_PSaturation_UpperSa Racing_Mode.Racing_Mode_P.K_Reduction_TemperatureSatura_m Racing_Mode.Racing_Mode_P.K_Reduction_TemperatureSaturati Racing_Mode.Racing_Mode_P.Max_Regenerative_TorqueSatura_o Racing_Mode.Racing_Mode_P.Max_Regenerative_TorqueSaturati Racing_Mode.Racing_Mode_P.Merge_InitialOutput Racing_Mode.Racing_Mode_P.Power_LimitSaturation_LowerSat Racing_Mode.Racing_Mode_P.Power_LimitSaturation_UpperSat Racing_Mode.Racing_Mode_P.SKF_InitialSaturation_LowerSat Racing_Mode.Racing_Mode_P.SKF_InitialSaturation_UpperSat /end REF_CHARACTERISTIC
/end GROUP
/begin GROUP Synchronism "" ROOT
 /begin REF_MEASUREMENT Synchronism.Synchronism_DW.counter Synchronism.Synchronism_Y.Sync_CAN1 Synchronism.Synchronism_Y.Sync_CAN2 /end REF_MEASUREMENT
 /begin REF_CHARACTERISTIC Synchronism.Synchronism_P.Constant1_Value Synchronism.Synchronism_P.Constant_Value Synchronism.Synchronism_P.Constant_Value_e Synchronism.Synchronism_P.DataStoreMemory_InitialValue /end REF_CHARACTERISTIC
 /begin SUB_GROUP Synchronism.Synchronism_DW Synchronism.Synchronism_Y Synchronism.Synchronism_P /end SUB_GROUP
/end GROUP
/begin GROUP Synchronism.Synchronism_DW "" /begin REF_MEASUREMENT Synchronism.Synchronism_DW.counter /end REF_MEASUREMENT /end GROUP
/begin GROUP Synchronism.Synchronism_Y ""
 /begin REF_MEASUREMENT Synchronism.Synchronism_Y.Sync_CAN1 Synchronism.Synchronism_Y.Sync_CAN2 /end REF_MEASUREMENT
/end GROUP
/begin GROUP Synchronism.Synchronism_P ""
 /begin REF_CHARACTERISTIC Synchronism.Synchronism_P.Constant1_Value Synchronism.Synchronism_P.Constant_Value Synchronism.Synchronism_P.Constant_Value_e Synchronism.Synchronism_P.DataStoreMemory_InitialValue /end REF_CHARACTERISTIC
/end GROUP
/begin GROUP Torque_Control "" ROOT
 /begin REF_CHARACTERISTIC Torque_Control.Torque_Control_P.ANm_Gain Torque_Control.Torque_Control_P.ANm_Gain_b Torque_Control.Torque_Control_P.Accu_Temperature_Limitation_Fla Torque_Control.Torque_Control_P.CKF_act_Y0 Torque_Control.Torque_Control_P.CKF_act_Y0_j Torque_Control.Torque_Control_P.CompareToConstant1_const Torque_Control.Torque_Control_P.CompareToConstant_const Torque_Control.Torque_Control_P.CompareToConstant_const_p Torque_Control.Torque_Control_P.Constant12_Value Torque_Control.Torque_Control_P.Constant13_Value Torque_Control.Torque_Control_P.Constant14_Value Torque_Control.Torque_Control_P.Constant17_Value Torque_Control.Torque_Control_P.Constant1_Value Torque_Control.Torque_Control_P.Constant1_Value_a Torque_Control.Torque_Control_P.Constant1_Value_ab Torque_Control.Torque_Control_P.Constant1_Value_b Torque_Control.Torque_Control_P.Constant1_Value_c Torque_Control.Torque_Control_P.Constant1_Value_e Torque_Control.Torque_Control_P.Constant1_Value_f Torque_Control.Torque_Control_P.Constant1_Value_fp Torque_Control.Torque_Control_P.Constant1_Value_l Torque_Control.Torque_Control_P.Constant1_Value_ln Torque_Control.Torque_Control_P.Constant1_Value_o Torque_Control.Torque_Control_P.Constant1_Value_p Torque_Control.Torque_Control_P.Constant1_Value_p2 Torque_Control.Torque_Control_P.Constant2_Value Torque_Control.Torque_Control_P.Constant2_Value_b Torque_Control.Torque_Control_P.Constant2_Value_d Torque_Control.Torque_Control_P.Constant2_Value_g Torque_Control.Torque_Control_P.Constant2_Value_g1 Torque_Control.Torque_Control_P.Constant2_Value_h Torque_Control.Torque_Control_P.Constant2_Value_hv Torque_Control.Torque_Control_P.Constant2_Value_m Torque_Control.Torque_Control_P.Constant2_Value_mw Torque_Control.Torque_Control_P.Constant3_Value Torque_Control.Torque_Control_P.Constant3_Value_c Torque_Control.Torque_Control_P.Constant3_Value_d Torque_Control.Torque_Control_P.Constant3_Value_e Torque_Control.Torque_Control_P.Constant3_Value_h Torque_Control.Torque_Control_P.Constant3_Value_i Torque_Control.Torque_Control_P.Constant3_Value_k Torque_Control.Torque_Control_P.Constant3_Value_n Torque_Control.Torque_Control_P.Constant3_Value_o Torque_Control.Torque_Control_P.Constant4_Value Torque_Control.Torque_Control_P.Constant4_Value_p Torque_Control.Torque_Control_P.Constant5_Value Torque_Control.Torque_Control_P.Constant6_Value Torque_Control.Torque_Control_P.Constant6_Value_p Torque_Control.Torque_Control_P.Constant7_Value Torque_Control.Torque_Control_P.Constant8_Value Torque_Control.Torque_Control_P.Constant_Value Torque_Control.Torque_Control_P.Constant_Value_a Torque_Control.Torque_Control_P.Constant_Value_ad Torque_Control.Torque_Control_P.Constant_Value_ae Torque_Control.Torque_Control_P.Constant_Value_b Torque_Control.Torque_Control_P.Constant_Value_d Torque_Control.Torque_Control_P.Constant_Value_dl Torque_Control.Torque_Control_P.Constant_Value_dm Torque_Control.Torque_Control_P.Constant_Value_dx Torque_Control.Torque_Control_P.Constant_Value_f Torque_Control.Torque_Control_P.Constant_Value_f0 Torque_Control.Torque_Control_P.Constant_Value_h Torque_Control.Torque_Control_P.Constant_Value_i Torque_Control.Torque_Control_P.Constant_Value_ib Torque_Control.Torque_Control_P.Constant_Value_k Torque_Control.Torque_Control_P.Constant_Value_k4 /end REF_CHARACTERISTIC
 /begin SUB_GROUP Torque_Control.Torque_Control_B Torque_Control.Torque_Control_B.BrakingwithRegenerative Torque_Control.Torque_Control_B.BrakingwithRegenerative.sf_MATLABFunction Torque_Control.Torque_Control_B.BrakingwithRegenerative_b Torque_Control.Torque_Control_B.BrakingwithRegenerative_b.sf_MATLABFunction Torque_Control.Torque_Control_B.sf_Acceleratorbehaviour Torque_Control.Torque_Control_B.sf_Acceleratorbehaviour_b Torque_Control.Torque_Control_B.sf_Acceleratorbehaviour_br Torque_Control.Torque_Control_B.sf_Acceleratorbehaviour_o Torque_Control.Torque_Control_B.sf_MATLABFunction1_b Torque_Control.Torque_Control_B.sf_MATLABFunction1_f Torque_Control.Torque_Control_B.sf_MATLABFunction1_g Torque_Control.Torque_Control_B.sf_MATLABFunction1_gm Torque_Control.Torque_Control_B.sf_MATLABFunction1_h Torque_Control.Torque_Control_B.sf_MATLABFunction1_m Torque_Control.Torque_Control_B.sf_MATLABFunction1_mk Torque_Control.Torque_Control_B.sf_MATLABFunction1_ny Torque_Control.Torque_Control_B.sf_MATLABFunction2 Torque_Control.Torque_Control_B.sf_MATLABFunction2_b Torque_Control.Torque_Control_B.sf_MATLABFunction2_e Torque_Control.Torque_Control_B.sf_MATLABFunction2_l Torque_Control.Torque_Control_B.sf_MATLABFunction2_m Torque_Control.Torque_Control_B.sf_MATLABFunction_a Torque_Control.Torque_Control_B.sf_MATLABFunction_ab Torque_Control.Torque_Control_B.sf_MATLABFunction_d Torque_Control.Torque_Control_B.sf_MATLABFunction_e Torque_Control.Torque_Control_B.sf_MATLABFunction_fa Torque_Control.Torque_Control_B.sf_MATLABFunction_fq Torque_Control.Torque_Control_B.sf_MATLABFunction_i1 Torque_Control.Torque_Control_B.sf_MATLABFunction_k2 Torque_Control.Torque_Control_B.sf_MATLABFunction_mt Torque_Control.Torque_Control_B.sf_MATLABFunction_n Torque_Control.Torque_Control_DW Torque_Control.Torque_Control_U Torque_Control.Torque_Control_Y Torque_Control.Torque_Control_P /end SUB_GROUP
/end GROUP
/begin GROUP Torque_Control.Torque_Control_P ""
 /begin REF_CHARACTERISTIC Torque_Control.Torque_Control_P.ANm_Gain Torque_Control.Torque_Control_P.ANm_Gain_b Torque_Control.Torque_Control_P.Accu_Temperature_Limitation_Fla Torque_Control.Torque_Control_P.CKF_act_Y0 Torque_Control.Torque_Control_P.CKF_act_Y0_j Torque_Control.Torque_Control_P.CompareToConstant1_const Torque_Control.Torque_Control_P.CompareToConstant_const Torque_Control.Torque_Control_P.CompareToConstant_const_p Torque_Control.Torque_Control_P.Constant12_Value Torque_Control.Torque_Control_P.Constant13_Value Torque_Control.Torque_Control_P.Constant14_Value Torque_Control.Torque_Control_P.Constant17_Value Torque_Control.Torque_Control_P.Constant1_Value Torque_Control.Torque_Control_P.Constant1_Value_a Torque_Control.Torque_Control_P.Constant1_Value_ab Torque_Control.Torque_Control_P.Constant1_Value_b Torque_Control.Torque_Control_P.Constant1_Value_c Torque_Control.Torque_Control_P.Constant1_Value_e Torque_Control.Torque_Control_P.Constant1_Value_f Torque_Control.Torque_Control_P.Constant1_Value_fp Torque_Control.Torque_Control_P.Constant1_Value_l Torque_Control.Torque_Control_P.Constant1_Value_ln Torque_Control.Torque_Control_P.Constant1_Value_o Torque_Control.Torque_Control_P.Constant1_Value_p Torque_Control.Torque_Control_P.Constant1_Value_p2 Torque_Control.Torque_Control_P.Constant2_Value Torque_Control.Torque_Control_P.Constant2_Value_b Torque_Control.Torque_Control_P.Constant2_Value_d Torque_Control.Torque_Control_P.Constant2_Value_g Torque_Control.Torque_Control_P.Constant2_Value_g1 Torque_Control.Torque_Control_P.Constant2_Value_h Torque_Control.Torque_Control_P.Constant2_Value_hv Torque_Control.Torque_Control_P.Constant2_Value_m Torque_Control.Torque_Control_P.Constant2_Value_mw Torque_Control.Torque_Control_P.Constant3_Value Torque_Control.Torque_Control_P.Constant3_Value_c Torque_Control.Torque_Control_P.Constant3_Value_d Torque_Control.Torque_Control_P.Constant3_Value_e Torque_Control.Torque_Control_P.Constant3_Value_h Torque_Control.Torque_Control_P.Constant3_Value_i Torque_Control.Torque_Control_P.Constant3_Value_k Torque_Control.Torque_Control_P.Constant3_Value_n Torque_Control.Torque_Control_P.Constant3_Value_o Torque_Control.Torque_Control_P.Constant4_Value Torque_Control.Torque_Control_P.Constant4_Value_p Torque_Control.Torque_Control_P.Constant5_Value Torque_Control.Torque_Control_P.Constant6_Value Torque_Control.Torque_Control_P.Constant6_Value_p Torque_Control.Torque_Control_P.Constant7_Value Torque_Control.Torque_Control_P.Constant8_Value Torque_Control.Torque_Control_P.Constant_Value Torque_Control.Torque_Control_P.Constant_Value_a Torque_Control.Torque_Control_P.Constant_Value_ad Torque_Control.Torque_Control_P.Constant_Value_ae Torque_Control.Torque_Control_P.Constant_Value_b Torque_Control.Torque_Control_P.Constant_Value_d Torque_Control.Torque_Control_P.Constant_Value_dl Torque_Control.Torque_Control_P.Constant_Value_dm Torque_Control.Torque_Control_P.Constant_Value_dx Torque_Control.Torque_Control_P.Constant_Value_f Torque_Control.Torque_Control_P.Constant_Value_f0 Torque_Control.Torque_Control_P.Constant_Value_h Torque_Control.Torque_Control_P.Constant_Value_i Torque_Control.Torque_Control_P.Constant_Value_ib Torque_Control.Torque_Control_P.Constant_Value_k Torque_Control.Torque_Control_P.Constant_Value_k4 /end REF_CHARACTERISTIC
/end GROUP
/end MODULE
/* INTECRIO_MERGED */
/end PROJECT
/* ETAS */
