ASAP2_VERSION 1 61
/begin PROJECT ETAS "Generated by ETAS from INTECRIO V5.0.5.1003 integration project"
/begin HEADER "" VERSION "" PROJECT_NO Y /end HEADER
/begin MODULE INTECRIO_MERGED "Generated by ETAS INTECRIO V5.0.5.1003 for M/C interface ETARGET"
/begin MOD_PAR "" VERSION "" ADDR_EPK 0x0 EPK "" SUPPLIER "ETAS GmbH" CUSTOMER "" CUSTOMER_NO "" USER "" PHONE_NO "" ECU "NO_ECU" CPU_TYPE "MPC750" NO_OF_INTERFACES 1 /end MOD_PAR
/begin MOD_COMMON "Common definitions" BYTE_ORDER MSB_FIRST ALIGNMENT_BYTE 1 ALIGNMENT_WORD 2 ALIGNMENT_LONG 4 ALIGNMENT_FLOAT32_IEEE 4 ALIGNMENT_FLOAT64_IEEE 8 /end MOD_COMMON
/begin IF_DATA E_TARGET
 /begin SOURCE "Timer_Inv" 0 3000 QP_BLOB 33 /end SOURCE
 /begin SOURCE "SWT_CAN1_AP_BMS_AIRs_State" 0 1000 QP_BLOB 1 /end SOURCE
 /begin SOURCE "SWT_CAN1_AP_BMS_ChargerParameters" 0 1000 QP_BLOB 2 /end SOURCE
 /begin SOURCE "SWT_CAN1_AP_BMS_SDC" 0 1000 QP_BLOB 3 /end SOURCE
 /begin SOURCE "SWT_CAN1_AP_BMS_Temperatures" 0 1000 QP_BLOB 4 /end SOURCE
 /begin SOURCE "SWT_CAN1_AP_BMS_Voltages" 0 1000 QP_BLOB 5 /end SOURCE
 /begin SOURCE "SWT_CAN1_AP_CurrentSensor" 0 1000 QP_BLOB 6 /end SOURCE
 /begin SOURCE "SWT_CAN1_AP_DASH_EnableDrive" 0 1000 QP_BLOB 7 /end SOURCE
 /begin SOURCE "SWT_CAN1_AP_DASH_Mode" 0 1000 QP_BLOB 8 /end SOURCE
 /begin SOURCE "SWT_CAN1_AP_DASH_PrechargeRequest" 0 1000 QP_BLOB 9 /end SOURCE
 /begin SOURCE "SWT_CAN1_AP_Inverter_L_Tx" 0 1000 QP_BLOB 10 /end SOURCE
 /begin SOURCE "SWT_CAN1_AP_Inverter_R_Tx" 0 1000 QP_BLOB 11 /end SOURCE
 /begin SOURCE "SWT_CAN1_NM_BMS_Keep_Alive" 0 1000 QP_BLOB 12 /end SOURCE
 /begin SOURCE "SWT_CAN1_NM_DASH_Keep_Alive" 0 1000 QP_BLOB 13 /end SOURCE
 /begin SOURCE "SWT_CAN2_AP_ELLIPSE_AUTO" 0 1000 QP_BLOB 14 /end SOURCE
 /begin SOURCE "SWT_CAN2_AP_ELLIPSE_EKF_EULER" 0 1000 QP_BLOB 15 /end SOURCE
 /begin SOURCE "SWT_CAN2_AP_ELLIPSE_EKF_POS" 0 1000 QP_BLOB 16 /end SOURCE
 /begin SOURCE "SWT_CAN2_AP_ELLIPSE_EKF_VEL" 0 1000 QP_BLOB 17 /end SOURCE
 /begin SOURCE "SWT_CAN2_AP_ELLIPSE_GPS_VEL" 0 1000 QP_BLOB 18 /end SOURCE
 /begin SOURCE "SWT_CAN2_AP_ELLIPSE_IMU_ACCEL" 0 1000 QP_BLOB 19 /end SOURCE
 /begin SOURCE "SWT_CAN2_AP_ELLIPSE_IMU_GYRO" 0 1000 QP_BLOB 20 /end SOURCE
 /begin SOURCE "SWT_CAN2_AP_ELLIPSE_VEL_Valid" 0 1000 QP_BLOB 21 /end SOURCE
 /begin SOURCE "SWT_CAN2_AP_FECU_Data1" 0 1000 QP_BLOB 22 /end SOURCE
 /begin SOURCE "SWT_CAN2_AP_FECU_Data2" 0 1000 QP_BLOB 23 /end SOURCE
 /begin SOURCE "SWT_CAN2_AP_RECU_Data" 0 1000 QP_BLOB 24 /end SOURCE
 /begin SOURCE "SWT_CAN2_MEAS_RECU_SDC" 0 1000 QP_BLOB 25 /end SOURCE
 /begin SOURCE "SWT_CAN2_NM_ELLIPSE_Status" 0 1000 QP_BLOB 26 /end SOURCE
 /begin SOURCE "SWT_CAN2_NM_FECU_Keep_Alive" 0 1000 QP_BLOB 27 /end SOURCE
 /begin SOURCE "SWT_CAN2_NM_RECU_Keep_Alive" 0 1000 QP_BLOB 28 /end SOURCE
 /begin SOURCE "Sync_25ms" 0 25000 QP_BLOB 29 /end SOURCE
 /begin SOURCE "Timer_1000ms" 0 1000000 QP_BLOB 30 /end SOURCE
 /begin SOURCE "Timer_100ms" 0 100000 QP_BLOB 31 /end SOURCE
 /begin SOURCE "Timer_25ms" 0 25000 QP_BLOB 32 /end SOURCE
 /begin TP_BLOB /* Program identifier */ 2149049204 /* HW target identifier */ 0x6 /* Skip flag */ 0 /* Skip to link */ 2 /* Loader identifier */ 0x02000001 /end TP_BLOB
/end IF_DATA
/begin MEASUREMENT Car_State.Car_State_B.InvertersAction "" FLOAT64_IEEE Car_State_CM_double 0 0 -1.7e+308 1.7e+308 ECU_ADDRESS 0x0 DISPLAY_IDENTIFIER Car_State.Car_State_Manager.InvertersAction /end MEASUREMENT
/begin MEASUREMENT Car_State.Car_State_B.Merge "" FLOAT64_IEEE Car_State_CM_double 0 0 -1.7e+308 1.7e+308 ECU_ADDRESS 0x0 DISPLAY_IDENTIFIER Car_State.AIRS_Request.Merge.Merge /end MEASUREMENT
/begin MEASUREMENT Car_State.Car_State_B.Merge_b "" FLOAT64_IEEE Car_State_CM_double 0 0 -1.7e+308 1.7e+308 ECU_ADDRESS 0x0 DISPLAY_IDENTIFIER Car_State.Inv_Action.Merge.Merge_b /end MEASUREMENT
/begin MEASUREMENT Car_State.Car_State_DW.A "" FLOAT64_IEEE Car_State_CM_double 0 0 -1.7e+308 1.7e+308 ECU_ADDRESS 0x0 DISPLAY_IDENTIFIER Car_State.CurrentPathDisconnection_Detection.Subsystem.Data_Store_Memory.A /end MEASUREMENT
/begin MEASUREMENT Car_State.Car_State_U.AIRs_State "" FLOAT64_IEEE Car_State_CM_double 0 0 -1.7e+308 1.7e+308 ECU_ADDRESS 0x0 DISPLAY_IDENTIFIER Car_State.AIRs_State /end MEASUREMENT
/begin MEASUREMENT Car_State.Car_State_U.APPS1_Value "" FLOAT64_IEEE Car_State_CM_double 0 0 -1.7e+308 1.7e+308 ECU_ADDRESS 0x0 DISPLAY_IDENTIFIER Car_State.APPS1_Value /end MEASUREMENT
/begin MEASUREMENT Car_State.Car_State_U.Accumulator_Voltage "" FLOAT64_IEEE Car_State_CM_double 0 0 -1.7e+308 1.7e+308 ECU_ADDRESS 0x0 DISPLAY_IDENTIFIER Car_State.Accumulator_Voltage /end MEASUREMENT
/begin MEASUREMENT Car_State.Car_State_U.BrakePedal_Value "" FLOAT64_IEEE Car_State_CM_double 0 0 -1.7e+308 1.7e+308 ECU_ADDRESS 0x0 DISPLAY_IDENTIFIER Car_State.BrakePedal_Value /end MEASUREMENT
/begin MEASUREMENT Car_State.Car_State_U.Critical_CAN_Disconnection "" FLOAT64_IEEE Car_State_CM_double 0 0 -1.7e+308 1.7e+308 ECU_ADDRESS 0x0 DISPLAY_IDENTIFIER Car_State.Critical_CAN_Disconnection /end MEASUREMENT
/begin MEASUREMENT Car_State.Car_State_U.EnableDrive_Order "" UBYTE Car_State_CM_boolean 0 0 0 1 ECU_ADDRESS 0x0 DISPLAY_IDENTIFIER Car_State.EnableDrive_Order /end MEASUREMENT
/begin MEASUREMENT Car_State.Car_State_U.InvertersMinDCBus "" FLOAT64_IEEE Car_State_CM_double 0 0 -1.7e+308 1.7e+308 ECU_ADDRESS 0x0 DISPLAY_IDENTIFIER Car_State.InvertersMinDCBus /end MEASUREMENT
/begin MEASUREMENT Car_State.Car_State_U.InvertersSubscribed "" FLOAT64_IEEE Car_State_CM_double 0 0 -1.7e+308 1.7e+308 ECU_ADDRESS 0x0 DISPLAY_IDENTIFIER Car_State.InvertersSubscribed /end MEASUREMENT
/begin MEASUREMENT Car_State.Car_State_U.PrechargeRequest "" FLOAT64_IEEE Car_State_CM_double 0 0 -1.7e+308 1.7e+308 ECU_ADDRESS 0x0 DISPLAY_IDENTIFIER Car_State.PrechargeRequest /end MEASUREMENT
/begin MEASUREMENT Car_State.Car_State_U.Shutdown_PackageIntck "" UBYTE Car_State_CM_boolean 0 0 0 1 ECU_ADDRESS 0x0 DISPLAY_IDENTIFIER Car_State.Shutdown_PackageIntck /end MEASUREMENT
/begin MEASUREMENT Car_State.Car_State_Y.AIRs_Request "" FLOAT64_IEEE Car_State_CM_double 0 0 -1.7e+308 1.7e+308 ECU_ADDRESS 0x0 DISPLAY_IDENTIFIER Car_State.AIRs_Request /end MEASUREMENT
/begin MEASUREMENT Car_State.Car_State_Y.Car_OK "" UBYTE Car_State_CM_boolean 0 0 0 1 ECU_ADDRESS 0x0 DISPLAY_IDENTIFIER Car_State.Car_OK /end MEASUREMENT
/begin MEASUREMENT Car_State.Car_State_Y.Car_State_b "" FLOAT64_IEEE Car_State_CM_double 0 0 -1.7e+308 1.7e+308 ECU_ADDRESS 0x0 DISPLAY_IDENTIFIER Car_State.Car_State /end MEASUREMENT
/begin MEASUREMENT Car_State.Car_State_Y.InvertersAction "" FLOAT64_IEEE Car_State_CM_double 0 0 -1.7e+308 1.7e+308 ECU_ADDRESS 0x0 DISPLAY_IDENTIFIER Car_State.InvertersAction /end MEASUREMENT
/begin MEASUREMENT Car_State.Car_State_Y.PrechargeAssert "" FLOAT64_IEEE Car_State_CM_double 0 0 -1.7e+308 1.7e+308 ECU_ADDRESS 0x0 DISPLAY_IDENTIFIER Car_State.PrechargeAssert /end MEASUREMENT
/begin MEASUREMENT Car_State.Car_State_Y.Precharge_Percentage "" FLOAT64_IEEE Car_State_CM_double 0 0 -1.7e+308 1.7e+308 ECU_ADDRESS 0x0 DISPLAY_IDENTIFIER Car_State.Precharge_Percentage /end MEASUREMENT
/begin MEASUREMENT Car_State.Car_State_Y.Precharge_Voltage "" FLOAT64_IEEE Car_State_CM_double 0 0 -1.7e+308 1.7e+308 ECU_ADDRESS 0x0 DISPLAY_IDENTIFIER Car_State.Precharge_Voltage /end MEASUREMENT
/begin MEASUREMENT Car_State.Car_State_Y.Relay_Error "" FLOAT64_IEEE Car_State_CM_double 0 0 -1.7e+308 1.7e+308 ECU_ADDRESS 0x0 DISPLAY_IDENTIFIER Car_State.Relay_Error /end MEASUREMENT
/begin MEASUREMENT Car_State.Car_State_Y.TorqueEnable "" FLOAT64_IEEE Car_State_CM_double 0 0 -1.7e+308 1.7e+308 ECU_ADDRESS 0x0 DISPLAY_IDENTIFIER Car_State.TorqueEnable /end MEASUREMENT
/begin MEASUREMENT Car_State.Car_State_Y.errors "" FLOAT64_IEEE Car_State_CM_double 0 0 -1.7e+308 1.7e+308 ECU_ADDRESS 0x0 DISPLAY_IDENTIFIER Car_State.errors /end MEASUREMENT
/begin MEASUREMENT Disconnections.Disconnections_B.Merge "" FLOAT64_IEEE Disconnections_CM_double 0 0 -1.7e+308 1.7e+308 ECU_ADDRESS 0x0 DISPLAY_IDENTIFIER Disconnections.Sensor_Disconnections__Noise_.Life_check_APPS1.Merge.Merge /end MEASUREMENT
/begin MEASUREMENT Disconnections.Disconnections_B.Merge_d "" FLOAT64_IEEE Disconnections_CM_double 0 0 -1.7e+308 1.7e+308 ECU_ADDRESS 0x0 DISPLAY_IDENTIFIER Disconnections.Sensor_Disconnections__Noise_.Life_check_Steer.Merge.Merge_d /end MEASUREMENT
/begin MEASUREMENT Disconnections.Disconnections_B.Merge_dt "" FLOAT64_IEEE Disconnections_CM_double 0 0 -1.7e+308 1.7e+308 ECU_ADDRESS 0x0 DISPLAY_IDENTIFIER Disconnections.ECU_Disconections.Life_check4.Merge.Merge_dt /end MEASUREMENT
/begin MEASUREMENT Disconnections.Disconnections_B.Merge_e "" FLOAT64_IEEE Disconnections_CM_double 0 0 -1.7e+308 1.7e+308 ECU_ADDRESS 0x0 DISPLAY_IDENTIFIER Disconnections.Sensor_Disconnections__Noise_.Life_check_APPS2.Merge.Merge_e /end MEASUREMENT
/begin MEASUREMENT Disconnections.Disconnections_B.Merge_ed "" FLOAT64_IEEE Disconnections_CM_double 0 0 -1.7e+308 1.7e+308 ECU_ADDRESS 0x0 DISPLAY_IDENTIFIER Disconnections.Sensor_Disconnections__Noise_.Life_check_Brake.Merge.Merge_ed /end MEASUREMENT
/begin MEASUREMENT Disconnections.Disconnections_B.Merge_g "" FLOAT64_IEEE Disconnections_CM_double 0 0 -1.7e+308 1.7e+308 ECU_ADDRESS 0x0 DISPLAY_IDENTIFIER Disconnections.ECU_Disconections.LifeCheck_BMS.Merge.Merge_g /end MEASUREMENT
/begin MEASUREMENT Disconnections.Disconnections_B.Merge_go "" FLOAT64_IEEE Disconnections_CM_double 0 0 -1.7e+308 1.7e+308 ECU_ADDRESS 0x0 DISPLAY_IDENTIFIER Disconnections.ECU_Disconections.LifeCheck_AccFront.Merge.Merge_go /end MEASUREMENT
/begin MEASUREMENT Disconnections.Disconnections_B.Merge_j "" FLOAT64_IEEE Disconnections_CM_double 0 0 -1.7e+308 1.7e+308 ECU_ADDRESS 0x0 DISPLAY_IDENTIFIER Disconnections.ECU_Disconections.LifeCheck_Dash.Merge.Merge_j /end MEASUREMENT
/begin MEASUREMENT Disconnections.Disconnections_B.Merge_k "" FLOAT64_IEEE Disconnections_CM_double 0 0 -1.7e+308 1.7e+308 ECU_ADDRESS 0x0 DISPLAY_IDENTIFIER Disconnections.Sensor_Disconnections__Noise_.Life_check_SuspFR.Merge.Merge_k /end MEASUREMENT
/begin MEASUREMENT Disconnections.Disconnections_B.Merge_kw "" FLOAT64_IEEE Disconnections_CM_double 0 0 -1.7e+308 1.7e+308 ECU_ADDRESS 0x0 DISPLAY_IDENTIFIER Disconnections.Sensor_Disconnections__Noise_.Life_check_SuspRR.Merge.Merge_kw /end MEASUREMENT
/begin MEASUREMENT Disconnections.Disconnections_B.Merge_m "" FLOAT64_IEEE Disconnections_CM_double 0 0 -1.7e+308 1.7e+308 ECU_ADDRESS 0x0 DISPLAY_IDENTIFIER Disconnections.ECU_Disconections.LifeCheck_AccRear.Merge.Merge_m /end MEASUREMENT
/begin MEASUREMENT Disconnections.Disconnections_B.Merge_n "" FLOAT64_IEEE Disconnections_CM_double 0 0 -1.7e+308 1.7e+308 ECU_ADDRESS 0x0 DISPLAY_IDENTIFIER Disconnections.Sensor_Disconnections__Noise_.Life_check_SuspFL.Merge.Merge_n /end MEASUREMENT
/begin MEASUREMENT Disconnections.Disconnections_B.Merge_p "" FLOAT64_IEEE Disconnections_CM_double 0 0 -1.7e+308 1.7e+308 ECU_ADDRESS 0x0 DISPLAY_IDENTIFIER Disconnections.Sensor_Disconnections__Noise_.Life_check_SuspRL.Merge.Merge_p /end MEASUREMENT
/begin MEASUREMENT Disconnections.Disconnections_DW.A "" FLOAT64_IEEE Disconnections_CM_double 0 0 -1.7e+308 1.7e+308 ECU_ADDRESS 0x0 DISPLAY_IDENTIFIER Disconnections.Counter.Data_Store_Memory.A /end MEASUREMENT
/begin MEASUREMENT Disconnections.Disconnections_DW.A_o "" FLOAT64_IEEE Disconnections_CM_double 0 0 -1.7e+308 1.7e+308 ECU_ADDRESS 0x0 DISPLAY_IDENTIFIER Disconnections.Counter1.Data_Store_Memory.A_o /end MEASUREMENT
/begin MEASUREMENT Disconnections.Disconnections_DW.Last_alive "" FLOAT64_IEEE Disconnections_CM_double 0 0 -1.7e+308 1.7e+308 ECU_ADDRESS 0x0 DISPLAY_IDENTIFIER Disconnections.ECU_Disconections.LifeCheck_BMS.Data_Store_Memory.Last_alive /end MEASUREMENT
/begin MEASUREMENT Disconnections.Disconnections_DW.Last_alive_n "" FLOAT64_IEEE Disconnections_CM_double 0 0 -1.7e+308 1.7e+308 ECU_ADDRESS 0x0 DISPLAY_IDENTIFIER Disconnections.ECU_Disconections.LifeCheck_AccFront.Data_Store_Memory.Last_alive_n /end MEASUREMENT
/begin MEASUREMENT Disconnections.Disconnections_DW.Last_alive_n0 "" FLOAT64_IEEE Disconnections_CM_double 0 0 -1.7e+308 1.7e+308 ECU_ADDRESS 0x0 DISPLAY_IDENTIFIER Disconnections.ECU_Disconections.LifeCheck_AccRear.Data_Store_Memory.Last_alive_n0 /end MEASUREMENT
/begin MEASUREMENT Disconnections.Disconnections_DW.Last_alive_p "" FLOAT64_IEEE Disconnections_CM_double 0 0 -1.7e+308 1.7e+308 ECU_ADDRESS 0x0 DISPLAY_IDENTIFIER Disconnections.ECU_Disconections.LifeCheck_Dash.Data_Store_Memory.Last_alive_p /end MEASUREMENT
/begin MEASUREMENT Disconnections.Disconnections_DW.Last_alive_pb "" FLOAT64_IEEE Disconnections_CM_double 0 0 -1.7e+308 1.7e+308 ECU_ADDRESS 0x0 DISPLAY_IDENTIFIER Disconnections.ECU_Disconections.Life_check4.Data_Store_Memory.Last_alive_pb /end MEASUREMENT
/begin MEASUREMENT Disconnections.Disconnections_U.APPS1_Bits "" FLOAT64_IEEE Disconnections_CM_double 0 0 -1.7e+308 1.7e+308 ECU_ADDRESS 0x0 DISPLAY_IDENTIFIER Disconnections.APPS1_Bits /end MEASUREMENT
/begin MEASUREMENT Disconnections.Disconnections_U.APPS2_Bits "" FLOAT64_IEEE Disconnections_CM_double 0 0 -1.7e+308 1.7e+308 ECU_ADDRESS 0x0 DISPLAY_IDENTIFIER Disconnections.APPS2_Bits /end MEASUREMENT
/begin MEASUREMENT Disconnections.Disconnections_U.BMS_Alive "" FLOAT64_IEEE Disconnections_CM_double 0 0 -1.7e+308 1.7e+308 ECU_ADDRESS 0x0 DISPLAY_IDENTIFIER Disconnections.BMS_Alive /end MEASUREMENT
/begin MEASUREMENT Disconnections.Disconnections_U.BrakePedal_Bits "" FLOAT64_IEEE Disconnections_CM_double 0 0 -1.7e+308 1.7e+308 ECU_ADDRESS 0x0 DISPLAY_IDENTIFIER Disconnections.BrakePedal_Bits /end MEASUREMENT
/begin MEASUREMENT Disconnections.Disconnections_U.Dash_Alive "" FLOAT64_IEEE Disconnections_CM_double 0 0 -1.7e+308 1.7e+308 ECU_ADDRESS 0x0 DISPLAY_IDENTIFIER Disconnections.Dash_Alive /end MEASUREMENT
/begin MEASUREMENT Disconnections.Disconnections_U.Disconnection_InvL "" UBYTE Disconnections_CM_boolean 0 0 0 1 ECU_ADDRESS 0x0 DISPLAY_IDENTIFIER Disconnections.Disconnection_InvL /end MEASUREMENT
/begin MEASUREMENT Disconnections.Disconnections_U.Disconnection_InvR "" UBYTE Disconnections_CM_boolean 0 0 0 1 ECU_ADDRESS 0x0 DISPLAY_IDENTIFIER Disconnections.Disconnection_InvR /end MEASUREMENT
/begin MEASUREMENT Disconnections.Disconnections_U.Ellipse_Alive "" FLOAT64_IEEE Disconnections_CM_double 0 0 -1.7e+308 1.7e+308 ECU_ADDRESS 0x0 DISPLAY_IDENTIFIER Disconnections.Ellipse_Alive /end MEASUREMENT
/begin MEASUREMENT Disconnections.Disconnections_U.Front_Alive "" FLOAT64_IEEE Disconnections_CM_double 0 0 -1.7e+308 1.7e+308 ECU_ADDRESS 0x0 DISPLAY_IDENTIFIER Disconnections.Front_Alive /end MEASUREMENT
/begin MEASUREMENT Disconnections.Disconnections_U.Rear_Alive "" FLOAT64_IEEE Disconnections_CM_double 0 0 -1.7e+308 1.7e+308 ECU_ADDRESS 0x0 DISPLAY_IDENTIFIER Disconnections.Rear_Alive /end MEASUREMENT
/begin MEASUREMENT Disconnections.Disconnections_U.SteeringSensor_Bits "" FLOAT64_IEEE Disconnections_CM_double 0 0 -1.7e+308 1.7e+308 ECU_ADDRESS 0x0 DISPLAY_IDENTIFIER Disconnections.SteeringSensor_Bits /end MEASUREMENT
/begin MEASUREMENT Disconnections.Disconnections_U.Susp_F_L_Bits "" FLOAT64_IEEE Disconnections_CM_double 0 0 -1.7e+308 1.7e+308 ECU_ADDRESS 0x0 DISPLAY_IDENTIFIER Disconnections.Susp_F_L_Bits /end MEASUREMENT
/begin MEASUREMENT Disconnections.Disconnections_U.Susp_F_R_Bits "" FLOAT64_IEEE Disconnections_CM_double 0 0 -1.7e+308 1.7e+308 ECU_ADDRESS 0x0 DISPLAY_IDENTIFIER Disconnections.Susp_F_R_Bits /end MEASUREMENT
/begin MEASUREMENT Disconnections.Disconnections_U.Susp_R_L_Bits "" FLOAT64_IEEE Disconnections_CM_double 0 0 -1.7e+308 1.7e+308 ECU_ADDRESS 0x0 DISPLAY_IDENTIFIER Disconnections.Susp_R_L_Bits /end MEASUREMENT
/begin MEASUREMENT Disconnections.Disconnections_U.Susp_R_R_Bits "" FLOAT64_IEEE Disconnections_CM_double 0 0 -1.7e+308 1.7e+308 ECU_ADDRESS 0x0 DISPLAY_IDENTIFIER Disconnections.Susp_R_R_Bits /end MEASUREMENT
/begin MEASUREMENT Disconnections.Disconnections_U.el_Vel_OK "" FLOAT64_IEEE Disconnections_CM_double 0 0 -1.7e+308 1.7e+308 ECU_ADDRESS 0x0 DISPLAY_IDENTIFIER Disconnections.el_Vel_OK /end MEASUREMENT
/begin MEASUREMENT Disconnections.Disconnections_Y.CriticalDisconnection "" UBYTE Disconnections_CM_boolean 0 0 0 1 ECU_ADDRESS 0x0 DISPLAY_IDENTIFIER Disconnections.CriticalDisconnection /end MEASUREMENT
/begin MEASUREMENT Disconnections.Disconnections_Y.Critical_CAN_Disconnection "" UBYTE Disconnections_CM_boolean 0 0 0 1 ECU_ADDRESS 0x0 DISPLAY_IDENTIFIER Disconnections.Critical_CAN_Disconnection /end MEASUREMENT
/begin MEASUREMENT Disconnections.Disconnections_Y.Critical_Signal_Disconnection "" UBYTE Disconnections_CM_boolean 0 0 0 1 ECU_ADDRESS 0x0 DISPLAY_IDENTIFIER Disconnections.Critical_Signal_Disconnection /end MEASUREMENT
/begin MEASUREMENT Disconnections.Disconnections_Y.Disconnection_APPS1 "" FLOAT64_IEEE Disconnections_CM_double 0 0 -1.7e+308 1.7e+308 ECU_ADDRESS 0x0 DISPLAY_IDENTIFIER Disconnections.Disconnection_APPS1 /end MEASUREMENT
/begin MEASUREMENT Disconnections.Disconnections_Y.Disconnection_APPS2 "" FLOAT64_IEEE Disconnections_CM_double 0 0 -1.7e+308 1.7e+308 ECU_ADDRESS 0x0 DISPLAY_IDENTIFIER Disconnections.Disconnection_APPS2 /end MEASUREMENT
/begin MEASUREMENT Disconnections.Disconnections_Y.Disconnection_BMS "" FLOAT64_IEEE Disconnections_CM_double 0 0 -1.7e+308 1.7e+308 ECU_ADDRESS 0x0 DISPLAY_IDENTIFIER Disconnections.Disconnection_BMS /end MEASUREMENT
/begin MEASUREMENT Disconnections.Disconnections_Y.Disconnection_BrakePedal "" FLOAT64_IEEE Disconnections_CM_double 0 0 -1.7e+308 1.7e+308 ECU_ADDRESS 0x0 DISPLAY_IDENTIFIER Disconnections.Disconnection_BrakePedal /end MEASUREMENT
/begin MEASUREMENT Disconnections.Disconnections_Y.Disconnection_DashBoard "" FLOAT64_IEEE Disconnections_CM_double 0 0 -1.7e+308 1.7e+308 ECU_ADDRESS 0x0 DISPLAY_IDENTIFIER Disconnections.Disconnection_DashBoard /end MEASUREMENT
/begin MEASUREMENT Disconnections.Disconnections_Y.Disconnection_Ellipse "" FLOAT64_IEEE Disconnections_CM_double 0 0 -1.7e+308 1.7e+308 ECU_ADDRESS 0x0 DISPLAY_IDENTIFIER Disconnections.Disconnection_Ellipse /end MEASUREMENT
/begin MEASUREMENT Disconnections.Disconnections_Y.Disconnection_Front "" FLOAT64_IEEE Disconnections_CM_double 0 0 -1.7e+308 1.7e+308 ECU_ADDRESS 0x0 DISPLAY_IDENTIFIER Disconnections.Disconnection_Front /end MEASUREMENT
/begin MEASUREMENT Disconnections.Disconnections_Y.Disconnection_Mode "" FLOAT64_IEEE Disconnections_CM_double 0 0 -1.7e+308 1.7e+308 ECU_ADDRESS 0x0 DISPLAY_IDENTIFIER Disconnections.Disconnection_Mode /end MEASUREMENT
/begin MEASUREMENT Disconnections.Disconnections_Y.Disconnection_Rear "" FLOAT64_IEEE Disconnections_CM_double 0 0 -1.7e+308 1.7e+308 ECU_ADDRESS 0x0 DISPLAY_IDENTIFIER Disconnections.Disconnection_Rear /end MEASUREMENT
/begin MEASUREMENT Disconnections.Disconnections_Y.Disconnection_SteeringSensor "" FLOAT64_IEEE Disconnections_CM_double 0 0 -1.7e+308 1.7e+308 ECU_ADDRESS 0x0 DISPLAY_IDENTIFIER Disconnections.Disconnection_SteeringSensor /end MEASUREMENT
/begin MEASUREMENT Disconnections.Disconnections_Y.Disconnection_Susp_F_L "" FLOAT64_IEEE Disconnections_CM_double 0 0 -1.7e+308 1.7e+308 ECU_ADDRESS 0x0 DISPLAY_IDENTIFIER Disconnections.Disconnection_Susp_F_L /end MEASUREMENT
/begin MEASUREMENT Disconnections.Disconnections_Y.Disconnection_Susp_F_R "" FLOAT64_IEEE Disconnections_CM_double 0 0 -1.7e+308 1.7e+308 ECU_ADDRESS 0x0 DISPLAY_IDENTIFIER Disconnections.Disconnection_Susp_F_R /end MEASUREMENT
/begin MEASUREMENT Disconnections.Disconnections_Y.Disconnection_Susp_R_L "" FLOAT64_IEEE Disconnections_CM_double 0 0 -1.7e+308 1.7e+308 ECU_ADDRESS 0x0 DISPLAY_IDENTIFIER Disconnections.Disconnection_Susp_R_L /end MEASUREMENT
/begin MEASUREMENT Disconnections.Disconnections_Y.Disconnection_Susp_R_R "" FLOAT64_IEEE Disconnections_CM_double 0 0 -1.7e+308 1.7e+308 ECU_ADDRESS 0x0 DISPLAY_IDENTIFIER Disconnections.Disconnection_Susp_R_R /end MEASUREMENT
/begin MEASUREMENT Ellipse.Ellipse_B.Merge "" FLOAT64_IEEE Ellipse_CM_double 0 0 -1.7e+308 1.7e+308 ECU_ADDRESS 0x0 DISPLAY_IDENTIFIER Ellipse.Merge.Merge /end MEASUREMENT
/begin MEASUREMENT Ellipse.Ellipse_U.el_AngleTrack "" FLOAT64_IEEE Ellipse_CM_double 0 0 -1.7e+308 1.7e+308 ECU_ADDRESS 0x0 DISPLAY_IDENTIFIER Ellipse.el_AngleTrack /end MEASUREMENT
/begin MEASUREMENT Ellipse.Ellipse_U.el_CurvatureRadius "" FLOAT64_IEEE Ellipse_CM_double 0 0 -1.7e+308 1.7e+308 ECU_ADDRESS 0x0 DISPLAY_IDENTIFIER Ellipse.el_CurvatureRadius /end MEASUREMENT
/begin MEASUREMENT Ellipse.Ellipse_U.el_Curvature_Valid "" FLOAT64_IEEE Ellipse_CM_double 0 0 -1.7e+308 1.7e+308 ECU_ADDRESS 0x0 DISPLAY_IDENTIFIER Ellipse.el_Curvature_Valid /end MEASUREMENT
/begin MEASUREMENT Ellipse.Ellipse_U.el_LATITUDE_EKF "" FLOAT64_IEEE Ellipse_CM_double 0 0 -1.7e+308 1.7e+308 ECU_ADDRESS 0x0 DISPLAY_IDENTIFIER Ellipse.el_LATITUDE_EKF /end MEASUREMENT
/begin MEASUREMENT Ellipse.Ellipse_U.el_LONGITUDE_EKF "" FLOAT64_IEEE Ellipse_CM_double 0 0 -1.7e+308 1.7e+308 ECU_ADDRESS 0x0 DISPLAY_IDENTIFIER Ellipse.el_LONGITUDE_EKF /end MEASUREMENT
/begin MEASUREMENT Ellipse.Ellipse_U.el_SlipAngle "" FLOAT64_IEEE Ellipse_CM_double 0 0 -1.7e+308 1.7e+308 ECU_ADDRESS 0x0 DISPLAY_IDENTIFIER Ellipse.el_SlipAngle /end MEASUREMENT
/begin MEASUREMENT Ellipse.Ellipse_U.el_Slip_Valid "" FLOAT64_IEEE Ellipse_CM_double 0 0 -1.7e+308 1.7e+308 ECU_ADDRESS 0x0 DISPLAY_IDENTIFIER Ellipse.el_Slip_Valid /end MEASUREMENT
/begin MEASUREMENT Ellipse.Ellipse_U.el_SolutionMode "" FLOAT64_IEEE Ellipse_CM_double 0 0 -1.7e+308 1.7e+308 ECU_ADDRESS 0x0 DISPLAY_IDENTIFIER Ellipse.el_SolutionMode /end MEASUREMENT
/begin MEASUREMENT Ellipse.Ellipse_U.el_Vel_EKF_Valid "" FLOAT64_IEEE Ellipse_CM_double 0 0 -1.7e+308 1.7e+308 ECU_ADDRESS 0x0 DISPLAY_IDENTIFIER Ellipse.el_Vel_EKF_Valid /end MEASUREMENT
/begin MEASUREMENT Ellipse.Ellipse_U.el_Vel_EKF_X "" FLOAT64_IEEE Ellipse_CM_double 0 0 -1.7e+308 1.7e+308 ECU_ADDRESS 0x0 DISPLAY_IDENTIFIER Ellipse.el_Vel_EKF_X /end MEASUREMENT
/begin MEASUREMENT Ellipse.Ellipse_U.el_Vel_EKF_Y "" FLOAT64_IEEE Ellipse_CM_double 0 0 -1.7e+308 1.7e+308 ECU_ADDRESS 0x0 DISPLAY_IDENTIFIER Ellipse.el_Vel_EKF_Y /end MEASUREMENT
/begin MEASUREMENT Ellipse.Ellipse_U.el_Vel_EKF_Z "" FLOAT64_IEEE Ellipse_CM_double 0 0 -1.7e+308 1.7e+308 ECU_ADDRESS 0x0 DISPLAY_IDENTIFIER Ellipse.el_Vel_EKF_Z /end MEASUREMENT
/begin MEASUREMENT Ellipse.Ellipse_U.el_Vel_GPS_D "" FLOAT64_IEEE Ellipse_CM_double 0 0 -1.7e+308 1.7e+308 ECU_ADDRESS 0x0 DISPLAY_IDENTIFIER Ellipse.el_Vel_GPS_D /end MEASUREMENT
/begin MEASUREMENT Ellipse.Ellipse_U.el_Vel_GPS_E "" FLOAT64_IEEE Ellipse_CM_double 0 0 -1.7e+308 1.7e+308 ECU_ADDRESS 0x0 DISPLAY_IDENTIFIER Ellipse.el_Vel_GPS_E /end MEASUREMENT
/begin MEASUREMENT Ellipse.Ellipse_U.el_Vel_GPS_N "" FLOAT64_IEEE Ellipse_CM_double 0 0 -1.7e+308 1.7e+308 ECU_ADDRESS 0x0 DISPLAY_IDENTIFIER Ellipse.el_Vel_GPS_N /end MEASUREMENT
/begin MEASUREMENT Ellipse.Ellipse_U.el_Vel_GPS_Valid "" FLOAT64_IEEE Ellipse_CM_double 0 0 -1.7e+308 1.7e+308 ECU_ADDRESS 0x0 DISPLAY_IDENTIFIER Ellipse.el_Vel_GPS_Valid /end MEASUREMENT
/begin MEASUREMENT Ellipse.Ellipse_Y.el_VEL "" FLOAT64_IEEE Ellipse_CM_double 0 0 -1.7e+308 1.7e+308 ECU_ADDRESS 0x0 DISPLAY_IDENTIFIER Ellipse.el_VEL /end MEASUREMENT
/begin MEASUREMENT Ellipse.Ellipse_Y.el_Vel_OK "" FLOAT64_IEEE Ellipse_CM_double 0 0 -1.7e+308 1.7e+308 ECU_ADDRESS 0x0 DISPLAY_IDENTIFIER Ellipse.el_Vel_OK /end MEASUREMENT
/begin MEASUREMENT Inverters_Action.Inverters_Action_B.Merge "" UBYTE Inverters_Action_CM_boolean 0 0 0 1 ECU_ADDRESS 0x0 DISPLAY_IDENTIFIER Inverters_Action.Merge.Merge /end MEASUREMENT
/begin MEASUREMENT Inverters_Action.Inverters_Action_B.Merge2 "" UBYTE Inverters_Action_CM_uint8 0 0 0.0 255.0 ECU_ADDRESS 0x0 DISPLAY_IDENTIFIER Inverters_Action.Blost_e_Left.Merge2.Merge2 /end MEASUREMENT
/begin MEASUREMENT Inverters_Action.Inverters_Action_B.Merge2_p "" UBYTE Inverters_Action_CM_uint8 0 0 0.0 255.0 ECU_ADDRESS 0x0 DISPLAY_IDENTIFIER Inverters_Action.Blost_e_Right.Merge2.Merge2_p /end MEASUREMENT
/begin MEASUREMENT Inverters_Action.Inverters_Action_B.subscribed "" UBYTE Inverters_Action_CM_boolean 0 0 0 1 ECU_ADDRESS 0x0 DISPLAY_IDENTIFIER Inverters_Action.Blost_e_Right.Unsubscribe__Subscribe.subscribed_.subscribed /end MEASUREMENT
/begin MEASUREMENT Inverters_Action.Inverters_Action_B.subscribed_k "" UBYTE Inverters_Action_CM_boolean 0 0 0 1 ECU_ADDRESS 0x0 DISPLAY_IDENTIFIER Inverters_Action.Blost_e_Left.Unsubscribe__Subscribe.subscribed_.subscribed_k /end MEASUREMENT
/begin MEASUREMENT Inverters_Action.Inverters_Action_ConstB.TorqueCommand.Divide "" FLOAT64_IEEE Inverters_Action_CM_double 0 0 -1.7e+308 1.7e+308 ECU_ADDRESS 0x0 DISPLAY_IDENTIFIER Inverters_Action.Blost_e_Left.Torque_Command.Divide.Divide /end MEASUREMENT
/begin MEASUREMENT Inverters_Action.Inverters_Action_ConstB.TorqueCommand0.BitwiseOperator1 "" UWORD Inverters_Action_CM_uint16 0 0 0.0 65535.0 ECU_ADDRESS 0x0 DISPLAY_IDENTIFIER Inverters_Action.Blost_e_Left.Torque_Command_0.Subsystem.Bitwise_Operator1.BitwiseOperator1 /end MEASUREMENT
/begin MEASUREMENT Inverters_Action.Inverters_Action_ConstB.TorqueCommand0.Current0to65535 "" UWORD Inverters_Action_CM_uint16 0 0 0.0 65535.0 ECU_ADDRESS 0x0 DISPLAY_IDENTIFIER Inverters_Action.Blost_e_Left.Torque_Command_0.Product.Current_0_to_65535 /end MEASUREMENT
/begin MEASUREMENT Inverters_Action.Inverters_Action_ConstB.TorqueCommand0.Divide "" FLOAT64_IEEE Inverters_Action_CM_double 0 0 -1.7e+308 1.7e+308 ECU_ADDRESS 0x0 DISPLAY_IDENTIFIER Inverters_Action.Blost_e_Left.Torque_Command_0.Divide.Divide /end MEASUREMENT
/begin MEASUREMENT Inverters_Action.Inverters_Action_ConstB.TorqueCommand0.ShiftArithmetic "" UWORD Inverters_Action_CM_uint16 0 0 0.0 65535.0 ECU_ADDRESS 0x0 DISPLAY_IDENTIFIER Inverters_Action.Blost_e_Left.Torque_Command_0.Subsystem.Shift_Arithmetic.ShiftArithmetic /end MEASUREMENT
/begin MEASUREMENT Inverters_Action.Inverters_Action_ConstB.TorqueCommand0.b7tob0 "" UWORD Inverters_Action_CM_uint16 0 0 0.0 65535.0 ECU_ADDRESS 0x0 DISPLAY_IDENTIFIER Inverters_Action.Blost_e_Left.Torque_Command_0.Subsystem.Bitwise_Operator.b7_to_b0 /end MEASUREMENT
/begin MEASUREMENT Inverters_Action.Inverters_Action_ConstB.TorqueCommand0_a.BitwiseOperator1 "" UWORD Inverters_Action_CM_uint16 0 0 0.0 65535.0 ECU_ADDRESS 0x0 DISPLAY_IDENTIFIER Inverters_Action.Blost_e_Right.Torque_Command_0.Subsystem.Bitwise_Operator1.BitwiseOperator1 /end MEASUREMENT
/begin MEASUREMENT Inverters_Action.Inverters_Action_ConstB.TorqueCommand0_a.Current0to65535 "" UWORD Inverters_Action_CM_uint16 0 0 0.0 65535.0 ECU_ADDRESS 0x0 DISPLAY_IDENTIFIER Inverters_Action.Blost_e_Right.Torque_Command_0.Product.Current_0_to_65535 /end MEASUREMENT
/begin MEASUREMENT Inverters_Action.Inverters_Action_ConstB.TorqueCommand0_a.Divide "" FLOAT64_IEEE Inverters_Action_CM_double 0 0 -1.7e+308 1.7e+308 ECU_ADDRESS 0x0 DISPLAY_IDENTIFIER Inverters_Action.Blost_e_Right.Torque_Command_0.Divide.Divide /end MEASUREMENT
/begin MEASUREMENT Inverters_Action.Inverters_Action_ConstB.TorqueCommand0_a.ShiftArithmetic "" UWORD Inverters_Action_CM_uint16 0 0 0.0 65535.0 ECU_ADDRESS 0x0 DISPLAY_IDENTIFIER Inverters_Action.Blost_e_Right.Torque_Command_0.Subsystem.Shift_Arithmetic.ShiftArithmetic /end MEASUREMENT
/begin MEASUREMENT Inverters_Action.Inverters_Action_ConstB.TorqueCommand0_a.b7tob0 "" UWORD Inverters_Action_CM_uint16 0 0 0.0 65535.0 ECU_ADDRESS 0x0 DISPLAY_IDENTIFIER Inverters_Action.Blost_e_Right.Torque_Command_0.Subsystem.Bitwise_Operator.b7_to_b0 /end MEASUREMENT
/begin MEASUREMENT Inverters_Action.Inverters_Action_ConstB.TorqueCommand_k.Divide "" FLOAT64_IEEE Inverters_Action_CM_double 0 0 -1.7e+308 1.7e+308 ECU_ADDRESS 0x0 DISPLAY_IDENTIFIER Inverters_Action.Blost_e_Right.Torque_Command.Divide.Divide /end MEASUREMENT
/begin MEASUREMENT Inverters_Action.Inverters_Action_DW.EnumerationCounter "" FLOAT64_IEEE Inverters_Action_CM_double 0 0 -1.7e+308 1.7e+308 ECU_ADDRESS 0x0 DISPLAY_IDENTIFIER Inverters_Action.Blost_e_Left.Data_Store_Memory2.EnumerationCounter /end MEASUREMENT
/begin MEASUREMENT Inverters_Action.Inverters_Action_DW.EnumerationCounter_g "" FLOAT64_IEEE Inverters_Action_CM_double 0 0 -1.7e+308 1.7e+308 ECU_ADDRESS 0x0 DISPLAY_IDENTIFIER Inverters_Action.Blost_e_Right.Data_Store_Memory2.EnumerationCounter_g /end MEASUREMENT
/begin MEASUREMENT Inverters_Action.Inverters_Action_DW.LastAction "" FLOAT64_IEEE Inverters_Action_CM_double 0 0 -1.7e+308 1.7e+308 ECU_ADDRESS 0x0 DISPLAY_IDENTIFIER Inverters_Action.Blost_e_Left.Data_Store_Memory1.LastAction /end MEASUREMENT
/begin MEASUREMENT Inverters_Action.Inverters_Action_DW.LastAction_l "" FLOAT64_IEEE Inverters_Action_CM_double 0 0 -1.7e+308 1.7e+308 ECU_ADDRESS 0x0 DISPLAY_IDENTIFIER Inverters_Action.Blost_e_Right.Data_Store_Memory1.LastAction_l /end MEASUREMENT
/begin MEASUREMENT Inverters_Action.Inverters_Action_U.InvertersAction "" FLOAT64_IEEE Inverters_Action_CM_double 0 0 -1.7e+308 1.7e+308 ECU_ADDRESS 0x0 DISPLAY_IDENTIFIER Inverters_Action.InvertersAction /end MEASUREMENT
/begin MEASUREMENT Inverters_Action.Inverters_Action_U.current_L "" FLOAT64_IEEE Inverters_Action_CM_double 0 0 -1.7e+308 1.7e+308 ECU_ADDRESS 0x0 DISPLAY_IDENTIFIER Inverters_Action.current_L /end MEASUREMENT
/begin MEASUREMENT Inverters_Action.Inverters_Action_U.current_R "" FLOAT64_IEEE Inverters_Action_CM_double 0 0 -1.7e+308 1.7e+308 ECU_ADDRESS 0x0 DISPLAY_IDENTIFIER Inverters_Action.current_R /end MEASUREMENT
/begin MEASUREMENT Inverters_Action.Inverters_Action_Y.Inverter_L_RegID "" UBYTE Inverters_Action_CM_uint8 0 0 0.0 255.0 ECU_ADDRESS 0x0 DISPLAY_IDENTIFIER Inverters_Action.Inverter_L_RegID /end MEASUREMENT
/begin MEASUREMENT Inverters_Action.Inverters_Action_Y.Inverter_L_b15tob8 "" UBYTE Inverters_Action_CM_uint8 0 0 0.0 255.0 ECU_ADDRESS 0x0 DISPLAY_IDENTIFIER Inverters_Action.Inverter_L_b15tob8 /end MEASUREMENT
/begin MEASUREMENT Inverters_Action.Inverters_Action_Y.Inverter_L_b7tob0 "" UBYTE Inverters_Action_CM_uint8 0 0 0.0 255.0 ECU_ADDRESS 0x0 DISPLAY_IDENTIFIER Inverters_Action.Inverter_L_b7tob0 /end MEASUREMENT
/begin MEASUREMENT Inverters_Action.Inverters_Action_Y.Inverter_R_RegID "" UBYTE Inverters_Action_CM_uint8 0 0 0.0 255.0 ECU_ADDRESS 0x0 DISPLAY_IDENTIFIER Inverters_Action.Inverter_R_RegID /end MEASUREMENT
/begin MEASUREMENT Inverters_Action.Inverters_Action_Y.Inverter_R_b15tob8 "" UBYTE Inverters_Action_CM_uint8 0 0 0.0 255.0 ECU_ADDRESS 0x0 DISPLAY_IDENTIFIER Inverters_Action.Inverter_R_b15tob8 /end MEASUREMENT
/begin MEASUREMENT Inverters_Action.Inverters_Action_Y.Inverter_R_b7tob0 "" UBYTE Inverters_Action_CM_uint8 0 0 0.0 255.0 ECU_ADDRESS 0x0 DISPLAY_IDENTIFIER Inverters_Action.Inverter_R_b7tob0 /end MEASUREMENT
/begin MEASUREMENT Inverters_Action.Inverters_Action_Y.InvertersSubscribed "" UBYTE Inverters_Action_CM_boolean 0 0 0 1 ECU_ADDRESS 0x0 DISPLAY_IDENTIFIER Inverters_Action.InvertersSubscribed /end MEASUREMENT
/begin MEASUREMENT Inverters_Data.Inverters_Data_DW.Last_alive "" FLOAT64_IEEE Inverters_Data_CM_double 0 0 -1.7e+308 1.7e+308 ECU_ADDRESS 0x0 DISPLAY_IDENTIFIER Inverters_Data.Life_check_InverterL.Data_Store_Memory.Last_alive /end MEASUREMENT
/begin MEASUREMENT Inverters_Data.Inverters_Data_DW.Last_alive_h "" FLOAT64_IEEE Inverters_Data_CM_double 0 0 -1.7e+308 1.7e+308 ECU_ADDRESS 0x0 DISPLAY_IDENTIFIER Inverters_Data.Life_check_InverterR.Data_Store_Memory.Last_alive_h /end MEASUREMENT
/begin MEASUREMENT Inverters_Data.Inverters_Data_DW.Tot_Errors "" FLOAT64_IEEE Inverters_Data_CM_double 0 0 -1.7e+308 1.7e+308 ECU_ADDRESS 0x0 DISPLAY_IDENTIFIER Inverters_Data.Life_check_InverterL.Data_Store_Memory1.Tot_Errors /end MEASUREMENT
/begin MEASUREMENT Inverters_Data.Inverters_Data_DW.Tot_Errors_c "" FLOAT64_IEEE Inverters_Data_CM_double 0 0 -1.7e+308 1.7e+308 ECU_ADDRESS 0x0 DISPLAY_IDENTIFIER Inverters_Data.Life_check_InverterR.Data_Store_Memory1.Tot_Errors_c /end MEASUREMENT
/begin MEASUREMENT Inverters_Data.Inverters_Data_U.Inv_L_RegID "" FLOAT64_IEEE Inverters_Data_CM_double 0 0 -1.7e+308 1.7e+308 ECU_ADDRESS 0x0 DISPLAY_IDENTIFIER Inverters_Data.Inv_L_RegID /end MEASUREMENT
/begin MEASUREMENT Inverters_Data.Inverters_Data_U.Inv_L_RegID_M235_Inv_L_DCBus "" FLOAT64_IEEE Inverters_Data_CM_double 0 0 -1.7e+308 1.7e+308 ECU_ADDRESS 0x0 DISPLAY_IDENTIFIER Inverters_Data.Inv_L_RegID_M235_Inv_L_DCBus /end MEASUREMENT
/begin MEASUREMENT Inverters_Data.Inverters_Data_U.Inv_L_RegID_M48_Inv_L_Speed "" FLOAT64_IEEE Inverters_Data_CM_double 0 0 -1.7e+308 1.7e+308 ECU_ADDRESS 0x0 DISPLAY_IDENTIFIER Inverters_Data.Inv_L_RegID_M48_Inv_L_Speed /end MEASUREMENT
/begin MEASUREMENT Inverters_Data.Inverters_Data_U.Inv_L_RegID_M73_Inv_L_TempMotor "" FLOAT64_IEEE Inverters_Data_CM_double 0 0 -1.7e+308 1.7e+308 ECU_ADDRESS 0x0 DISPLAY_IDENTIFIER Inverters_Data.Inv_L_RegID_M73_Inv_L_TempMotor /end MEASUREMENT
/begin MEASUREMENT Inverters_Data.Inverters_Data_U.Inv_L_RegID_M74_Inv_L_TempIGBT "" FLOAT64_IEEE Inverters_Data_CM_double 0 0 -1.7e+308 1.7e+308 ECU_ADDRESS 0x0 DISPLAY_IDENTIFIER Inverters_Data.Inv_L_RegID_M74_Inv_L_TempIGBT /end MEASUREMENT
/begin MEASUREMENT Inverters_Data.Inverters_Data_U.Inv_R_RegID "" FLOAT64_IEEE Inverters_Data_CM_double 0 0 -1.7e+308 1.7e+308 ECU_ADDRESS 0x0 DISPLAY_IDENTIFIER Inverters_Data.Inv_R_RegID /end MEASUREMENT
/begin MEASUREMENT Inverters_Data.Inverters_Data_U.Inv_R_RegID_M235_Inv_R_DCBus "" FLOAT64_IEEE Inverters_Data_CM_double 0 0 -1.7e+308 1.7e+308 ECU_ADDRESS 0x0 DISPLAY_IDENTIFIER Inverters_Data.Inv_R_RegID_M235_Inv_R_DCBus /end MEASUREMENT
/begin MEASUREMENT Inverters_Data.Inverters_Data_U.Inv_R_RegID_M48_Inv_R_Speed "" FLOAT64_IEEE Inverters_Data_CM_double 0 0 -1.7e+308 1.7e+308 ECU_ADDRESS 0x0 DISPLAY_IDENTIFIER Inverters_Data.Inv_R_RegID_M48_Inv_R_Speed /end MEASUREMENT
/begin MEASUREMENT Inverters_Data.Inverters_Data_U.Inv_R_RegID_M73_Inv_R_TempMotor "" FLOAT64_IEEE Inverters_Data_CM_double 0 0 -1.7e+308 1.7e+308 ECU_ADDRESS 0x0 DISPLAY_IDENTIFIER Inverters_Data.Inv_R_RegID_M73_Inv_R_TempMotor /end MEASUREMENT
/begin MEASUREMENT Inverters_Data.Inverters_Data_U.Inv_R_RegID_M74_Inv_R_TempIGBT "" FLOAT64_IEEE Inverters_Data_CM_double 0 0 -1.7e+308 1.7e+308 ECU_ADDRESS 0x0 DISPLAY_IDENTIFIER Inverters_Data.Inv_R_RegID_M74_Inv_R_TempIGBT /end MEASUREMENT
/begin MEASUREMENT Inverters_Data.Inverters_Data_Y.Disconnection_InvL "" FLOAT64_IEEE Inverters_Data_CM_double 0 0 -1.7e+308 1.7e+308 ECU_ADDRESS 0x0 DISPLAY_IDENTIFIER Inverters_Data.Disconnection_InvL /end MEASUREMENT
/begin MEASUREMENT Inverters_Data.Inverters_Data_Y.Disconnection_InvR "" FLOAT64_IEEE Inverters_Data_CM_double 0 0 -1.7e+308 1.7e+308 ECU_ADDRESS 0x0 DISPLAY_IDENTIFIER Inverters_Data.Disconnection_InvR /end MEASUREMENT
/begin MEASUREMENT Inverters_Data.Inverters_Data_Y.Inv_L_TempIGBT "" FLOAT64_IEEE Inverters_Data_CM_double 0 0 -1.7e+308 1.7e+308 ECU_ADDRESS 0x0 DISPLAY_IDENTIFIER Inverters_Data.Inv_L_TempIGBT /end MEASUREMENT
/begin MEASUREMENT Inverters_Data.Inverters_Data_Y.Inv_L_TempMotor "" FLOAT64_IEEE Inverters_Data_CM_double 0 0 -1.7e+308 1.7e+308 ECU_ADDRESS 0x0 DISPLAY_IDENTIFIER Inverters_Data.Inv_L_TempMotor /end MEASUREMENT
/begin MEASUREMENT Inverters_Data.Inverters_Data_Y.Inv_R_TempIGBT "" FLOAT64_IEEE Inverters_Data_CM_double 0 0 -1.7e+308 1.7e+308 ECU_ADDRESS 0x0 DISPLAY_IDENTIFIER Inverters_Data.Inv_R_TempIGBT /end MEASUREMENT
/begin MEASUREMENT Inverters_Data.Inverters_Data_Y.Inv_R_TempMotor "" FLOAT64_IEEE Inverters_Data_CM_double 0 0 -1.7e+308 1.7e+308 ECU_ADDRESS 0x0 DISPLAY_IDENTIFIER Inverters_Data.Inv_R_TempMotor /end MEASUREMENT
/begin MEASUREMENT Inverters_Data.Inverters_Data_Y.InvertersMinDCBus "" FLOAT64_IEEE Inverters_Data_CM_double 0 0 -1.7e+308 1.7e+308 ECU_ADDRESS 0x0 DISPLAY_IDENTIFIER Inverters_Data.InvertersMinDCBus /end MEASUREMENT
/begin MEASUREMENT Inverters_Data.Inverters_Data_Y.Max_Temp_IGBT "" FLOAT64_IEEE Inverters_Data_CM_double 0 0 -1.7e+308 1.7e+308 ECU_ADDRESS 0x0 DISPLAY_IDENTIFIER Inverters_Data.Max_Temp_IGBT /end MEASUREMENT
/begin MEASUREMENT Inverters_Data.Inverters_Data_Y.Max_Temp_Motors "" FLOAT64_IEEE Inverters_Data_CM_double 0 0 -1.7e+308 1.7e+308 ECU_ADDRESS 0x0 DISPLAY_IDENTIFIER Inverters_Data.Max_Temp_Motors /end MEASUREMENT
/begin MEASUREMENT Inverters_Data.Inverters_Data_Y.RL_Vel_ms_Wheel "" FLOAT64_IEEE Inverters_Data_CM_double 0 0 -1.7e+308 1.7e+308 ECU_ADDRESS 0x0 DISPLAY_IDENTIFIER Inverters_Data.RL_Vel_ms_Wheel /end MEASUREMENT
/begin MEASUREMENT Inverters_Data.Inverters_Data_Y.RL_rads_Motor "" FLOAT64_IEEE Inverters_Data_CM_double 0 0 -1.7e+308 1.7e+308 ECU_ADDRESS 0x0 DISPLAY_IDENTIFIER Inverters_Data.RL_rads_Motor /end MEASUREMENT
/begin MEASUREMENT Inverters_Data.Inverters_Data_Y.RR_Vel_ms_Wheel "" FLOAT64_IEEE Inverters_Data_CM_double 0 0 -1.7e+308 1.7e+308 ECU_ADDRESS 0x0 DISPLAY_IDENTIFIER Inverters_Data.RR_Vel_ms_Wheel /end MEASUREMENT
/begin MEASUREMENT Inverters_Data.Inverters_Data_Y.RR_rads_Motor "" FLOAT64_IEEE Inverters_Data_CM_double 0 0 -1.7e+308 1.7e+308 ECU_ADDRESS 0x0 DISPLAY_IDENTIFIER Inverters_Data.RR_rads_Motor /end MEASUREMENT
/begin MEASUREMENT Inverters_Data.Inverters_Data_Y.Speed "" FLOAT64_IEEE Inverters_Data_CM_double 0 0 -1.7e+308 1.7e+308 ECU_ADDRESS 0x0 DISPLAY_IDENTIFIER Inverters_Data.Speed /end MEASUREMENT
/begin MEASUREMENT Power_Control.Power_Control_B.sf_InverterL_Temp_Limitation.Current_out "" FLOAT64_IEEE Power_Control_CM_double 0 0 -1.7e+308 1.7e+308 ECU_ADDRESS 0x0 DISPLAY_IDENTIFIER Power_Control.InverterL_Temp_Limitation.Current_out /end MEASUREMENT
/begin MEASUREMENT Power_Control.Power_Control_B.sf_InverterR_Temp_Limitation.Current_out "" FLOAT64_IEEE Power_Control_CM_double 0 0 -1.7e+308 1.7e+308 ECU_ADDRESS 0x0 DISPLAY_IDENTIFIER Power_Control.InverterR_Temp_Limitation.Current_out /end MEASUREMENT
/begin MEASUREMENT Power_Control.Power_Control_B.sf_MotorL_Temp_Limitation.Current_out "" FLOAT64_IEEE Power_Control_CM_double 0 0 -1.7e+308 1.7e+308 ECU_ADDRESS 0x0 DISPLAY_IDENTIFIER Power_Control.MotorL_Temp_Limitation.Current_out /end MEASUREMENT
/begin MEASUREMENT Power_Control.Power_Control_B.sf_MotorR_Temp_Limitation.Current_out "" FLOAT64_IEEE Power_Control_CM_double 0 0 -1.7e+308 1.7e+308 ECU_ADDRESS 0x0 DISPLAY_IDENTIFIER Power_Control.MotorR_Temp_Limitation.Current_out /end MEASUREMENT
/begin MEASUREMENT Power_Control.Power_Control_DW.A "" FLOAT64_IEEE Power_Control_CM_double 0 0 -1.7e+308 1.7e+308 ECU_ADDRESS 0x0 DISPLAY_IDENTIFIER Power_Control.Accumulator_Power.PowerLimitDetection.Data_Store_Memory10.A /end MEASUREMENT
/begin MEASUREMENT Power_Control.Power_Control_U.Accumulator_Current "" FLOAT64_IEEE Power_Control_CM_double 0 0 -1.7e+308 1.7e+308 ECU_ADDRESS 0x0 DISPLAY_IDENTIFIER Power_Control.Accumulator_Current /end MEASUREMENT
/begin MEASUREMENT Power_Control.Power_Control_U.Accumulator_Voltage "" FLOAT64_IEEE Power_Control_CM_double 0 0 -1.7e+308 1.7e+308 ECU_ADDRESS 0x0 DISPLAY_IDENTIFIER Power_Control.Accumulator_Voltage /end MEASUREMENT
/begin MEASUREMENT Power_Control.Power_Control_U.Inv_L_TempIGBT "" FLOAT64_IEEE Power_Control_CM_double 0 0 -1.7e+308 1.7e+308 ECU_ADDRESS 0x0 DISPLAY_IDENTIFIER Power_Control.Inv_L_TempIGBT /end MEASUREMENT
/begin MEASUREMENT Power_Control.Power_Control_U.Inv_L_TempMotor "" FLOAT64_IEEE Power_Control_CM_double 0 0 -1.7e+308 1.7e+308 ECU_ADDRESS 0x0 DISPLAY_IDENTIFIER Power_Control.Inv_L_TempMotor /end MEASUREMENT
/begin MEASUREMENT Power_Control.Power_Control_U.Inv_R_TempIGBT "" FLOAT64_IEEE Power_Control_CM_double 0 0 -1.7e+308 1.7e+308 ECU_ADDRESS 0x0 DISPLAY_IDENTIFIER Power_Control.Inv_R_TempIGBT /end MEASUREMENT
/begin MEASUREMENT Power_Control.Power_Control_U.Inv_R_TempMotor "" FLOAT64_IEEE Power_Control_CM_double 0 0 -1.7e+308 1.7e+308 ECU_ADDRESS 0x0 DISPLAY_IDENTIFIER Power_Control.Inv_R_TempMotor /end MEASUREMENT
/begin MEASUREMENT Power_Control.Power_Control_U.Torque_L "" FLOAT64_IEEE Power_Control_CM_double 0 0 -1.7e+308 1.7e+308 ECU_ADDRESS 0x0 DISPLAY_IDENTIFIER Power_Control.Torque_L /end MEASUREMENT
/begin MEASUREMENT Power_Control.Power_Control_U.Torque_R "" FLOAT64_IEEE Power_Control_CM_double 0 0 -1.7e+308 1.7e+308 ECU_ADDRESS 0x0 DISPLAY_IDENTIFIER Power_Control.Torque_R /end MEASUREMENT
/begin MEASUREMENT Power_Control.Power_Control_Y.Power "" FLOAT64_IEEE Power_Control_CM_double 0 0 -1.7e+308 1.7e+308 ECU_ADDRESS 0x0 DISPLAY_IDENTIFIER Power_Control.Power /end MEASUREMENT
/begin MEASUREMENT Power_Control.Power_Control_Y.PowerLimitReached "" FLOAT64_IEEE Power_Control_CM_double 0 0 -1.7e+308 1.7e+308 ECU_ADDRESS 0x0 DISPLAY_IDENTIFIER Power_Control.PowerLimitReached /end MEASUREMENT
/begin MEASUREMENT Power_Control.Power_Control_Y.PowerMean500ms "" FLOAT64_IEEE Power_Control_CM_double 0 0 -1.7e+308 1.7e+308 ECU_ADDRESS 0x0 DISPLAY_IDENTIFIER Power_Control.PowerMean500ms /end MEASUREMENT
/begin MEASUREMENT Power_Control.Power_Control_Y.current_L "" FLOAT64_IEEE Power_Control_CM_double 0 0 -1.7e+308 1.7e+308 ECU_ADDRESS 0x0 DISPLAY_IDENTIFIER Power_Control.current_L /end MEASUREMENT
/begin MEASUREMENT Power_Control.Power_Control_Y.current_R "" FLOAT64_IEEE Power_Control_CM_double 0 0 -1.7e+308 1.7e+308 ECU_ADDRESS 0x0 DISPLAY_IDENTIFIER Power_Control.current_R /end MEASUREMENT
/begin MEASUREMENT Sensors.Sensors_ConstB.Subtract "" FLOAT64_IEEE Sensors_CM_double 0 0 -1.7e+308 1.7e+308 ECU_ADDRESS 0x0 DISPLAY_IDENTIFIER Sensors.Suspension_FL_Data_Conv.Subtract.Subtract /end MEASUREMENT
/begin MEASUREMENT Sensors.Sensors_ConstB.Subtract_a "" FLOAT64_IEEE Sensors_CM_double 0 0 -1.7e+308 1.7e+308 ECU_ADDRESS 0x0 DISPLAY_IDENTIFIER Sensors.Suspension_FR_Data_Conv.Subtract.Subtract_a /end MEASUREMENT
/begin MEASUREMENT Sensors.Sensors_ConstB.Subtract_e "" FLOAT64_IEEE Sensors_CM_double 0 0 -1.7e+308 1.7e+308 ECU_ADDRESS 0x0 DISPLAY_IDENTIFIER Sensors.Suspension_RL_Data_Conv.Subtract.Subtract_e /end MEASUREMENT
/begin MEASUREMENT Sensors.Sensors_ConstB.Subtract_n "" FLOAT64_IEEE Sensors_CM_double 0 0 -1.7e+308 1.7e+308 ECU_ADDRESS 0x0 DISPLAY_IDENTIFIER Sensors.Suspension_RR_Data_Conv.Subtract.Subtract_n /end MEASUREMENT
/begin MEASUREMENT Sensors.Sensors_ConstB.Subtract_p "" FLOAT64_IEEE Sensors_CM_double 0 0 -1.7e+308 1.7e+308 ECU_ADDRESS 0x0 DISPLAY_IDENTIFIER Sensors.Steering_Data_Conv.Low_Pass.Subtract.Subtract_p /end MEASUREMENT
/begin MEASUREMENT Sensors.Sensors_ConstB.Sum1 "" FLOAT64_IEEE Sensors_CM_double 0 0 -1.7e+308 1.7e+308 ECU_ADDRESS 0x0 DISPLAY_IDENTIFIER Sensors.APPS1_Data_Conv.Sum1.Sum1 /end MEASUREMENT
/begin MEASUREMENT Sensors.Sensors_ConstB.Sum1_c "" FLOAT64_IEEE Sensors_CM_double 0 0 -1.7e+308 1.7e+308 ECU_ADDRESS 0x0 DISPLAY_IDENTIFIER Sensors.Brake_Pedal_Data_Conv.Sum1.Sum1_c /end MEASUREMENT
/begin MEASUREMENT Sensors.Sensors_ConstB.Sum1_d "" FLOAT64_IEEE Sensors_CM_double 0 0 -1.7e+308 1.7e+308 ECU_ADDRESS 0x0 DISPLAY_IDENTIFIER Sensors.APPS1_Data_Conv1.Sum1.Sum1_d /end MEASUREMENT
/begin MEASUREMENT Sensors.Sensors_DW.Previous_IN "" FLOAT64_IEEE Sensors_CM_double 0 0 -1.7e+308 1.7e+308 ECU_ADDRESS 0x0 DISPLAY_IDENTIFIER Sensors.Steering_Data_Conv.Low_Pass.Data_Store_Memory.Previous_IN /end MEASUREMENT
/begin MEASUREMENT Sensors.Sensors_DW.Previous_OUT "" FLOAT64_IEEE Sensors_CM_double 0 0 -1.7e+308 1.7e+308 ECU_ADDRESS 0x0 DISPLAY_IDENTIFIER Sensors.Steering_Data_Conv.Low_Pass.Data_Store_Memory1.Previous_OUT /end MEASUREMENT
/begin MEASUREMENT Sensors.Sensors_U.APPS1_Bits "" FLOAT64_IEEE Sensors_CM_double 0 0 -1.7e+308 1.7e+308 ECU_ADDRESS 0x0 DISPLAY_IDENTIFIER Sensors.APPS1_Bits /end MEASUREMENT
/begin MEASUREMENT Sensors.Sensors_U.APPS2_Bits "" FLOAT64_IEEE Sensors_CM_double 0 0 -1.7e+308 1.7e+308 ECU_ADDRESS 0x0 DISPLAY_IDENTIFIER Sensors.APPS2_Bits /end MEASUREMENT
/begin MEASUREMENT Sensors.Sensors_U.BrakePedal_Bits "" FLOAT64_IEEE Sensors_CM_double 0 0 -1.7e+308 1.7e+308 ECU_ADDRESS 0x0 DISPLAY_IDENTIFIER Sensors.BrakePedal_Bits /end MEASUREMENT
/begin MEASUREMENT Sensors.Sensors_U.Disconnection_APPS1 "" FLOAT64_IEEE Sensors_CM_double 0 0 -1.7e+308 1.7e+308 ECU_ADDRESS 0x0 DISPLAY_IDENTIFIER Sensors.Disconnection_APPS1 /end MEASUREMENT
/begin MEASUREMENT Sensors.Sensors_U.Disconnection_APPS2 "" FLOAT64_IEEE Sensors_CM_double 0 0 -1.7e+308 1.7e+308 ECU_ADDRESS 0x0 DISPLAY_IDENTIFIER Sensors.Disconnection_APPS2 /end MEASUREMENT
/begin MEASUREMENT Sensors.Sensors_U.SteeringSensor_Bits "" FLOAT64_IEEE Sensors_CM_double 0 0 -1.7e+308 1.7e+308 ECU_ADDRESS 0x0 DISPLAY_IDENTIFIER Sensors.SteeringSensor_Bits /end MEASUREMENT
/begin MEASUREMENT Sensors.Sensors_U.Susp_F_L_Bits "" FLOAT64_IEEE Sensors_CM_double 0 0 -1.7e+308 1.7e+308 ECU_ADDRESS 0x0 DISPLAY_IDENTIFIER Sensors.Susp_F_L_Bits /end MEASUREMENT
/begin MEASUREMENT Sensors.Sensors_U.Susp_F_R_Bits "" FLOAT64_IEEE Sensors_CM_double 0 0 -1.7e+308 1.7e+308 ECU_ADDRESS 0x0 DISPLAY_IDENTIFIER Sensors.Susp_F_R_Bits /end MEASUREMENT
/begin MEASUREMENT Sensors.Sensors_U.Susp_R_L_Bits "" FLOAT64_IEEE Sensors_CM_double 0 0 -1.7e+308 1.7e+308 ECU_ADDRESS 0x0 DISPLAY_IDENTIFIER Sensors.Susp_R_L_Bits /end MEASUREMENT
/begin MEASUREMENT Sensors.Sensors_U.Susp_R_R_Bits "" FLOAT64_IEEE Sensors_CM_double 0 0 -1.7e+308 1.7e+308 ECU_ADDRESS 0x0 DISPLAY_IDENTIFIER Sensors.Susp_R_R_Bits /end MEASUREMENT
/begin MEASUREMENT Sensors.Sensors_Y.APPS1_Value "" FLOAT64_IEEE Sensors_CM_double 0 0 -1.7e+308 1.7e+308 ECU_ADDRESS 0x0 DISPLAY_IDENTIFIER Sensors.APPS1_Value /end MEASUREMENT
/begin MEASUREMENT Sensors.Sensors_Y.APPS2_Value "" FLOAT64_IEEE Sensors_CM_double 0 0 -1.7e+308 1.7e+308 ECU_ADDRESS 0x0 DISPLAY_IDENTIFIER Sensors.APPS2_Value /end MEASUREMENT
/begin MEASUREMENT Sensors.Sensors_Y.BrakePedal_Value "" FLOAT64_IEEE Sensors_CM_double 0 0 -1.7e+308 1.7e+308 ECU_ADDRESS 0x0 DISPLAY_IDENTIFIER Sensors.BrakePedal_Value /end MEASUREMENT
/begin MEASUREMENT Sensors.Sensors_Y.SUSP_F_L "" FLOAT64_IEEE Sensors_CM_double 0 0 -1.7e+308 1.7e+308 ECU_ADDRESS 0x0 DISPLAY_IDENTIFIER Sensors.SUSP_F_L /end MEASUREMENT
/begin MEASUREMENT Sensors.Sensors_Y.SUSP_F_R "" FLOAT64_IEEE Sensors_CM_double 0 0 -1.7e+308 1.7e+308 ECU_ADDRESS 0x0 DISPLAY_IDENTIFIER Sensors.SUSP_F_R /end MEASUREMENT
/begin MEASUREMENT Sensors.Sensors_Y.SUSP_R_L "" FLOAT64_IEEE Sensors_CM_double 0 0 -1.7e+308 1.7e+308 ECU_ADDRESS 0x0 DISPLAY_IDENTIFIER Sensors.SUSP_R_L /end MEASUREMENT
/begin MEASUREMENT Sensors.Sensors_Y.SUSP_R_R "" FLOAT64_IEEE Sensors_CM_double 0 0 -1.7e+308 1.7e+308 ECU_ADDRESS 0x0 DISPLAY_IDENTIFIER Sensors.SUSP_R_R /end MEASUREMENT
/begin MEASUREMENT Sensors.Sensors_Y.SteeringSensor_Value "" FLOAT64_IEEE Sensors_CM_double 0 0 -1.7e+308 1.7e+308 ECU_ADDRESS 0x0 DISPLAY_IDENTIFIER Sensors.SteeringSensor_Value /end MEASUREMENT
/begin MEASUREMENT SoC.SoC_B.AccuOCVtoSOC2024 "" FLOAT64_IEEE SoC_CM_double 0 0 -1.7e+308 1.7e+308 ECU_ADDRESS 0x0 DISPLAY_IDENTIFIER SoC.Accu_OCV_to_SOC_2024.AccuOCVtoSOC2024 /end MEASUREMENT
/begin MEASUREMENT SoC.SoC_B.CellOCVtoSOC1 "" FLOAT64_IEEE SoC_CM_double 0 0 -1.7e+308 1.7e+308 ECU_ADDRESS 0x0 DISPLAY_IDENTIFIER SoC.Cell_OCV_to_SOC_1.CellOCVtoSOC1 /end MEASUREMENT
/begin MEASUREMENT SoC.SoC_B.CellOCVtoSOC2024 "" FLOAT64_IEEE SoC_CM_double 0 0 -1.7e+308 1.7e+308 ECU_ADDRESS 0x0 DISPLAY_IDENTIFIER SoC.Cell_OCV_to_SOC_2024.CellOCVtoSOC2024 /end MEASUREMENT
/begin MEASUREMENT SoC.SoC_B.CoreSubsys[0].Pdot "" FLOAT64_IEEE SoC_CM_double 0 0 -1.7e+308 1.7e+308 ECU_ADDRESS 0x0 DISPLAY_IDENTIFIER SoC.3RC_Accu.EKF_3RC.Prediction_correction.Sum.Pdot MATRIX_DIM 4 4 1 /end MEASUREMENT
/begin MEASUREMENT SoC.SoC_B.CoreSubsys[0].Sum2 "" FLOAT64_IEEE SoC_CM_double 0 0 -1.7e+308 1.7e+308 ECU_ADDRESS 0x0 DISPLAY_IDENTIFIER SoC.3RC_Accu.EKF_3RC.Prediction_correction.Sum2.Sum2 ARRAY_SIZE 4 /end MEASUREMENT
/begin MEASUREMENT SoC.SoC_B.CoreSubsys[0].TmpSignalConversionAtIntegrator "" FLOAT64_IEEE SoC_CM_double 0 0 -1.7e+308 1.7e+308 ECU_ADDRESS 0x0 DISPLAY_IDENTIFIER SoC.Opaque.TmpSignalConversionAtIntegrator ARRAY_SIZE 4 /end MEASUREMENT
/begin MEASUREMENT SoC.SoC_B.uRC_Cell_H[0].CoreSubsys.Pdot "" FLOAT64_IEEE SoC_CM_double 0 0 -1.7e+308 1.7e+308 ECU_ADDRESS 0x0 DISPLAY_IDENTIFIER SoC.3RC_Cell_H.EKF_3RC.Prediction_correction.Sum.Pdot MATRIX_DIM 4 4 1 /end MEASUREMENT
/begin MEASUREMENT SoC.SoC_B.uRC_Cell_H[0].CoreSubsys.Sum2 "" FLOAT64_IEEE SoC_CM_double 0 0 -1.7e+308 1.7e+308 ECU_ADDRESS 0x0 DISPLAY_IDENTIFIER SoC.3RC_Cell_H.EKF_3RC.Jacobian.Sum2.Sum2 /end MEASUREMENT
/begin MEASUREMENT SoC.SoC_B.uRC_Cell_H[0].CoreSubsys.Sum2_h "" FLOAT64_IEEE SoC_CM_double 0 0 -1.7e+308 1.7e+308 ECU_ADDRESS 0x0 DISPLAY_IDENTIFIER SoC.3RC_Cell_H.EKF_3RC.Prediction_correction.Sum2.Sum2_h ARRAY_SIZE 4 /end MEASUREMENT
/begin MEASUREMENT SoC.SoC_B.uRC_Cell_H[0].CoreSubsys.TmpSignalConversionAtIntegrator "" FLOAT64_IEEE SoC_CM_double 0 0 -1.7e+308 1.7e+308 ECU_ADDRESS 0x0 DISPLAY_IDENTIFIER SoC.Opaque.TmpSignalConversionAtIntegrator ARRAY_SIZE 4 /end MEASUREMENT
/begin MEASUREMENT SoC.SoC_B.uRC_Cell_L[0].CoreSubsys.Pdot "" FLOAT64_IEEE SoC_CM_double 0 0 -1.7e+308 1.7e+308 ECU_ADDRESS 0x0 DISPLAY_IDENTIFIER SoC.3RC_Cell_L.EKF_3RC.Prediction_correction.Sum.Pdot MATRIX_DIM 4 4 1 /end MEASUREMENT
/begin MEASUREMENT SoC.SoC_B.uRC_Cell_L[0].CoreSubsys.Sum2 "" FLOAT64_IEEE SoC_CM_double 0 0 -1.7e+308 1.7e+308 ECU_ADDRESS 0x0 DISPLAY_IDENTIFIER SoC.3RC_Cell_L.EKF_3RC.Jacobian.Sum2.Sum2 /end MEASUREMENT
/begin MEASUREMENT SoC.SoC_B.uRC_Cell_L[0].CoreSubsys.Sum2_h "" FLOAT64_IEEE SoC_CM_double 0 0 -1.7e+308 1.7e+308 ECU_ADDRESS 0x0 DISPLAY_IDENTIFIER SoC.3RC_Cell_L.EKF_3RC.Prediction_correction.Sum2.Sum2_h ARRAY_SIZE 4 /end MEASUREMENT
/begin MEASUREMENT SoC.SoC_B.uRC_Cell_L[0].CoreSubsys.TmpSignalConversionAtIntegrator "" FLOAT64_IEEE SoC_CM_double 0 0 -1.7e+308 1.7e+308 ECU_ADDRESS 0x0 DISPLAY_IDENTIFIER SoC.Opaque.TmpSignalConversionAtIntegrator ARRAY_SIZE 4 /end MEASUREMENT
/begin MEASUREMENT SoC.SoC_ConstB.CoreSubsys.Divide "" FLOAT64_IEEE SoC_CM_double 0 0 -1.7e+308 1.7e+308 ECU_ADDRESS 0x0 DISPLAY_IDENTIFIER SoC.3RC_Accu.EKF_3RC.Prediction_correction.Divide.Divide /end MEASUREMENT
/begin MEASUREMENT SoC.SoC_ConstB.uRC_Cell_H.CoreSubsys.Divide "" FLOAT64_IEEE SoC_CM_double 0 0 -1.7e+308 1.7e+308 ECU_ADDRESS 0x0 DISPLAY_IDENTIFIER SoC.3RC_Cell_H.EKF_3RC.Prediction_correction.Divide.Divide /end MEASUREMENT
/begin MEASUREMENT SoC.SoC_ConstB.uRC_Cell_L.CoreSubsys.Divide "" FLOAT64_IEEE SoC_CM_double 0 0 -1.7e+308 1.7e+308 ECU_ADDRESS 0x0 DISPLAY_IDENTIFIER SoC.3RC_Cell_L.EKF_3RC.Prediction_correction.Divide.Divide /end MEASUREMENT
/begin MEASUREMENT SoC.SoC_U.Accumulator_Current "" FLOAT64_IEEE SoC_CM_double 0 0 -1.7e+308 1.7e+308 ECU_ADDRESS 0x0 DISPLAY_IDENTIFIER SoC.Accumulator_Current /end MEASUREMENT
/begin MEASUREMENT SoC.SoC_U.Accumulator_Voltage "" FLOAT64_IEEE SoC_CM_double 0 0 -1.7e+308 1.7e+308 ECU_ADDRESS 0x0 DISPLAY_IDENTIFIER SoC.Accumulator_Voltage /end MEASUREMENT
/begin MEASUREMENT SoC.SoC_U.Average_CellTemp "" FLOAT64_IEEE SoC_CM_double 0 0 -1.7e+308 1.7e+308 ECU_ADDRESS 0x0 DISPLAY_IDENTIFIER SoC.Average_CellTemp /end MEASUREMENT
/begin MEASUREMENT SoC.SoC_U.Highest_CellVoltage "" FLOAT64_IEEE SoC_CM_double 0 0 -1.7e+308 1.7e+308 ECU_ADDRESS 0x0 DISPLAY_IDENTIFIER SoC.Highest_CellVoltage /end MEASUREMENT
/begin MEASUREMENT SoC.SoC_U.Lowest_CellVoltage "" FLOAT64_IEEE SoC_CM_double 0 0 -1.7e+308 1.7e+308 ECU_ADDRESS 0x0 DISPLAY_IDENTIFIER SoC.Lowest_CellVoltage /end MEASUREMENT
/begin MEASUREMENT SoC.SoC_Y.SoC_Avg "" FLOAT64_IEEE SoC_CM_double 0 0 -1.7e+308 1.7e+308 ECU_ADDRESS 0x0 DISPLAY_IDENTIFIER SoC.SoC_Avg /end MEASUREMENT
/begin MEASUREMENT SoC.SoC_Y.SoC_High "" FLOAT64_IEEE SoC_CM_double 0 0 -1.7e+308 1.7e+308 ECU_ADDRESS 0x0 DISPLAY_IDENTIFIER SoC.SoC_High /end MEASUREMENT
/begin MEASUREMENT SoC.SoC_Y.SoC_KF "" FLOAT64_IEEE SoC_CM_double 0 0 -1.7e+308 1.7e+308 ECU_ADDRESS 0x0 DISPLAY_IDENTIFIER SoC.SoC_KF /end MEASUREMENT
/begin MEASUREMENT SoC.SoC_Y.SoC_Low "" FLOAT64_IEEE SoC_CM_double 0 0 -1.7e+308 1.7e+308 ECU_ADDRESS 0x0 DISPLAY_IDENTIFIER SoC.SoC_Low /end MEASUREMENT
/begin MEASUREMENT Synchronism.Synchronism_DW.counter "" FLOAT64_IEEE Synchronism_CM_double 0 0 -1.7e+308 1.7e+308 ECU_ADDRESS 0x0 DISPLAY_IDENTIFIER Synchronism.Counter.Data_Store_Memory.counter /end MEASUREMENT
/begin MEASUREMENT Synchronism.Synchronism_Y.Sync_CAN1 "" FLOAT64_IEEE Synchronism_CM_double 0 0 -1.7e+308 1.7e+308 ECU_ADDRESS 0x0 DISPLAY_IDENTIFIER Synchronism.Sync_CAN1 /end MEASUREMENT
/begin MEASUREMENT Synchronism.Synchronism_Y.Sync_CAN2 "" FLOAT64_IEEE Synchronism_CM_double 0 0 -1.7e+308 1.7e+308 ECU_ADDRESS 0x0 DISPLAY_IDENTIFIER Synchronism.Sync_CAN2 /end MEASUREMENT
/begin MEASUREMENT VDC.VDC_B.Merge1 "" FLOAT64_IEEE VDC_CM_double 0 0 -1.7e+308 1.7e+308 ECU_ADDRESS 0x0 DISPLAY_IDENTIFIER VDC.Merge1.Merge1 /end MEASUREMENT
/begin MEASUREMENT VDC.VDC_B.Merge2 "" FLOAT64_IEEE VDC_CM_double 0 0 -1.7e+308 1.7e+308 ECU_ADDRESS 0x0 DISPLAY_IDENTIFIER VDC.Merge2.Merge2 /end MEASUREMENT
/begin MEASUREMENT VDC.VDC_B.Merge3 "" FLOAT64_IEEE VDC_CM_double 0 0 -1.7e+308 1.7e+308 ECU_ADDRESS 0x0 DISPLAY_IDENTIFIER VDC.Merge3.Merge3 /end MEASUREMENT
/begin MEASUREMENT VDC.VDC_B.Merge4 "" FLOAT64_IEEE VDC_CM_double 0 0 -1.7e+308 1.7e+308 ECU_ADDRESS 0x0 DISPLAY_IDENTIFIER VDC.Merge4.Merge4 /end MEASUREMENT
/begin MEASUREMENT VDC.VDC_B.Merge6 "" FLOAT64_IEEE VDC_CM_double 0 0 -1.7e+308 1.7e+308 ECU_ADDRESS 0x0 DISPLAY_IDENTIFIER VDC.Merge6.Merge6 /end MEASUREMENT
/begin MEASUREMENT VDC.VDC_B.TC_Warning "" FLOAT64_IEEE VDC_CM_double 0 0 -1.7e+308 1.7e+308 ECU_ADDRESS 0x0 DISPLAY_IDENTIFIER VDC.ACCELERATION.RIGIDAXLE_WITH_TC.Rigid_Axle_with_TC_2024.TC_Warning /end MEASUREMENT
/begin MEASUREMENT VDC.VDC_B.TC_Warning_l "" FLOAT64_IEEE VDC_CM_double 0 0 -1.7e+308 1.7e+308 ECU_ADDRESS 0x0 DISPLAY_IDENTIFIER VDC.SKIDPAD.TC_TV.Rigid_Axle_with_TC_2024.TC_Warning /end MEASUREMENT
/begin MEASUREMENT VDC.VDC_B.sf_MATLABFunction.Torque_L_Nm "" FLOAT64_IEEE VDC_CM_double 0 0 -1.7e+308 1.7e+308 ECU_ADDRESS 0x0 DISPLAY_IDENTIFIER VDC.SKIDPAD.TC_TV.MATLAB_Function.Torque_L_Nm /end MEASUREMENT
/begin MEASUREMENT VDC.VDC_B.sf_MATLABFunction.Torque_R_Nm "" FLOAT64_IEEE VDC_CM_double 0 0 -1.7e+308 1.7e+308 ECU_ADDRESS 0x0 DISPLAY_IDENTIFIER VDC.SKIDPAD.TC_TV.MATLAB_Function.Torque_R_Nm /end MEASUREMENT
/begin MEASUREMENT VDC.VDC_B.sf_MATLABFunction_a.Torque_L_Nm "" FLOAT64_IEEE VDC_CM_double 0 0 -1.7e+308 1.7e+308 ECU_ADDRESS 0x0 DISPLAY_IDENTIFIER VDC.SKIDPAD.TV_with_TC_OFF.MATLAB_Function.Torque_L_Nm /end MEASUREMENT
/begin MEASUREMENT VDC.VDC_B.sf_MATLABFunction_a.Torque_R_Nm "" FLOAT64_IEEE VDC_CM_double 0 0 -1.7e+308 1.7e+308 ECU_ADDRESS 0x0 DISPLAY_IDENTIFIER VDC.SKIDPAD.TV_with_TC_OFF.MATLAB_Function.Torque_R_Nm /end MEASUREMENT
/begin MEASUREMENT VDC.VDC_B.sf_RigidAxlewithTC2024_c.Motor_Torque_RL "" FLOAT64_IEEE VDC_CM_double 0 0 -1.7e+308 1.7e+308 ECU_ADDRESS 0x0 DISPLAY_IDENTIFIER VDC.ENDURANCE.RIGIDAXLE_WITH_TC.Rigid_Axle_with_TC_2024.Motor_Torque_RL /end MEASUREMENT
/begin MEASUREMENT VDC.VDC_B.sf_RigidAxlewithTC2024_c.Motor_Torque_RR "" FLOAT64_IEEE VDC_CM_double 0 0 -1.7e+308 1.7e+308 ECU_ADDRESS 0x0 DISPLAY_IDENTIFIER VDC.ENDURANCE.RIGIDAXLE_WITH_TC.Rigid_Axle_with_TC_2024.Motor_Torque_RR /end MEASUREMENT
/begin MEASUREMENT VDC.VDC_B.sf_RigidAxlewithTC2024_c.TC_Warning "" FLOAT64_IEEE VDC_CM_double 0 0 -1.7e+308 1.7e+308 ECU_ADDRESS 0x0 DISPLAY_IDENTIFIER VDC.ENDURANCE.RIGIDAXLE_WITH_TC.Rigid_Axle_with_TC_2024.TC_Warning /end MEASUREMENT
/begin MEASUREMENT VDC.VDC_B.sf_RigidAxlewithTC2024_p2.Motor_Torque_RL "" FLOAT64_IEEE VDC_CM_double 0 0 -1.7e+308 1.7e+308 ECU_ADDRESS 0x0 DISPLAY_IDENTIFIER VDC.AUTOX1.RIGIDAXLE_WITH_TC.Rigid_Axle_with_TC_2024.Motor_Torque_RL /end MEASUREMENT
/begin MEASUREMENT VDC.VDC_B.sf_RigidAxlewithTC2024_p2.Motor_Torque_RR "" FLOAT64_IEEE VDC_CM_double 0 0 -1.7e+308 1.7e+308 ECU_ADDRESS 0x0 DISPLAY_IDENTIFIER VDC.AUTOX1.RIGIDAXLE_WITH_TC.Rigid_Axle_with_TC_2024.Motor_Torque_RR /end MEASUREMENT
/begin MEASUREMENT VDC.VDC_B.sf_RigidAxlewithTC2024_p2.TC_Warning "" FLOAT64_IEEE VDC_CM_double 0 0 -1.7e+308 1.7e+308 ECU_ADDRESS 0x0 DISPLAY_IDENTIFIER VDC.AUTOX1.RIGIDAXLE_WITH_TC.Rigid_Axle_with_TC_2024.TC_Warning /end MEASUREMENT
/begin MEASUREMENT VDC.VDC_B.sf_Torquedemandedbythedriver_a.Throttle_Torque "" FLOAT64_IEEE VDC_CM_double 0 0 -1.7e+308 1.7e+308 ECU_ADDRESS 0x0 DISPLAY_IDENTIFIER VDC.AUTOX1.Torque_demanded_by_the_driver.Throttle_Torque /end MEASUREMENT
/begin MEASUREMENT VDC.VDC_B.sf_Torquedemandedbythedriver_k.Throttle_Torque "" FLOAT64_IEEE VDC_CM_double 0 0 -1.7e+308 1.7e+308 ECU_ADDRESS 0x0 DISPLAY_IDENTIFIER VDC.ACCELERATION.Torque_demanded_by_the_driver.Throttle_Torque /end MEASUREMENT
/begin MEASUREMENT VDC.VDC_B.sf_Torquedemandedbythedriver_m.Throttle_Torque "" FLOAT64_IEEE VDC_CM_double 0 0 -1.7e+308 1.7e+308 ECU_ADDRESS 0x0 DISPLAY_IDENTIFIER VDC.SKIDPAD.Torque_demanded_by_the_driver.Throttle_Torque /end MEASUREMENT
/begin MEASUREMENT VDC.VDC_B.state "" FLOAT64_IEEE VDC_CM_double 0 0 -1.7e+308 1.7e+308 ECU_ADDRESS 0x0 DISPLAY_IDENTIFIER VDC.ENDURANCE.Torque.state.state /end MEASUREMENT
/begin MEASUREMENT VDC.VDC_DW.ERROR_Counter "" FLOAT64_IEEE VDC_CM_double 0 0 -1.7e+308 1.7e+308 ECU_ADDRESS 0x0 DISPLAY_IDENTIFIER VDC.SAFETY_BLOCK.APPS_IMPLAUSIBILITY.Data_Store_Memory1.ERROR_Counter /end MEASUREMENT
/begin MEASUREMENT VDC.VDC_U.APPS1_Value "" FLOAT64_IEEE VDC_CM_double 0 0 -1.7e+308 1.7e+308 ECU_ADDRESS 0x0 DISPLAY_IDENTIFIER VDC.APPS1_Value /end MEASUREMENT
/begin MEASUREMENT VDC.VDC_U.APPS2_Value "" FLOAT64_IEEE VDC_CM_double 0 0 -1.7e+308 1.7e+308 ECU_ADDRESS 0x0 DISPLAY_IDENTIFIER VDC.APPS2_Value /end MEASUREMENT
/begin MEASUREMENT VDC.VDC_U.Accumulator_Voltage "" FLOAT64_IEEE VDC_CM_double 0 0 -1.7e+308 1.7e+308 ECU_ADDRESS 0x0 DISPLAY_IDENTIFIER VDC.Accumulator_Voltage /end MEASUREMENT
/begin MEASUREMENT VDC.VDC_U.BrakePedal_Value "" FLOAT64_IEEE VDC_CM_double 0 0 -1.7e+308 1.7e+308 ECU_ADDRESS 0x0 DISPLAY_IDENTIFIER VDC.BrakePedal_Value /end MEASUREMENT
/begin MEASUREMENT VDC.VDC_U.Car_State "" FLOAT64_IEEE VDC_CM_double 0 0 -1.7e+308 1.7e+308 ECU_ADDRESS 0x0 DISPLAY_IDENTIFIER VDC.Car_State /end MEASUREMENT
/begin MEASUREMENT VDC.VDC_U.CriticalDisconnection "" UBYTE VDC_CM_boolean 0 0 0 1 ECU_ADDRESS 0x0 DISPLAY_IDENTIFIER VDC.CriticalDisconnection /end MEASUREMENT
/begin MEASUREMENT VDC.VDC_U.Disconnection_Mode "" FLOAT64_IEEE VDC_CM_double 0 0 -1.7e+308 1.7e+308 ECU_ADDRESS 0x0 DISPLAY_IDENTIFIER VDC.Disconnection_Mode /end MEASUREMENT
/begin MEASUREMENT VDC.VDC_U.RL_Vel_ms_Wheel "" FLOAT64_IEEE VDC_CM_double 0 0 -1.7e+308 1.7e+308 ECU_ADDRESS 0x0 DISPLAY_IDENTIFIER VDC.RL_Vel_ms_Wheel /end MEASUREMENT
/begin MEASUREMENT VDC.VDC_U.RL_rads_Motor "" FLOAT64_IEEE VDC_CM_double 0 0 -1.7e+308 1.7e+308 ECU_ADDRESS 0x0 DISPLAY_IDENTIFIER VDC.RL_rads_Motor /end MEASUREMENT
/begin MEASUREMENT VDC.VDC_U.RR_Vel_ms_Wheel "" FLOAT64_IEEE VDC_CM_double 0 0 -1.7e+308 1.7e+308 ECU_ADDRESS 0x0 DISPLAY_IDENTIFIER VDC.RR_Vel_ms_Wheel /end MEASUREMENT
/begin MEASUREMENT VDC.VDC_U.RR_rads_Motor "" FLOAT64_IEEE VDC_CM_double 0 0 -1.7e+308 1.7e+308 ECU_ADDRESS 0x0 DISPLAY_IDENTIFIER VDC.RR_rads_Motor /end MEASUREMENT
/begin MEASUREMENT VDC.VDC_U.RacingMode "" FLOAT64_IEEE VDC_CM_double 0 0 -1.7e+308 1.7e+308 ECU_ADDRESS 0x0 DISPLAY_IDENTIFIER VDC.RacingMode /end MEASUREMENT
/begin MEASUREMENT VDC.VDC_U.Shutdown_PackageIntck "" UBYTE VDC_CM_boolean 0 0 0 1 ECU_ADDRESS 0x0 DISPLAY_IDENTIFIER VDC.Shutdown_PackageIntck /end MEASUREMENT
/begin MEASUREMENT VDC.VDC_U.SteeringSensor_Value "" FLOAT64_IEEE VDC_CM_double 0 0 -1.7e+308 1.7e+308 ECU_ADDRESS 0x0 DISPLAY_IDENTIFIER VDC.SteeringSensor_Value /end MEASUREMENT
/begin MEASUREMENT VDC.VDC_U.Susp_F_L "" FLOAT64_IEEE VDC_CM_double 0 0 -1.7e+308 1.7e+308 ECU_ADDRESS 0x0 DISPLAY_IDENTIFIER VDC.Susp_F_L /end MEASUREMENT
/begin MEASUREMENT VDC.VDC_U.Susp_F_R "" FLOAT64_IEEE VDC_CM_double 0 0 -1.7e+308 1.7e+308 ECU_ADDRESS 0x0 DISPLAY_IDENTIFIER VDC.Susp_F_R /end MEASUREMENT
/begin MEASUREMENT VDC.VDC_U.Susp_R_L "" FLOAT64_IEEE VDC_CM_double 0 0 -1.7e+308 1.7e+308 ECU_ADDRESS 0x0 DISPLAY_IDENTIFIER VDC.Susp_R_L /end MEASUREMENT
/begin MEASUREMENT VDC.VDC_U.Susp_R_R "" FLOAT64_IEEE VDC_CM_double 0 0 -1.7e+308 1.7e+308 ECU_ADDRESS 0x0 DISPLAY_IDENTIFIER VDC.Susp_R_R /end MEASUREMENT
/begin MEASUREMENT VDC.VDC_U.TorqueEnable "" UBYTE VDC_CM_boolean 0 0 0 1 ECU_ADDRESS 0x0 DISPLAY_IDENTIFIER VDC.TorqueEnable /end MEASUREMENT
/begin MEASUREMENT VDC.VDC_U.el_ACCEL_X "" FLOAT64_IEEE VDC_CM_double 0 0 -1.7e+308 1.7e+308 ECU_ADDRESS 0x0 DISPLAY_IDENTIFIER VDC.el_ACCEL_X /end MEASUREMENT
/begin MEASUREMENT VDC.VDC_U.el_ACCEL_Y "" FLOAT64_IEEE VDC_CM_double 0 0 -1.7e+308 1.7e+308 ECU_ADDRESS 0x0 DISPLAY_IDENTIFIER VDC.el_ACCEL_Y /end MEASUREMENT
/begin MEASUREMENT VDC.VDC_U.el_ACCEL_Z "" FLOAT64_IEEE VDC_CM_double 0 0 -1.7e+308 1.7e+308 ECU_ADDRESS 0x0 DISPLAY_IDENTIFIER VDC.el_ACCEL_Z /end MEASUREMENT
/begin MEASUREMENT VDC.VDC_U.el_GYRO_X "" FLOAT64_IEEE VDC_CM_double 0 0 -1.7e+308 1.7e+308 ECU_ADDRESS 0x0 DISPLAY_IDENTIFIER VDC.el_GYRO_X /end MEASUREMENT
/begin MEASUREMENT VDC.VDC_U.el_GYRO_Y "" FLOAT64_IEEE VDC_CM_double 0 0 -1.7e+308 1.7e+308 ECU_ADDRESS 0x0 DISPLAY_IDENTIFIER VDC.el_GYRO_Y /end MEASUREMENT
/begin MEASUREMENT VDC.VDC_U.el_GYRO_Z "" FLOAT64_IEEE VDC_CM_double 0 0 -1.7e+308 1.7e+308 ECU_ADDRESS 0x0 DISPLAY_IDENTIFIER VDC.el_GYRO_Z /end MEASUREMENT
/begin MEASUREMENT VDC.VDC_U.el_PITCH "" FLOAT64_IEEE VDC_CM_double 0 0 -1.7e+308 1.7e+308 ECU_ADDRESS 0x0 DISPLAY_IDENTIFIER VDC.el_PITCH /end MEASUREMENT
/begin MEASUREMENT VDC.VDC_U.el_ROLL "" FLOAT64_IEEE VDC_CM_double 0 0 -1.7e+308 1.7e+308 ECU_ADDRESS 0x0 DISPLAY_IDENTIFIER VDC.el_ROLL /end MEASUREMENT
/begin MEASUREMENT VDC.VDC_U.el_VEL "" FLOAT64_IEEE VDC_CM_double 0 0 -1.7e+308 1.7e+308 ECU_ADDRESS 0x0 DISPLAY_IDENTIFIER VDC.el_VEL /end MEASUREMENT
/begin MEASUREMENT VDC.VDC_U.el_YAW "" FLOAT64_IEEE VDC_CM_double 0 0 -1.7e+308 1.7e+308 ECU_ADDRESS 0x0 DISPLAY_IDENTIFIER VDC.el_YAW /end MEASUREMENT
/begin MEASUREMENT VDC.VDC_Y.APPS_Implausibility "" FLOAT64_IEEE VDC_CM_double 0 0 -1.7e+308 1.7e+308 ECU_ADDRESS 0x0 DISPLAY_IDENTIFIER VDC.APPS_Implausibility /end MEASUREMENT
/begin MEASUREMENT VDC.VDC_Y.BrakeLight_Control "" FLOAT64_IEEE VDC_CM_double 0 0 -1.7e+308 1.7e+308 ECU_ADDRESS 0x0 DISPLAY_IDENTIFIER VDC.BrakeLight_Control /end MEASUREMENT
/begin MEASUREMENT VDC.VDC_Y.Regenerative_Enable "" FLOAT64_IEEE VDC_CM_double 0 0 -1.7e+308 1.7e+308 ECU_ADDRESS 0x0 DISPLAY_IDENTIFIER VDC.Regenerative_Enable /end MEASUREMENT
/begin MEASUREMENT VDC.VDC_Y.Sensorics_Mode "" FLOAT64_IEEE VDC_CM_double 0 0 -1.7e+308 1.7e+308 ECU_ADDRESS 0x0 DISPLAY_IDENTIFIER VDC.Sensorics_Mode /end MEASUREMENT
/begin MEASUREMENT VDC.VDC_Y.TC_Warning "" FLOAT64_IEEE VDC_CM_double 0 0 -1.7e+308 1.7e+308 ECU_ADDRESS 0x0 DISPLAY_IDENTIFIER VDC.TC_Warning /end MEASUREMENT
/begin MEASUREMENT VDC.VDC_Y.Throttle_Torque "" FLOAT64_IEEE VDC_CM_double 0 0 -1.7e+308 1.7e+308 ECU_ADDRESS 0x0 DISPLAY_IDENTIFIER VDC.Throttle_Torque /end MEASUREMENT
/begin MEASUREMENT VDC.VDC_Y.Torque_L "" FLOAT64_IEEE VDC_CM_double 0 0 -1.7e+308 1.7e+308 ECU_ADDRESS 0x0 DISPLAY_IDENTIFIER VDC.Torque_L /end MEASUREMENT
/begin MEASUREMENT VDC.VDC_Y.Torque_OK "" FLOAT64_IEEE VDC_CM_double 0 0 -1.7e+308 1.7e+308 ECU_ADDRESS 0x0 DISPLAY_IDENTIFIER VDC.Torque_OK /end MEASUREMENT
/begin MEASUREMENT VDC.VDC_Y.Torque_R "" FLOAT64_IEEE VDC_CM_double 0 0 -1.7e+308 1.7e+308 ECU_ADDRESS 0x0 DISPLAY_IDENTIFIER VDC.Torque_R /end MEASUREMENT
/begin MEASUREMENT VDC.VDC_Y.VDC_Max_Tyre_Slip "" FLOAT64_IEEE VDC_CM_double 0 0 -1.7e+308 1.7e+308 ECU_ADDRESS 0x0 DISPLAY_IDENTIFIER VDC.VDC_Max_Tyre_Slip /end MEASUREMENT
/begin COMPU_METHOD Car_State_CM_double "Q = V" RAT_FUNC "%9.6" "NO_PHYSICAL_QTY" COEFFS 0.0 1.0 0.0 0.0 0.0 1.0 /end COMPU_METHOD
/begin COMPU_METHOD Car_State_CM_boolean "Q = V" RAT_FUNC "%9.6" "NO_PHYSICAL_QTY" COEFFS 0.0 1.0 0.0 0.0 0.0 1.0 /end COMPU_METHOD
/begin COMPU_METHOD Disconnections_CM_double "Q = V" RAT_FUNC "%9.6" "NO_PHYSICAL_QTY" COEFFS 0.0 1.0 0.0 0.0 0.0 1.0 /end COMPU_METHOD
/begin COMPU_METHOD Disconnections_CM_boolean "Q = V" RAT_FUNC "%9.6" "NO_PHYSICAL_QTY" COEFFS 0.0 1.0 0.0 0.0 0.0 1.0 /end COMPU_METHOD
/begin COMPU_METHOD Ellipse_CM_double "Q = V" RAT_FUNC "%9.6" "NO_PHYSICAL_QTY" COEFFS 0.0 1.0 0.0 0.0 0.0 1.0 /end COMPU_METHOD
/begin COMPU_METHOD Inverters_Action_CM_boolean "Q = V" RAT_FUNC "%9.6" "NO_PHYSICAL_QTY" COEFFS 0.0 1.0 0.0 0.0 0.0 1.0 /end COMPU_METHOD
/begin COMPU_METHOD Inverters_Action_CM_uint8 "Q = V" RAT_FUNC "%9.6" "NO_PHYSICAL_QTY" COEFFS 0.0 1.0 0.0 0.0 0.0 1.0 /end COMPU_METHOD
/begin COMPU_METHOD Inverters_Action_CM_double "Q = V" RAT_FUNC "%9.6" "NO_PHYSICAL_QTY" COEFFS 0.0 1.0 0.0 0.0 0.0 1.0 /end COMPU_METHOD
/begin COMPU_METHOD Inverters_Action_CM_uint16 "Q = V" RAT_FUNC "%9.6" "NO_PHYSICAL_QTY" COEFFS 0.0 1.0 0.0 0.0 0.0 1.0 /end COMPU_METHOD
/begin COMPU_METHOD Inverters_Data_CM_double "Q = V" RAT_FUNC "%9.6" "NO_PHYSICAL_QTY" COEFFS 0.0 1.0 0.0 0.0 0.0 1.0 /end COMPU_METHOD
/begin COMPU_METHOD Power_Control_CM_double "Q = V" RAT_FUNC "%9.6" "NO_PHYSICAL_QTY" COEFFS 0.0 1.0 0.0 0.0 0.0 1.0 /end COMPU_METHOD
/begin COMPU_METHOD Sensors_CM_double "Q = V" RAT_FUNC "%9.6" "NO_PHYSICAL_QTY" COEFFS 0.0 1.0 0.0 0.0 0.0 1.0 /end COMPU_METHOD
/begin COMPU_METHOD SoC_CM_double "Q = V" RAT_FUNC "%9.6" "NO_PHYSICAL_QTY" COEFFS 0.0 1.0 0.0 0.0 0.0 1.0 /end COMPU_METHOD
/begin COMPU_METHOD Synchronism_CM_double "Q = V" RAT_FUNC "%9.6" "NO_PHYSICAL_QTY" COEFFS 0.0 1.0 0.0 0.0 0.0 1.0 /end COMPU_METHOD
/begin COMPU_METHOD VDC_CM_double "Q = V" RAT_FUNC "%9.6" "NO_PHYSICAL_QTY" COEFFS 0.0 1.0 0.0 0.0 0.0 1.0 /end COMPU_METHOD
/begin COMPU_METHOD VDC_CM_boolean "Q = V" RAT_FUNC "%9.6" "NO_PHYSICAL_QTY" COEFFS 0.0 1.0 0.0 0.0 0.0 1.0 /end COMPU_METHOD
/begin GROUP Car_State "" ROOT
 /begin REF_MEASUREMENT Car_State.Car_State_B.InvertersAction Car_State.Car_State_B.Merge Car_State.Car_State_B.Merge_b Car_State.Car_State_DW.A Car_State.Car_State_U.AIRs_State Car_State.Car_State_U.APPS1_Value Car_State.Car_State_U.Accumulator_Voltage Car_State.Car_State_U.BrakePedal_Value Car_State.Car_State_U.Critical_CAN_Disconnection Car_State.Car_State_U.EnableDrive_Order Car_State.Car_State_U.InvertersMinDCBus Car_State.Car_State_U.InvertersSubscribed Car_State.Car_State_U.PrechargeRequest Car_State.Car_State_U.Shutdown_PackageIntck Car_State.Car_State_Y.AIRs_Request Car_State.Car_State_Y.Car_OK Car_State.Car_State_Y.Car_State_b Car_State.Car_State_Y.InvertersAction Car_State.Car_State_Y.PrechargeAssert Car_State.Car_State_Y.Precharge_Percentage Car_State.Car_State_Y.Precharge_Voltage Car_State.Car_State_Y.Relay_Error Car_State.Car_State_Y.TorqueEnable Car_State.Car_State_Y.errors /end REF_MEASUREMENT
 /begin SUB_GROUP Car_State.Car_State_B Car_State.Car_State_DW Car_State.Car_State_U Car_State.Car_State_Y /end SUB_GROUP
/end GROUP
/begin GROUP Car_State.Car_State_B ""
 /begin REF_MEASUREMENT Car_State.Car_State_B.InvertersAction Car_State.Car_State_B.Merge Car_State.Car_State_B.Merge_b /end REF_MEASUREMENT
/end GROUP
/begin GROUP Car_State.Car_State_DW "" /begin REF_MEASUREMENT Car_State.Car_State_DW.A /end REF_MEASUREMENT /end GROUP
/begin GROUP Car_State.Car_State_U ""
 /begin REF_MEASUREMENT Car_State.Car_State_U.AIRs_State Car_State.Car_State_U.APPS1_Value Car_State.Car_State_U.Accumulator_Voltage Car_State.Car_State_U.BrakePedal_Value Car_State.Car_State_U.Critical_CAN_Disconnection Car_State.Car_State_U.EnableDrive_Order Car_State.Car_State_U.InvertersMinDCBus Car_State.Car_State_U.InvertersSubscribed Car_State.Car_State_U.PrechargeRequest Car_State.Car_State_U.Shutdown_PackageIntck /end REF_MEASUREMENT
/end GROUP
/begin GROUP Car_State.Car_State_Y ""
 /begin REF_MEASUREMENT Car_State.Car_State_Y.AIRs_Request Car_State.Car_State_Y.Car_OK Car_State.Car_State_Y.Car_State_b Car_State.Car_State_Y.InvertersAction Car_State.Car_State_Y.PrechargeAssert Car_State.Car_State_Y.Precharge_Percentage Car_State.Car_State_Y.Precharge_Voltage Car_State.Car_State_Y.Relay_Error Car_State.Car_State_Y.TorqueEnable Car_State.Car_State_Y.errors /end REF_MEASUREMENT
/end GROUP
/begin GROUP Disconnections "" ROOT
 /begin REF_MEASUREMENT Disconnections.Disconnections_B.Merge Disconnections.Disconnections_B.Merge_d Disconnections.Disconnections_B.Merge_dt Disconnections.Disconnections_B.Merge_e Disconnections.Disconnections_B.Merge_ed Disconnections.Disconnections_B.Merge_g Disconnections.Disconnections_B.Merge_go Disconnections.Disconnections_B.Merge_j Disconnections.Disconnections_B.Merge_k Disconnections.Disconnections_B.Merge_kw Disconnections.Disconnections_B.Merge_m Disconnections.Disconnections_B.Merge_n Disconnections.Disconnections_B.Merge_p Disconnections.Disconnections_DW.A Disconnections.Disconnections_DW.A_o Disconnections.Disconnections_DW.Last_alive Disconnections.Disconnections_DW.Last_alive_n Disconnections.Disconnections_DW.Last_alive_n0 Disconnections.Disconnections_DW.Last_alive_p Disconnections.Disconnections_DW.Last_alive_pb Disconnections.Disconnections_U.APPS1_Bits Disconnections.Disconnections_U.APPS2_Bits Disconnections.Disconnections_U.BMS_Alive Disconnections.Disconnections_U.BrakePedal_Bits Disconnections.Disconnections_U.Dash_Alive Disconnections.Disconnections_U.Disconnection_InvL Disconnections.Disconnections_U.Disconnection_InvR Disconnections.Disconnections_U.Ellipse_Alive Disconnections.Disconnections_U.Front_Alive Disconnections.Disconnections_U.Rear_Alive Disconnections.Disconnections_U.SteeringSensor_Bits Disconnections.Disconnections_U.Susp_F_L_Bits Disconnections.Disconnections_U.Susp_F_R_Bits Disconnections.Disconnections_U.Susp_R_L_Bits Disconnections.Disconnections_U.Susp_R_R_Bits Disconnections.Disconnections_U.el_Vel_OK Disconnections.Disconnections_Y.CriticalDisconnection Disconnections.Disconnections_Y.Critical_CAN_Disconnection Disconnections.Disconnections_Y.Critical_Signal_Disconnection Disconnections.Disconnections_Y.Disconnection_APPS1 Disconnections.Disconnections_Y.Disconnection_APPS2 Disconnections.Disconnections_Y.Disconnection_BMS Disconnections.Disconnections_Y.Disconnection_BrakePedal Disconnections.Disconnections_Y.Disconnection_DashBoard Disconnections.Disconnections_Y.Disconnection_Ellipse Disconnections.Disconnections_Y.Disconnection_Front Disconnections.Disconnections_Y.Disconnection_Mode Disconnections.Disconnections_Y.Disconnection_Rear Disconnections.Disconnections_Y.Disconnection_SteeringSensor Disconnections.Disconnections_Y.Disconnection_Susp_F_L Disconnections.Disconnections_Y.Disconnection_Susp_F_R Disconnections.Disconnections_Y.Disconnection_Susp_R_L Disconnections.Disconnections_Y.Disconnection_Susp_R_R /end REF_MEASUREMENT
 /begin SUB_GROUP Disconnections.Disconnections_B Disconnections.Disconnections_DW Disconnections.Disconnections_U Disconnections.Disconnections_Y /end SUB_GROUP
/end GROUP
/begin GROUP Disconnections.Disconnections_B ""
 /begin REF_MEASUREMENT Disconnections.Disconnections_B.Merge Disconnections.Disconnections_B.Merge_d Disconnections.Disconnections_B.Merge_dt Disconnections.Disconnections_B.Merge_e Disconnections.Disconnections_B.Merge_ed Disconnections.Disconnections_B.Merge_g Disconnections.Disconnections_B.Merge_go Disconnections.Disconnections_B.Merge_j Disconnections.Disconnections_B.Merge_k Disconnections.Disconnections_B.Merge_kw Disconnections.Disconnections_B.Merge_m Disconnections.Disconnections_B.Merge_n Disconnections.Disconnections_B.Merge_p /end REF_MEASUREMENT
/end GROUP
/begin GROUP Disconnections.Disconnections_DW ""
 /begin REF_MEASUREMENT Disconnections.Disconnections_DW.A Disconnections.Disconnections_DW.A_o Disconnections.Disconnections_DW.Last_alive Disconnections.Disconnections_DW.Last_alive_n Disconnections.Disconnections_DW.Last_alive_n0 Disconnections.Disconnections_DW.Last_alive_p Disconnections.Disconnections_DW.Last_alive_pb /end REF_MEASUREMENT
/end GROUP
/begin GROUP Disconnections.Disconnections_U ""
 /begin REF_MEASUREMENT Disconnections.Disconnections_U.APPS1_Bits Disconnections.Disconnections_U.APPS2_Bits Disconnections.Disconnections_U.BMS_Alive Disconnections.Disconnections_U.BrakePedal_Bits Disconnections.Disconnections_U.Dash_Alive Disconnections.Disconnections_U.Disconnection_InvL Disconnections.Disconnections_U.Disconnection_InvR Disconnections.Disconnections_U.Ellipse_Alive Disconnections.Disconnections_U.Front_Alive Disconnections.Disconnections_U.Rear_Alive Disconnections.Disconnections_U.SteeringSensor_Bits Disconnections.Disconnections_U.Susp_F_L_Bits Disconnections.Disconnections_U.Susp_F_R_Bits Disconnections.Disconnections_U.Susp_R_L_Bits Disconnections.Disconnections_U.Susp_R_R_Bits Disconnections.Disconnections_U.el_Vel_OK /end REF_MEASUREMENT
/end GROUP
/begin GROUP Disconnections.Disconnections_Y ""
 /begin REF_MEASUREMENT Disconnections.Disconnections_Y.CriticalDisconnection Disconnections.Disconnections_Y.Critical_CAN_Disconnection Disconnections.Disconnections_Y.Critical_Signal_Disconnection Disconnections.Disconnections_Y.Disconnection_APPS1 Disconnections.Disconnections_Y.Disconnection_APPS2 Disconnections.Disconnections_Y.Disconnection_BMS Disconnections.Disconnections_Y.Disconnection_BrakePedal Disconnections.Disconnections_Y.Disconnection_DashBoard Disconnections.Disconnections_Y.Disconnection_Ellipse Disconnections.Disconnections_Y.Disconnection_Front Disconnections.Disconnections_Y.Disconnection_Mode Disconnections.Disconnections_Y.Disconnection_Rear Disconnections.Disconnections_Y.Disconnection_SteeringSensor Disconnections.Disconnections_Y.Disconnection_Susp_F_L Disconnections.Disconnections_Y.Disconnection_Susp_F_R Disconnections.Disconnections_Y.Disconnection_Susp_R_L Disconnections.Disconnections_Y.Disconnection_Susp_R_R /end REF_MEASUREMENT
/end GROUP
/begin GROUP Ellipse "" ROOT
 /begin REF_MEASUREMENT Ellipse.Ellipse_B.Merge Ellipse.Ellipse_U.el_AngleTrack Ellipse.Ellipse_U.el_CurvatureRadius Ellipse.Ellipse_U.el_Curvature_Valid Ellipse.Ellipse_U.el_LATITUDE_EKF Ellipse.Ellipse_U.el_LONGITUDE_EKF Ellipse.Ellipse_U.el_SlipAngle Ellipse.Ellipse_U.el_Slip_Valid Ellipse.Ellipse_U.el_SolutionMode Ellipse.Ellipse_U.el_Vel_EKF_Valid Ellipse.Ellipse_U.el_Vel_EKF_X Ellipse.Ellipse_U.el_Vel_EKF_Y Ellipse.Ellipse_U.el_Vel_EKF_Z Ellipse.Ellipse_U.el_Vel_GPS_D Ellipse.Ellipse_U.el_Vel_GPS_E Ellipse.Ellipse_U.el_Vel_GPS_N Ellipse.Ellipse_U.el_Vel_GPS_Valid Ellipse.Ellipse_Y.el_VEL Ellipse.Ellipse_Y.el_Vel_OK /end REF_MEASUREMENT
 /begin SUB_GROUP Ellipse.Ellipse_B Ellipse.Ellipse_U Ellipse.Ellipse_Y /end SUB_GROUP
/end GROUP
/begin GROUP Ellipse.Ellipse_B "" /begin REF_MEASUREMENT Ellipse.Ellipse_B.Merge /end REF_MEASUREMENT /end GROUP
/begin GROUP Ellipse.Ellipse_U ""
 /begin REF_MEASUREMENT Ellipse.Ellipse_U.el_AngleTrack Ellipse.Ellipse_U.el_CurvatureRadius Ellipse.Ellipse_U.el_Curvature_Valid Ellipse.Ellipse_U.el_LATITUDE_EKF Ellipse.Ellipse_U.el_LONGITUDE_EKF Ellipse.Ellipse_U.el_SlipAngle Ellipse.Ellipse_U.el_Slip_Valid Ellipse.Ellipse_U.el_SolutionMode Ellipse.Ellipse_U.el_Vel_EKF_Valid Ellipse.Ellipse_U.el_Vel_EKF_X Ellipse.Ellipse_U.el_Vel_EKF_Y Ellipse.Ellipse_U.el_Vel_EKF_Z Ellipse.Ellipse_U.el_Vel_GPS_D Ellipse.Ellipse_U.el_Vel_GPS_E Ellipse.Ellipse_U.el_Vel_GPS_N Ellipse.Ellipse_U.el_Vel_GPS_Valid /end REF_MEASUREMENT
/end GROUP
/begin GROUP Ellipse.Ellipse_Y "" /begin REF_MEASUREMENT Ellipse.Ellipse_Y.el_VEL Ellipse.Ellipse_Y.el_Vel_OK /end REF_MEASUREMENT /end GROUP
/begin GROUP Inverters_Action "" ROOT
 /begin REF_MEASUREMENT Inverters_Action.Inverters_Action_B.Merge Inverters_Action.Inverters_Action_B.Merge2 Inverters_Action.Inverters_Action_B.Merge2_p Inverters_Action.Inverters_Action_B.subscribed Inverters_Action.Inverters_Action_B.subscribed_k Inverters_Action.Inverters_Action_ConstB.TorqueCommand.Divide Inverters_Action.Inverters_Action_ConstB.TorqueCommand0.BitwiseOperator1 Inverters_Action.Inverters_Action_ConstB.TorqueCommand0.Current0to65535 Inverters_Action.Inverters_Action_ConstB.TorqueCommand0.Divide Inverters_Action.Inverters_Action_ConstB.TorqueCommand0.ShiftArithmetic Inverters_Action.Inverters_Action_ConstB.TorqueCommand0.b7tob0 Inverters_Action.Inverters_Action_ConstB.TorqueCommand0_a.BitwiseOperator1 Inverters_Action.Inverters_Action_ConstB.TorqueCommand0_a.Current0to65535 Inverters_Action.Inverters_Action_ConstB.TorqueCommand0_a.Divide Inverters_Action.Inverters_Action_ConstB.TorqueCommand0_a.ShiftArithmetic Inverters_Action.Inverters_Action_ConstB.TorqueCommand0_a.b7tob0 Inverters_Action.Inverters_Action_ConstB.TorqueCommand_k.Divide Inverters_Action.Inverters_Action_DW.EnumerationCounter Inverters_Action.Inverters_Action_DW.EnumerationCounter_g Inverters_Action.Inverters_Action_DW.LastAction Inverters_Action.Inverters_Action_DW.LastAction_l Inverters_Action.Inverters_Action_U.InvertersAction Inverters_Action.Inverters_Action_U.current_L Inverters_Action.Inverters_Action_U.current_R Inverters_Action.Inverters_Action_Y.Inverter_L_RegID Inverters_Action.Inverters_Action_Y.Inverter_L_b15tob8 Inverters_Action.Inverters_Action_Y.Inverter_L_b7tob0 Inverters_Action.Inverters_Action_Y.Inverter_R_RegID Inverters_Action.Inverters_Action_Y.Inverter_R_b15tob8 Inverters_Action.Inverters_Action_Y.Inverter_R_b7tob0 Inverters_Action.Inverters_Action_Y.InvertersSubscribed /end REF_MEASUREMENT
 /begin SUB_GROUP Inverters_Action.Inverters_Action_B Inverters_Action.Inverters_Action_ConstB Inverters_Action.Inverters_Action_ConstB.TorqueCommand Inverters_Action.Inverters_Action_ConstB.TorqueCommand0 Inverters_Action.Inverters_Action_ConstB.TorqueCommand0_a Inverters_Action.Inverters_Action_ConstB.TorqueCommand_k Inverters_Action.Inverters_Action_DW Inverters_Action.Inverters_Action_U Inverters_Action.Inverters_Action_Y /end SUB_GROUP
/end GROUP
/begin GROUP Inverters_Action.Inverters_Action_B ""
 /begin REF_MEASUREMENT Inverters_Action.Inverters_Action_B.Merge Inverters_Action.Inverters_Action_B.Merge2 Inverters_Action.Inverters_Action_B.Merge2_p Inverters_Action.Inverters_Action_B.subscribed Inverters_Action.Inverters_Action_B.subscribed_k /end REF_MEASUREMENT
/end GROUP
/begin GROUP Inverters_Action.Inverters_Action_ConstB ""
 /begin REF_MEASUREMENT Inverters_Action.Inverters_Action_ConstB.TorqueCommand.Divide Inverters_Action.Inverters_Action_ConstB.TorqueCommand0.BitwiseOperator1 Inverters_Action.Inverters_Action_ConstB.TorqueCommand0.Current0to65535 Inverters_Action.Inverters_Action_ConstB.TorqueCommand0.Divide Inverters_Action.Inverters_Action_ConstB.TorqueCommand0.ShiftArithmetic Inverters_Action.Inverters_Action_ConstB.TorqueCommand0.b7tob0 Inverters_Action.Inverters_Action_ConstB.TorqueCommand0_a.BitwiseOperator1 Inverters_Action.Inverters_Action_ConstB.TorqueCommand0_a.Current0to65535 Inverters_Action.Inverters_Action_ConstB.TorqueCommand0_a.Divide Inverters_Action.Inverters_Action_ConstB.TorqueCommand0_a.ShiftArithmetic Inverters_Action.Inverters_Action_ConstB.TorqueCommand0_a.b7tob0 Inverters_Action.Inverters_Action_ConstB.TorqueCommand_k.Divide /end REF_MEASUREMENT
/end GROUP
/begin GROUP Inverters_Action.Inverters_Action_ConstB.TorqueCommand ""
 /begin REF_MEASUREMENT Inverters_Action.Inverters_Action_ConstB.TorqueCommand.Divide /end REF_MEASUREMENT
/end GROUP
/begin GROUP Inverters_Action.Inverters_Action_ConstB.TorqueCommand0 ""
 /begin REF_MEASUREMENT Inverters_Action.Inverters_Action_ConstB.TorqueCommand0.BitwiseOperator1 Inverters_Action.Inverters_Action_ConstB.TorqueCommand0.Current0to65535 Inverters_Action.Inverters_Action_ConstB.TorqueCommand0.Divide Inverters_Action.Inverters_Action_ConstB.TorqueCommand0.ShiftArithmetic Inverters_Action.Inverters_Action_ConstB.TorqueCommand0.b7tob0 /end REF_MEASUREMENT
/end GROUP
/begin GROUP Inverters_Action.Inverters_Action_ConstB.TorqueCommand0_a ""
 /begin REF_MEASUREMENT Inverters_Action.Inverters_Action_ConstB.TorqueCommand0_a.BitwiseOperator1 Inverters_Action.Inverters_Action_ConstB.TorqueCommand0_a.Current0to65535 Inverters_Action.Inverters_Action_ConstB.TorqueCommand0_a.Divide Inverters_Action.Inverters_Action_ConstB.TorqueCommand0_a.ShiftArithmetic Inverters_Action.Inverters_Action_ConstB.TorqueCommand0_a.b7tob0 /end REF_MEASUREMENT
/end GROUP
/begin GROUP Inverters_Action.Inverters_Action_ConstB.TorqueCommand_k ""
 /begin REF_MEASUREMENT Inverters_Action.Inverters_Action_ConstB.TorqueCommand_k.Divide /end REF_MEASUREMENT
/end GROUP
/begin GROUP Inverters_Action.Inverters_Action_DW ""
 /begin REF_MEASUREMENT Inverters_Action.Inverters_Action_DW.EnumerationCounter Inverters_Action.Inverters_Action_DW.EnumerationCounter_g Inverters_Action.Inverters_Action_DW.LastAction Inverters_Action.Inverters_Action_DW.LastAction_l /end REF_MEASUREMENT
/end GROUP
/begin GROUP Inverters_Action.Inverters_Action_U ""
 /begin REF_MEASUREMENT Inverters_Action.Inverters_Action_U.InvertersAction Inverters_Action.Inverters_Action_U.current_L Inverters_Action.Inverters_Action_U.current_R /end REF_MEASUREMENT
/end GROUP
/begin GROUP Inverters_Action.Inverters_Action_Y ""
 /begin REF_MEASUREMENT Inverters_Action.Inverters_Action_Y.Inverter_L_RegID Inverters_Action.Inverters_Action_Y.Inverter_L_b15tob8 Inverters_Action.Inverters_Action_Y.Inverter_L_b7tob0 Inverters_Action.Inverters_Action_Y.Inverter_R_RegID Inverters_Action.Inverters_Action_Y.Inverter_R_b15tob8 Inverters_Action.Inverters_Action_Y.Inverter_R_b7tob0 Inverters_Action.Inverters_Action_Y.InvertersSubscribed /end REF_MEASUREMENT
/end GROUP
/begin GROUP Inverters_Data "" ROOT
 /begin REF_MEASUREMENT Inverters_Data.Inverters_Data_DW.Last_alive Inverters_Data.Inverters_Data_DW.Last_alive_h Inverters_Data.Inverters_Data_DW.Tot_Errors Inverters_Data.Inverters_Data_DW.Tot_Errors_c Inverters_Data.Inverters_Data_U.Inv_L_RegID Inverters_Data.Inverters_Data_U.Inv_L_RegID_M235_Inv_L_DCBus Inverters_Data.Inverters_Data_U.Inv_L_RegID_M48_Inv_L_Speed Inverters_Data.Inverters_Data_U.Inv_L_RegID_M73_Inv_L_TempMotor Inverters_Data.Inverters_Data_U.Inv_L_RegID_M74_Inv_L_TempIGBT Inverters_Data.Inverters_Data_U.Inv_R_RegID Inverters_Data.Inverters_Data_U.Inv_R_RegID_M235_Inv_R_DCBus Inverters_Data.Inverters_Data_U.Inv_R_RegID_M48_Inv_R_Speed Inverters_Data.Inverters_Data_U.Inv_R_RegID_M73_Inv_R_TempMotor Inverters_Data.Inverters_Data_U.Inv_R_RegID_M74_Inv_R_TempIGBT Inverters_Data.Inverters_Data_Y.Disconnection_InvL Inverters_Data.Inverters_Data_Y.Disconnection_InvR Inverters_Data.Inverters_Data_Y.Inv_L_TempIGBT Inverters_Data.Inverters_Data_Y.Inv_L_TempMotor Inverters_Data.Inverters_Data_Y.Inv_R_TempIGBT Inverters_Data.Inverters_Data_Y.Inv_R_TempMotor Inverters_Data.Inverters_Data_Y.InvertersMinDCBus Inverters_Data.Inverters_Data_Y.Max_Temp_IGBT Inverters_Data.Inverters_Data_Y.Max_Temp_Motors Inverters_Data.Inverters_Data_Y.RL_Vel_ms_Wheel Inverters_Data.Inverters_Data_Y.RL_rads_Motor Inverters_Data.Inverters_Data_Y.RR_Vel_ms_Wheel Inverters_Data.Inverters_Data_Y.RR_rads_Motor Inverters_Data.Inverters_Data_Y.Speed /end REF_MEASUREMENT
 /begin SUB_GROUP Inverters_Data.Inverters_Data_DW Inverters_Data.Inverters_Data_U Inverters_Data.Inverters_Data_Y /end SUB_GROUP
/end GROUP
/begin GROUP Inverters_Data.Inverters_Data_DW ""
 /begin REF_MEASUREMENT Inverters_Data.Inverters_Data_DW.Last_alive Inverters_Data.Inverters_Data_DW.Last_alive_h Inverters_Data.Inverters_Data_DW.Tot_Errors Inverters_Data.Inverters_Data_DW.Tot_Errors_c /end REF_MEASUREMENT
/end GROUP
/begin GROUP Inverters_Data.Inverters_Data_U ""
 /begin REF_MEASUREMENT Inverters_Data.Inverters_Data_U.Inv_L_RegID Inverters_Data.Inverters_Data_U.Inv_L_RegID_M235_Inv_L_DCBus Inverters_Data.Inverters_Data_U.Inv_L_RegID_M48_Inv_L_Speed Inverters_Data.Inverters_Data_U.Inv_L_RegID_M73_Inv_L_TempMotor Inverters_Data.Inverters_Data_U.Inv_L_RegID_M74_Inv_L_TempIGBT Inverters_Data.Inverters_Data_U.Inv_R_RegID Inverters_Data.Inverters_Data_U.Inv_R_RegID_M235_Inv_R_DCBus Inverters_Data.Inverters_Data_U.Inv_R_RegID_M48_Inv_R_Speed Inverters_Data.Inverters_Data_U.Inv_R_RegID_M73_Inv_R_TempMotor Inverters_Data.Inverters_Data_U.Inv_R_RegID_M74_Inv_R_TempIGBT /end REF_MEASUREMENT
/end GROUP
/begin GROUP Inverters_Data.Inverters_Data_Y ""
 /begin REF_MEASUREMENT Inverters_Data.Inverters_Data_Y.Disconnection_InvL Inverters_Data.Inverters_Data_Y.Disconnection_InvR Inverters_Data.Inverters_Data_Y.Inv_L_TempIGBT Inverters_Data.Inverters_Data_Y.Inv_L_TempMotor Inverters_Data.Inverters_Data_Y.Inv_R_TempIGBT Inverters_Data.Inverters_Data_Y.Inv_R_TempMotor Inverters_Data.Inverters_Data_Y.InvertersMinDCBus Inverters_Data.Inverters_Data_Y.Max_Temp_IGBT Inverters_Data.Inverters_Data_Y.Max_Temp_Motors Inverters_Data.Inverters_Data_Y.RL_Vel_ms_Wheel Inverters_Data.Inverters_Data_Y.RL_rads_Motor Inverters_Data.Inverters_Data_Y.RR_Vel_ms_Wheel Inverters_Data.Inverters_Data_Y.RR_rads_Motor Inverters_Data.Inverters_Data_Y.Speed /end REF_MEASUREMENT
/end GROUP
/begin GROUP Power_Control "" ROOT
 /begin REF_MEASUREMENT Power_Control.Power_Control_B.sf_InverterL_Temp_Limitation.Current_out Power_Control.Power_Control_B.sf_InverterR_Temp_Limitation.Current_out Power_Control.Power_Control_B.sf_MotorL_Temp_Limitation.Current_out Power_Control.Power_Control_B.sf_MotorR_Temp_Limitation.Current_out Power_Control.Power_Control_DW.A Power_Control.Power_Control_U.Accumulator_Current Power_Control.Power_Control_U.Accumulator_Voltage Power_Control.Power_Control_U.Inv_L_TempIGBT Power_Control.Power_Control_U.Inv_L_TempMotor Power_Control.Power_Control_U.Inv_R_TempIGBT Power_Control.Power_Control_U.Inv_R_TempMotor Power_Control.Power_Control_U.Torque_L Power_Control.Power_Control_U.Torque_R Power_Control.Power_Control_Y.Power Power_Control.Power_Control_Y.PowerLimitReached Power_Control.Power_Control_Y.PowerMean500ms Power_Control.Power_Control_Y.current_L Power_Control.Power_Control_Y.current_R /end REF_MEASUREMENT
 /begin SUB_GROUP Power_Control.Power_Control_B Power_Control.Power_Control_B.sf_InverterL_Temp_Limitation Power_Control.Power_Control_B.sf_InverterR_Temp_Limitation Power_Control.Power_Control_B.sf_MotorL_Temp_Limitation Power_Control.Power_Control_B.sf_MotorR_Temp_Limitation Power_Control.Power_Control_DW Power_Control.Power_Control_U Power_Control.Power_Control_Y /end SUB_GROUP
/end GROUP
/begin GROUP Power_Control.Power_Control_B ""
 /begin REF_MEASUREMENT Power_Control.Power_Control_B.sf_InverterL_Temp_Limitation.Current_out Power_Control.Power_Control_B.sf_InverterR_Temp_Limitation.Current_out Power_Control.Power_Control_B.sf_MotorL_Temp_Limitation.Current_out Power_Control.Power_Control_B.sf_MotorR_Temp_Limitation.Current_out /end REF_MEASUREMENT
/end GROUP
/begin GROUP Power_Control.Power_Control_B.sf_InverterL_Temp_Limitation ""
 /begin REF_MEASUREMENT Power_Control.Power_Control_B.sf_InverterL_Temp_Limitation.Current_out /end REF_MEASUREMENT
/end GROUP
/begin GROUP Power_Control.Power_Control_B.sf_InverterR_Temp_Limitation ""
 /begin REF_MEASUREMENT Power_Control.Power_Control_B.sf_InverterR_Temp_Limitation.Current_out /end REF_MEASUREMENT
/end GROUP
/begin GROUP Power_Control.Power_Control_B.sf_MotorL_Temp_Limitation ""
 /begin REF_MEASUREMENT Power_Control.Power_Control_B.sf_MotorL_Temp_Limitation.Current_out /end REF_MEASUREMENT
/end GROUP
/begin GROUP Power_Control.Power_Control_B.sf_MotorR_Temp_Limitation ""
 /begin REF_MEASUREMENT Power_Control.Power_Control_B.sf_MotorR_Temp_Limitation.Current_out /end REF_MEASUREMENT
/end GROUP
/begin GROUP Power_Control.Power_Control_DW "" /begin REF_MEASUREMENT Power_Control.Power_Control_DW.A /end REF_MEASUREMENT /end GROUP
/begin GROUP Power_Control.Power_Control_U ""
 /begin REF_MEASUREMENT Power_Control.Power_Control_U.Accumulator_Current Power_Control.Power_Control_U.Accumulator_Voltage Power_Control.Power_Control_U.Inv_L_TempIGBT Power_Control.Power_Control_U.Inv_L_TempMotor Power_Control.Power_Control_U.Inv_R_TempIGBT Power_Control.Power_Control_U.Inv_R_TempMotor Power_Control.Power_Control_U.Torque_L Power_Control.Power_Control_U.Torque_R /end REF_MEASUREMENT
/end GROUP
/begin GROUP Power_Control.Power_Control_Y ""
 /begin REF_MEASUREMENT Power_Control.Power_Control_Y.Power Power_Control.Power_Control_Y.PowerLimitReached Power_Control.Power_Control_Y.PowerMean500ms Power_Control.Power_Control_Y.current_L Power_Control.Power_Control_Y.current_R /end REF_MEASUREMENT
/end GROUP
/begin GROUP Sensors "" ROOT
 /begin REF_MEASUREMENT Sensors.Sensors_ConstB.Subtract Sensors.Sensors_ConstB.Subtract_a Sensors.Sensors_ConstB.Subtract_e Sensors.Sensors_ConstB.Subtract_n Sensors.Sensors_ConstB.Subtract_p Sensors.Sensors_ConstB.Sum1 Sensors.Sensors_ConstB.Sum1_c Sensors.Sensors_ConstB.Sum1_d Sensors.Sensors_DW.Previous_IN Sensors.Sensors_DW.Previous_OUT Sensors.Sensors_U.APPS1_Bits Sensors.Sensors_U.APPS2_Bits Sensors.Sensors_U.BrakePedal_Bits Sensors.Sensors_U.Disconnection_APPS1 Sensors.Sensors_U.Disconnection_APPS2 Sensors.Sensors_U.SteeringSensor_Bits Sensors.Sensors_U.Susp_F_L_Bits Sensors.Sensors_U.Susp_F_R_Bits Sensors.Sensors_U.Susp_R_L_Bits Sensors.Sensors_U.Susp_R_R_Bits Sensors.Sensors_Y.APPS1_Value Sensors.Sensors_Y.APPS2_Value Sensors.Sensors_Y.BrakePedal_Value Sensors.Sensors_Y.SUSP_F_L Sensors.Sensors_Y.SUSP_F_R Sensors.Sensors_Y.SUSP_R_L Sensors.Sensors_Y.SUSP_R_R Sensors.Sensors_Y.SteeringSensor_Value /end REF_MEASUREMENT
 /begin SUB_GROUP Sensors.Sensors_ConstB Sensors.Sensors_DW Sensors.Sensors_U Sensors.Sensors_Y /end SUB_GROUP
/end GROUP
/begin GROUP Sensors.Sensors_ConstB ""
 /begin REF_MEASUREMENT Sensors.Sensors_ConstB.Subtract Sensors.Sensors_ConstB.Subtract_a Sensors.Sensors_ConstB.Subtract_e Sensors.Sensors_ConstB.Subtract_n Sensors.Sensors_ConstB.Subtract_p Sensors.Sensors_ConstB.Sum1 Sensors.Sensors_ConstB.Sum1_c Sensors.Sensors_ConstB.Sum1_d /end REF_MEASUREMENT
/end GROUP
/begin GROUP Sensors.Sensors_DW ""
 /begin REF_MEASUREMENT Sensors.Sensors_DW.Previous_IN Sensors.Sensors_DW.Previous_OUT /end REF_MEASUREMENT
/end GROUP
/begin GROUP Sensors.Sensors_U ""
 /begin REF_MEASUREMENT Sensors.Sensors_U.APPS1_Bits Sensors.Sensors_U.APPS2_Bits Sensors.Sensors_U.BrakePedal_Bits Sensors.Sensors_U.Disconnection_APPS1 Sensors.Sensors_U.Disconnection_APPS2 Sensors.Sensors_U.SteeringSensor_Bits Sensors.Sensors_U.Susp_F_L_Bits Sensors.Sensors_U.Susp_F_R_Bits Sensors.Sensors_U.Susp_R_L_Bits Sensors.Sensors_U.Susp_R_R_Bits /end REF_MEASUREMENT
/end GROUP
/begin GROUP Sensors.Sensors_Y ""
 /begin REF_MEASUREMENT Sensors.Sensors_Y.APPS1_Value Sensors.Sensors_Y.APPS2_Value Sensors.Sensors_Y.BrakePedal_Value Sensors.Sensors_Y.SUSP_F_L Sensors.Sensors_Y.SUSP_F_R Sensors.Sensors_Y.SUSP_R_L Sensors.Sensors_Y.SUSP_R_R Sensors.Sensors_Y.SteeringSensor_Value /end REF_MEASUREMENT
/end GROUP
/begin GROUP SoC "" ROOT
 /begin REF_MEASUREMENT SoC.SoC_B.AccuOCVtoSOC2024 SoC.SoC_B.CellOCVtoSOC1 SoC.SoC_B.CellOCVtoSOC2024 SoC.SoC_B.CoreSubsys[0].Pdot SoC.SoC_B.CoreSubsys[0].Sum2 SoC.SoC_B.CoreSubsys[0].TmpSignalConversionAtIntegrator SoC.SoC_B.uRC_Cell_H[0].CoreSubsys.Pdot SoC.SoC_B.uRC_Cell_H[0].CoreSubsys.Sum2 SoC.SoC_B.uRC_Cell_H[0].CoreSubsys.Sum2_h SoC.SoC_B.uRC_Cell_H[0].CoreSubsys.TmpSignalConversionAtIntegrator SoC.SoC_B.uRC_Cell_L[0].CoreSubsys.Pdot SoC.SoC_B.uRC_Cell_L[0].CoreSubsys.Sum2 SoC.SoC_B.uRC_Cell_L[0].CoreSubsys.Sum2_h SoC.SoC_B.uRC_Cell_L[0].CoreSubsys.TmpSignalConversionAtIntegrator SoC.SoC_ConstB.CoreSubsys.Divide SoC.SoC_ConstB.uRC_Cell_H.CoreSubsys.Divide SoC.SoC_ConstB.uRC_Cell_L.CoreSubsys.Divide SoC.SoC_U.Accumulator_Current SoC.SoC_U.Accumulator_Voltage SoC.SoC_U.Average_CellTemp SoC.SoC_U.Highest_CellVoltage SoC.SoC_U.Lowest_CellVoltage SoC.SoC_Y.SoC_Avg SoC.SoC_Y.SoC_High SoC.SoC_Y.SoC_KF SoC.SoC_Y.SoC_Low /end REF_MEASUREMENT
 /begin SUB_GROUP SoC.SoC_B SoC.SoC_B.CoreSubsys[0] SoC.SoC_B.uRC_Cell_H[0] SoC.SoC_B.uRC_Cell_H[0].CoreSubsys SoC.SoC_B.uRC_Cell_L[0] SoC.SoC_B.uRC_Cell_L[0].CoreSubsys SoC.SoC_ConstB SoC.SoC_ConstB.CoreSubsys SoC.SoC_ConstB.uRC_Cell_H SoC.SoC_ConstB.uRC_Cell_H.CoreSubsys SoC.SoC_ConstB.uRC_Cell_L SoC.SoC_ConstB.uRC_Cell_L.CoreSubsys SoC.SoC_U SoC.SoC_Y /end SUB_GROUP
/end GROUP
/begin GROUP SoC.SoC_B ""
 /begin REF_MEASUREMENT SoC.SoC_B.AccuOCVtoSOC2024 SoC.SoC_B.CellOCVtoSOC1 SoC.SoC_B.CellOCVtoSOC2024 SoC.SoC_B.CoreSubsys[0].Pdot SoC.SoC_B.CoreSubsys[0].Sum2 SoC.SoC_B.CoreSubsys[0].TmpSignalConversionAtIntegrator SoC.SoC_B.uRC_Cell_H[0].CoreSubsys.Pdot SoC.SoC_B.uRC_Cell_H[0].CoreSubsys.Sum2 SoC.SoC_B.uRC_Cell_H[0].CoreSubsys.Sum2_h SoC.SoC_B.uRC_Cell_H[0].CoreSubsys.TmpSignalConversionAtIntegrator SoC.SoC_B.uRC_Cell_L[0].CoreSubsys.Pdot SoC.SoC_B.uRC_Cell_L[0].CoreSubsys.Sum2 SoC.SoC_B.uRC_Cell_L[0].CoreSubsys.Sum2_h SoC.SoC_B.uRC_Cell_L[0].CoreSubsys.TmpSignalConversionAtIntegrator /end REF_MEASUREMENT
/end GROUP
/begin GROUP SoC.SoC_B.CoreSubsys[0] ""
 /begin REF_MEASUREMENT SoC.SoC_B.CoreSubsys[0].Pdot SoC.SoC_B.CoreSubsys[0].Sum2 SoC.SoC_B.CoreSubsys[0].TmpSignalConversionAtIntegrator /end REF_MEASUREMENT
/end GROUP
/begin GROUP SoC.SoC_B.uRC_Cell_H[0] ""
 /begin REF_MEASUREMENT SoC.SoC_B.uRC_Cell_H[0].CoreSubsys.Pdot SoC.SoC_B.uRC_Cell_H[0].CoreSubsys.Sum2 SoC.SoC_B.uRC_Cell_H[0].CoreSubsys.Sum2_h SoC.SoC_B.uRC_Cell_H[0].CoreSubsys.TmpSignalConversionAtIntegrator /end REF_MEASUREMENT
/end GROUP
/begin GROUP SoC.SoC_B.uRC_Cell_H[0].CoreSubsys ""
 /begin REF_MEASUREMENT SoC.SoC_B.uRC_Cell_H[0].CoreSubsys.Pdot SoC.SoC_B.uRC_Cell_H[0].CoreSubsys.Sum2 SoC.SoC_B.uRC_Cell_H[0].CoreSubsys.Sum2_h SoC.SoC_B.uRC_Cell_H[0].CoreSubsys.TmpSignalConversionAtIntegrator /end REF_MEASUREMENT
/end GROUP
/begin GROUP SoC.SoC_B.uRC_Cell_L[0] ""
 /begin REF_MEASUREMENT SoC.SoC_B.uRC_Cell_L[0].CoreSubsys.Pdot SoC.SoC_B.uRC_Cell_L[0].CoreSubsys.Sum2 SoC.SoC_B.uRC_Cell_L[0].CoreSubsys.Sum2_h SoC.SoC_B.uRC_Cell_L[0].CoreSubsys.TmpSignalConversionAtIntegrator /end REF_MEASUREMENT
/end GROUP
/begin GROUP SoC.SoC_B.uRC_Cell_L[0].CoreSubsys ""
 /begin REF_MEASUREMENT SoC.SoC_B.uRC_Cell_L[0].CoreSubsys.Pdot SoC.SoC_B.uRC_Cell_L[0].CoreSubsys.Sum2 SoC.SoC_B.uRC_Cell_L[0].CoreSubsys.Sum2_h SoC.SoC_B.uRC_Cell_L[0].CoreSubsys.TmpSignalConversionAtIntegrator /end REF_MEASUREMENT
/end GROUP
/begin GROUP SoC.SoC_ConstB ""
 /begin REF_MEASUREMENT SoC.SoC_ConstB.CoreSubsys.Divide SoC.SoC_ConstB.uRC_Cell_H.CoreSubsys.Divide SoC.SoC_ConstB.uRC_Cell_L.CoreSubsys.Divide /end REF_MEASUREMENT
/end GROUP
/begin GROUP SoC.SoC_ConstB.CoreSubsys "" /begin REF_MEASUREMENT SoC.SoC_ConstB.CoreSubsys.Divide /end REF_MEASUREMENT /end GROUP
/begin GROUP SoC.SoC_ConstB.uRC_Cell_H "" /begin REF_MEASUREMENT SoC.SoC_ConstB.uRC_Cell_H.CoreSubsys.Divide /end REF_MEASUREMENT /end GROUP
/begin GROUP SoC.SoC_ConstB.uRC_Cell_H.CoreSubsys "" /begin REF_MEASUREMENT SoC.SoC_ConstB.uRC_Cell_H.CoreSubsys.Divide /end REF_MEASUREMENT /end GROUP
/begin GROUP SoC.SoC_ConstB.uRC_Cell_L "" /begin REF_MEASUREMENT SoC.SoC_ConstB.uRC_Cell_L.CoreSubsys.Divide /end REF_MEASUREMENT /end GROUP
/begin GROUP SoC.SoC_ConstB.uRC_Cell_L.CoreSubsys "" /begin REF_MEASUREMENT SoC.SoC_ConstB.uRC_Cell_L.CoreSubsys.Divide /end REF_MEASUREMENT /end GROUP
/begin GROUP SoC.SoC_U ""
 /begin REF_MEASUREMENT SoC.SoC_U.Accumulator_Current SoC.SoC_U.Accumulator_Voltage SoC.SoC_U.Average_CellTemp SoC.SoC_U.Highest_CellVoltage SoC.SoC_U.Lowest_CellVoltage /end REF_MEASUREMENT
/end GROUP
/begin GROUP SoC.SoC_Y ""
 /begin REF_MEASUREMENT SoC.SoC_Y.SoC_Avg SoC.SoC_Y.SoC_High SoC.SoC_Y.SoC_KF SoC.SoC_Y.SoC_Low /end REF_MEASUREMENT
/end GROUP
/begin GROUP Synchronism "" ROOT
 /begin REF_MEASUREMENT Synchronism.Synchronism_DW.counter Synchronism.Synchronism_Y.Sync_CAN1 Synchronism.Synchronism_Y.Sync_CAN2 /end REF_MEASUREMENT
 /begin SUB_GROUP Synchronism.Synchronism_DW Synchronism.Synchronism_Y /end SUB_GROUP
/end GROUP
/begin GROUP Synchronism.Synchronism_DW "" /begin REF_MEASUREMENT Synchronism.Synchronism_DW.counter /end REF_MEASUREMENT /end GROUP
/begin GROUP Synchronism.Synchronism_Y ""
 /begin REF_MEASUREMENT Synchronism.Synchronism_Y.Sync_CAN1 Synchronism.Synchronism_Y.Sync_CAN2 /end REF_MEASUREMENT
/end GROUP
/begin GROUP VDC "" ROOT
 /begin REF_MEASUREMENT VDC.VDC_B.Merge1 VDC.VDC_B.Merge2 VDC.VDC_B.Merge3 VDC.VDC_B.Merge4 VDC.VDC_B.Merge6 VDC.VDC_B.TC_Warning VDC.VDC_B.TC_Warning_l VDC.VDC_B.sf_MATLABFunction.Torque_L_Nm VDC.VDC_B.sf_MATLABFunction.Torque_R_Nm VDC.VDC_B.sf_MATLABFunction_a.Torque_L_Nm VDC.VDC_B.sf_MATLABFunction_a.Torque_R_Nm VDC.VDC_B.sf_RigidAxlewithTC2024_c.Motor_Torque_RL VDC.VDC_B.sf_RigidAxlewithTC2024_c.Motor_Torque_RR VDC.VDC_B.sf_RigidAxlewithTC2024_c.TC_Warning VDC.VDC_B.sf_RigidAxlewithTC2024_p2.Motor_Torque_RL VDC.VDC_B.sf_RigidAxlewithTC2024_p2.Motor_Torque_RR VDC.VDC_B.sf_RigidAxlewithTC2024_p2.TC_Warning VDC.VDC_B.sf_Torquedemandedbythedriver_a.Throttle_Torque VDC.VDC_B.sf_Torquedemandedbythedriver_k.Throttle_Torque VDC.VDC_B.sf_Torquedemandedbythedriver_m.Throttle_Torque VDC.VDC_B.state VDC.VDC_DW.ERROR_Counter VDC.VDC_U.APPS1_Value VDC.VDC_U.APPS2_Value VDC.VDC_U.Accumulator_Voltage VDC.VDC_U.BrakePedal_Value VDC.VDC_U.Car_State VDC.VDC_U.CriticalDisconnection VDC.VDC_U.Disconnection_Mode VDC.VDC_U.RL_Vel_ms_Wheel VDC.VDC_U.RL_rads_Motor VDC.VDC_U.RR_Vel_ms_Wheel VDC.VDC_U.RR_rads_Motor VDC.VDC_U.RacingMode VDC.VDC_U.Shutdown_PackageIntck VDC.VDC_U.SteeringSensor_Value VDC.VDC_U.Susp_F_L VDC.VDC_U.Susp_F_R VDC.VDC_U.Susp_R_L VDC.VDC_U.Susp_R_R VDC.VDC_U.TorqueEnable VDC.VDC_U.el_ACCEL_X VDC.VDC_U.el_ACCEL_Y VDC.VDC_U.el_ACCEL_Z VDC.VDC_U.el_GYRO_X VDC.VDC_U.el_GYRO_Y VDC.VDC_U.el_GYRO_Z VDC.VDC_U.el_PITCH VDC.VDC_U.el_ROLL VDC.VDC_U.el_VEL VDC.VDC_U.el_YAW VDC.VDC_Y.APPS_Implausibility VDC.VDC_Y.BrakeLight_Control VDC.VDC_Y.Regenerative_Enable VDC.VDC_Y.Sensorics_Mode VDC.VDC_Y.TC_Warning VDC.VDC_Y.Throttle_Torque VDC.VDC_Y.Torque_L VDC.VDC_Y.Torque_OK VDC.VDC_Y.Torque_R VDC.VDC_Y.VDC_Max_Tyre_Slip /end REF_MEASUREMENT
 /begin SUB_GROUP VDC.VDC_B VDC.VDC_B.sf_MATLABFunction VDC.VDC_B.sf_MATLABFunction_a VDC.VDC_B.sf_RigidAxlewithTC2024_c VDC.VDC_B.sf_RigidAxlewithTC2024_p2 VDC.VDC_B.sf_Torquedemandedbythedriver_a VDC.VDC_B.sf_Torquedemandedbythedriver_k VDC.VDC_B.sf_Torquedemandedbythedriver_m VDC.VDC_DW VDC.VDC_U VDC.VDC_Y /end SUB_GROUP
/end GROUP
/begin GROUP VDC.VDC_B ""
 /begin REF_MEASUREMENT VDC.VDC_B.Merge1 VDC.VDC_B.Merge2 VDC.VDC_B.Merge3 VDC.VDC_B.Merge4 VDC.VDC_B.Merge6 VDC.VDC_B.TC_Warning VDC.VDC_B.TC_Warning_l VDC.VDC_B.sf_MATLABFunction.Torque_L_Nm VDC.VDC_B.sf_MATLABFunction.Torque_R_Nm VDC.VDC_B.sf_MATLABFunction_a.Torque_L_Nm VDC.VDC_B.sf_MATLABFunction_a.Torque_R_Nm VDC.VDC_B.sf_RigidAxlewithTC2024_c.Motor_Torque_RL VDC.VDC_B.sf_RigidAxlewithTC2024_c.Motor_Torque_RR VDC.VDC_B.sf_RigidAxlewithTC2024_c.TC_Warning VDC.VDC_B.sf_RigidAxlewithTC2024_p2.Motor_Torque_RL VDC.VDC_B.sf_RigidAxlewithTC2024_p2.Motor_Torque_RR VDC.VDC_B.sf_RigidAxlewithTC2024_p2.TC_Warning VDC.VDC_B.sf_Torquedemandedbythedriver_a.Throttle_Torque VDC.VDC_B.sf_Torquedemandedbythedriver_k.Throttle_Torque VDC.VDC_B.sf_Torquedemandedbythedriver_m.Throttle_Torque VDC.VDC_B.state /end REF_MEASUREMENT
/end GROUP
/begin GROUP VDC.VDC_B.sf_MATLABFunction ""
 /begin REF_MEASUREMENT VDC.VDC_B.sf_MATLABFunction.Torque_L_Nm VDC.VDC_B.sf_MATLABFunction.Torque_R_Nm /end REF_MEASUREMENT
/end GROUP
/begin GROUP VDC.VDC_B.sf_MATLABFunction_a ""
 /begin REF_MEASUREMENT VDC.VDC_B.sf_MATLABFunction_a.Torque_L_Nm VDC.VDC_B.sf_MATLABFunction_a.Torque_R_Nm /end REF_MEASUREMENT
/end GROUP
/begin GROUP VDC.VDC_B.sf_RigidAxlewithTC2024_c ""
 /begin REF_MEASUREMENT VDC.VDC_B.sf_RigidAxlewithTC2024_c.Motor_Torque_RL VDC.VDC_B.sf_RigidAxlewithTC2024_c.Motor_Torque_RR VDC.VDC_B.sf_RigidAxlewithTC2024_c.TC_Warning /end REF_MEASUREMENT
/end GROUP
/begin GROUP VDC.VDC_B.sf_RigidAxlewithTC2024_p2 ""
 /begin REF_MEASUREMENT VDC.VDC_B.sf_RigidAxlewithTC2024_p2.Motor_Torque_RL VDC.VDC_B.sf_RigidAxlewithTC2024_p2.Motor_Torque_RR VDC.VDC_B.sf_RigidAxlewithTC2024_p2.TC_Warning /end REF_MEASUREMENT
/end GROUP
/begin GROUP VDC.VDC_B.sf_Torquedemandedbythedriver_a "" /begin REF_MEASUREMENT VDC.VDC_B.sf_Torquedemandedbythedriver_a.Throttle_Torque /end REF_MEASUREMENT /end GROUP
/begin GROUP VDC.VDC_B.sf_Torquedemandedbythedriver_k "" /begin REF_MEASUREMENT VDC.VDC_B.sf_Torquedemandedbythedriver_k.Throttle_Torque /end REF_MEASUREMENT /end GROUP
/begin GROUP VDC.VDC_B.sf_Torquedemandedbythedriver_m "" /begin REF_MEASUREMENT VDC.VDC_B.sf_Torquedemandedbythedriver_m.Throttle_Torque /end REF_MEASUREMENT /end GROUP
/begin GROUP VDC.VDC_DW "" /begin REF_MEASUREMENT VDC.VDC_DW.ERROR_Counter /end REF_MEASUREMENT /end GROUP
/begin GROUP VDC.VDC_U ""
 /begin REF_MEASUREMENT VDC.VDC_U.APPS1_Value VDC.VDC_U.APPS2_Value VDC.VDC_U.Accumulator_Voltage VDC.VDC_U.BrakePedal_Value VDC.VDC_U.Car_State VDC.VDC_U.CriticalDisconnection VDC.VDC_U.Disconnection_Mode VDC.VDC_U.RL_Vel_ms_Wheel VDC.VDC_U.RL_rads_Motor VDC.VDC_U.RR_Vel_ms_Wheel VDC.VDC_U.RR_rads_Motor VDC.VDC_U.RacingMode VDC.VDC_U.Shutdown_PackageIntck VDC.VDC_U.SteeringSensor_Value VDC.VDC_U.Susp_F_L VDC.VDC_U.Susp_F_R VDC.VDC_U.Susp_R_L VDC.VDC_U.Susp_R_R VDC.VDC_U.TorqueEnable VDC.VDC_U.el_ACCEL_X VDC.VDC_U.el_ACCEL_Y VDC.VDC_U.el_ACCEL_Z VDC.VDC_U.el_GYRO_X VDC.VDC_U.el_GYRO_Y VDC.VDC_U.el_GYRO_Z VDC.VDC_U.el_PITCH VDC.VDC_U.el_ROLL VDC.VDC_U.el_VEL VDC.VDC_U.el_YAW /end REF_MEASUREMENT
/end GROUP
/begin GROUP VDC.VDC_Y ""
 /begin REF_MEASUREMENT VDC.VDC_Y.APPS_Implausibility VDC.VDC_Y.BrakeLight_Control VDC.VDC_Y.Regenerative_Enable VDC.VDC_Y.Sensorics_Mode VDC.VDC_Y.TC_Warning VDC.VDC_Y.Throttle_Torque VDC.VDC_Y.Torque_L VDC.VDC_Y.Torque_OK VDC.VDC_Y.Torque_R VDC.VDC_Y.VDC_Max_Tyre_Slip /end REF_MEASUREMENT
/end GROUP
/end MODULE
/* INTECRIO_MERGED */
/end PROJECT
/* ETAS */
