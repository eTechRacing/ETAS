ASAP2_VERSION 1 61
/begin PROJECT ETAS "Generated by ETAS from INTECRIO V5.0.4.1005 integration project"
/begin HEADER "" VERSION "" PROJECT_NO Y /end HEADER
/begin MODULE INTECRIO_MERGED "Generated by ETAS INTECRIO V5.0.4.1005 for M/C interface ETARGET"
/begin MOD_PAR "" VERSION "" ADDR_EPK 0x0 EPK "" SUPPLIER "ETAS GmbH" CUSTOMER "" CUSTOMER_NO "" USER "" PHONE_NO "" ECU "NO_ECU" CPU_TYPE "MPC750" NO_OF_INTERFACES 1 /end MOD_PAR
/begin MOD_COMMON "Common definitions" BYTE_ORDER MSB_FIRST ALIGNMENT_BYTE 1 ALIGNMENT_WORD 2 ALIGNMENT_LONG 4 ALIGNMENT_FLOAT32_IEEE 4 ALIGNMENT_FLOAT64_IEEE 8 /end MOD_COMMON
/begin IF_DATA E_TARGET
 /begin SOURCE "Timer_Inv" 0 3000 QP_BLOB 34 /end SOURCE
 /begin SOURCE "SWT_CAN1_AP_BMS_AIRs_State" 0 1000 QP_BLOB 1 /end SOURCE
 /begin SOURCE "SWT_CAN1_AP_BMS_BatteryTemperatures" 0 1000 QP_BLOB 2 /end SOURCE
 /begin SOURCE "SWT_CAN1_AP_BMS_ChargerParameters" 0 1000 QP_BLOB 3 /end SOURCE
 /begin SOURCE "SWT_CAN1_AP_BMS_SDC" 0 1000 QP_BLOB 4 /end SOURCE
 /begin SOURCE "SWT_CAN1_AP_BMS_Voltages" 0 1000 QP_BLOB 5 /end SOURCE
 /begin SOURCE "SWT_CAN1_AP_CurrentSensor" 0 1000 QP_BLOB 6 /end SOURCE
 /begin SOURCE "SWT_CAN1_AP_DASH_CustomMode" 0 1000 QP_BLOB 7 /end SOURCE
 /begin SOURCE "SWT_CAN1_AP_DASH_EnableDrive" 0 1000 QP_BLOB 8 /end SOURCE
 /begin SOURCE "SWT_CAN1_AP_DASH_Mode" 0 1000 QP_BLOB 9 /end SOURCE
 /begin SOURCE "SWT_CAN1_AP_DASH_PrechargeRequest" 0 1000 QP_BLOB 10 /end SOURCE
 /begin SOURCE "SWT_CAN1_AP_DASH_TorqueLockOn" 0 1000 QP_BLOB 11 /end SOURCE
 /begin SOURCE "SWT_CAN1_AP_Inverter_L_Tx" 0 1000 QP_BLOB 12 /end SOURCE
 /begin SOURCE "SWT_CAN1_AP_Inverter_R_Tx" 0 1000 QP_BLOB 13 /end SOURCE
 /begin SOURCE "SWT_CAN1_NM_BMS_Keep_Alive" 0 1000 QP_BLOB 14 /end SOURCE
 /begin SOURCE "SWT_CAN1_NM_DASH_Keep_Alive" 0 1000 QP_BLOB 15 /end SOURCE
 /begin SOURCE "SWT_CAN2_AP_ELLIPSE_EKF_EULER" 0 1000 QP_BLOB 16 /end SOURCE
 /begin SOURCE "SWT_CAN2_AP_ELLIPSE_EKF_POS" 0 1000 QP_BLOB 17 /end SOURCE
 /begin SOURCE "SWT_CAN2_AP_ELLIPSE_EKF_VEL" 0 1000 QP_BLOB 18 /end SOURCE
 /begin SOURCE "SWT_CAN2_AP_ELLIPSE_IMU_ACCEL" 0 1000 QP_BLOB 19 /end SOURCE
 /begin SOURCE "SWT_CAN2_AP_ELLIPSE_IMU_GYRO" 0 1000 QP_BLOB 20 /end SOURCE
 /begin SOURCE "SWT_CAN2_AP_ELLIPSE_SLIP_CURV" 0 1000 QP_BLOB 21 /end SOURCE
 /begin SOURCE "SWT_CAN2_AP_FECU_Data1" 0 1000 QP_BLOB 22 /end SOURCE
 /begin SOURCE "SWT_CAN2_AP_FECU_Data2" 0 1000 QP_BLOB 23 /end SOURCE
 /begin SOURCE "SWT_CAN2_AP_RECU_Data" 0 1000 QP_BLOB 24 /end SOURCE
 /begin SOURCE "SWT_CAN2_MEAS_FECU_SDC" 0 1000 QP_BLOB 25 /end SOURCE
 /begin SOURCE "SWT_CAN2_MEAS_RECU_SDC" 0 1000 QP_BLOB 26 /end SOURCE
 /begin SOURCE "SWT_CAN2_NM_ELLIPSE_Status" 0 1000 QP_BLOB 27 /end SOURCE
 /begin SOURCE "SWT_CAN2_NM_FECU_Keep_Alive" 0 1000 QP_BLOB 28 /end SOURCE
 /begin SOURCE "SWT_CAN2_NM_RECU_Keep_Alive" 0 1000 QP_BLOB 29 /end SOURCE
 /begin SOURCE "Sync_25ms" 0 25000 QP_BLOB 30 /end SOURCE
 /begin SOURCE "Timer_1000ms" 0 1000000 QP_BLOB 31 /end SOURCE
 /begin SOURCE "Timer_100ms" 0 100000 QP_BLOB 32 /end SOURCE
 /begin SOURCE "Timer_25ms" 0 25000 QP_BLOB 33 /end SOURCE
 /begin TP_BLOB /* Program identifier */ 1651477093 /* HW target identifier */ 0x6 /* Skip flag */ 0 /* Skip to link */ 2 /* Loader identifier */ 0x02000001 /end TP_BLOB
/end IF_DATA
/begin MEASUREMENT Car_State.Car_State_B.Merge "" FLOAT64_IEEE Car_State_CM_double 0 0 -1.7e+308 1.7e+308 ECU_ADDRESS 0x0 DISPLAY_IDENTIFIER Car_State.AIRS_Request.Merge.Merge /end MEASUREMENT
/begin MEASUREMENT Car_State.Car_State_DW.A "" FLOAT64_IEEE Car_State_CM_double 0 0 -1.7e+308 1.7e+308 ECU_ADDRESS 0x0 DISPLAY_IDENTIFIER Car_State.CurrentPathDisconnection_Detection.Data_Store_Memory.A /end MEASUREMENT
/begin MEASUREMENT Car_State.Car_State_U.AIRs_State "" FLOAT64_IEEE Car_State_CM_double 0 0 -1.7e+308 1.7e+308 ECU_ADDRESS 0x0 DISPLAY_IDENTIFIER Car_State.AIRs_State /end MEASUREMENT
/begin MEASUREMENT Car_State.Car_State_U.Accumulator_Voltage "" FLOAT64_IEEE Car_State_CM_double 0 0 -1.7e+308 1.7e+308 ECU_ADDRESS 0x0 DISPLAY_IDENTIFIER Car_State.Accumulator_Voltage /end MEASUREMENT
/begin MEASUREMENT Car_State.Car_State_U.Critical_CAN_Disconnection "" FLOAT64_IEEE Car_State_CM_double 0 0 -1.7e+308 1.7e+308 ECU_ADDRESS 0x0 DISPLAY_IDENTIFIER Car_State.Critical_CAN_Disconnection /end MEASUREMENT
/begin MEASUREMENT Car_State.Car_State_U.EnableDrive_Order "" FLOAT64_IEEE Car_State_CM_double 0 0 -1.7e+308 1.7e+308 ECU_ADDRESS 0x0 DISPLAY_IDENTIFIER Car_State.EnableDrive_Order /end MEASUREMENT
/begin MEASUREMENT Car_State.Car_State_U.InvertersMinDCBus "" FLOAT64_IEEE Car_State_CM_double 0 0 -1.7e+308 1.7e+308 ECU_ADDRESS 0x0 DISPLAY_IDENTIFIER Car_State.InvertersMinDCBus /end MEASUREMENT
/begin MEASUREMENT Car_State.Car_State_U.InvertersSubscribed "" FLOAT64_IEEE Car_State_CM_double 0 0 -1.7e+308 1.7e+308 ECU_ADDRESS 0x0 DISPLAY_IDENTIFIER Car_State.InvertersSubscribed /end MEASUREMENT
/begin MEASUREMENT Car_State.Car_State_U.PrechargeRequest "" FLOAT64_IEEE Car_State_CM_double 0 0 -1.7e+308 1.7e+308 ECU_ADDRESS 0x0 DISPLAY_IDENTIFIER Car_State.PrechargeRequest /end MEASUREMENT
/begin MEASUREMENT Car_State.Car_State_U.Shutdown_PackageIntck "" UBYTE Car_State_CM_boolean 0 0 0 1 ECU_ADDRESS 0x0 DISPLAY_IDENTIFIER Car_State.Shutdown_PackageIntck /end MEASUREMENT
/begin MEASUREMENT Car_State.Car_State_U.Torque_LockON "" FLOAT64_IEEE Car_State_CM_double 0 0 -1.7e+308 1.7e+308 ECU_ADDRESS 0x0 DISPLAY_IDENTIFIER Car_State.Torque_LockON /end MEASUREMENT
/begin MEASUREMENT Car_State.Car_State_Y.AIRs_Request "" FLOAT64_IEEE Car_State_CM_double 0 0 -1.7e+308 1.7e+308 ECU_ADDRESS 0x0 DISPLAY_IDENTIFIER Car_State.AIRs_Request /end MEASUREMENT
/begin MEASUREMENT Car_State.Car_State_Y.Car_OK "" UBYTE Car_State_CM_boolean 0 0 0 1 ECU_ADDRESS 0x0 DISPLAY_IDENTIFIER Car_State.Car_OK /end MEASUREMENT
/begin MEASUREMENT Car_State.Car_State_Y.Car_State_f "" FLOAT64_IEEE Car_State_CM_double 0 0 -1.7e+308 1.7e+308 ECU_ADDRESS 0x0 DISPLAY_IDENTIFIER Car_State.Car_State /end MEASUREMENT
/begin MEASUREMENT Car_State.Car_State_Y.CurrentPathDisconnectionFlag "" FLOAT64_IEEE Car_State_CM_double 0 0 -1.7e+308 1.7e+308 ECU_ADDRESS 0x0 DISPLAY_IDENTIFIER Car_State.CurrentPathDisconnectionFlag /end MEASUREMENT
/begin MEASUREMENT Car_State.Car_State_Y.InvertersAction "" FLOAT64_IEEE Car_State_CM_double 0 0 -1.7e+308 1.7e+308 ECU_ADDRESS 0x0 DISPLAY_IDENTIFIER Car_State.InvertersAction /end MEASUREMENT
/begin MEASUREMENT Car_State.Car_State_Y.PrechargeAssert "" FLOAT64_IEEE Car_State_CM_double 0 0 -1.7e+308 1.7e+308 ECU_ADDRESS 0x0 DISPLAY_IDENTIFIER Car_State.PrechargeAssert /end MEASUREMENT
/begin MEASUREMENT Car_State.Car_State_Y.Precharge_Percentage "" FLOAT64_IEEE Car_State_CM_double 0 0 -1.7e+308 1.7e+308 ECU_ADDRESS 0x0 DISPLAY_IDENTIFIER Car_State.Precharge_Percentage /end MEASUREMENT
/begin MEASUREMENT Car_State.Car_State_Y.Precharge_Voltage "" FLOAT64_IEEE Car_State_CM_double 0 0 -1.7e+308 1.7e+308 ECU_ADDRESS 0x0 DISPLAY_IDENTIFIER Car_State.Precharge_Voltage /end MEASUREMENT
/begin MEASUREMENT Car_State.Car_State_Y.TorqueEnable "" FLOAT64_IEEE Car_State_CM_double 0 0 -1.7e+308 1.7e+308 ECU_ADDRESS 0x0 DISPLAY_IDENTIFIER Car_State.TorqueEnable /end MEASUREMENT
/begin MEASUREMENT Car_State.Car_State_Y.errors "" FLOAT64_IEEE Car_State_CM_double 0 0 -1.7e+308 1.7e+308 ECU_ADDRESS 0x0 DISPLAY_IDENTIFIER Car_State.errors /end MEASUREMENT
/begin MEASUREMENT Disconnections.Disconnections_B.Merge "" FLOAT64_IEEE Disconnections_CM_double 0 0 -1.7e+308 1.7e+308 ECU_ADDRESS 0x0 DISPLAY_IDENTIFIER Disconnections.ECU_Disconections.LifeCheck_BMS.Merge.Merge /end MEASUREMENT
/begin MEASUREMENT Disconnections.Disconnections_B.Merge_b "" FLOAT64_IEEE Disconnections_CM_double 0 0 -1.7e+308 1.7e+308 ECU_ADDRESS 0x0 DISPLAY_IDENTIFIER Disconnections.ECU_Disconections.LifeCheck_AccFront.Merge.Merge_b /end MEASUREMENT
/begin MEASUREMENT Disconnections.Disconnections_B.Merge_d "" FLOAT64_IEEE Disconnections_CM_double 0 0 -1.7e+308 1.7e+308 ECU_ADDRESS 0x0 DISPLAY_IDENTIFIER Disconnections.ECU_Disconections.LifeCheck_AccRear.Merge.Merge_d /end MEASUREMENT
/begin MEASUREMENT Disconnections.Disconnections_B.Merge_f "" FLOAT64_IEEE Disconnections_CM_double 0 0 -1.7e+308 1.7e+308 ECU_ADDRESS 0x0 DISPLAY_IDENTIFIER Disconnections.ECU_Disconections.Life_check4.Merge.Merge_f /end MEASUREMENT
/begin MEASUREMENT Disconnections.Disconnections_B.Merge_h "" FLOAT64_IEEE Disconnections_CM_double 0 0 -1.7e+308 1.7e+308 ECU_ADDRESS 0x0 DISPLAY_IDENTIFIER Disconnections.ECU_Disconections.LifeCheck_Dash.Merge.Merge_h /end MEASUREMENT
/begin MEASUREMENT Disconnections.Disconnections_DW.A "" FLOAT64_IEEE Disconnections_CM_double 0 0 -1.7e+308 1.7e+308 ECU_ADDRESS 0x0 DISPLAY_IDENTIFIER Disconnections.Counter.Data_Store_Memory.A /end MEASUREMENT
/begin MEASUREMENT Disconnections.Disconnections_DW.Last_alive "" FLOAT64_IEEE Disconnections_CM_double 0 0 -1.7e+308 1.7e+308 ECU_ADDRESS 0x0 DISPLAY_IDENTIFIER Disconnections.Pedal_Box_Disconnections__Noise_.Life_check3.Data_Store_Memory.Last_alive /end MEASUREMENT
/begin MEASUREMENT Disconnections.Disconnections_DW.Last_alive_a "" FLOAT64_IEEE Disconnections_CM_double 0 0 -1.7e+308 1.7e+308 ECU_ADDRESS 0x0 DISPLAY_IDENTIFIER Disconnections.ECU_Disconections.LifeCheck_AccFront.Data_Store_Memory.Last_alive_a /end MEASUREMENT
/begin MEASUREMENT Disconnections.Disconnections_DW.Last_alive_c "" FLOAT64_IEEE Disconnections_CM_double 0 0 -1.7e+308 1.7e+308 ECU_ADDRESS 0x0 DISPLAY_IDENTIFIER Disconnections.Pedal_Box_Disconnections__Noise_.Life_check2.Data_Store_Memory.Last_alive_c /end MEASUREMENT
/begin MEASUREMENT Disconnections.Disconnections_DW.Last_alive_c0 "" FLOAT64_IEEE Disconnections_CM_double 0 0 -1.7e+308 1.7e+308 ECU_ADDRESS 0x0 DISPLAY_IDENTIFIER Disconnections.ECU_Disconections.LifeCheck_BMS.Data_Store_Memory.Last_alive_c0 /end MEASUREMENT
/begin MEASUREMENT Disconnections.Disconnections_DW.Last_alive_g "" FLOAT64_IEEE Disconnections_CM_double 0 0 -1.7e+308 1.7e+308 ECU_ADDRESS 0x0 DISPLAY_IDENTIFIER Disconnections.Pedal_Box_Disconnections__Noise_.Life_check1.Data_Store_Memory.Last_alive_g /end MEASUREMENT
/begin MEASUREMENT Disconnections.Disconnections_DW.Last_alive_gx "" FLOAT64_IEEE Disconnections_CM_double 0 0 -1.7e+308 1.7e+308 ECU_ADDRESS 0x0 DISPLAY_IDENTIFIER Disconnections.ECU_Disconections.LifeCheck_AccRear.Data_Store_Memory.Last_alive_gx /end MEASUREMENT
/begin MEASUREMENT Disconnections.Disconnections_DW.Last_alive_j "" FLOAT64_IEEE Disconnections_CM_double 0 0 -1.7e+308 1.7e+308 ECU_ADDRESS 0x0 DISPLAY_IDENTIFIER Disconnections.ECU_Disconections.Life_check4.Data_Store_Memory.Last_alive_j /end MEASUREMENT
/begin MEASUREMENT Disconnections.Disconnections_DW.Last_alive_o "" FLOAT64_IEEE Disconnections_CM_double 0 0 -1.7e+308 1.7e+308 ECU_ADDRESS 0x0 DISPLAY_IDENTIFIER Disconnections.ECU_Disconections.LifeCheck_Dash.Data_Store_Memory.Last_alive_o /end MEASUREMENT
/begin MEASUREMENT Disconnections.Disconnections_DW.Tot_Errors "" FLOAT64_IEEE Disconnections_CM_double 0 0 -1.7e+308 1.7e+308 ECU_ADDRESS 0x0 DISPLAY_IDENTIFIER Disconnections.Pedal_Box_Disconnections__Noise_.Life_check3.Data_Store_Memory1.Tot_Errors /end MEASUREMENT
/begin MEASUREMENT Disconnections.Disconnections_DW.Tot_Errors_j "" FLOAT64_IEEE Disconnections_CM_double 0 0 -1.7e+308 1.7e+308 ECU_ADDRESS 0x0 DISPLAY_IDENTIFIER Disconnections.Pedal_Box_Disconnections__Noise_.Life_check2.Data_Store_Memory1.Tot_Errors_j /end MEASUREMENT
/begin MEASUREMENT Disconnections.Disconnections_DW.Tot_Errors_k "" FLOAT64_IEEE Disconnections_CM_double 0 0 -1.7e+308 1.7e+308 ECU_ADDRESS 0x0 DISPLAY_IDENTIFIER Disconnections.Pedal_Box_Disconnections__Noise_.Life_check1.Data_Store_Memory1.Tot_Errors_k /end MEASUREMENT
/begin MEASUREMENT Disconnections.Disconnections_U.APPS1_Bits "" FLOAT64_IEEE Disconnections_CM_double 0 0 -1.7e+308 1.7e+308 ECU_ADDRESS 0x0 DISPLAY_IDENTIFIER Disconnections.APPS1_Bits /end MEASUREMENT
/begin MEASUREMENT Disconnections.Disconnections_U.APPS2_Bits "" FLOAT64_IEEE Disconnections_CM_double 0 0 -1.7e+308 1.7e+308 ECU_ADDRESS 0x0 DISPLAY_IDENTIFIER Disconnections.APPS2_Bits /end MEASUREMENT
/begin MEASUREMENT Disconnections.Disconnections_U.BMS_Alive "" FLOAT64_IEEE Disconnections_CM_double 0 0 -1.7e+308 1.7e+308 ECU_ADDRESS 0x0 DISPLAY_IDENTIFIER Disconnections.BMS_Alive /end MEASUREMENT
/begin MEASUREMENT Disconnections.Disconnections_U.BrakeSensor_Bits "" FLOAT64_IEEE Disconnections_CM_double 0 0 -1.7e+308 1.7e+308 ECU_ADDRESS 0x0 DISPLAY_IDENTIFIER Disconnections.BrakeSensor_Bits /end MEASUREMENT
/begin MEASUREMENT Disconnections.Disconnections_U.Dash_Alive "" FLOAT64_IEEE Disconnections_CM_double 0 0 -1.7e+308 1.7e+308 ECU_ADDRESS 0x0 DISPLAY_IDENTIFIER Disconnections.Dash_Alive /end MEASUREMENT
/begin MEASUREMENT Disconnections.Disconnections_U.Ellipse_Alive "" FLOAT64_IEEE Disconnections_CM_double 0 0 -1.7e+308 1.7e+308 ECU_ADDRESS 0x0 DISPLAY_IDENTIFIER Disconnections.Ellipse_Alive /end MEASUREMENT
/begin MEASUREMENT Disconnections.Disconnections_U.Front_Alive "" FLOAT64_IEEE Disconnections_CM_double 0 0 -1.7e+308 1.7e+308 ECU_ADDRESS 0x0 DISPLAY_IDENTIFIER Disconnections.Front_Alive /end MEASUREMENT
/begin MEASUREMENT Disconnections.Disconnections_U.Rear_Alive "" FLOAT64_IEEE Disconnections_CM_double 0 0 -1.7e+308 1.7e+308 ECU_ADDRESS 0x0 DISPLAY_IDENTIFIER Disconnections.Rear_Alive /end MEASUREMENT
/begin MEASUREMENT Disconnections.Disconnections_U.SteeringSensor_Bits "" FLOAT64_IEEE Disconnections_CM_double 0 0 -1.7e+308 1.7e+308 ECU_ADDRESS 0x0 DISPLAY_IDENTIFIER Disconnections.SteeringSensor_Bits /end MEASUREMENT
/begin MEASUREMENT Disconnections.Disconnections_U.Susp_F_L_Bits "" FLOAT64_IEEE Disconnections_CM_double 0 0 -1.7e+308 1.7e+308 ECU_ADDRESS 0x0 DISPLAY_IDENTIFIER Disconnections.Susp_F_L_Bits /end MEASUREMENT
/begin MEASUREMENT Disconnections.Disconnections_U.Susp_F_R_Bits "" FLOAT64_IEEE Disconnections_CM_double 0 0 -1.7e+308 1.7e+308 ECU_ADDRESS 0x0 DISPLAY_IDENTIFIER Disconnections.Susp_F_R_Bits /end MEASUREMENT
/begin MEASUREMENT Disconnections.Disconnections_U.Susp_R_L_Bits "" FLOAT64_IEEE Disconnections_CM_double 0 0 -1.7e+308 1.7e+308 ECU_ADDRESS 0x0 DISPLAY_IDENTIFIER Disconnections.Susp_R_L_Bits /end MEASUREMENT
/begin MEASUREMENT Disconnections.Disconnections_U.Susp_R_R_Bits "" FLOAT64_IEEE Disconnections_CM_double 0 0 -1.7e+308 1.7e+308 ECU_ADDRESS 0x0 DISPLAY_IDENTIFIER Disconnections.Susp_R_R_Bits /end MEASUREMENT
/begin MEASUREMENT Disconnections.Disconnections_Y.CounterOut "" FLOAT64_IEEE Disconnections_CM_double 0 0 -1.7e+308 1.7e+308 ECU_ADDRESS 0x0 DISPLAY_IDENTIFIER Disconnections.CounterOut /end MEASUREMENT
/begin MEASUREMENT Disconnections.Disconnections_Y.CriticalDisconnection "" UBYTE Disconnections_CM_boolean 0 0 0 1 ECU_ADDRESS 0x0 DISPLAY_IDENTIFIER Disconnections.CriticalDisconnection /end MEASUREMENT
/begin MEASUREMENT Disconnections.Disconnections_Y.Critical_CAN_Disconnection "" UBYTE Disconnections_CM_boolean 0 0 0 1 ECU_ADDRESS 0x0 DISPLAY_IDENTIFIER Disconnections.Critical_CAN_Disconnection /end MEASUREMENT
/begin MEASUREMENT Disconnections.Disconnections_Y.Critical_Signal_Disconnection "" UBYTE Disconnections_CM_boolean 0 0 0 1 ECU_ADDRESS 0x0 DISPLAY_IDENTIFIER Disconnections.Critical_Signal_Disconnection /end MEASUREMENT
/begin MEASUREMENT Disconnections.Disconnections_Y.Disconnection_APPS1 "" FLOAT64_IEEE Disconnections_CM_double 0 0 -1.7e+308 1.7e+308 ECU_ADDRESS 0x0 DISPLAY_IDENTIFIER Disconnections.Disconnection_APPS1 /end MEASUREMENT
/begin MEASUREMENT Disconnections.Disconnections_Y.Disconnection_APPS2 "" FLOAT64_IEEE Disconnections_CM_double 0 0 -1.7e+308 1.7e+308 ECU_ADDRESS 0x0 DISPLAY_IDENTIFIER Disconnections.Disconnection_APPS2 /end MEASUREMENT
/begin MEASUREMENT Disconnections.Disconnections_Y.Disconnection_BMS "" FLOAT64_IEEE Disconnections_CM_double 0 0 -1.7e+308 1.7e+308 ECU_ADDRESS 0x0 DISPLAY_IDENTIFIER Disconnections.Disconnection_BMS /end MEASUREMENT
/begin MEASUREMENT Disconnections.Disconnections_Y.Disconnection_Brake_Sensor "" FLOAT64_IEEE Disconnections_CM_double 0 0 -1.7e+308 1.7e+308 ECU_ADDRESS 0x0 DISPLAY_IDENTIFIER Disconnections.Disconnection_Brake_Sensor /end MEASUREMENT
/begin MEASUREMENT Disconnections.Disconnections_Y.Disconnection_DashBoard "" FLOAT64_IEEE Disconnections_CM_double 0 0 -1.7e+308 1.7e+308 ECU_ADDRESS 0x0 DISPLAY_IDENTIFIER Disconnections.Disconnection_DashBoard /end MEASUREMENT
/begin MEASUREMENT Disconnections.Disconnections_Y.Disconnection_Ellipse "" FLOAT64_IEEE Disconnections_CM_double 0 0 -1.7e+308 1.7e+308 ECU_ADDRESS 0x0 DISPLAY_IDENTIFIER Disconnections.Disconnection_Ellipse /end MEASUREMENT
/begin MEASUREMENT Disconnections.Disconnections_Y.Disconnection_Front "" FLOAT64_IEEE Disconnections_CM_double 0 0 -1.7e+308 1.7e+308 ECU_ADDRESS 0x0 DISPLAY_IDENTIFIER Disconnections.Disconnection_Front /end MEASUREMENT
/begin MEASUREMENT Disconnections.Disconnections_Y.Disconnection_Rear "" FLOAT64_IEEE Disconnections_CM_double 0 0 -1.7e+308 1.7e+308 ECU_ADDRESS 0x0 DISPLAY_IDENTIFIER Disconnections.Disconnection_Rear /end MEASUREMENT
/begin MEASUREMENT Disconnections.Disconnections_Y.Disconnection_SteeringSensor "" UBYTE Disconnections_CM_uint8 0 0 0.0 255.0 ECU_ADDRESS 0x0 DISPLAY_IDENTIFIER Disconnections.Disconnection_SteeringSensor /end MEASUREMENT
/begin MEASUREMENT Disconnections.Disconnections_Y.Disconnection_Susp_F_L "" UBYTE Disconnections_CM_uint8 0 0 0.0 255.0 ECU_ADDRESS 0x0 DISPLAY_IDENTIFIER Disconnections.Disconnection_Susp_F_L /end MEASUREMENT
/begin MEASUREMENT Disconnections.Disconnections_Y.Disconnection_Susp_F_R "" UBYTE Disconnections_CM_uint8 0 0 0.0 255.0 ECU_ADDRESS 0x0 DISPLAY_IDENTIFIER Disconnections.Disconnection_Susp_F_R /end MEASUREMENT
/begin MEASUREMENT Disconnections.Disconnections_Y.Disconnection_Susp_R_L "" UBYTE Disconnections_CM_uint8 0 0 0.0 255.0 ECU_ADDRESS 0x0 DISPLAY_IDENTIFIER Disconnections.Disconnection_Susp_R_L /end MEASUREMENT
/begin MEASUREMENT Disconnections.Disconnections_Y.Disconnection_Susp_R_R "" UBYTE Disconnections_CM_uint8 0 0 0.0 255.0 ECU_ADDRESS 0x0 DISPLAY_IDENTIFIER Disconnections.Disconnection_Susp_R_R /end MEASUREMENT
/begin MEASUREMENT Disconnections.Disconnections_Y.TV_mode "" FLOAT64_IEEE Disconnections_CM_double 0 0 -1.7e+308 1.7e+308 ECU_ADDRESS 0x0 DISPLAY_IDENTIFIER Disconnections.TV_mode /end MEASUREMENT
/begin MEASUREMENT Ellipse.Ellipse_U.el_AUTO_STATUS "" FLOAT64_IEEE Ellipse_CM_double 0 0 -1.7e+308 1.7e+308 ECU_ADDRESS 0x0 DISPLAY_IDENTIFIER Ellipse.el_AUTO_STATUS /end MEASUREMENT
/begin MEASUREMENT Ellipse.Ellipse_U.el_AngleTrack "" FLOAT64_IEEE Ellipse_CM_double 0 0 -1.7e+308 1.7e+308 ECU_ADDRESS 0x0 DISPLAY_IDENTIFIER Ellipse.el_AngleTrack /end MEASUREMENT
/begin MEASUREMENT Ellipse.Ellipse_U.el_CLOCK "" FLOAT64_IEEE Ellipse_CM_double 0 0 -1.7e+308 1.7e+308 ECU_ADDRESS 0x0 DISPLAY_IDENTIFIER Ellipse.el_CLOCK /end MEASUREMENT
/begin MEASUREMENT Ellipse.Ellipse_U.el_CurvatureRadius "" FLOAT64_IEEE Ellipse_CM_double 0 0 -1.7e+308 1.7e+308 ECU_ADDRESS 0x0 DISPLAY_IDENTIFIER Ellipse.el_CurvatureRadius /end MEASUREMENT
/begin MEASUREMENT Ellipse.Ellipse_U.el_GENERAL "" FLOAT64_IEEE Ellipse_CM_double 0 0 -1.7e+308 1.7e+308 ECU_ADDRESS 0x0 DISPLAY_IDENTIFIER Ellipse.el_GENERAL /end MEASUREMENT
/begin MEASUREMENT Ellipse.Ellipse_U.el_LATITUDE_EKF "" FLOAT64_IEEE Ellipse_CM_double 0 0 -1.7e+308 1.7e+308 ECU_ADDRESS 0x0 DISPLAY_IDENTIFIER Ellipse.el_LATITUDE_EKF /end MEASUREMENT
/begin MEASUREMENT Ellipse.Ellipse_U.el_LONGITUDE_EKF "" FLOAT64_IEEE Ellipse_CM_double 0 0 -1.7e+308 1.7e+308 ECU_ADDRESS 0x0 DISPLAY_IDENTIFIER Ellipse.el_LONGITUDE_EKF /end MEASUREMENT
/begin MEASUREMENT Ellipse.Ellipse_U.el_SlipAngle "" FLOAT64_IEEE Ellipse_CM_double 0 0 -1.7e+308 1.7e+308 ECU_ADDRESS 0x0 DISPLAY_IDENTIFIER Ellipse.el_SlipAngle /end MEASUREMENT
/begin MEASUREMENT Ellipse.Ellipse_Y.Clock_Tx "" FLOAT64_IEEE Ellipse_CM_double 0 0 -1.7e+308 1.7e+308 ECU_ADDRESS 0x0 DISPLAY_IDENTIFIER Ellipse.Clock_Tx /end MEASUREMENT
/begin MEASUREMENT Ellipse.Ellipse_Y.CurvRadius "" FLOAT64_IEEE Ellipse_CM_double 0 0 -1.7e+308 1.7e+308 ECU_ADDRESS 0x0 DISPLAY_IDENTIFIER Ellipse.CurvRadius /end MEASUREMENT
/begin MEASUREMENT Ellipse.Ellipse_Y.General_Tx "" FLOAT64_IEEE Ellipse_CM_double 0 0 -1.7e+308 1.7e+308 ECU_ADDRESS 0x0 DISPLAY_IDENTIFIER Ellipse.General_Tx /end MEASUREMENT
/begin MEASUREMENT Ellipse.Ellipse_Y.Lat_EKF "" FLOAT64_IEEE Ellipse_CM_double 0 0 -1.7e+308 1.7e+308 ECU_ADDRESS 0x0 DISPLAY_IDENTIFIER Ellipse.Lat_EKF /end MEASUREMENT
/begin MEASUREMENT Ellipse.Ellipse_Y.Long_EKF "" FLOAT64_IEEE Ellipse_CM_double 0 0 -1.7e+308 1.7e+308 ECU_ADDRESS 0x0 DISPLAY_IDENTIFIER Ellipse.Long_EKF /end MEASUREMENT
/begin MEASUREMENT Ellipse.Ellipse_Y.SlipAngle "" FLOAT64_IEEE Ellipse_CM_double 0 0 -1.7e+308 1.7e+308 ECU_ADDRESS 0x0 DISPLAY_IDENTIFIER Ellipse.SlipAngle /end MEASUREMENT
/begin MEASUREMENT Ellipse.Ellipse_Y.Status_Auto "" FLOAT64_IEEE Ellipse_CM_double 0 0 -1.7e+308 1.7e+308 ECU_ADDRESS 0x0 DISPLAY_IDENTIFIER Ellipse.Status_Auto /end MEASUREMENT
/begin MEASUREMENT Ellipse.Ellipse_Y.TrackAngle "" FLOAT64_IEEE Ellipse_CM_double 0 0 -1.7e+308 1.7e+308 ECU_ADDRESS 0x0 DISPLAY_IDENTIFIER Ellipse.TrackAngle /end MEASUREMENT
/begin MEASUREMENT Inverters_Action.Inverters_Action_B.Merge "" UBYTE Inverters_Action_CM_boolean 0 0 0 1 ECU_ADDRESS 0x0 DISPLAY_IDENTIFIER Inverters_Action.Merge.Merge /end MEASUREMENT
/begin MEASUREMENT Inverters_Action.Inverters_Action_B.Merge2 "" UBYTE Inverters_Action_CM_uint8 0 0 0.0 255.0 ECU_ADDRESS 0x0 DISPLAY_IDENTIFIER Inverters_Action.Subsystem9.Merge2.Merge2 /end MEASUREMENT
/begin MEASUREMENT Inverters_Action.Inverters_Action_B.Merge2_p "" UBYTE Inverters_Action_CM_uint8 0 0 0.0 255.0 ECU_ADDRESS 0x0 DISPLAY_IDENTIFIER Inverters_Action.Subsystem10.Merge2.Merge2_p /end MEASUREMENT
/begin MEASUREMENT Inverters_Action.Inverters_Action_B.subscribed "" UBYTE Inverters_Action_CM_boolean 0 0 0 1 ECU_ADDRESS 0x0 DISPLAY_IDENTIFIER Inverters_Action.Subsystem9.Unsubscribe__Subscribe.subscribed_.subscribed /end MEASUREMENT
/begin MEASUREMENT Inverters_Action.Inverters_Action_B.subscribed_b "" UBYTE Inverters_Action_CM_boolean 0 0 0 1 ECU_ADDRESS 0x0 DISPLAY_IDENTIFIER Inverters_Action.Subsystem10.Unsubscribe__Subscribe.subscribed_.subscribed_b /end MEASUREMENT
/begin MEASUREMENT Inverters_Action.Inverters_Action_ConstB.TorqueCommand.Divide "" FLOAT64_IEEE Inverters_Action_CM_double 0 0 -1.7e+308 1.7e+308 ECU_ADDRESS 0x0 DISPLAY_IDENTIFIER Inverters_Action.Subsystem10.Torque_Command.Divide.Divide /end MEASUREMENT
/begin MEASUREMENT Inverters_Action.Inverters_Action_ConstB.TorqueCommand0.BitwiseOperator1 "" UWORD Inverters_Action_CM_uint16 0 0 0.0 65535.0 ECU_ADDRESS 0x0 DISPLAY_IDENTIFIER Inverters_Action.Subsystem10.Torque_Command_0.Subsystem.Bitwise_Operator1.BitwiseOperator1 /end MEASUREMENT
/begin MEASUREMENT Inverters_Action.Inverters_Action_ConstB.TorqueCommand0.Current0to65535 "" UWORD Inverters_Action_CM_uint16 0 0 0.0 65535.0 ECU_ADDRESS 0x0 DISPLAY_IDENTIFIER Inverters_Action.Subsystem10.Torque_Command_0.Product.Current_0_to_65535 /end MEASUREMENT
/begin MEASUREMENT Inverters_Action.Inverters_Action_ConstB.TorqueCommand0.Divide "" FLOAT64_IEEE Inverters_Action_CM_double 0 0 -1.7e+308 1.7e+308 ECU_ADDRESS 0x0 DISPLAY_IDENTIFIER Inverters_Action.Subsystem10.Torque_Command_0.Divide.Divide /end MEASUREMENT
/begin MEASUREMENT Inverters_Action.Inverters_Action_ConstB.TorqueCommand0.ShiftArithmetic "" UWORD Inverters_Action_CM_uint16 0 0 0.0 65535.0 ECU_ADDRESS 0x0 DISPLAY_IDENTIFIER Inverters_Action.Subsystem10.Torque_Command_0.Subsystem.Shift_Arithmetic.ShiftArithmetic /end MEASUREMENT
/begin MEASUREMENT Inverters_Action.Inverters_Action_ConstB.TorqueCommand0.b7tob0 "" UWORD Inverters_Action_CM_uint16 0 0 0.0 65535.0 ECU_ADDRESS 0x0 DISPLAY_IDENTIFIER Inverters_Action.Subsystem10.Torque_Command_0.Subsystem.Bitwise_Operator.b7_to_b0 /end MEASUREMENT
/begin MEASUREMENT Inverters_Action.Inverters_Action_ConstB.TorqueCommand0_g.BitwiseOperator1 "" UWORD Inverters_Action_CM_uint16 0 0 0.0 65535.0 ECU_ADDRESS 0x0 DISPLAY_IDENTIFIER Inverters_Action.Subsystem9.Torque_Command_0.Subsystem.Bitwise_Operator1.BitwiseOperator1 /end MEASUREMENT
/begin MEASUREMENT Inverters_Action.Inverters_Action_ConstB.TorqueCommand0_g.Current0to65535 "" UWORD Inverters_Action_CM_uint16 0 0 0.0 65535.0 ECU_ADDRESS 0x0 DISPLAY_IDENTIFIER Inverters_Action.Subsystem9.Torque_Command_0.Product.Current_0_to_65535 /end MEASUREMENT
/begin MEASUREMENT Inverters_Action.Inverters_Action_ConstB.TorqueCommand0_g.Divide "" FLOAT64_IEEE Inverters_Action_CM_double 0 0 -1.7e+308 1.7e+308 ECU_ADDRESS 0x0 DISPLAY_IDENTIFIER Inverters_Action.Subsystem9.Torque_Command_0.Divide.Divide /end MEASUREMENT
/begin MEASUREMENT Inverters_Action.Inverters_Action_ConstB.TorqueCommand0_g.ShiftArithmetic "" UWORD Inverters_Action_CM_uint16 0 0 0.0 65535.0 ECU_ADDRESS 0x0 DISPLAY_IDENTIFIER Inverters_Action.Subsystem9.Torque_Command_0.Subsystem.Shift_Arithmetic.ShiftArithmetic /end MEASUREMENT
/begin MEASUREMENT Inverters_Action.Inverters_Action_ConstB.TorqueCommand0_g.b7tob0 "" UWORD Inverters_Action_CM_uint16 0 0 0.0 65535.0 ECU_ADDRESS 0x0 DISPLAY_IDENTIFIER Inverters_Action.Subsystem9.Torque_Command_0.Subsystem.Bitwise_Operator.b7_to_b0 /end MEASUREMENT
/begin MEASUREMENT Inverters_Action.Inverters_Action_ConstB.TorqueCommand_m.Divide "" FLOAT64_IEEE Inverters_Action_CM_double 0 0 -1.7e+308 1.7e+308 ECU_ADDRESS 0x0 DISPLAY_IDENTIFIER Inverters_Action.Subsystem9.Torque_Command.Divide.Divide /end MEASUREMENT
/begin MEASUREMENT Inverters_Action.Inverters_Action_DW.EnumerationCounter "" FLOAT64_IEEE Inverters_Action_CM_double 0 0 -1.7e+308 1.7e+308 ECU_ADDRESS 0x0 DISPLAY_IDENTIFIER Inverters_Action.Subsystem10.Data_Store_Memory2.EnumerationCounter /end MEASUREMENT
/begin MEASUREMENT Inverters_Action.Inverters_Action_DW.EnumerationCounter_m "" FLOAT64_IEEE Inverters_Action_CM_double 0 0 -1.7e+308 1.7e+308 ECU_ADDRESS 0x0 DISPLAY_IDENTIFIER Inverters_Action.Subsystem9.Data_Store_Memory2.EnumerationCounter_m /end MEASUREMENT
/begin MEASUREMENT Inverters_Action.Inverters_Action_DW.LastAction "" FLOAT64_IEEE Inverters_Action_CM_double 0 0 -1.7e+308 1.7e+308 ECU_ADDRESS 0x0 DISPLAY_IDENTIFIER Inverters_Action.Subsystem10.Data_Store_Memory1.LastAction /end MEASUREMENT
/begin MEASUREMENT Inverters_Action.Inverters_Action_DW.LastAction_k "" FLOAT64_IEEE Inverters_Action_CM_double 0 0 -1.7e+308 1.7e+308 ECU_ADDRESS 0x0 DISPLAY_IDENTIFIER Inverters_Action.Subsystem9.Data_Store_Memory1.LastAction_k /end MEASUREMENT
/begin MEASUREMENT Inverters_Action.Inverters_Action_U.InvertersAction "" FLOAT64_IEEE Inverters_Action_CM_double 0 0 -1.7e+308 1.7e+308 ECU_ADDRESS 0x0 DISPLAY_IDENTIFIER Inverters_Action.InvertersAction /end MEASUREMENT
/begin MEASUREMENT Inverters_Action.Inverters_Action_U.current_L "" FLOAT64_IEEE Inverters_Action_CM_double 0 0 -1.7e+308 1.7e+308 ECU_ADDRESS 0x0 DISPLAY_IDENTIFIER Inverters_Action.current_L /end MEASUREMENT
/begin MEASUREMENT Inverters_Action.Inverters_Action_U.current_R "" FLOAT64_IEEE Inverters_Action_CM_double 0 0 -1.7e+308 1.7e+308 ECU_ADDRESS 0x0 DISPLAY_IDENTIFIER Inverters_Action.current_R /end MEASUREMENT
/begin MEASUREMENT Inverters_Action.Inverters_Action_Y.Inverter_L_RegID "" UBYTE Inverters_Action_CM_uint8 0 0 0.0 255.0 ECU_ADDRESS 0x0 DISPLAY_IDENTIFIER Inverters_Action.Inverter_L_RegID /end MEASUREMENT
/begin MEASUREMENT Inverters_Action.Inverters_Action_Y.Inverter_L_b15tob8 "" UBYTE Inverters_Action_CM_uint8 0 0 0.0 255.0 ECU_ADDRESS 0x0 DISPLAY_IDENTIFIER Inverters_Action.Inverter_L_b15tob8 /end MEASUREMENT
/begin MEASUREMENT Inverters_Action.Inverters_Action_Y.Inverter_L_b7tob0 "" UBYTE Inverters_Action_CM_uint8 0 0 0.0 255.0 ECU_ADDRESS 0x0 DISPLAY_IDENTIFIER Inverters_Action.Inverter_L_b7tob0 /end MEASUREMENT
/begin MEASUREMENT Inverters_Action.Inverters_Action_Y.Inverter_R_RegID "" UBYTE Inverters_Action_CM_uint8 0 0 0.0 255.0 ECU_ADDRESS 0x0 DISPLAY_IDENTIFIER Inverters_Action.Inverter_R_RegID /end MEASUREMENT
/begin MEASUREMENT Inverters_Action.Inverters_Action_Y.Inverter_R_b15tob8 "" UBYTE Inverters_Action_CM_uint8 0 0 0.0 255.0 ECU_ADDRESS 0x0 DISPLAY_IDENTIFIER Inverters_Action.Inverter_R_b15tob8 /end MEASUREMENT
/begin MEASUREMENT Inverters_Action.Inverters_Action_Y.Inverter_R_b7tob0 "" UBYTE Inverters_Action_CM_uint8 0 0 0.0 255.0 ECU_ADDRESS 0x0 DISPLAY_IDENTIFIER Inverters_Action.Inverter_R_b7tob0 /end MEASUREMENT
/begin MEASUREMENT Inverters_Action.Inverters_Action_Y.InvertersSubscribed "" UBYTE Inverters_Action_CM_boolean 0 0 0 1 ECU_ADDRESS 0x0 DISPLAY_IDENTIFIER Inverters_Action.InvertersSubscribed /end MEASUREMENT
/begin MEASUREMENT Inverters_Data.Inverters_Data_U.Inv_L_RegID_M235_Inv_L_DCBus "" FLOAT64_IEEE Inverters_Data_CM_double 0 0 -1.7e+308 1.7e+308 ECU_ADDRESS 0x0 DISPLAY_IDENTIFIER Inverters_Data.Inv_L_RegID_M235_Inv_L_DCBus /end MEASUREMENT
/begin MEASUREMENT Inverters_Data.Inverters_Data_U.Inv_L_RegID_M32_Inv_L_Iactual "" FLOAT64_IEEE Inverters_Data_CM_double 0 0 -1.7e+308 1.7e+308 ECU_ADDRESS 0x0 DISPLAY_IDENTIFIER Inverters_Data.Inv_L_RegID_M32_Inv_L_Iactual /end MEASUREMENT
/begin MEASUREMENT Inverters_Data.Inverters_Data_U.Inv_L_RegID_M38_Inv_L_Icommand "" FLOAT64_IEEE Inverters_Data_CM_double 0 0 -1.7e+308 1.7e+308 ECU_ADDRESS 0x0 DISPLAY_IDENTIFIER Inverters_Data.Inv_L_RegID_M38_Inv_L_Icommand /end MEASUREMENT
/begin MEASUREMENT Inverters_Data.Inverters_Data_U.Inv_L_RegID_M39_Inv_L_Iq "" FLOAT64_IEEE Inverters_Data_CM_double 0 0 -1.7e+308 1.7e+308 ECU_ADDRESS 0x0 DISPLAY_IDENTIFIER Inverters_Data.Inv_L_RegID_M39_Inv_L_Iq /end MEASUREMENT
/begin MEASUREMENT Inverters_Data.Inverters_Data_U.Inv_L_RegID_M48_Inv_L_Speed "" FLOAT64_IEEE Inverters_Data_CM_double 0 0 -1.7e+308 1.7e+308 ECU_ADDRESS 0x0 DISPLAY_IDENTIFIER Inverters_Data.Inv_L_RegID_M48_Inv_L_Speed /end MEASUREMENT
/begin MEASUREMENT Inverters_Data.Inverters_Data_U.Inv_L_RegID_M73_Inv_L_TempMotor "" FLOAT64_IEEE Inverters_Data_CM_double 0 0 -1.7e+308 1.7e+308 ECU_ADDRESS 0x0 DISPLAY_IDENTIFIER Inverters_Data.Inv_L_RegID_M73_Inv_L_TempMotor /end MEASUREMENT
/begin MEASUREMENT Inverters_Data.Inverters_Data_U.Inv_L_RegID_M74_Inv_L_TempIGBT "" FLOAT64_IEEE Inverters_Data_CM_double 0 0 -1.7e+308 1.7e+308 ECU_ADDRESS 0x0 DISPLAY_IDENTIFIER Inverters_Data.Inv_L_RegID_M74_Inv_L_TempIGBT /end MEASUREMENT
/begin MEASUREMENT Inverters_Data.Inverters_Data_U.Inv_R_RegID_M235_Inv_R_DCBus "" FLOAT64_IEEE Inverters_Data_CM_double 0 0 -1.7e+308 1.7e+308 ECU_ADDRESS 0x0 DISPLAY_IDENTIFIER Inverters_Data.Inv_R_RegID_M235_Inv_R_DCBus /end MEASUREMENT
/begin MEASUREMENT Inverters_Data.Inverters_Data_U.Inv_R_RegID_M32_Inv_R_Iactual "" FLOAT64_IEEE Inverters_Data_CM_double 0 0 -1.7e+308 1.7e+308 ECU_ADDRESS 0x0 DISPLAY_IDENTIFIER Inverters_Data.Inv_R_RegID_M32_Inv_R_Iactual /end MEASUREMENT
/begin MEASUREMENT Inverters_Data.Inverters_Data_U.Inv_R_RegID_M38_Inv_R_Icommand "" FLOAT64_IEEE Inverters_Data_CM_double 0 0 -1.7e+308 1.7e+308 ECU_ADDRESS 0x0 DISPLAY_IDENTIFIER Inverters_Data.Inv_R_RegID_M38_Inv_R_Icommand /end MEASUREMENT
/begin MEASUREMENT Inverters_Data.Inverters_Data_U.Inv_R_RegID_M39_Inv_R_Iq "" FLOAT64_IEEE Inverters_Data_CM_double 0 0 -1.7e+308 1.7e+308 ECU_ADDRESS 0x0 DISPLAY_IDENTIFIER Inverters_Data.Inv_R_RegID_M39_Inv_R_Iq /end MEASUREMENT
/begin MEASUREMENT Inverters_Data.Inverters_Data_U.Inv_R_RegID_M48_Inv_R_Speed "" FLOAT64_IEEE Inverters_Data_CM_double 0 0 -1.7e+308 1.7e+308 ECU_ADDRESS 0x0 DISPLAY_IDENTIFIER Inverters_Data.Inv_R_RegID_M48_Inv_R_Speed /end MEASUREMENT
/begin MEASUREMENT Inverters_Data.Inverters_Data_U.Inv_R_RegID_M73_Inv_R_TempMotor "" FLOAT64_IEEE Inverters_Data_CM_double 0 0 -1.7e+308 1.7e+308 ECU_ADDRESS 0x0 DISPLAY_IDENTIFIER Inverters_Data.Inv_R_RegID_M73_Inv_R_TempMotor /end MEASUREMENT
/begin MEASUREMENT Inverters_Data.Inverters_Data_U.Inv_R_RegID_M74_Inv_R_TempIGBT "" FLOAT64_IEEE Inverters_Data_CM_double 0 0 -1.7e+308 1.7e+308 ECU_ADDRESS 0x0 DISPLAY_IDENTIFIER Inverters_Data.Inv_R_RegID_M74_Inv_R_TempIGBT /end MEASUREMENT
/begin MEASUREMENT Inverters_Data.Inverters_Data_Y.Inv_L_Iactual "" FLOAT64_IEEE Inverters_Data_CM_double 0 0 -1.7e+308 1.7e+308 ECU_ADDRESS 0x0 DISPLAY_IDENTIFIER Inverters_Data.Inv_L_Iactual /end MEASUREMENT
/begin MEASUREMENT Inverters_Data.Inverters_Data_Y.Inv_L_Icommand "" FLOAT64_IEEE Inverters_Data_CM_double 0 0 -1.7e+308 1.7e+308 ECU_ADDRESS 0x0 DISPLAY_IDENTIFIER Inverters_Data.Inv_L_Icommand /end MEASUREMENT
/begin MEASUREMENT Inverters_Data.Inverters_Data_Y.Inv_L_Iq "" FLOAT64_IEEE Inverters_Data_CM_double 0 0 -1.7e+308 1.7e+308 ECU_ADDRESS 0x0 DISPLAY_IDENTIFIER Inverters_Data.Inv_L_Iq /end MEASUREMENT
/begin MEASUREMENT Inverters_Data.Inverters_Data_Y.Inv_L_TempIGBT "" FLOAT64_IEEE Inverters_Data_CM_double 0 0 -1.7e+308 1.7e+308 ECU_ADDRESS 0x0 DISPLAY_IDENTIFIER Inverters_Data.Inv_L_TempIGBT /end MEASUREMENT
/begin MEASUREMENT Inverters_Data.Inverters_Data_Y.Inv_L_TempMotor "" FLOAT64_IEEE Inverters_Data_CM_double 0 0 -1.7e+308 1.7e+308 ECU_ADDRESS 0x0 DISPLAY_IDENTIFIER Inverters_Data.Inv_L_TempMotor /end MEASUREMENT
/begin MEASUREMENT Inverters_Data.Inverters_Data_Y.Inv_L_VdcBus "" FLOAT64_IEEE Inverters_Data_CM_double 0 0 -1.7e+308 1.7e+308 ECU_ADDRESS 0x0 DISPLAY_IDENTIFIER Inverters_Data.Inv_L_VdcBus /end MEASUREMENT
/begin MEASUREMENT Inverters_Data.Inverters_Data_Y.Inv_R_Iactual "" FLOAT64_IEEE Inverters_Data_CM_double 0 0 -1.7e+308 1.7e+308 ECU_ADDRESS 0x0 DISPLAY_IDENTIFIER Inverters_Data.Inv_R_Iactual /end MEASUREMENT
/begin MEASUREMENT Inverters_Data.Inverters_Data_Y.Inv_R_Icommand "" FLOAT64_IEEE Inverters_Data_CM_double 0 0 -1.7e+308 1.7e+308 ECU_ADDRESS 0x0 DISPLAY_IDENTIFIER Inverters_Data.Inv_R_Icommand /end MEASUREMENT
/begin MEASUREMENT Inverters_Data.Inverters_Data_Y.Inv_R_Iq "" FLOAT64_IEEE Inverters_Data_CM_double 0 0 -1.7e+308 1.7e+308 ECU_ADDRESS 0x0 DISPLAY_IDENTIFIER Inverters_Data.Inv_R_Iq /end MEASUREMENT
/begin MEASUREMENT Inverters_Data.Inverters_Data_Y.Inv_R_TempIGBT "" FLOAT64_IEEE Inverters_Data_CM_double 0 0 -1.7e+308 1.7e+308 ECU_ADDRESS 0x0 DISPLAY_IDENTIFIER Inverters_Data.Inv_R_TempIGBT /end MEASUREMENT
/begin MEASUREMENT Inverters_Data.Inverters_Data_Y.Inv_R_TempMotor "" FLOAT64_IEEE Inverters_Data_CM_double 0 0 -1.7e+308 1.7e+308 ECU_ADDRESS 0x0 DISPLAY_IDENTIFIER Inverters_Data.Inv_R_TempMotor /end MEASUREMENT
/begin MEASUREMENT Inverters_Data.Inverters_Data_Y.Inv_R_VdcBus "" FLOAT64_IEEE Inverters_Data_CM_double 0 0 -1.7e+308 1.7e+308 ECU_ADDRESS 0x0 DISPLAY_IDENTIFIER Inverters_Data.Inv_R_VdcBus /end MEASUREMENT
/begin MEASUREMENT Inverters_Data.Inverters_Data_Y.InvertersMinDCBus "" FLOAT64_IEEE Inverters_Data_CM_double 0 0 -1.7e+308 1.7e+308 ECU_ADDRESS 0x0 DISPLAY_IDENTIFIER Inverters_Data.InvertersMinDCBus /end MEASUREMENT
/begin MEASUREMENT Inverters_Data.Inverters_Data_Y.RL_Vel_ms_Wheel "" FLOAT64_IEEE Inverters_Data_CM_double 0 0 -1.7e+308 1.7e+308 ECU_ADDRESS 0x0 DISPLAY_IDENTIFIER Inverters_Data.RL_Vel_ms_Wheel /end MEASUREMENT
/begin MEASUREMENT Inverters_Data.Inverters_Data_Y.RL_rads_Motor "" FLOAT64_IEEE Inverters_Data_CM_double 0 0 -1.7e+308 1.7e+308 ECU_ADDRESS 0x0 DISPLAY_IDENTIFIER Inverters_Data.RL_rads_Motor /end MEASUREMENT
/begin MEASUREMENT Inverters_Data.Inverters_Data_Y.RR_Vel_ms_Wheel "" FLOAT64_IEEE Inverters_Data_CM_double 0 0 -1.7e+308 1.7e+308 ECU_ADDRESS 0x0 DISPLAY_IDENTIFIER Inverters_Data.RR_Vel_ms_Wheel /end MEASUREMENT
/begin MEASUREMENT Inverters_Data.Inverters_Data_Y.RR_rads_Motor "" FLOAT64_IEEE Inverters_Data_CM_double 0 0 -1.7e+308 1.7e+308 ECU_ADDRESS 0x0 DISPLAY_IDENTIFIER Inverters_Data.RR_rads_Motor /end MEASUREMENT
/begin MEASUREMENT Inverters_Data.Inverters_Data_Y.Speed "" FLOAT64_IEEE Inverters_Data_CM_double 0 0 -1.7e+308 1.7e+308 ECU_ADDRESS 0x0 DISPLAY_IDENTIFIER Inverters_Data.Speed /end MEASUREMENT
/begin MEASUREMENT Inverters_Data.Inverters_Data_Y.Temp_IGBT "" FLOAT64_IEEE Inverters_Data_CM_double 0 0 -1.7e+308 1.7e+308 ECU_ADDRESS 0x0 DISPLAY_IDENTIFIER Inverters_Data.Temp_IGBT /end MEASUREMENT
/begin MEASUREMENT Inverters_Data.Inverters_Data_Y.Temp_Motors "" FLOAT64_IEEE Inverters_Data_CM_double 0 0 -1.7e+308 1.7e+308 ECU_ADDRESS 0x0 DISPLAY_IDENTIFIER Inverters_Data.Temp_Motors /end MEASUREMENT
/begin MEASUREMENT Inverters_Data.Inverters_Data_Y.Wheel_RL_Speed "" FLOAT64_IEEE Inverters_Data_CM_double 0 0 -1.7e+308 1.7e+308 ECU_ADDRESS 0x0 DISPLAY_IDENTIFIER Inverters_Data.Wheel_RL_Speed /end MEASUREMENT
/begin MEASUREMENT Inverters_Data.Inverters_Data_Y.Wheel_RR_Speed "" FLOAT64_IEEE Inverters_Data_CM_double 0 0 -1.7e+308 1.7e+308 ECU_ADDRESS 0x0 DISPLAY_IDENTIFIER Inverters_Data.Wheel_RR_Speed /end MEASUREMENT
/begin MEASUREMENT Sensors.Sensors_ConstB.Subtract "" FLOAT64_IEEE Sensors_CM_double 0 0 -1.7e+308 1.7e+308 ECU_ADDRESS 0x0 DISPLAY_IDENTIFIER Sensors.Suspension_FL_Data_Conv.Subtract.Subtract /end MEASUREMENT
/begin MEASUREMENT Sensors.Sensors_ConstB.Subtract_e "" FLOAT64_IEEE Sensors_CM_double 0 0 -1.7e+308 1.7e+308 ECU_ADDRESS 0x0 DISPLAY_IDENTIFIER Sensors.Suspension_RL_Data_Conv.Subtract.Subtract_e /end MEASUREMENT
/begin MEASUREMENT Sensors.Sensors_ConstB.Subtract_ev "" FLOAT64_IEEE Sensors_CM_double 0 0 -1.7e+308 1.7e+308 ECU_ADDRESS 0x0 DISPLAY_IDENTIFIER Sensors.Suspension_RR_Data_Conv.Subtract.Subtract_ev /end MEASUREMENT
/begin MEASUREMENT Sensors.Sensors_ConstB.Subtract_k "" FLOAT64_IEEE Sensors_CM_double 0 0 -1.7e+308 1.7e+308 ECU_ADDRESS 0x0 DISPLAY_IDENTIFIER Sensors.Suspension_FR_Data_Conv.Subtract.Subtract_k /end MEASUREMENT
/begin MEASUREMENT Sensors.Sensors_ConstB.Subtract_p "" FLOAT64_IEEE Sensors_CM_double 0 0 -1.7e+308 1.7e+308 ECU_ADDRESS 0x0 DISPLAY_IDENTIFIER Sensors.Steering_Data_Conv.Low_Pass.Subtract.Subtract_p /end MEASUREMENT
/begin MEASUREMENT Sensors.Sensors_ConstB.Sum1 "" FLOAT64_IEEE Sensors_CM_double 0 0 -1.7e+308 1.7e+308 ECU_ADDRESS 0x0 DISPLAY_IDENTIFIER Sensors.BRS_Data_Conv.Sum1.Sum1 /end MEASUREMENT
/begin MEASUREMENT Sensors.Sensors_ConstB.Sum1_f "" FLOAT64_IEEE Sensors_CM_double 0 0 -1.7e+308 1.7e+308 ECU_ADDRESS 0x0 DISPLAY_IDENTIFIER Sensors.APPS2_Data_Conv.Sum1.Sum1_f /end MEASUREMENT
/begin MEASUREMENT Sensors.Sensors_ConstB.Sum1_p "" FLOAT64_IEEE Sensors_CM_double 0 0 -1.7e+308 1.7e+308 ECU_ADDRESS 0x0 DISPLAY_IDENTIFIER Sensors.APPS1_Data_Conv.Sum1.Sum1_p /end MEASUREMENT
/begin MEASUREMENT Sensors.Sensors_DW.Previous_IN "" FLOAT64_IEEE Sensors_CM_double 0 0 -1.7e+308 1.7e+308 ECU_ADDRESS 0x0 DISPLAY_IDENTIFIER Sensors.Steering_Data_Conv.Low_Pass.Data_Store_Memory.Previous_IN /end MEASUREMENT
/begin MEASUREMENT Sensors.Sensors_DW.Previous_OUT "" FLOAT64_IEEE Sensors_CM_double 0 0 -1.7e+308 1.7e+308 ECU_ADDRESS 0x0 DISPLAY_IDENTIFIER Sensors.Steering_Data_Conv.Low_Pass.Data_Store_Memory1.Previous_OUT /end MEASUREMENT
/begin MEASUREMENT Sensors.Sensors_U.APPS1_Bits "" FLOAT64_IEEE Sensors_CM_double 0 0 -1.7e+308 1.7e+308 ECU_ADDRESS 0x0 DISPLAY_IDENTIFIER Sensors.APPS1_Bits /end MEASUREMENT
/begin MEASUREMENT Sensors.Sensors_U.APPS2_Bits "" FLOAT64_IEEE Sensors_CM_double 0 0 -1.7e+308 1.7e+308 ECU_ADDRESS 0x0 DISPLAY_IDENTIFIER Sensors.APPS2_Bits /end MEASUREMENT
/begin MEASUREMENT Sensors.Sensors_U.BrakeSensor_Bits "" FLOAT64_IEEE Sensors_CM_double 0 0 -1.7e+308 1.7e+308 ECU_ADDRESS 0x0 DISPLAY_IDENTIFIER Sensors.BrakeSensor_Bits /end MEASUREMENT
/begin MEASUREMENT Sensors.Sensors_U.SteeringSensor_Bits "" FLOAT64_IEEE Sensors_CM_double 0 0 -1.7e+308 1.7e+308 ECU_ADDRESS 0x0 DISPLAY_IDENTIFIER Sensors.SteeringSensor_Bits /end MEASUREMENT
/begin MEASUREMENT Sensors.Sensors_U.Susp_F_L_Bits "" FLOAT64_IEEE Sensors_CM_double 0 0 -1.7e+308 1.7e+308 ECU_ADDRESS 0x0 DISPLAY_IDENTIFIER Sensors.Susp_F_L_Bits /end MEASUREMENT
/begin MEASUREMENT Sensors.Sensors_U.Susp_F_R_Bits "" FLOAT64_IEEE Sensors_CM_double 0 0 -1.7e+308 1.7e+308 ECU_ADDRESS 0x0 DISPLAY_IDENTIFIER Sensors.Susp_F_R_Bits /end MEASUREMENT
/begin MEASUREMENT Sensors.Sensors_U.Susp_R_L_Bits "" FLOAT64_IEEE Sensors_CM_double 0 0 -1.7e+308 1.7e+308 ECU_ADDRESS 0x0 DISPLAY_IDENTIFIER Sensors.Susp_R_L_Bits /end MEASUREMENT
/begin MEASUREMENT Sensors.Sensors_U.Susp_R_R_Bits "" FLOAT64_IEEE Sensors_CM_double 0 0 -1.7e+308 1.7e+308 ECU_ADDRESS 0x0 DISPLAY_IDENTIFIER Sensors.Susp_R_R_Bits /end MEASUREMENT
/begin MEASUREMENT Sensors.Sensors_Y.APPS1_Value "" FLOAT64_IEEE Sensors_CM_double 0 0 -1.7e+308 1.7e+308 ECU_ADDRESS 0x0 DISPLAY_IDENTIFIER Sensors.APPS1_Value /end MEASUREMENT
/begin MEASUREMENT Sensors.Sensors_Y.APPS2_Value "" FLOAT64_IEEE Sensors_CM_double 0 0 -1.7e+308 1.7e+308 ECU_ADDRESS 0x0 DISPLAY_IDENTIFIER Sensors.APPS2_Value /end MEASUREMENT
/begin MEASUREMENT Sensors.Sensors_Y.BrakeLight_Control "" FLOAT64_IEEE Sensors_CM_double 0 0 -1.7e+308 1.7e+308 ECU_ADDRESS 0x0 DISPLAY_IDENTIFIER Sensors.BrakeLight_Control /end MEASUREMENT
/begin MEASUREMENT Sensors.Sensors_Y.BrakeSensor_Value "" FLOAT64_IEEE Sensors_CM_double 0 0 -1.7e+308 1.7e+308 ECU_ADDRESS 0x0 DISPLAY_IDENTIFIER Sensors.BrakeSensor_Value /end MEASUREMENT
/begin MEASUREMENT Sensors.Sensors_Y.SUSP_F_L "" FLOAT64_IEEE Sensors_CM_double 0 0 -1.7e+308 1.7e+308 ECU_ADDRESS 0x0 DISPLAY_IDENTIFIER Sensors.SUSP_F_L /end MEASUREMENT
/begin MEASUREMENT Sensors.Sensors_Y.SUSP_F_R "" FLOAT64_IEEE Sensors_CM_double 0 0 -1.7e+308 1.7e+308 ECU_ADDRESS 0x0 DISPLAY_IDENTIFIER Sensors.SUSP_F_R /end MEASUREMENT
/begin MEASUREMENT Sensors.Sensors_Y.SUSP_R_L "" FLOAT64_IEEE Sensors_CM_double 0 0 -1.7e+308 1.7e+308 ECU_ADDRESS 0x0 DISPLAY_IDENTIFIER Sensors.SUSP_R_L /end MEASUREMENT
/begin MEASUREMENT Sensors.Sensors_Y.SUSP_R_R "" FLOAT64_IEEE Sensors_CM_double 0 0 -1.7e+308 1.7e+308 ECU_ADDRESS 0x0 DISPLAY_IDENTIFIER Sensors.SUSP_R_R /end MEASUREMENT
/begin MEASUREMENT Sensors.Sensors_Y.SteeringSensor_Value "" FLOAT64_IEEE Sensors_CM_double 0 0 -1.7e+308 1.7e+308 ECU_ADDRESS 0x0 DISPLAY_IDENTIFIER Sensors.SteeringSensor_Value /end MEASUREMENT
/begin MEASUREMENT SoC.SoC_B.Memory "" FLOAT64_IEEE SoC_CM_double 0 0 -1.7e+308 1.7e+308 ECU_ADDRESS 0x0 DISPLAY_IDENTIFIER SoC.SoC_Lowest.Memory.Memory /end MEASUREMENT
/begin MEASUREMENT SoC.SoC_B.Memory_p "" FLOAT64_IEEE SoC_CM_double 0 0 -1.7e+308 1.7e+308 ECU_ADDRESS 0x0 DISPLAY_IDENTIFIER SoC.SoC_Highest.Memory.Memory_p /end MEASUREMENT
/begin MEASUREMENT SoC.SoC_B.NOT "" UBYTE SoC_CM_boolean 0 0 0 1 ECU_ADDRESS 0x0 DISPLAY_IDENTIFIER SoC.SoC_Lowest.NOT.NOT /end MEASUREMENT
/begin MEASUREMENT SoC.SoC_B.NOT_p "" UBYTE SoC_CM_boolean 0 0 0 1 ECU_ADDRESS 0x0 DISPLAY_IDENTIFIER SoC.SoC_Highest.NOT.NOT_p /end MEASUREMENT
/begin MEASUREMENT SoC.SoC_B.Switch "" FLOAT64_IEEE SoC_CM_double 0 0 -1.7e+308 1.7e+308 ECU_ADDRESS 0x0 DISPLAY_IDENTIFIER SoC.SoC_Lowest.Switch.Switch /end MEASUREMENT
/begin MEASUREMENT SoC.SoC_B.Switch_d "" FLOAT64_IEEE SoC_CM_double 0 0 -1.7e+308 1.7e+308 ECU_ADDRESS 0x0 DISPLAY_IDENTIFIER SoC.SoC_Highest.Switch.Switch_d /end MEASUREMENT
/begin MEASUREMENT SoC.SoC_U.Accumulator_Current "" FLOAT64_IEEE SoC_CM_double 0 0 -1.7e+308 1.7e+308 ECU_ADDRESS 0x0 DISPLAY_IDENTIFIER SoC.Accumulator_Current /end MEASUREMENT
/begin MEASUREMENT SoC.SoC_U.Car_State "" FLOAT64_IEEE SoC_CM_double 0 0 -1.7e+308 1.7e+308 ECU_ADDRESS 0x0 DISPLAY_IDENTIFIER SoC.Car_State /end MEASUREMENT
/begin MEASUREMENT SoC.SoC_U.Highest_CellVoltage "" FLOAT64_IEEE SoC_CM_double 0 0 -1.7e+308 1.7e+308 ECU_ADDRESS 0x0 DISPLAY_IDENTIFIER SoC.Highest_CellVoltage /end MEASUREMENT
/begin MEASUREMENT SoC.SoC_U.Lowest_CellVoltage "" FLOAT64_IEEE SoC_CM_double 0 0 -1.7e+308 1.7e+308 ECU_ADDRESS 0x0 DISPLAY_IDENTIFIER SoC.Lowest_CellVoltage /end MEASUREMENT
/begin MEASUREMENT SoC.SoC_Y.SoC_Avg "" FLOAT64_IEEE SoC_CM_double 0 0 -1.7e+308 1.7e+308 ECU_ADDRESS 0x0 DISPLAY_IDENTIFIER SoC.SoC_Avg /end MEASUREMENT
/begin MEASUREMENT SoC.SoC_Y.SoC_High "" FLOAT64_IEEE SoC_CM_double 0 0 -1.7e+308 1.7e+308 ECU_ADDRESS 0x0 DISPLAY_IDENTIFIER SoC.SoC_High /end MEASUREMENT
/begin MEASUREMENT SoC.SoC_Y.SoC_Low "" FLOAT64_IEEE SoC_CM_double 0 0 -1.7e+308 1.7e+308 ECU_ADDRESS 0x0 DISPLAY_IDENTIFIER SoC.SoC_Low /end MEASUREMENT
/begin MEASUREMENT Synchronism.Synchronism_DW.counter "" FLOAT64_IEEE Synchronism_CM_double 0 0 -1.7e+308 1.7e+308 ECU_ADDRESS 0x0 DISPLAY_IDENTIFIER Synchronism.Counter.Data_Store_Memory.counter /end MEASUREMENT
/begin MEASUREMENT Synchronism.Synchronism_Y.Sync_CAN1 "" FLOAT64_IEEE Synchronism_CM_double 0 0 -1.7e+308 1.7e+308 ECU_ADDRESS 0x0 DISPLAY_IDENTIFIER Synchronism.Sync_CAN1 /end MEASUREMENT
/begin MEASUREMENT Synchronism.Synchronism_Y.Sync_CAN2 "" FLOAT64_IEEE Synchronism_CM_double 0 0 -1.7e+308 1.7e+308 ECU_ADDRESS 0x0 DISPLAY_IDENTIFIER Synchronism.Sync_CAN2 /end MEASUREMENT
/begin MEASUREMENT racing_modes_R2022a.racing_modes_R2022a_B.Gain "" FLOAT64_IEEE racing_modes_R2022a_CM_double 0 0 -1.7e+308 1.7e+308 ECU_ADDRESS 0x0 DISPLAY_IDENTIFIER racing_modes_R2022a.Custom_Dash__11_.Max_tyre_slip.Gain.Gain /end MEASUREMENT
/begin MEASUREMENT racing_modes_R2022a.racing_modes_R2022a_B.Merge "" FLOAT64_IEEE racing_modes_R2022a_CM_double 0 0 -1.7e+308 1.7e+308 ECU_ADDRESS 0x0 DISPLAY_IDENTIFIER racing_modes_R2022a.Merge.Merge /end MEASUREMENT
/begin MEASUREMENT racing_modes_R2022a.racing_modes_R2022a_U.CustomMode_Data "" FLOAT64_IEEE racing_modes_R2022a_CM_double 0 0 -1.7e+308 1.7e+308 ECU_ADDRESS 0x0 DISPLAY_IDENTIFIER racing_modes_R2022a.CustomMode_Data /end MEASUREMENT
/begin MEASUREMENT racing_modes_R2022a.racing_modes_R2022a_U.CustomMode_Identifier "" FLOAT64_IEEE racing_modes_R2022a_CM_double 0 0 -1.7e+308 1.7e+308 ECU_ADDRESS 0x0 DISPLAY_IDENTIFIER racing_modes_R2022a.CustomMode_Identifier /end MEASUREMENT
/begin MEASUREMENT racing_modes_R2022a.racing_modes_R2022a_U.RacingMode "" UBYTE racing_modes_R2022a_CM_uint8 0 0 0.0 255.0 ECU_ADDRESS 0x0 DISPLAY_IDENTIFIER racing_modes_R2022a.RacingMode /end MEASUREMENT
/begin MEASUREMENT racing_modes_R2022a.racing_modes_R2022a_Y.VDC_Max_tire_slip "" FLOAT64_IEEE racing_modes_R2022a_CM_double 0 0 -1.7e+308 1.7e+308 ECU_ADDRESS 0x0 DISPLAY_IDENTIFIER racing_modes_R2022a.VDC_Max_tire_slip /end MEASUREMENT
/begin MEASUREMENT racing_modes_R2022a.racing_modes_R2022a_Y.Workshop_Mode_Enable "" UBYTE racing_modes_R2022a_CM_boolean 0 0 0 1 ECU_ADDRESS 0x0 DISPLAY_IDENTIFIER racing_modes_R2022a.Workshop_Mode_Enable /end MEASUREMENT
/begin MEASUREMENT vdc_r2022a.vdc_r2022a_B.Merge1 "" FLOAT64_IEEE vdc_r2022a_CM_double 0 0 -1.7e+308 1.7e+308 ECU_ADDRESS 0x0 DISPLAY_IDENTIFIER vdc_r2022a.Merge1.Merge1 /end MEASUREMENT
/begin MEASUREMENT vdc_r2022a.vdc_r2022a_B.Merge2 "" FLOAT64_IEEE vdc_r2022a_CM_double 0 0 -1.7e+308 1.7e+308 ECU_ADDRESS 0x0 DISPLAY_IDENTIFIER vdc_r2022a.Merge2.Merge2 /end MEASUREMENT
/begin MEASUREMENT vdc_r2022a.vdc_r2022a_B.Merge3 "" UBYTE vdc_r2022a_CM_boolean 0 0 0 1 ECU_ADDRESS 0x0 DISPLAY_IDENTIFIER vdc_r2022a.Merge3.Merge3 /end MEASUREMENT
/begin MEASUREMENT vdc_r2022a.vdc_r2022a_DW.A "" FLOAT64_IEEE vdc_r2022a_CM_double 0 0 -1.7e+308 1.7e+308 ECU_ADDRESS 0x0 DISPLAY_IDENTIFIER vdc_r2022a.Accumulator_Power.PowerLimitDetection.Data_Store_Memory10.A /end MEASUREMENT
/begin MEASUREMENT vdc_r2022a.vdc_r2022a_DW.ERROR_Counter "" FLOAT64_IEEE vdc_r2022a_CM_double 0 0 -1.7e+308 1.7e+308 ECU_ADDRESS 0x0 DISPLAY_IDENTIFIER vdc_r2022a.SAFETY_BLOCK.APPS_IMPLAUSIBILITY.Data_Store_Memory1.ERROR_Counter /end MEASUREMENT
/begin MEASUREMENT vdc_r2022a.vdc_r2022a_U.APPS1_Value "" FLOAT64_IEEE vdc_r2022a_CM_double 0 0 -1.7e+308 1.7e+308 ECU_ADDRESS 0x0 DISPLAY_IDENTIFIER vdc_r2022a.APPS1_Value /end MEASUREMENT
/begin MEASUREMENT vdc_r2022a.vdc_r2022a_U.APPS2_Value "" FLOAT64_IEEE vdc_r2022a_CM_double 0 0 -1.7e+308 1.7e+308 ECU_ADDRESS 0x0 DISPLAY_IDENTIFIER vdc_r2022a.APPS2_Value /end MEASUREMENT
/begin MEASUREMENT vdc_r2022a.vdc_r2022a_U.Accumulator_Current "" FLOAT64_IEEE vdc_r2022a_CM_double 0 0 -1.7e+308 1.7e+308 ECU_ADDRESS 0x0 DISPLAY_IDENTIFIER vdc_r2022a.Accumulator_Current /end MEASUREMENT
/begin MEASUREMENT vdc_r2022a.vdc_r2022a_U.Accumulator_Voltage "" FLOAT64_IEEE vdc_r2022a_CM_double 0 0 -1.7e+308 1.7e+308 ECU_ADDRESS 0x0 DISPLAY_IDENTIFIER vdc_r2022a.Accumulator_Voltage /end MEASUREMENT
/begin MEASUREMENT vdc_r2022a.vdc_r2022a_U.BrakeSensor_Value "" FLOAT64_IEEE vdc_r2022a_CM_double 0 0 -1.7e+308 1.7e+308 ECU_ADDRESS 0x0 DISPLAY_IDENTIFIER vdc_r2022a.BrakeSensor_Value /end MEASUREMENT
/begin MEASUREMENT vdc_r2022a.vdc_r2022a_U.Car_State "" FLOAT64_IEEE vdc_r2022a_CM_double 0 0 -1.7e+308 1.7e+308 ECU_ADDRESS 0x0 DISPLAY_IDENTIFIER vdc_r2022a.Car_State /end MEASUREMENT
/begin MEASUREMENT vdc_r2022a.vdc_r2022a_U.CriticalDisconnection "" UBYTE vdc_r2022a_CM_boolean 0 0 0 1 ECU_ADDRESS 0x0 DISPLAY_IDENTIFIER vdc_r2022a.CriticalDisconnection /end MEASUREMENT
/begin MEASUREMENT vdc_r2022a.vdc_r2022a_U.RL_Vel_ms_Wheel "" FLOAT64_IEEE vdc_r2022a_CM_double 0 0 -1.7e+308 1.7e+308 ECU_ADDRESS 0x0 DISPLAY_IDENTIFIER vdc_r2022a.RL_Vel_ms_Wheel /end MEASUREMENT
/begin MEASUREMENT vdc_r2022a.vdc_r2022a_U.RL_rads_Motor "" FLOAT64_IEEE vdc_r2022a_CM_double 0 0 -1.7e+308 1.7e+308 ECU_ADDRESS 0x0 DISPLAY_IDENTIFIER vdc_r2022a.RL_rads_Motor /end MEASUREMENT
/begin MEASUREMENT vdc_r2022a.vdc_r2022a_U.RR_Vel_ms_Wheel "" FLOAT64_IEEE vdc_r2022a_CM_double 0 0 -1.7e+308 1.7e+308 ECU_ADDRESS 0x0 DISPLAY_IDENTIFIER vdc_r2022a.RR_Vel_ms_Wheel /end MEASUREMENT
/begin MEASUREMENT vdc_r2022a.vdc_r2022a_U.RR_rads_Motor "" FLOAT64_IEEE vdc_r2022a_CM_double 0 0 -1.7e+308 1.7e+308 ECU_ADDRESS 0x0 DISPLAY_IDENTIFIER vdc_r2022a.RR_rads_Motor /end MEASUREMENT
/begin MEASUREMENT vdc_r2022a.vdc_r2022a_U.Shutdown_PackageIntck "" UBYTE vdc_r2022a_CM_boolean 0 0 0 1 ECU_ADDRESS 0x0 DISPLAY_IDENTIFIER vdc_r2022a.Shutdown_PackageIntck /end MEASUREMENT
/begin MEASUREMENT vdc_r2022a.vdc_r2022a_U.SteeringSensor_Value "" FLOAT64_IEEE vdc_r2022a_CM_double 0 0 -1.7e+308 1.7e+308 ECU_ADDRESS 0x0 DISPLAY_IDENTIFIER vdc_r2022a.SteeringSensor_Value /end MEASUREMENT
/begin MEASUREMENT vdc_r2022a.vdc_r2022a_U.Susp_F_L "" FLOAT64_IEEE vdc_r2022a_CM_double 0 0 -1.7e+308 1.7e+308 ECU_ADDRESS 0x0 DISPLAY_IDENTIFIER vdc_r2022a.Susp_F_L /end MEASUREMENT
/begin MEASUREMENT vdc_r2022a.vdc_r2022a_U.Susp_F_R "" FLOAT64_IEEE vdc_r2022a_CM_double 0 0 -1.7e+308 1.7e+308 ECU_ADDRESS 0x0 DISPLAY_IDENTIFIER vdc_r2022a.Susp_F_R /end MEASUREMENT
/begin MEASUREMENT vdc_r2022a.vdc_r2022a_U.Susp_R_L "" FLOAT64_IEEE vdc_r2022a_CM_double 0 0 -1.7e+308 1.7e+308 ECU_ADDRESS 0x0 DISPLAY_IDENTIFIER vdc_r2022a.Susp_R_L /end MEASUREMENT
/begin MEASUREMENT vdc_r2022a.vdc_r2022a_U.Susp_R_R "" FLOAT64_IEEE vdc_r2022a_CM_double 0 0 -1.7e+308 1.7e+308 ECU_ADDRESS 0x0 DISPLAY_IDENTIFIER vdc_r2022a.Susp_R_R /end MEASUREMENT
/begin MEASUREMENT vdc_r2022a.vdc_r2022a_U.TV_Mode "" FLOAT64_IEEE vdc_r2022a_CM_double 0 0 -1.7e+308 1.7e+308 ECU_ADDRESS 0x0 DISPLAY_IDENTIFIER vdc_r2022a.TV_Mode /end MEASUREMENT
/begin MEASUREMENT vdc_r2022a.vdc_r2022a_U.TorqueEnable "" UBYTE vdc_r2022a_CM_boolean 0 0 0 1 ECU_ADDRESS 0x0 DISPLAY_IDENTIFIER vdc_r2022a.TorqueEnable /end MEASUREMENT
/begin MEASUREMENT vdc_r2022a.vdc_r2022a_U.VDC_Max_tire_slip "" FLOAT64_IEEE vdc_r2022a_CM_double 0 0 -1.7e+308 1.7e+308 ECU_ADDRESS 0x0 DISPLAY_IDENTIFIER vdc_r2022a.VDC_Max_tire_slip /end MEASUREMENT
/begin MEASUREMENT vdc_r2022a.vdc_r2022a_U.Workshop_Mode_Enable "" FLOAT64_IEEE vdc_r2022a_CM_double 0 0 -1.7e+308 1.7e+308 ECU_ADDRESS 0x0 DISPLAY_IDENTIFIER vdc_r2022a.Workshop_Mode_Enable /end MEASUREMENT
/begin MEASUREMENT vdc_r2022a.vdc_r2022a_U.el_ACCEL_X "" FLOAT64_IEEE vdc_r2022a_CM_double 0 0 -1.7e+308 1.7e+308 ECU_ADDRESS 0x0 DISPLAY_IDENTIFIER vdc_r2022a.el_ACCEL_X /end MEASUREMENT
/begin MEASUREMENT vdc_r2022a.vdc_r2022a_U.el_ACCEL_Y "" FLOAT64_IEEE vdc_r2022a_CM_double 0 0 -1.7e+308 1.7e+308 ECU_ADDRESS 0x0 DISPLAY_IDENTIFIER vdc_r2022a.el_ACCEL_Y /end MEASUREMENT
/begin MEASUREMENT vdc_r2022a.vdc_r2022a_U.el_ACCEL_Z "" FLOAT64_IEEE vdc_r2022a_CM_double 0 0 -1.7e+308 1.7e+308 ECU_ADDRESS 0x0 DISPLAY_IDENTIFIER vdc_r2022a.el_ACCEL_Z /end MEASUREMENT
/begin MEASUREMENT vdc_r2022a.vdc_r2022a_U.el_GYRO_X "" FLOAT64_IEEE vdc_r2022a_CM_double 0 0 -1.7e+308 1.7e+308 ECU_ADDRESS 0x0 DISPLAY_IDENTIFIER vdc_r2022a.el_GYRO_X /end MEASUREMENT
/begin MEASUREMENT vdc_r2022a.vdc_r2022a_U.el_GYRO_Y "" FLOAT64_IEEE vdc_r2022a_CM_double 0 0 -1.7e+308 1.7e+308 ECU_ADDRESS 0x0 DISPLAY_IDENTIFIER vdc_r2022a.el_GYRO_Y /end MEASUREMENT
/begin MEASUREMENT vdc_r2022a.vdc_r2022a_U.el_GYRO_Z "" FLOAT64_IEEE vdc_r2022a_CM_double 0 0 -1.7e+308 1.7e+308 ECU_ADDRESS 0x0 DISPLAY_IDENTIFIER vdc_r2022a.el_GYRO_Z /end MEASUREMENT
/begin MEASUREMENT vdc_r2022a.vdc_r2022a_U.el_PITCH "" FLOAT64_IEEE vdc_r2022a_CM_double 0 0 -1.7e+308 1.7e+308 ECU_ADDRESS 0x0 DISPLAY_IDENTIFIER vdc_r2022a.el_PITCH /end MEASUREMENT
/begin MEASUREMENT vdc_r2022a.vdc_r2022a_U.el_ROLL "" FLOAT64_IEEE vdc_r2022a_CM_double 0 0 -1.7e+308 1.7e+308 ECU_ADDRESS 0x0 DISPLAY_IDENTIFIER vdc_r2022a.el_ROLL /end MEASUREMENT
/begin MEASUREMENT vdc_r2022a.vdc_r2022a_U.el_Vel_X "" FLOAT64_IEEE vdc_r2022a_CM_double 0 0 -1.7e+308 1.7e+308 ECU_ADDRESS 0x0 DISPLAY_IDENTIFIER vdc_r2022a.el_Vel_X /end MEASUREMENT
/begin MEASUREMENT vdc_r2022a.vdc_r2022a_U.el_Vel_Y "" FLOAT64_IEEE vdc_r2022a_CM_double 0 0 -1.7e+308 1.7e+308 ECU_ADDRESS 0x0 DISPLAY_IDENTIFIER vdc_r2022a.el_Vel_Y /end MEASUREMENT
/begin MEASUREMENT vdc_r2022a.vdc_r2022a_U.el_Vel_Z "" FLOAT64_IEEE vdc_r2022a_CM_double 0 0 -1.7e+308 1.7e+308 ECU_ADDRESS 0x0 DISPLAY_IDENTIFIER vdc_r2022a.el_Vel_Z /end MEASUREMENT
/begin MEASUREMENT vdc_r2022a.vdc_r2022a_U.el_YAW "" FLOAT64_IEEE vdc_r2022a_CM_double 0 0 -1.7e+308 1.7e+308 ECU_ADDRESS 0x0 DISPLAY_IDENTIFIER vdc_r2022a.el_YAW /end MEASUREMENT
/begin MEASUREMENT vdc_r2022a.vdc_r2022a_Y.APPS_Implausibility "" FLOAT64_IEEE vdc_r2022a_CM_double 0 0 -1.7e+308 1.7e+308 ECU_ADDRESS 0x0 DISPLAY_IDENTIFIER vdc_r2022a.APPS_Implausibility /end MEASUREMENT
/begin MEASUREMENT vdc_r2022a.vdc_r2022a_Y.Power "" FLOAT64_IEEE vdc_r2022a_CM_double 0 0 -1.7e+308 1.7e+308 ECU_ADDRESS 0x0 DISPLAY_IDENTIFIER vdc_r2022a.Power /end MEASUREMENT
/begin MEASUREMENT vdc_r2022a.vdc_r2022a_Y.PowerLimitReached "" FLOAT64_IEEE vdc_r2022a_CM_double 0 0 -1.7e+308 1.7e+308 ECU_ADDRESS 0x0 DISPLAY_IDENTIFIER vdc_r2022a.PowerLimitReached /end MEASUREMENT
/begin MEASUREMENT vdc_r2022a.vdc_r2022a_Y.PowerMean500ms "" FLOAT64_IEEE vdc_r2022a_CM_double 0 0 -1.7e+308 1.7e+308 ECU_ADDRESS 0x0 DISPLAY_IDENTIFIER vdc_r2022a.PowerMean500ms /end MEASUREMENT
/begin MEASUREMENT vdc_r2022a.vdc_r2022a_Y.TC_WARNING "" UBYTE vdc_r2022a_CM_boolean 0 0 0 1 ECU_ADDRESS 0x0 DISPLAY_IDENTIFIER vdc_r2022a.TC_WARNING /end MEASUREMENT
/begin MEASUREMENT vdc_r2022a.vdc_r2022a_Y.Torque_L_out "" FLOAT64_IEEE vdc_r2022a_CM_double 0 0 -1.7e+308 1.7e+308 ECU_ADDRESS 0x0 DISPLAY_IDENTIFIER vdc_r2022a.Torque_L_out /end MEASUREMENT
/begin MEASUREMENT vdc_r2022a.vdc_r2022a_Y.Torque_OK "" FLOAT64_IEEE vdc_r2022a_CM_double 0 0 -1.7e+308 1.7e+308 ECU_ADDRESS 0x0 DISPLAY_IDENTIFIER vdc_r2022a.Torque_OK /end MEASUREMENT
/begin MEASUREMENT vdc_r2022a.vdc_r2022a_Y.Torque_R_out "" FLOAT64_IEEE vdc_r2022a_CM_double 0 0 -1.7e+308 1.7e+308 ECU_ADDRESS 0x0 DISPLAY_IDENTIFIER vdc_r2022a.Torque_R_out /end MEASUREMENT
/begin COMPU_METHOD Car_State_CM_double "Q = V" RAT_FUNC "%9.6" "NO_PHYSICAL_QTY" COEFFS 0.0 1.0 0.0 0.0 0.0 1.0 /end COMPU_METHOD
/begin COMPU_METHOD Car_State_CM_boolean "Q = V" RAT_FUNC "%9.6" "NO_PHYSICAL_QTY" COEFFS 0.0 1.0 0.0 0.0 0.0 1.0 /end COMPU_METHOD
/begin COMPU_METHOD Disconnections_CM_double "Q = V" RAT_FUNC "%9.6" "NO_PHYSICAL_QTY" COEFFS 0.0 1.0 0.0 0.0 0.0 1.0 /end COMPU_METHOD
/begin COMPU_METHOD Disconnections_CM_boolean "Q = V" RAT_FUNC "%9.6" "NO_PHYSICAL_QTY" COEFFS 0.0 1.0 0.0 0.0 0.0 1.0 /end COMPU_METHOD
/begin COMPU_METHOD Disconnections_CM_uint8 "Q = V" RAT_FUNC "%9.6" "NO_PHYSICAL_QTY" COEFFS 0.0 1.0 0.0 0.0 0.0 1.0 /end COMPU_METHOD
/begin COMPU_METHOD Ellipse_CM_double "Q = V" RAT_FUNC "%9.6" "NO_PHYSICAL_QTY" COEFFS 0.0 1.0 0.0 0.0 0.0 1.0 /end COMPU_METHOD
/begin COMPU_METHOD Inverters_Action_CM_boolean "Q = V" RAT_FUNC "%9.6" "NO_PHYSICAL_QTY" COEFFS 0.0 1.0 0.0 0.0 0.0 1.0 /end COMPU_METHOD
/begin COMPU_METHOD Inverters_Action_CM_uint8 "Q = V" RAT_FUNC "%9.6" "NO_PHYSICAL_QTY" COEFFS 0.0 1.0 0.0 0.0 0.0 1.0 /end COMPU_METHOD
/begin COMPU_METHOD Inverters_Action_CM_double "Q = V" RAT_FUNC "%9.6" "NO_PHYSICAL_QTY" COEFFS 0.0 1.0 0.0 0.0 0.0 1.0 /end COMPU_METHOD
/begin COMPU_METHOD Inverters_Action_CM_uint16 "Q = V" RAT_FUNC "%9.6" "NO_PHYSICAL_QTY" COEFFS 0.0 1.0 0.0 0.0 0.0 1.0 /end COMPU_METHOD
/begin COMPU_METHOD Inverters_Data_CM_double "Q = V" RAT_FUNC "%9.6" "NO_PHYSICAL_QTY" COEFFS 0.0 1.0 0.0 0.0 0.0 1.0 /end COMPU_METHOD
/begin COMPU_METHOD Sensors_CM_double "Q = V" RAT_FUNC "%9.6" "NO_PHYSICAL_QTY" COEFFS 0.0 1.0 0.0 0.0 0.0 1.0 /end COMPU_METHOD
/begin COMPU_METHOD SoC_CM_double "Q = V" RAT_FUNC "%9.6" "NO_PHYSICAL_QTY" COEFFS 0.0 1.0 0.0 0.0 0.0 1.0 /end COMPU_METHOD
/begin COMPU_METHOD SoC_CM_boolean "Q = V" RAT_FUNC "%9.6" "NO_PHYSICAL_QTY" COEFFS 0.0 1.0 0.0 0.0 0.0 1.0 /end COMPU_METHOD
/begin COMPU_METHOD Synchronism_CM_double "Q = V" RAT_FUNC "%9.6" "NO_PHYSICAL_QTY" COEFFS 0.0 1.0 0.0 0.0 0.0 1.0 /end COMPU_METHOD
/begin COMPU_METHOD racing_modes_R2022a_CM_double "Q = V" RAT_FUNC "%9.6" "NO_PHYSICAL_QTY" COEFFS 0.0 1.0 0.0 0.0 0.0 1.0 /end COMPU_METHOD
/begin COMPU_METHOD racing_modes_R2022a_CM_uint8 "Q = V" RAT_FUNC "%9.6" "NO_PHYSICAL_QTY" COEFFS 0.0 1.0 0.0 0.0 0.0 1.0 /end COMPU_METHOD
/begin COMPU_METHOD racing_modes_R2022a_CM_boolean "Q = V" RAT_FUNC "%9.6" "NO_PHYSICAL_QTY" COEFFS 0.0 1.0 0.0 0.0 0.0 1.0 /end COMPU_METHOD
/begin COMPU_METHOD vdc_r2022a_CM_double "Q = V" RAT_FUNC "%9.6" "NO_PHYSICAL_QTY" COEFFS 0.0 1.0 0.0 0.0 0.0 1.0 /end COMPU_METHOD
/begin COMPU_METHOD vdc_r2022a_CM_boolean "Q = V" RAT_FUNC "%9.6" "NO_PHYSICAL_QTY" COEFFS 0.0 1.0 0.0 0.0 0.0 1.0 /end COMPU_METHOD
/begin GROUP Car_State "" ROOT
 /begin REF_MEASUREMENT Car_State.Car_State_B.Merge Car_State.Car_State_DW.A Car_State.Car_State_U.AIRs_State Car_State.Car_State_U.Accumulator_Voltage Car_State.Car_State_U.Critical_CAN_Disconnection Car_State.Car_State_U.EnableDrive_Order Car_State.Car_State_U.InvertersMinDCBus Car_State.Car_State_U.InvertersSubscribed Car_State.Car_State_U.PrechargeRequest Car_State.Car_State_U.Shutdown_PackageIntck Car_State.Car_State_U.Torque_LockON Car_State.Car_State_Y.AIRs_Request Car_State.Car_State_Y.Car_OK Car_State.Car_State_Y.Car_State_f Car_State.Car_State_Y.CurrentPathDisconnectionFlag Car_State.Car_State_Y.InvertersAction Car_State.Car_State_Y.PrechargeAssert Car_State.Car_State_Y.Precharge_Percentage Car_State.Car_State_Y.Precharge_Voltage Car_State.Car_State_Y.TorqueEnable Car_State.Car_State_Y.errors /end REF_MEASUREMENT
 /begin SUB_GROUP Car_State.Car_State_B Car_State.Car_State_DW Car_State.Car_State_U Car_State.Car_State_Y /end SUB_GROUP
/end GROUP
/begin GROUP Car_State.Car_State_B "" /begin REF_MEASUREMENT Car_State.Car_State_B.Merge /end REF_MEASUREMENT /end GROUP
/begin GROUP Car_State.Car_State_DW "" /begin REF_MEASUREMENT Car_State.Car_State_DW.A /end REF_MEASUREMENT /end GROUP
/begin GROUP Car_State.Car_State_U ""
 /begin REF_MEASUREMENT Car_State.Car_State_U.AIRs_State Car_State.Car_State_U.Accumulator_Voltage Car_State.Car_State_U.Critical_CAN_Disconnection Car_State.Car_State_U.EnableDrive_Order Car_State.Car_State_U.InvertersMinDCBus Car_State.Car_State_U.InvertersSubscribed Car_State.Car_State_U.PrechargeRequest Car_State.Car_State_U.Shutdown_PackageIntck Car_State.Car_State_U.Torque_LockON /end REF_MEASUREMENT
/end GROUP
/begin GROUP Car_State.Car_State_Y ""
 /begin REF_MEASUREMENT Car_State.Car_State_Y.AIRs_Request Car_State.Car_State_Y.Car_OK Car_State.Car_State_Y.Car_State_f Car_State.Car_State_Y.CurrentPathDisconnectionFlag Car_State.Car_State_Y.InvertersAction Car_State.Car_State_Y.PrechargeAssert Car_State.Car_State_Y.Precharge_Percentage Car_State.Car_State_Y.Precharge_Voltage Car_State.Car_State_Y.TorqueEnable Car_State.Car_State_Y.errors /end REF_MEASUREMENT
/end GROUP
/begin GROUP Disconnections "" ROOT
 /begin REF_MEASUREMENT Disconnections.Disconnections_B.Merge Disconnections.Disconnections_B.Merge_b Disconnections.Disconnections_B.Merge_d Disconnections.Disconnections_B.Merge_f Disconnections.Disconnections_B.Merge_h Disconnections.Disconnections_DW.A Disconnections.Disconnections_DW.Last_alive Disconnections.Disconnections_DW.Last_alive_a Disconnections.Disconnections_DW.Last_alive_c Disconnections.Disconnections_DW.Last_alive_c0 Disconnections.Disconnections_DW.Last_alive_g Disconnections.Disconnections_DW.Last_alive_gx Disconnections.Disconnections_DW.Last_alive_j Disconnections.Disconnections_DW.Last_alive_o Disconnections.Disconnections_DW.Tot_Errors Disconnections.Disconnections_DW.Tot_Errors_j Disconnections.Disconnections_DW.Tot_Errors_k Disconnections.Disconnections_U.APPS1_Bits Disconnections.Disconnections_U.APPS2_Bits Disconnections.Disconnections_U.BMS_Alive Disconnections.Disconnections_U.BrakeSensor_Bits Disconnections.Disconnections_U.Dash_Alive Disconnections.Disconnections_U.Ellipse_Alive Disconnections.Disconnections_U.Front_Alive Disconnections.Disconnections_U.Rear_Alive Disconnections.Disconnections_U.SteeringSensor_Bits Disconnections.Disconnections_U.Susp_F_L_Bits Disconnections.Disconnections_U.Susp_F_R_Bits Disconnections.Disconnections_U.Susp_R_L_Bits Disconnections.Disconnections_U.Susp_R_R_Bits Disconnections.Disconnections_Y.CounterOut Disconnections.Disconnections_Y.CriticalDisconnection Disconnections.Disconnections_Y.Critical_CAN_Disconnection Disconnections.Disconnections_Y.Critical_Signal_Disconnection Disconnections.Disconnections_Y.Disconnection_APPS1 Disconnections.Disconnections_Y.Disconnection_APPS2 Disconnections.Disconnections_Y.Disconnection_BMS Disconnections.Disconnections_Y.Disconnection_Brake_Sensor Disconnections.Disconnections_Y.Disconnection_DashBoard Disconnections.Disconnections_Y.Disconnection_Ellipse Disconnections.Disconnections_Y.Disconnection_Front Disconnections.Disconnections_Y.Disconnection_Rear Disconnections.Disconnections_Y.Disconnection_SteeringSensor Disconnections.Disconnections_Y.Disconnection_Susp_F_L Disconnections.Disconnections_Y.Disconnection_Susp_F_R Disconnections.Disconnections_Y.Disconnection_Susp_R_L Disconnections.Disconnections_Y.Disconnection_Susp_R_R Disconnections.Disconnections_Y.TV_mode /end REF_MEASUREMENT
 /begin SUB_GROUP Disconnections.Disconnections_B Disconnections.Disconnections_DW Disconnections.Disconnections_U Disconnections.Disconnections_Y /end SUB_GROUP
/end GROUP
/begin GROUP Disconnections.Disconnections_B ""
 /begin REF_MEASUREMENT Disconnections.Disconnections_B.Merge Disconnections.Disconnections_B.Merge_b Disconnections.Disconnections_B.Merge_d Disconnections.Disconnections_B.Merge_f Disconnections.Disconnections_B.Merge_h /end REF_MEASUREMENT
/end GROUP
/begin GROUP Disconnections.Disconnections_DW ""
 /begin REF_MEASUREMENT Disconnections.Disconnections_DW.A Disconnections.Disconnections_DW.Last_alive Disconnections.Disconnections_DW.Last_alive_a Disconnections.Disconnections_DW.Last_alive_c Disconnections.Disconnections_DW.Last_alive_c0 Disconnections.Disconnections_DW.Last_alive_g Disconnections.Disconnections_DW.Last_alive_gx Disconnections.Disconnections_DW.Last_alive_j Disconnections.Disconnections_DW.Last_alive_o Disconnections.Disconnections_DW.Tot_Errors Disconnections.Disconnections_DW.Tot_Errors_j Disconnections.Disconnections_DW.Tot_Errors_k /end REF_MEASUREMENT
/end GROUP
/begin GROUP Disconnections.Disconnections_U ""
 /begin REF_MEASUREMENT Disconnections.Disconnections_U.APPS1_Bits Disconnections.Disconnections_U.APPS2_Bits Disconnections.Disconnections_U.BMS_Alive Disconnections.Disconnections_U.BrakeSensor_Bits Disconnections.Disconnections_U.Dash_Alive Disconnections.Disconnections_U.Ellipse_Alive Disconnections.Disconnections_U.Front_Alive Disconnections.Disconnections_U.Rear_Alive Disconnections.Disconnections_U.SteeringSensor_Bits Disconnections.Disconnections_U.Susp_F_L_Bits Disconnections.Disconnections_U.Susp_F_R_Bits Disconnections.Disconnections_U.Susp_R_L_Bits Disconnections.Disconnections_U.Susp_R_R_Bits /end REF_MEASUREMENT
/end GROUP
/begin GROUP Disconnections.Disconnections_Y ""
 /begin REF_MEASUREMENT Disconnections.Disconnections_Y.CounterOut Disconnections.Disconnections_Y.CriticalDisconnection Disconnections.Disconnections_Y.Critical_CAN_Disconnection Disconnections.Disconnections_Y.Critical_Signal_Disconnection Disconnections.Disconnections_Y.Disconnection_APPS1 Disconnections.Disconnections_Y.Disconnection_APPS2 Disconnections.Disconnections_Y.Disconnection_BMS Disconnections.Disconnections_Y.Disconnection_Brake_Sensor Disconnections.Disconnections_Y.Disconnection_DashBoard Disconnections.Disconnections_Y.Disconnection_Ellipse Disconnections.Disconnections_Y.Disconnection_Front Disconnections.Disconnections_Y.Disconnection_Rear Disconnections.Disconnections_Y.Disconnection_SteeringSensor Disconnections.Disconnections_Y.Disconnection_Susp_F_L Disconnections.Disconnections_Y.Disconnection_Susp_F_R Disconnections.Disconnections_Y.Disconnection_Susp_R_L Disconnections.Disconnections_Y.Disconnection_Susp_R_R Disconnections.Disconnections_Y.TV_mode /end REF_MEASUREMENT
/end GROUP
/begin GROUP Ellipse "" ROOT
 /begin REF_MEASUREMENT Ellipse.Ellipse_U.el_AUTO_STATUS Ellipse.Ellipse_U.el_AngleTrack Ellipse.Ellipse_U.el_CLOCK Ellipse.Ellipse_U.el_CurvatureRadius Ellipse.Ellipse_U.el_GENERAL Ellipse.Ellipse_U.el_LATITUDE_EKF Ellipse.Ellipse_U.el_LONGITUDE_EKF Ellipse.Ellipse_U.el_SlipAngle Ellipse.Ellipse_Y.Clock_Tx Ellipse.Ellipse_Y.CurvRadius Ellipse.Ellipse_Y.General_Tx Ellipse.Ellipse_Y.Lat_EKF Ellipse.Ellipse_Y.Long_EKF Ellipse.Ellipse_Y.SlipAngle Ellipse.Ellipse_Y.Status_Auto Ellipse.Ellipse_Y.TrackAngle /end REF_MEASUREMENT
 /begin SUB_GROUP Ellipse.Ellipse_U Ellipse.Ellipse_Y /end SUB_GROUP
/end GROUP
/begin GROUP Ellipse.Ellipse_U ""
 /begin REF_MEASUREMENT Ellipse.Ellipse_U.el_AUTO_STATUS Ellipse.Ellipse_U.el_AngleTrack Ellipse.Ellipse_U.el_CLOCK Ellipse.Ellipse_U.el_CurvatureRadius Ellipse.Ellipse_U.el_GENERAL Ellipse.Ellipse_U.el_LATITUDE_EKF Ellipse.Ellipse_U.el_LONGITUDE_EKF Ellipse.Ellipse_U.el_SlipAngle /end REF_MEASUREMENT
/end GROUP
/begin GROUP Ellipse.Ellipse_Y ""
 /begin REF_MEASUREMENT Ellipse.Ellipse_Y.Clock_Tx Ellipse.Ellipse_Y.CurvRadius Ellipse.Ellipse_Y.General_Tx Ellipse.Ellipse_Y.Lat_EKF Ellipse.Ellipse_Y.Long_EKF Ellipse.Ellipse_Y.SlipAngle Ellipse.Ellipse_Y.Status_Auto Ellipse.Ellipse_Y.TrackAngle /end REF_MEASUREMENT
/end GROUP
/begin GROUP Inverters_Action "" ROOT
 /begin REF_MEASUREMENT Inverters_Action.Inverters_Action_B.Merge Inverters_Action.Inverters_Action_B.Merge2 Inverters_Action.Inverters_Action_B.Merge2_p Inverters_Action.Inverters_Action_B.subscribed Inverters_Action.Inverters_Action_B.subscribed_b Inverters_Action.Inverters_Action_ConstB.TorqueCommand.Divide Inverters_Action.Inverters_Action_ConstB.TorqueCommand0.BitwiseOperator1 Inverters_Action.Inverters_Action_ConstB.TorqueCommand0.Current0to65535 Inverters_Action.Inverters_Action_ConstB.TorqueCommand0.Divide Inverters_Action.Inverters_Action_ConstB.TorqueCommand0.ShiftArithmetic Inverters_Action.Inverters_Action_ConstB.TorqueCommand0.b7tob0 Inverters_Action.Inverters_Action_ConstB.TorqueCommand0_g.BitwiseOperator1 Inverters_Action.Inverters_Action_ConstB.TorqueCommand0_g.Current0to65535 Inverters_Action.Inverters_Action_ConstB.TorqueCommand0_g.Divide Inverters_Action.Inverters_Action_ConstB.TorqueCommand0_g.ShiftArithmetic Inverters_Action.Inverters_Action_ConstB.TorqueCommand0_g.b7tob0 Inverters_Action.Inverters_Action_ConstB.TorqueCommand_m.Divide Inverters_Action.Inverters_Action_DW.EnumerationCounter Inverters_Action.Inverters_Action_DW.EnumerationCounter_m Inverters_Action.Inverters_Action_DW.LastAction Inverters_Action.Inverters_Action_DW.LastAction_k Inverters_Action.Inverters_Action_U.InvertersAction Inverters_Action.Inverters_Action_U.current_L Inverters_Action.Inverters_Action_U.current_R Inverters_Action.Inverters_Action_Y.Inverter_L_RegID Inverters_Action.Inverters_Action_Y.Inverter_L_b15tob8 Inverters_Action.Inverters_Action_Y.Inverter_L_b7tob0 Inverters_Action.Inverters_Action_Y.Inverter_R_RegID Inverters_Action.Inverters_Action_Y.Inverter_R_b15tob8 Inverters_Action.Inverters_Action_Y.Inverter_R_b7tob0 Inverters_Action.Inverters_Action_Y.InvertersSubscribed /end REF_MEASUREMENT
 /begin SUB_GROUP Inverters_Action.Inverters_Action_B Inverters_Action.Inverters_Action_ConstB Inverters_Action.Inverters_Action_ConstB.TorqueCommand Inverters_Action.Inverters_Action_ConstB.TorqueCommand0 Inverters_Action.Inverters_Action_ConstB.TorqueCommand0_g Inverters_Action.Inverters_Action_ConstB.TorqueCommand_m Inverters_Action.Inverters_Action_DW Inverters_Action.Inverters_Action_U Inverters_Action.Inverters_Action_Y /end SUB_GROUP
/end GROUP
/begin GROUP Inverters_Action.Inverters_Action_B ""
 /begin REF_MEASUREMENT Inverters_Action.Inverters_Action_B.Merge Inverters_Action.Inverters_Action_B.Merge2 Inverters_Action.Inverters_Action_B.Merge2_p Inverters_Action.Inverters_Action_B.subscribed Inverters_Action.Inverters_Action_B.subscribed_b /end REF_MEASUREMENT
/end GROUP
/begin GROUP Inverters_Action.Inverters_Action_ConstB ""
 /begin REF_MEASUREMENT Inverters_Action.Inverters_Action_ConstB.TorqueCommand.Divide Inverters_Action.Inverters_Action_ConstB.TorqueCommand0.BitwiseOperator1 Inverters_Action.Inverters_Action_ConstB.TorqueCommand0.Current0to65535 Inverters_Action.Inverters_Action_ConstB.TorqueCommand0.Divide Inverters_Action.Inverters_Action_ConstB.TorqueCommand0.ShiftArithmetic Inverters_Action.Inverters_Action_ConstB.TorqueCommand0.b7tob0 Inverters_Action.Inverters_Action_ConstB.TorqueCommand0_g.BitwiseOperator1 Inverters_Action.Inverters_Action_ConstB.TorqueCommand0_g.Current0to65535 Inverters_Action.Inverters_Action_ConstB.TorqueCommand0_g.Divide Inverters_Action.Inverters_Action_ConstB.TorqueCommand0_g.ShiftArithmetic Inverters_Action.Inverters_Action_ConstB.TorqueCommand0_g.b7tob0 Inverters_Action.Inverters_Action_ConstB.TorqueCommand_m.Divide /end REF_MEASUREMENT
/end GROUP
/begin GROUP Inverters_Action.Inverters_Action_ConstB.TorqueCommand ""
 /begin REF_MEASUREMENT Inverters_Action.Inverters_Action_ConstB.TorqueCommand.Divide /end REF_MEASUREMENT
/end GROUP
/begin GROUP Inverters_Action.Inverters_Action_ConstB.TorqueCommand0 ""
 /begin REF_MEASUREMENT Inverters_Action.Inverters_Action_ConstB.TorqueCommand0.BitwiseOperator1 Inverters_Action.Inverters_Action_ConstB.TorqueCommand0.Current0to65535 Inverters_Action.Inverters_Action_ConstB.TorqueCommand0.Divide Inverters_Action.Inverters_Action_ConstB.TorqueCommand0.ShiftArithmetic Inverters_Action.Inverters_Action_ConstB.TorqueCommand0.b7tob0 /end REF_MEASUREMENT
/end GROUP
/begin GROUP Inverters_Action.Inverters_Action_ConstB.TorqueCommand0_g ""
 /begin REF_MEASUREMENT Inverters_Action.Inverters_Action_ConstB.TorqueCommand0_g.BitwiseOperator1 Inverters_Action.Inverters_Action_ConstB.TorqueCommand0_g.Current0to65535 Inverters_Action.Inverters_Action_ConstB.TorqueCommand0_g.Divide Inverters_Action.Inverters_Action_ConstB.TorqueCommand0_g.ShiftArithmetic Inverters_Action.Inverters_Action_ConstB.TorqueCommand0_g.b7tob0 /end REF_MEASUREMENT
/end GROUP
/begin GROUP Inverters_Action.Inverters_Action_ConstB.TorqueCommand_m ""
 /begin REF_MEASUREMENT Inverters_Action.Inverters_Action_ConstB.TorqueCommand_m.Divide /end REF_MEASUREMENT
/end GROUP
/begin GROUP Inverters_Action.Inverters_Action_DW ""
 /begin REF_MEASUREMENT Inverters_Action.Inverters_Action_DW.EnumerationCounter Inverters_Action.Inverters_Action_DW.EnumerationCounter_m Inverters_Action.Inverters_Action_DW.LastAction Inverters_Action.Inverters_Action_DW.LastAction_k /end REF_MEASUREMENT
/end GROUP
/begin GROUP Inverters_Action.Inverters_Action_U ""
 /begin REF_MEASUREMENT Inverters_Action.Inverters_Action_U.InvertersAction Inverters_Action.Inverters_Action_U.current_L Inverters_Action.Inverters_Action_U.current_R /end REF_MEASUREMENT
/end GROUP
/begin GROUP Inverters_Action.Inverters_Action_Y ""
 /begin REF_MEASUREMENT Inverters_Action.Inverters_Action_Y.Inverter_L_RegID Inverters_Action.Inverters_Action_Y.Inverter_L_b15tob8 Inverters_Action.Inverters_Action_Y.Inverter_L_b7tob0 Inverters_Action.Inverters_Action_Y.Inverter_R_RegID Inverters_Action.Inverters_Action_Y.Inverter_R_b15tob8 Inverters_Action.Inverters_Action_Y.Inverter_R_b7tob0 Inverters_Action.Inverters_Action_Y.InvertersSubscribed /end REF_MEASUREMENT
/end GROUP
/begin GROUP Inverters_Data "" ROOT
 /begin REF_MEASUREMENT Inverters_Data.Inverters_Data_U.Inv_L_RegID_M235_Inv_L_DCBus Inverters_Data.Inverters_Data_U.Inv_L_RegID_M32_Inv_L_Iactual Inverters_Data.Inverters_Data_U.Inv_L_RegID_M38_Inv_L_Icommand Inverters_Data.Inverters_Data_U.Inv_L_RegID_M39_Inv_L_Iq Inverters_Data.Inverters_Data_U.Inv_L_RegID_M48_Inv_L_Speed Inverters_Data.Inverters_Data_U.Inv_L_RegID_M73_Inv_L_TempMotor Inverters_Data.Inverters_Data_U.Inv_L_RegID_M74_Inv_L_TempIGBT Inverters_Data.Inverters_Data_U.Inv_R_RegID_M235_Inv_R_DCBus Inverters_Data.Inverters_Data_U.Inv_R_RegID_M32_Inv_R_Iactual Inverters_Data.Inverters_Data_U.Inv_R_RegID_M38_Inv_R_Icommand Inverters_Data.Inverters_Data_U.Inv_R_RegID_M39_Inv_R_Iq Inverters_Data.Inverters_Data_U.Inv_R_RegID_M48_Inv_R_Speed Inverters_Data.Inverters_Data_U.Inv_R_RegID_M73_Inv_R_TempMotor Inverters_Data.Inverters_Data_U.Inv_R_RegID_M74_Inv_R_TempIGBT Inverters_Data.Inverters_Data_Y.Inv_L_Iactual Inverters_Data.Inverters_Data_Y.Inv_L_Icommand Inverters_Data.Inverters_Data_Y.Inv_L_Iq Inverters_Data.Inverters_Data_Y.Inv_L_TempIGBT Inverters_Data.Inverters_Data_Y.Inv_L_TempMotor Inverters_Data.Inverters_Data_Y.Inv_L_VdcBus Inverters_Data.Inverters_Data_Y.Inv_R_Iactual Inverters_Data.Inverters_Data_Y.Inv_R_Icommand Inverters_Data.Inverters_Data_Y.Inv_R_Iq Inverters_Data.Inverters_Data_Y.Inv_R_TempIGBT Inverters_Data.Inverters_Data_Y.Inv_R_TempMotor Inverters_Data.Inverters_Data_Y.Inv_R_VdcBus Inverters_Data.Inverters_Data_Y.InvertersMinDCBus Inverters_Data.Inverters_Data_Y.RL_Vel_ms_Wheel Inverters_Data.Inverters_Data_Y.RL_rads_Motor Inverters_Data.Inverters_Data_Y.RR_Vel_ms_Wheel Inverters_Data.Inverters_Data_Y.RR_rads_Motor Inverters_Data.Inverters_Data_Y.Speed Inverters_Data.Inverters_Data_Y.Temp_IGBT Inverters_Data.Inverters_Data_Y.Temp_Motors Inverters_Data.Inverters_Data_Y.Wheel_RL_Speed Inverters_Data.Inverters_Data_Y.Wheel_RR_Speed /end REF_MEASUREMENT
 /begin SUB_GROUP Inverters_Data.Inverters_Data_U Inverters_Data.Inverters_Data_Y /end SUB_GROUP
/end GROUP
/begin GROUP Inverters_Data.Inverters_Data_U ""
 /begin REF_MEASUREMENT Inverters_Data.Inverters_Data_U.Inv_L_RegID_M235_Inv_L_DCBus Inverters_Data.Inverters_Data_U.Inv_L_RegID_M32_Inv_L_Iactual Inverters_Data.Inverters_Data_U.Inv_L_RegID_M38_Inv_L_Icommand Inverters_Data.Inverters_Data_U.Inv_L_RegID_M39_Inv_L_Iq Inverters_Data.Inverters_Data_U.Inv_L_RegID_M48_Inv_L_Speed Inverters_Data.Inverters_Data_U.Inv_L_RegID_M73_Inv_L_TempMotor Inverters_Data.Inverters_Data_U.Inv_L_RegID_M74_Inv_L_TempIGBT Inverters_Data.Inverters_Data_U.Inv_R_RegID_M235_Inv_R_DCBus Inverters_Data.Inverters_Data_U.Inv_R_RegID_M32_Inv_R_Iactual Inverters_Data.Inverters_Data_U.Inv_R_RegID_M38_Inv_R_Icommand Inverters_Data.Inverters_Data_U.Inv_R_RegID_M39_Inv_R_Iq Inverters_Data.Inverters_Data_U.Inv_R_RegID_M48_Inv_R_Speed Inverters_Data.Inverters_Data_U.Inv_R_RegID_M73_Inv_R_TempMotor Inverters_Data.Inverters_Data_U.Inv_R_RegID_M74_Inv_R_TempIGBT /end REF_MEASUREMENT
/end GROUP
/begin GROUP Inverters_Data.Inverters_Data_Y ""
 /begin REF_MEASUREMENT Inverters_Data.Inverters_Data_Y.Inv_L_Iactual Inverters_Data.Inverters_Data_Y.Inv_L_Icommand Inverters_Data.Inverters_Data_Y.Inv_L_Iq Inverters_Data.Inverters_Data_Y.Inv_L_TempIGBT Inverters_Data.Inverters_Data_Y.Inv_L_TempMotor Inverters_Data.Inverters_Data_Y.Inv_L_VdcBus Inverters_Data.Inverters_Data_Y.Inv_R_Iactual Inverters_Data.Inverters_Data_Y.Inv_R_Icommand Inverters_Data.Inverters_Data_Y.Inv_R_Iq Inverters_Data.Inverters_Data_Y.Inv_R_TempIGBT Inverters_Data.Inverters_Data_Y.Inv_R_TempMotor Inverters_Data.Inverters_Data_Y.Inv_R_VdcBus Inverters_Data.Inverters_Data_Y.InvertersMinDCBus Inverters_Data.Inverters_Data_Y.RL_Vel_ms_Wheel Inverters_Data.Inverters_Data_Y.RL_rads_Motor Inverters_Data.Inverters_Data_Y.RR_Vel_ms_Wheel Inverters_Data.Inverters_Data_Y.RR_rads_Motor Inverters_Data.Inverters_Data_Y.Speed Inverters_Data.Inverters_Data_Y.Temp_IGBT Inverters_Data.Inverters_Data_Y.Temp_Motors Inverters_Data.Inverters_Data_Y.Wheel_RL_Speed Inverters_Data.Inverters_Data_Y.Wheel_RR_Speed /end REF_MEASUREMENT
/end GROUP
/begin GROUP Sensors "" ROOT
 /begin REF_MEASUREMENT Sensors.Sensors_ConstB.Subtract Sensors.Sensors_ConstB.Subtract_e Sensors.Sensors_ConstB.Subtract_ev Sensors.Sensors_ConstB.Subtract_k Sensors.Sensors_ConstB.Subtract_p Sensors.Sensors_ConstB.Sum1 Sensors.Sensors_ConstB.Sum1_f Sensors.Sensors_ConstB.Sum1_p Sensors.Sensors_DW.Previous_IN Sensors.Sensors_DW.Previous_OUT Sensors.Sensors_U.APPS1_Bits Sensors.Sensors_U.APPS2_Bits Sensors.Sensors_U.BrakeSensor_Bits Sensors.Sensors_U.SteeringSensor_Bits Sensors.Sensors_U.Susp_F_L_Bits Sensors.Sensors_U.Susp_F_R_Bits Sensors.Sensors_U.Susp_R_L_Bits Sensors.Sensors_U.Susp_R_R_Bits Sensors.Sensors_Y.APPS1_Value Sensors.Sensors_Y.APPS2_Value Sensors.Sensors_Y.BrakeLight_Control Sensors.Sensors_Y.BrakeSensor_Value Sensors.Sensors_Y.SUSP_F_L Sensors.Sensors_Y.SUSP_F_R Sensors.Sensors_Y.SUSP_R_L Sensors.Sensors_Y.SUSP_R_R Sensors.Sensors_Y.SteeringSensor_Value /end REF_MEASUREMENT
 /begin SUB_GROUP Sensors.Sensors_ConstB Sensors.Sensors_DW Sensors.Sensors_U Sensors.Sensors_Y /end SUB_GROUP
/end GROUP
/begin GROUP Sensors.Sensors_ConstB ""
 /begin REF_MEASUREMENT Sensors.Sensors_ConstB.Subtract Sensors.Sensors_ConstB.Subtract_e Sensors.Sensors_ConstB.Subtract_ev Sensors.Sensors_ConstB.Subtract_k Sensors.Sensors_ConstB.Subtract_p Sensors.Sensors_ConstB.Sum1 Sensors.Sensors_ConstB.Sum1_f Sensors.Sensors_ConstB.Sum1_p /end REF_MEASUREMENT
/end GROUP
/begin GROUP Sensors.Sensors_DW ""
 /begin REF_MEASUREMENT Sensors.Sensors_DW.Previous_IN Sensors.Sensors_DW.Previous_OUT /end REF_MEASUREMENT
/end GROUP
/begin GROUP Sensors.Sensors_U ""
 /begin REF_MEASUREMENT Sensors.Sensors_U.APPS1_Bits Sensors.Sensors_U.APPS2_Bits Sensors.Sensors_U.BrakeSensor_Bits Sensors.Sensors_U.SteeringSensor_Bits Sensors.Sensors_U.Susp_F_L_Bits Sensors.Sensors_U.Susp_F_R_Bits Sensors.Sensors_U.Susp_R_L_Bits Sensors.Sensors_U.Susp_R_R_Bits /end REF_MEASUREMENT
/end GROUP
/begin GROUP Sensors.Sensors_Y ""
 /begin REF_MEASUREMENT Sensors.Sensors_Y.APPS1_Value Sensors.Sensors_Y.APPS2_Value Sensors.Sensors_Y.BrakeLight_Control Sensors.Sensors_Y.BrakeSensor_Value Sensors.Sensors_Y.SUSP_F_L Sensors.Sensors_Y.SUSP_F_R Sensors.Sensors_Y.SUSP_R_L Sensors.Sensors_Y.SUSP_R_R Sensors.Sensors_Y.SteeringSensor_Value /end REF_MEASUREMENT
/end GROUP
/begin GROUP SoC "" ROOT
 /begin REF_MEASUREMENT SoC.SoC_B.Memory SoC.SoC_B.Memory_p SoC.SoC_B.NOT SoC.SoC_B.NOT_p SoC.SoC_B.Switch SoC.SoC_B.Switch_d SoC.SoC_U.Accumulator_Current SoC.SoC_U.Car_State SoC.SoC_U.Highest_CellVoltage SoC.SoC_U.Lowest_CellVoltage SoC.SoC_Y.SoC_Avg SoC.SoC_Y.SoC_High SoC.SoC_Y.SoC_Low /end REF_MEASUREMENT
 /begin SUB_GROUP SoC.SoC_B SoC.SoC_U SoC.SoC_Y /end SUB_GROUP
/end GROUP
/begin GROUP SoC.SoC_B ""
 /begin REF_MEASUREMENT SoC.SoC_B.Memory SoC.SoC_B.Memory_p SoC.SoC_B.NOT SoC.SoC_B.NOT_p SoC.SoC_B.Switch SoC.SoC_B.Switch_d /end REF_MEASUREMENT
/end GROUP
/begin GROUP SoC.SoC_U ""
 /begin REF_MEASUREMENT SoC.SoC_U.Accumulator_Current SoC.SoC_U.Car_State SoC.SoC_U.Highest_CellVoltage SoC.SoC_U.Lowest_CellVoltage /end REF_MEASUREMENT
/end GROUP
/begin GROUP SoC.SoC_Y "" /begin REF_MEASUREMENT SoC.SoC_Y.SoC_Avg SoC.SoC_Y.SoC_High SoC.SoC_Y.SoC_Low /end REF_MEASUREMENT /end GROUP
/begin GROUP Synchronism "" ROOT
 /begin REF_MEASUREMENT Synchronism.Synchronism_DW.counter Synchronism.Synchronism_Y.Sync_CAN1 Synchronism.Synchronism_Y.Sync_CAN2 /end REF_MEASUREMENT
 /begin SUB_GROUP Synchronism.Synchronism_DW Synchronism.Synchronism_Y /end SUB_GROUP
/end GROUP
/begin GROUP Synchronism.Synchronism_DW "" /begin REF_MEASUREMENT Synchronism.Synchronism_DW.counter /end REF_MEASUREMENT /end GROUP
/begin GROUP Synchronism.Synchronism_Y ""
 /begin REF_MEASUREMENT Synchronism.Synchronism_Y.Sync_CAN1 Synchronism.Synchronism_Y.Sync_CAN2 /end REF_MEASUREMENT
/end GROUP
/begin GROUP racing_modes_R2022a "" ROOT
 /begin REF_MEASUREMENT racing_modes_R2022a.racing_modes_R2022a_B.Gain racing_modes_R2022a.racing_modes_R2022a_B.Merge racing_modes_R2022a.racing_modes_R2022a_U.CustomMode_Data racing_modes_R2022a.racing_modes_R2022a_U.CustomMode_Identifier racing_modes_R2022a.racing_modes_R2022a_U.RacingMode racing_modes_R2022a.racing_modes_R2022a_Y.VDC_Max_tire_slip racing_modes_R2022a.racing_modes_R2022a_Y.Workshop_Mode_Enable /end REF_MEASUREMENT
 /begin SUB_GROUP racing_modes_R2022a.racing_modes_R2022a_B racing_modes_R2022a.racing_modes_R2022a_U racing_modes_R2022a.racing_modes_R2022a_Y /end SUB_GROUP
/end GROUP
/begin GROUP racing_modes_R2022a.racing_modes_R2022a_B ""
 /begin REF_MEASUREMENT racing_modes_R2022a.racing_modes_R2022a_B.Gain racing_modes_R2022a.racing_modes_R2022a_B.Merge /end REF_MEASUREMENT
/end GROUP
/begin GROUP racing_modes_R2022a.racing_modes_R2022a_U ""
 /begin REF_MEASUREMENT racing_modes_R2022a.racing_modes_R2022a_U.CustomMode_Data racing_modes_R2022a.racing_modes_R2022a_U.CustomMode_Identifier racing_modes_R2022a.racing_modes_R2022a_U.RacingMode /end REF_MEASUREMENT
/end GROUP
/begin GROUP racing_modes_R2022a.racing_modes_R2022a_Y ""
 /begin REF_MEASUREMENT racing_modes_R2022a.racing_modes_R2022a_Y.VDC_Max_tire_slip racing_modes_R2022a.racing_modes_R2022a_Y.Workshop_Mode_Enable /end REF_MEASUREMENT
/end GROUP
/begin GROUP vdc_r2022a "" ROOT
 /begin REF_MEASUREMENT vdc_r2022a.vdc_r2022a_B.Merge1 vdc_r2022a.vdc_r2022a_B.Merge2 vdc_r2022a.vdc_r2022a_B.Merge3 vdc_r2022a.vdc_r2022a_DW.A vdc_r2022a.vdc_r2022a_DW.ERROR_Counter vdc_r2022a.vdc_r2022a_U.APPS1_Value vdc_r2022a.vdc_r2022a_U.APPS2_Value vdc_r2022a.vdc_r2022a_U.Accumulator_Current vdc_r2022a.vdc_r2022a_U.Accumulator_Voltage vdc_r2022a.vdc_r2022a_U.BrakeSensor_Value vdc_r2022a.vdc_r2022a_U.Car_State vdc_r2022a.vdc_r2022a_U.CriticalDisconnection vdc_r2022a.vdc_r2022a_U.RL_Vel_ms_Wheel vdc_r2022a.vdc_r2022a_U.RL_rads_Motor vdc_r2022a.vdc_r2022a_U.RR_Vel_ms_Wheel vdc_r2022a.vdc_r2022a_U.RR_rads_Motor vdc_r2022a.vdc_r2022a_U.Shutdown_PackageIntck vdc_r2022a.vdc_r2022a_U.SteeringSensor_Value vdc_r2022a.vdc_r2022a_U.Susp_F_L vdc_r2022a.vdc_r2022a_U.Susp_F_R vdc_r2022a.vdc_r2022a_U.Susp_R_L vdc_r2022a.vdc_r2022a_U.Susp_R_R vdc_r2022a.vdc_r2022a_U.TV_Mode vdc_r2022a.vdc_r2022a_U.TorqueEnable vdc_r2022a.vdc_r2022a_U.VDC_Max_tire_slip vdc_r2022a.vdc_r2022a_U.Workshop_Mode_Enable vdc_r2022a.vdc_r2022a_U.el_ACCEL_X vdc_r2022a.vdc_r2022a_U.el_ACCEL_Y vdc_r2022a.vdc_r2022a_U.el_ACCEL_Z vdc_r2022a.vdc_r2022a_U.el_GYRO_X vdc_r2022a.vdc_r2022a_U.el_GYRO_Y vdc_r2022a.vdc_r2022a_U.el_GYRO_Z vdc_r2022a.vdc_r2022a_U.el_PITCH vdc_r2022a.vdc_r2022a_U.el_ROLL vdc_r2022a.vdc_r2022a_U.el_Vel_X vdc_r2022a.vdc_r2022a_U.el_Vel_Y vdc_r2022a.vdc_r2022a_U.el_Vel_Z vdc_r2022a.vdc_r2022a_U.el_YAW vdc_r2022a.vdc_r2022a_Y.APPS_Implausibility vdc_r2022a.vdc_r2022a_Y.Power vdc_r2022a.vdc_r2022a_Y.PowerLimitReached vdc_r2022a.vdc_r2022a_Y.PowerMean500ms vdc_r2022a.vdc_r2022a_Y.TC_WARNING vdc_r2022a.vdc_r2022a_Y.Torque_L_out vdc_r2022a.vdc_r2022a_Y.Torque_OK vdc_r2022a.vdc_r2022a_Y.Torque_R_out /end REF_MEASUREMENT
 /begin SUB_GROUP vdc_r2022a.vdc_r2022a_B vdc_r2022a.vdc_r2022a_DW vdc_r2022a.vdc_r2022a_U vdc_r2022a.vdc_r2022a_Y /end SUB_GROUP
/end GROUP
/begin GROUP vdc_r2022a.vdc_r2022a_B ""
 /begin REF_MEASUREMENT vdc_r2022a.vdc_r2022a_B.Merge1 vdc_r2022a.vdc_r2022a_B.Merge2 vdc_r2022a.vdc_r2022a_B.Merge3 /end REF_MEASUREMENT
/end GROUP
/begin GROUP vdc_r2022a.vdc_r2022a_DW ""
 /begin REF_MEASUREMENT vdc_r2022a.vdc_r2022a_DW.A vdc_r2022a.vdc_r2022a_DW.ERROR_Counter /end REF_MEASUREMENT
/end GROUP
/begin GROUP vdc_r2022a.vdc_r2022a_U ""
 /begin REF_MEASUREMENT vdc_r2022a.vdc_r2022a_U.APPS1_Value vdc_r2022a.vdc_r2022a_U.APPS2_Value vdc_r2022a.vdc_r2022a_U.Accumulator_Current vdc_r2022a.vdc_r2022a_U.Accumulator_Voltage vdc_r2022a.vdc_r2022a_U.BrakeSensor_Value vdc_r2022a.vdc_r2022a_U.Car_State vdc_r2022a.vdc_r2022a_U.CriticalDisconnection vdc_r2022a.vdc_r2022a_U.RL_Vel_ms_Wheel vdc_r2022a.vdc_r2022a_U.RL_rads_Motor vdc_r2022a.vdc_r2022a_U.RR_Vel_ms_Wheel vdc_r2022a.vdc_r2022a_U.RR_rads_Motor vdc_r2022a.vdc_r2022a_U.Shutdown_PackageIntck vdc_r2022a.vdc_r2022a_U.SteeringSensor_Value vdc_r2022a.vdc_r2022a_U.Susp_F_L vdc_r2022a.vdc_r2022a_U.Susp_F_R vdc_r2022a.vdc_r2022a_U.Susp_R_L vdc_r2022a.vdc_r2022a_U.Susp_R_R vdc_r2022a.vdc_r2022a_U.TV_Mode vdc_r2022a.vdc_r2022a_U.TorqueEnable vdc_r2022a.vdc_r2022a_U.VDC_Max_tire_slip vdc_r2022a.vdc_r2022a_U.Workshop_Mode_Enable vdc_r2022a.vdc_r2022a_U.el_ACCEL_X vdc_r2022a.vdc_r2022a_U.el_ACCEL_Y vdc_r2022a.vdc_r2022a_U.el_ACCEL_Z vdc_r2022a.vdc_r2022a_U.el_GYRO_X vdc_r2022a.vdc_r2022a_U.el_GYRO_Y vdc_r2022a.vdc_r2022a_U.el_GYRO_Z vdc_r2022a.vdc_r2022a_U.el_PITCH vdc_r2022a.vdc_r2022a_U.el_ROLL vdc_r2022a.vdc_r2022a_U.el_Vel_X vdc_r2022a.vdc_r2022a_U.el_Vel_Y vdc_r2022a.vdc_r2022a_U.el_Vel_Z vdc_r2022a.vdc_r2022a_U.el_YAW /end REF_MEASUREMENT
/end GROUP
/begin GROUP vdc_r2022a.vdc_r2022a_Y ""
 /begin REF_MEASUREMENT vdc_r2022a.vdc_r2022a_Y.APPS_Implausibility vdc_r2022a.vdc_r2022a_Y.Power vdc_r2022a.vdc_r2022a_Y.PowerLimitReached vdc_r2022a.vdc_r2022a_Y.PowerMean500ms vdc_r2022a.vdc_r2022a_Y.TC_WARNING vdc_r2022a.vdc_r2022a_Y.Torque_L_out vdc_r2022a.vdc_r2022a_Y.Torque_OK vdc_r2022a.vdc_r2022a_Y.Torque_R_out /end REF_MEASUREMENT
/end GROUP
/end MODULE
/* INTECRIO_MERGED */
/end PROJECT
/* ETAS */
