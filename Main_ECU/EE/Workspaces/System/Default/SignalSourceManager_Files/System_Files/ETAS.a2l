ASAP2_VERSION 1 61
/begin PROJECT ETAS "Generated by ETAS from INTECRIO V5.0.4.1005 integration project"
/begin HEADER "" VERSION "" PROJECT_NO Y /end HEADER
/begin MODULE INTECRIO_MERGED "Generated by ETAS INTECRIO V5.0.4.1005 for M/C interface ETARGET"
/begin MOD_COMMON "Common definitions" BYTE_ORDER MSB_FIRST ALIGNMENT_BYTE 1 ALIGNMENT_WORD 2 ALIGNMENT_LONG 4 ALIGNMENT_FLOAT32_IEEE 4 ALIGNMENT_FLOAT64_IEEE 8 /end MOD_COMMON
/begin MEASUREMENT ETCSignals.ES910.ES910.CAN1.Presence.PresenceGroup.PresenceFlag "" FLOAT64_IEEE LINEAR_FUNCTION_M1_T0_U1 1 100 0 1 ECU_ADDRESS 0x0 /end MEASUREMENT
/begin MEASUREMENT ETCSignals.ES910.ES910.CAN1.CAN1.AP_BMS_SDC.Shutdown_PackageIntck "" FLOAT64_IEEE LINEAR_FUNCTION_M1_T0_U2 1 100 0 0 ECU_ADDRESS 0x0 /end MEASUREMENT
/begin MEASUREMENT ETCSignals.ES910.ES910.CAN1.CAN1.AP_BMS_SDC.Shutdown_IMD "" FLOAT64_IEEE LINEAR_FUNCTION_M1_T0_U2 1 100 0 0 ECU_ADDRESS 0x0 /end MEASUREMENT
/begin MEASUREMENT ETCSignals.ES910.ES910.CAN1.CAN1.AP_BMS_SDC.Shutdown_BMS "" FLOAT64_IEEE LINEAR_FUNCTION_M1_T0_U2 1 100 0 0 ECU_ADDRESS 0x0 /end MEASUREMENT
/begin MEASUREMENT ETCSignals.ES910.ES910.CAN1.CAN1.AP_CurrentSensor.ERROR "" FLOAT64_IEEE LINEAR_FUNCTION_M1_T0_U2 1 100 0 0 ECU_ADDRESS 0x0 /end MEASUREMENT
/begin MEASUREMENT ETCSignals.ES910.ES910.CAN1.CAN1.AP_CurrentSensor.Accumulator_Current "" FLOAT64_IEEE LINEAR_FUNCTION_M1_T0_U3 1 100 0 0 ECU_ADDRESS 0x0 /end MEASUREMENT
/begin MEASUREMENT ETCSignals.ES910.ES910.CAN1.CAN1.AP_BMS_Voltages.Lowest_CellVoltage "" FLOAT64_IEEE LINEAR_FUNCTION_M1_T0_U4 1 100 0 0 ECU_ADDRESS 0x0 /end MEASUREMENT
/begin MEASUREMENT ETCSignals.ES910.ES910.CAN1.CAN1.AP_BMS_Voltages.Highest_CellVoltage "" FLOAT64_IEEE LINEAR_FUNCTION_M1_T0_U4 1 100 0 0 ECU_ADDRESS 0x0 /end MEASUREMENT
/begin MEASUREMENT ETCSignals.ES910.ES910.CAN1.CAN1.AP_BMS_Voltages.Accumulator_Voltage "" FLOAT64_IEEE LINEAR_FUNCTION_M1_T0_U4 1 100 0 0 ECU_ADDRESS 0x0 /end MEASUREMENT
/begin MEASUREMENT ETCSignals.ES910.ES910.CAN1.CAN1.AP_BMS_ChargerParameters.Charger_MaxVoltage "" FLOAT64_IEEE LINEAR_FUNCTION_M1_T0_U1 1 100 0 0 ECU_ADDRESS 0x0 /end MEASUREMENT
/begin MEASUREMENT ETCSignals.ES910.ES910.CAN1.CAN1.AP_BMS_ChargerParameters.Charger_MaxCurrent "" FLOAT64_IEEE LINEAR_FUNCTION_M1_T0_U1 1 100 0 0 ECU_ADDRESS 0x0 /end MEASUREMENT
/begin MEASUREMENT ETCSignals.ES910.ES910.CAN1.CAN1.AP_BMS_BatteryTemperatures.Lowest_CellTemp "" FLOAT64_IEEE LINEAR_FUNCTION_M1_T0_U5 1 100 0 0 ECU_ADDRESS 0x0 /end MEASUREMENT
/begin MEASUREMENT ETCSignals.ES910.ES910.CAN1.CAN1.AP_BMS_BatteryTemperatures.Highest_CellTemp "" FLOAT64_IEEE LINEAR_FUNCTION_M1_T0_U5 1 100 0 0 ECU_ADDRESS 0x0 /end MEASUREMENT
/begin MEASUREMENT ETCSignals.ES910.ES910.CAN1.CAN1.AP_BMS_BatteryTemperatures.Average_CellTemp "" FLOAT64_IEEE LINEAR_FUNCTION_M1_T0_U5 1 100 0 0 ECU_ADDRESS 0x0 /end MEASUREMENT
/begin MEASUREMENT ETCSignals.ES910.ES910.CAN1.CAN1.AP_Inverter_R_Tx.Inv_R_RegID "" FLOAT64_IEEE LINEAR_FUNCTION_M1_T0_U6 1 100 0 0 ECU_ADDRESS 0x0 /end MEASUREMENT
/begin MEASUREMENT ETCSignals.ES910.ES910.CAN1.CAN1.AP_Inverter_R_Tx.Inv_R_RegID_M73_Inv_R_TempMotor "" FLOAT64_IEEE LINEAR_FUNCTION_M1_T0_U7 1 100 0 0 ECU_ADDRESS 0x0 /end MEASUREMENT
/begin MEASUREMENT ETCSignals.ES910.ES910.CAN1.CAN1.AP_Inverter_R_Tx.Inv_R_RegID_M74_Inv_R_TempIGBT "" FLOAT64_IEEE LINEAR_FUNCTION_M1_T0_U7 1 100 0 0 ECU_ADDRESS 0x0 /end MEASUREMENT
/begin MEASUREMENT ETCSignals.ES910.ES910.CAN1.CAN1.AP_Inverter_R_Tx.Inv_R_RegID_M48_Inv_R_Speed "" FLOAT64_IEEE LINEAR_FUNCTION_M1_T0_U7 1 100 0 0 ECU_ADDRESS 0x0 /end MEASUREMENT
/begin MEASUREMENT ETCSignals.ES910.ES910.CAN1.CAN1.AP_Inverter_R_Tx.Inv_R_RegID_M39_Inv_R_Iq "" FLOAT64_IEEE LINEAR_FUNCTION_M1_T0_U7 1 100 0 0 ECU_ADDRESS 0x0 /end MEASUREMENT
/begin MEASUREMENT ETCSignals.ES910.ES910.CAN1.CAN1.AP_Inverter_R_Tx.Inv_R_RegID_M38_Inv_R_Icommand "" FLOAT64_IEEE LINEAR_FUNCTION_M1_T0_U7 1 100 0 0 ECU_ADDRESS 0x0 /end MEASUREMENT
/begin MEASUREMENT ETCSignals.ES910.ES910.CAN1.CAN1.AP_Inverter_R_Tx.Inv_R_RegID_M32_Inv_R_Iactual "" FLOAT64_IEEE LINEAR_FUNCTION_M1_T0_U7 1 100 0 0 ECU_ADDRESS 0x0 /end MEASUREMENT
/begin MEASUREMENT ETCSignals.ES910.ES910.CAN1.CAN1.AP_Inverter_R_Tx.Inv_R_RegID_M232_Inv_R_Enable "" FLOAT64_IEEE LINEAR_FUNCTION_M1_T0_U7 1 100 0 0 ECU_ADDRESS 0x0 /end MEASUREMENT
/begin MEASUREMENT ETCSignals.ES910.ES910.CAN1.CAN1.AP_Inverter_R_Tx.Inv_R_RegID_M235_Inv_R_DCBus "" FLOAT64_IEEE LINEAR_FUNCTION_M1_T0_U4 1 100 0 0 ECU_ADDRESS 0x0 /end MEASUREMENT
/begin MEASUREMENT ETCSignals.ES910.ES910.CAN1.CAN1.AP_Inverter_L_Tx.Inv_L_RegID "" FLOAT64_IEEE LINEAR_FUNCTION_M1_T0_U6 1 100 0 0 ECU_ADDRESS 0x0 /end MEASUREMENT
/begin MEASUREMENT ETCSignals.ES910.ES910.CAN1.CAN1.AP_Inverter_L_Tx.Inv_L_RegID_M73_Inv_L_TempMotor "" FLOAT64_IEEE LINEAR_FUNCTION_M1_T0_U7 1 100 0 0 ECU_ADDRESS 0x0 /end MEASUREMENT
/begin MEASUREMENT ETCSignals.ES910.ES910.CAN1.CAN1.AP_Inverter_L_Tx.Inv_L_RegID_M74_Inv_L_TempIGBT "" FLOAT64_IEEE LINEAR_FUNCTION_M1_T0_U7 1 100 0 0 ECU_ADDRESS 0x0 /end MEASUREMENT
/begin MEASUREMENT ETCSignals.ES910.ES910.CAN1.CAN1.AP_Inverter_L_Tx.Inv_L_RegID_M48_Inv_L_Speed "" FLOAT64_IEEE LINEAR_FUNCTION_M1_T0_U7 1 100 0 0 ECU_ADDRESS 0x0 /end MEASUREMENT
/begin MEASUREMENT ETCSignals.ES910.ES910.CAN1.CAN1.AP_Inverter_L_Tx.Inv_L_RegID_M39_Inv_L_Iq "" FLOAT64_IEEE LINEAR_FUNCTION_M1_T0_U7 1 100 0 0 ECU_ADDRESS 0x0 /end MEASUREMENT
/begin MEASUREMENT ETCSignals.ES910.ES910.CAN1.CAN1.AP_Inverter_L_Tx.Inv_L_RegID_M38_Inv_L_Icommand "" FLOAT64_IEEE LINEAR_FUNCTION_M1_T0_U7 1 100 0 0 ECU_ADDRESS 0x0 /end MEASUREMENT
/begin MEASUREMENT ETCSignals.ES910.ES910.CAN1.CAN1.AP_Inverter_L_Tx.Inv_L_RegID_M32_Inv_L_Iactual "" FLOAT64_IEEE LINEAR_FUNCTION_M1_T0_U7 1 100 0 0 ECU_ADDRESS 0x0 /end MEASUREMENT
/begin MEASUREMENT ETCSignals.ES910.ES910.CAN1.CAN1.AP_Inverter_L_Tx.Inv_L_RegID_M232_Inv_L_Enable "" FLOAT64_IEEE LINEAR_FUNCTION_M1_T0_U7 1 100 0 0 ECU_ADDRESS 0x0 /end MEASUREMENT
/begin MEASUREMENT ETCSignals.ES910.ES910.CAN1.CAN1.AP_Inverter_L_Tx.Inv_L_RegID_M235_Inv_L_DCBus "" FLOAT64_IEEE LINEAR_FUNCTION_M1_T0_U4 1 100 0 0 ECU_ADDRESS 0x0 /end MEASUREMENT
/begin MEASUREMENT ETCSignals.ES910.ES910.CAN1.CAN1.AP_DASH_CustomMode.CustomMode_Identifier "" FLOAT64_IEEE LINEAR_FUNCTION_M1_T0_U1 1 100 0 0 ECU_ADDRESS 0x0 /end MEASUREMENT
/begin MEASUREMENT ETCSignals.ES910.ES910.CAN1.CAN1.AP_DASH_CustomMode.CustomMode_Data "" FLOAT64_IEEE LINEAR_FUNCTION_M1_T0_U1 1 100 0 0 ECU_ADDRESS 0x0 /end MEASUREMENT
/begin MEASUREMENT ETCSignals.ES910.ES910.CAN1.CAN1.AP_DASH_Mode.RacingMode "" FLOAT64_IEEE LINEAR_FUNCTION_M1_T0_U1 1 100 0 0 ECU_ADDRESS 0x0 /end MEASUREMENT
/begin MEASUREMENT ETCSignals.ES910.ES910.CAN1.CAN1.NM_BMS_Keep_Alive.BMS_Alive "" FLOAT64_IEEE LINEAR_FUNCTION_M1_T0_U1 1 100 0 0 ECU_ADDRESS 0x0 /end MEASUREMENT
/begin MEASUREMENT ETCSignals.ES910.ES910.CAN1.CAN1.AP_BMS_AIRs_State.AIRs_State "" FLOAT64_IEEE LINEAR_FUNCTION_M1_T0_U1 1 100 0 0 ECU_ADDRESS 0x0 /end MEASUREMENT
/begin MEASUREMENT ETCSignals.ES910.ES910.CAN1.CAN1.NM_DASH_Keep_Alive.Dash_Alive "" FLOAT64_IEEE LINEAR_FUNCTION_M1_T0_U1 1 100 0 0 ECU_ADDRESS 0x0 /end MEASUREMENT
/begin MEASUREMENT ETCSignals.ES910.ES910.CAN1.CAN1.AP_DASH_TorqueLockOn.Torque_LockOn "" FLOAT64_IEEE LINEAR_FUNCTION_M1_T0_U2 1 100 0 0 ECU_ADDRESS 0x0 /end MEASUREMENT
/begin MEASUREMENT ETCSignals.ES910.ES910.CAN1.CAN1.AP_DASH_PrechargeRequest.PrechargeRequest "" FLOAT64_IEEE LINEAR_FUNCTION_M1_T0_U1 1 100 0 0 ECU_ADDRESS 0x0 /end MEASUREMENT
/begin MEASUREMENT ETCSignals.ES910.ES910.CAN1.CAN1.AP_DASH_EnableDrive.EnableDrive_Order "" FLOAT64_IEEE LINEAR_FUNCTION_M1_T0_U2 1 100 0 0 ECU_ADDRESS 0x0 /end MEASUREMENT
/begin MEASUREMENT ETCSignals.ES910.ES910.CAN1.CAN1.AP_ETAS_DashData1.Speed "" FLOAT64_IEEE LINEAR_FUNCTION_M1_T0_U8 1 100 -128 127 ECU_ADDRESS 0x0 /end MEASUREMENT
/begin MEASUREMENT ETCSignals.ES910.ES910.CAN1.CAN1.AP_ETAS_DashData1.Precharge_Voltage "" FLOAT64_IEEE LINEAR_FUNCTION_M1_T0_U4 1 100 0 655.35 ECU_ADDRESS 0x0 /end MEASUREMENT
/begin MEASUREMENT ETCSignals.ES910.ES910.CAN1.CAN1.AP_ETAS_DashData1.Precharge_Percentage "" FLOAT64_IEEE LINEAR_FUNCTION_M1_T0_U9 1 100 0 100 ECU_ADDRESS 0x0 /end MEASUREMENT
/begin MEASUREMENT ETCSignals.ES910.ES910.CAN1.CAN1.AP_ETAS_VDCParams2.VDC_Cte_SKF "" FLOAT64_IEEE LINEAR_FUNCTION_M1_T0_U1 1 100 0 1 ECU_ADDRESS 0x0 /end MEASUREMENT
/begin MEASUREMENT ETCSignals.ES910.ES910.CAN1.CAN1.AP_ETAS_VDCParams2.VDC_Cte_CKF "" FLOAT64_IEEE LINEAR_FUNCTION_M1_T0_U1 1 100 0 1 ECU_ADDRESS 0x0 /end MEASUREMENT
/begin MEASUREMENT ETCSignals.ES910.ES910.CAN1.CAN1.AP_ETAS_VDCParams.VDC_CKF_Initial "" FLOAT64_IEEE LINEAR_FUNCTION_M1_T0_U6 1 100 0 1 ECU_ADDRESS 0x0 /end MEASUREMENT
/begin MEASUREMENT ETCSignals.ES910.ES910.CAN1.CAN1.AP_ETAS_VDCParams.VDC_SKF_Initial "" FLOAT64_IEEE LINEAR_FUNCTION_M1_T0_U6 1 100 0 1 ECU_ADDRESS 0x0 /end MEASUREMENT
/begin MEASUREMENT ETCSignals.ES910.ES910.CAN1.CAN1.AP_ETAS_VDCParams.VDC_Power_Limit "" FLOAT64_IEEE LINEAR_FUNCTION_M1_T0_U10 1 100 0 85 ECU_ADDRESS 0x0 /end MEASUREMENT
/begin MEASUREMENT ETCSignals.ES910.ES910.CAN1.CAN1.AP_ETAS_VDCParams.VDC_Max_Regen_Motor_Tq "" FLOAT64_IEEE LINEAR_FUNCTION_M1_T0_U1 1 100 0 10.2 ECU_ADDRESS 0x0 /end MEASUREMENT
/begin MEASUREMENT ETCSignals.ES910.ES910.CAN1.CAN1.AP_ETAS_VDCParams.VDC_K_Reduction_Temperature "" FLOAT64_IEEE LINEAR_FUNCTION_M1_T0_U1 1 100 0 1 ECU_ADDRESS 0x0 /end MEASUREMENT
/begin MEASUREMENT ETCSignals.ES910.ES910.CAN1.CAN1.AP_ETAS_VDCParams.VDC_K_Reduction_P "" FLOAT64_IEEE LINEAR_FUNCTION_M1_T0_U1 1 100 0 1 ECU_ADDRESS 0x0 /end MEASUREMENT
/begin MEASUREMENT ETCSignals.ES910.ES910.CAN1.CAN1.AP_ETAS_VDCParams.VDC_APPS_Sat_Up "" FLOAT64_IEEE LINEAR_FUNCTION_M1_T0_U6 1 100 0 1 ECU_ADDRESS 0x0 /end MEASUREMENT
/begin MEASUREMENT ETCSignals.ES910.ES910.CAN1.CAN1.AP_ETAS_VDCParams.VDC_APPS_Sat_Down "" FLOAT64_IEEE LINEAR_FUNCTION_M1_T0_U6 1 100 0 1 ECU_ADDRESS 0x0 /end MEASUREMENT
/begin MEASUREMENT ETCSignals.ES910.ES910.CAN1.CAN1.AP_ETAS_Inverter_R_Rx.Inverter_R_RegID "" FLOAT64_IEEE LINEAR_FUNCTION_M1_T0_U1 1 100 0 255 ECU_ADDRESS 0x0 /end MEASUREMENT
/begin MEASUREMENT ETCSignals.ES910.ES910.CAN1.CAN1.AP_ETAS_Inverter_R_Rx.Inverter_R_b7tob0 "" FLOAT64_IEEE LINEAR_FUNCTION_M1_T0_U1 1 100 0 255 ECU_ADDRESS 0x0 /end MEASUREMENT
/begin MEASUREMENT ETCSignals.ES910.ES910.CAN1.CAN1.AP_ETAS_Inverter_R_Rx.Inverter_R_b15tob8 "" FLOAT64_IEEE LINEAR_FUNCTION_M1_T0_U1 1 100 0 255 ECU_ADDRESS 0x0 /end MEASUREMENT
/begin MEASUREMENT ETCSignals.ES910.ES910.CAN1.CAN1.AP_ETAS_Inverter_L_Rx.Inverter_L_RegID "" FLOAT64_IEEE LINEAR_FUNCTION_M1_T0_U1 1 100 0 255 ECU_ADDRESS 0x0 /end MEASUREMENT
/begin MEASUREMENT ETCSignals.ES910.ES910.CAN1.CAN1.AP_ETAS_Inverter_L_Rx.Inverter_L_b7tob0 "" FLOAT64_IEEE LINEAR_FUNCTION_M1_T0_U1 1 100 0 255 ECU_ADDRESS 0x0 /end MEASUREMENT
/begin MEASUREMENT ETCSignals.ES910.ES910.CAN1.CAN1.AP_ETAS_Inverter_L_Rx.Inverter_L_b15tob8 "" FLOAT64_IEEE LINEAR_FUNCTION_M1_T0_U1 1 100 0 255 ECU_ADDRESS 0x0 /end MEASUREMENT
/begin MEASUREMENT ETCSignals.ES910.ES910.CAN1.CAN1.AP_ETAS_CarState.Car_State "" FLOAT64_IEEE LINEAR_FUNCTION_M1_T0_U1 1 100 0 21 ECU_ADDRESS 0x0 /end MEASUREMENT
/begin MEASUREMENT ETCSignals.ES910.ES910.CAN1.CAN1.AP_ETAS_AIRsRequest.AIRs_Request "" FLOAT64_IEEE LINEAR_FUNCTION_M1_T0_U1 1 100 0 7 ECU_ADDRESS 0x0 /end MEASUREMENT
/begin MEASUREMENT ETCSignals.ES910.ES910.CAN1.CAN1.MEAS_ETAS_InternalVars.CriticalDisconnection "" FLOAT64_IEEE LINEAR_FUNCTION_M1_T0_U2 1 100 0 1 ECU_ADDRESS 0x0 /end MEASUREMENT
/begin MEASUREMENT ETCSignals.ES910.ES910.CAN1.CAN1.MEAS_ETAS_InternalVars.CurrentPathDisconnectionFlag "" FLOAT64_IEEE LINEAR_FUNCTION_M1_T0_U2 1 100 0 1 ECU_ADDRESS 0x0 /end MEASUREMENT
/begin MEASUREMENT ETCSignals.ES910.ES910.CAN1.CAN1.MEAS_ETAS_InternalVars.Car_OK "" FLOAT64_IEEE LINEAR_FUNCTION_M1_T0_U2 1 100 0 1 ECU_ADDRESS 0x0 /end MEASUREMENT
/begin MEASUREMENT ETCSignals.ES910.ES910.CAN1.CAN1.MEAS_ETAS_InternalVars.Power "" FLOAT64_IEEE LINEAR_FUNCTION_M1_T0_U10 1 100 0 255 ECU_ADDRESS 0x0 /end MEASUREMENT
/begin MEASUREMENT ETCSignals.ES910.ES910.CAN1.CAN1.MEAS_ETAS_InternalVars.Torque_OK "" FLOAT64_IEEE LINEAR_FUNCTION_M1_T0_U2 1 100 0 1 ECU_ADDRESS 0x0 /end MEASUREMENT
/begin MEASUREMENT ETCSignals.ES910.ES910.CAN1.CAN1.MEAS_ETAS_InternalVars.TV_Mode "" FLOAT64_IEEE LINEAR_FUNCTION_M1_T0_U1 1 100 0 7 ECU_ADDRESS 0x0 /end MEASUREMENT
/begin MEASUREMENT ETCSignals.ES910.ES910.CAN1.CAN1.MEAS_ETAS_InternalVars.Critical_Signal_Disconnection "" FLOAT64_IEEE LINEAR_FUNCTION_M1_T0_U2 1 100 0 1 ECU_ADDRESS 0x0 /end MEASUREMENT
/begin MEASUREMENT ETCSignals.ES910.ES910.CAN1.CAN1.MEAS_ETAS_InternalVars.Critical_CAN_Disconnection "" FLOAT64_IEEE LINEAR_FUNCTION_M1_T0_U2 1 100 0 1 ECU_ADDRESS 0x0 /end MEASUREMENT
/begin MEASUREMENT ETCSignals.ES910.ES910.CAN1.CAN1.MEAS_ETAS_InternalVars.APPS_Implausibility "" FLOAT64_IEEE LINEAR_FUNCTION_M1_T0_U2 1 100 0 1 ECU_ADDRESS 0x0 /end MEASUREMENT
/begin MEASUREMENT ETCSignals.ES910.ES910.CAN1.CAN1.NM_ETAS_Disconnections.Disconnection_Pitot "" FLOAT64_IEEE LINEAR_FUNCTION_M1_T0_U2 1 100 0 1 ECU_ADDRESS 0x0 /end MEASUREMENT
/begin MEASUREMENT ETCSignals.ES910.ES910.CAN1.CAN1.NM_ETAS_Disconnections.Disconnection_BrakePressure "" FLOAT64_IEEE LINEAR_FUNCTION_M1_T0_U2 1 100 0 1 ECU_ADDRESS 0x0 /end MEASUREMENT
/begin MEASUREMENT ETCSignals.ES910.ES910.CAN1.CAN1.NM_ETAS_Disconnections.Disconnection_DashBoard "" FLOAT64_IEEE LINEAR_FUNCTION_M1_T0_U2 1 100 0 1 ECU_ADDRESS 0x0 /end MEASUREMENT
/begin MEASUREMENT ETCSignals.ES910.ES910.CAN1.CAN1.NM_ETAS_Disconnections.Disconnection_BMS "" FLOAT64_IEEE LINEAR_FUNCTION_M1_T0_U2 1 100 0 1 ECU_ADDRESS 0x0 /end MEASUREMENT
/begin MEASUREMENT ETCSignals.ES910.ES910.CAN1.CAN1.NM_ETAS_Disconnections.Disconnection_Front "" FLOAT64_IEEE LINEAR_FUNCTION_M1_T0_U2 1 100 0 1 ECU_ADDRESS 0x0 /end MEASUREMENT
/begin MEASUREMENT ETCSignals.ES910.ES910.CAN1.CAN1.NM_ETAS_Disconnections.Disconnection_Rear "" FLOAT64_IEEE LINEAR_FUNCTION_M1_T0_U2 1 100 0 1 ECU_ADDRESS 0x0 /end MEASUREMENT
/begin MEASUREMENT ETCSignals.ES910.ES910.CAN1.CAN1.NM_ETAS_Disconnections.Disconnection_SteeringSensor "" FLOAT64_IEEE LINEAR_FUNCTION_M1_T0_U2 1 100 0 1 ECU_ADDRESS 0x0 /end MEASUREMENT
/begin MEASUREMENT ETCSignals.ES910.ES910.CAN1.CAN1.NM_ETAS_Disconnections.Disconnection_Susp_R_R "" FLOAT64_IEEE LINEAR_FUNCTION_M1_T0_U2 1 100 0 1 ECU_ADDRESS 0x0 /end MEASUREMENT
/begin MEASUREMENT ETCSignals.ES910.ES910.CAN1.CAN1.NM_ETAS_Disconnections.Disconnection_Susp_R_L "" FLOAT64_IEEE LINEAR_FUNCTION_M1_T0_U2 1 100 0 1 ECU_ADDRESS 0x0 /end MEASUREMENT
/begin MEASUREMENT ETCSignals.ES910.ES910.CAN1.CAN1.NM_ETAS_Disconnections.Disconnection_Susp_F_R "" FLOAT64_IEEE LINEAR_FUNCTION_M1_T0_U2 1 100 0 1 ECU_ADDRESS 0x0 /end MEASUREMENT
/begin MEASUREMENT ETCSignals.ES910.ES910.CAN1.CAN1.NM_ETAS_Disconnections.Disconnection_Susp_F_L "" FLOAT64_IEEE LINEAR_FUNCTION_M1_T0_U2 1 100 0 1 ECU_ADDRESS 0x0 /end MEASUREMENT
/begin MEASUREMENT ETCSignals.ES910.ES910.CAN1.CAN1.NM_ETAS_Disconnections.Disconnection_BrakePedal "" FLOAT64_IEEE LINEAR_FUNCTION_M1_T0_U2 1 100 0 1 ECU_ADDRESS 0x0 /end MEASUREMENT
/begin MEASUREMENT ETCSignals.ES910.ES910.CAN1.CAN1.NM_ETAS_Disconnections.Disconnection_APPS2 "" FLOAT64_IEEE LINEAR_FUNCTION_M1_T0_U2 1 100 0 1 ECU_ADDRESS 0x0 /end MEASUREMENT
/begin MEASUREMENT ETCSignals.ES910.ES910.CAN1.CAN1.NM_ETAS_Disconnections.Disconnection_APPS1 "" FLOAT64_IEEE LINEAR_FUNCTION_M1_T0_U2 1 100 0 1 ECU_ADDRESS 0x0 /end MEASUREMENT
/begin MEASUREMENT ETCSignals.ES910.ES910.CAN1.CAN1.NM_ETAS_Disconnections.Disconnection_Ellipse "" FLOAT64_IEEE LINEAR_FUNCTION_M1_T0_U2 1 100 0 1 ECU_ADDRESS 0x0 /end MEASUREMENT
/begin MEASUREMENT ETCSignals.ES910.ES910.CAN1.CAN1.AP_ETAS_DashData2.SteeringSensor_Value "" FLOAT64_IEEE LINEAR_FUNCTION_M1_T0_U11 1 100 -128 127 ECU_ADDRESS 0x0 /end MEASUREMENT
/begin MEASUREMENT ETCSignals.ES910.ES910.CAN1.CAN1.AP_ETAS_DashData2.SKF_actual "" FLOAT64_IEEE LINEAR_FUNCTION_M1_T0_U1 1 100 0 25.5 ECU_ADDRESS 0x0 /end MEASUREMENT
/begin MEASUREMENT ETCSignals.ES910.ES910.CAN1.CAN1.AP_ETAS_DashData2.CKF_actual "" FLOAT64_IEEE LINEAR_FUNCTION_M1_T0_U1 1 100 0 25.5 ECU_ADDRESS 0x0 /end MEASUREMENT
/begin MEASUREMENT ETCSignals.ES910.ES910.CAN1.CAN1.AP_ETAS_DashData2.BrakeSensor_Value "" FLOAT64_IEEE LINEAR_FUNCTION_M1_T0_U9 1 100 0 1 ECU_ADDRESS 0x0 /end MEASUREMENT
/begin MEASUREMENT ETCSignals.ES910.ES910.CAN1.CAN1.AP_ETAS_DashData2.APPS2_Value "" FLOAT64_IEEE LINEAR_FUNCTION_M1_T0_U9 1 100 0 1 ECU_ADDRESS 0x0 /end MEASUREMENT
/begin MEASUREMENT ETCSignals.ES910.ES910.CAN1.CAN1.AP_ETAS_DashData2.APPS1_Value "" FLOAT64_IEEE LINEAR_FUNCTION_M1_T0_U9 1 100 0 1 ECU_ADDRESS 0x0 /end MEASUREMENT
/begin MEASUREMENT ETCSignals.ES910.ES910.CAN1.CAN1.AP_ETAS_Synchronism.Sync_CAN1 "" FLOAT64_IEEE LINEAR_FUNCTION_M1_T0_U1 1 100 0 255 ECU_ADDRESS 0x0 /end MEASUREMENT
/begin MEASUREMENT ETCSignals.ES910.ES910.CAN2.Presence.PresenceGroup.PresenceFlag "" FLOAT64_IEEE LINEAR_FUNCTION_M1_T0_U1 1 100 0 1 ECU_ADDRESS 0x0 /end MEASUREMENT
/begin MEASUREMENT ETCSignals.ES910.ES910.CAN2.CAN2.AP_ETAS_BrakeLight.BrakeLight_Control "" FLOAT64_IEEE LINEAR_FUNCTION_M1_T0_U2 1 100 0 1 ECU_ADDRESS 0x0 /end MEASUREMENT
/begin MEASUREMENT ETCSignals.ES910.ES910.CAN2.CAN2.MEAS_RECU_SDC.Shutdown_TSMS_TSMP "" FLOAT64_IEEE LINEAR_FUNCTION_M1_T0_U2 1 100 0 0 ECU_ADDRESS 0x0 /end MEASUREMENT
/begin MEASUREMENT ETCSignals.ES910.ES910.CAN2.CAN2.MEAS_RECU_SDC.Shutdown_HVD "" FLOAT64_IEEE LINEAR_FUNCTION_M1_T0_U2 1 100 0 0 ECU_ADDRESS 0x0 /end MEASUREMENT
/begin MEASUREMENT ETCSignals.ES910.ES910.CAN2.CAN2.MEAS_RECU_SDC.Shutdown_HVBox "" FLOAT64_IEEE LINEAR_FUNCTION_M1_T0_U2 1 100 0 0 ECU_ADDRESS 0x0 /end MEASUREMENT
/begin MEASUREMENT ETCSignals.ES910.ES910.CAN2.CAN2.MEAS_RECU_SDC.Shutdown_LeftTS "" FLOAT64_IEEE LINEAR_FUNCTION_M1_T0_U2 1 100 0 0 ECU_ADDRESS 0x0 /end MEASUREMENT
/begin MEASUREMENT ETCSignals.ES910.ES910.CAN2.CAN2.MEAS_RECU_SDC.Shutdown_RightTS "" FLOAT64_IEEE LINEAR_FUNCTION_M1_T0_U2 1 100 0 0 ECU_ADDRESS 0x0 /end MEASUREMENT
/begin MEASUREMENT ETCSignals.ES910.ES910.CAN2.CAN2.MEAS_FECU_SDC.Shutdown_SC_BOTS "" FLOAT64_IEEE LINEAR_FUNCTION_M1_T0_U2 1 100 0 0 ECU_ADDRESS 0x0 /end MEASUREMENT
/begin MEASUREMENT ETCSignals.ES910.ES910.CAN2.CAN2.MEAS_FECU_SDC.Shutdown_BSPD_Inertia "" FLOAT64_IEEE LINEAR_FUNCTION_M1_T0_U2 1 100 0 0 ECU_ADDRESS 0x0 /end MEASUREMENT
/begin MEASUREMENT ETCSignals.ES910.ES910.CAN2.CAN2.MEAS_FECU_SDC.Shutdown_Setas "" FLOAT64_IEEE LINEAR_FUNCTION_M1_T0_U2 1 100 0 0 ECU_ADDRESS 0x0 /end MEASUREMENT
/begin MEASUREMENT ETCSignals.ES910.ES910.CAN2.CAN2.AP_ELLIPSE_EKF_POS.el_LONGITUDE_EKF "" FLOAT64_IEEE LINEAR_FUNCTION_M1_T0_U12 1 100 0 0 ECU_ADDRESS 0x0 /end MEASUREMENT
/begin MEASUREMENT ETCSignals.ES910.ES910.CAN2.CAN2.AP_ELLIPSE_EKF_POS.el_LATITUDE_EKF "" FLOAT64_IEEE LINEAR_FUNCTION_M1_T0_U12 1 100 0 0 ECU_ADDRESS 0x0 /end MEASUREMENT
/begin MEASUREMENT ETCSignals.ES910.ES910.CAN2.CAN2.AP_ELLIPSE_IMU_ACCEL.el_ACCEL_Z "" FLOAT64_IEEE LINEAR_FUNCTION_M1_T0_U13 1 100 0 0 ECU_ADDRESS 0x0 /end MEASUREMENT
/begin MEASUREMENT ETCSignals.ES910.ES910.CAN2.CAN2.AP_ELLIPSE_IMU_ACCEL.el_ACCEL_Y "" FLOAT64_IEEE LINEAR_FUNCTION_M1_T0_U13 1 100 0 0 ECU_ADDRESS 0x0 /end MEASUREMENT
/begin MEASUREMENT ETCSignals.ES910.ES910.CAN2.CAN2.AP_ELLIPSE_IMU_ACCEL.el_ACCEL_X "" FLOAT64_IEEE LINEAR_FUNCTION_M1_T0_U13 1 100 0 0 ECU_ADDRESS 0x0 /end MEASUREMENT
/begin MEASUREMENT ETCSignals.ES910.ES910.CAN2.CAN2.AP_ELLIPSE_EKF_EULER.el_YAW "" FLOAT64_IEEE LINEAR_FUNCTION_M1_T0_U14 1 100 0 0 ECU_ADDRESS 0x0 /end MEASUREMENT
/begin MEASUREMENT ETCSignals.ES910.ES910.CAN2.CAN2.AP_ELLIPSE_EKF_EULER.el_PITCH "" FLOAT64_IEEE LINEAR_FUNCTION_M1_T0_U14 1 100 0 0 ECU_ADDRESS 0x0 /end MEASUREMENT
/begin MEASUREMENT ETCSignals.ES910.ES910.CAN2.CAN2.AP_ELLIPSE_EKF_EULER.el_ROLL "" FLOAT64_IEEE LINEAR_FUNCTION_M1_T0_U14 1 100 0 0 ECU_ADDRESS 0x0 /end MEASUREMENT
/begin MEASUREMENT ETCSignals.ES910.ES910.CAN2.CAN2.AP_ELLIPSE_EKF_VEL.el_Vel_Z "" FLOAT64_IEEE LINEAR_FUNCTION_M1_T0_U15 1 100 0 0 ECU_ADDRESS 0x0 /end MEASUREMENT
/begin MEASUREMENT ETCSignals.ES910.ES910.CAN2.CAN2.AP_ELLIPSE_EKF_VEL.el_Vel_Y "" FLOAT64_IEEE LINEAR_FUNCTION_M1_T0_U15 1 100 0 0 ECU_ADDRESS 0x0 /end MEASUREMENT
/begin MEASUREMENT ETCSignals.ES910.ES910.CAN2.CAN2.AP_ELLIPSE_EKF_VEL.el_Vel_X "" FLOAT64_IEEE LINEAR_FUNCTION_M1_T0_U15 1 100 0 0 ECU_ADDRESS 0x0 /end MEASUREMENT
/begin MEASUREMENT ETCSignals.ES910.ES910.CAN2.CAN2.NM_ELLIPSE_Status.el_CLOCK "" FLOAT64_IEEE LINEAR_FUNCTION_M1_T0_U1 1 100 0 0 ECU_ADDRESS 0x0 /end MEASUREMENT
/begin MEASUREMENT ETCSignals.ES910.ES910.CAN2.CAN2.NM_ELLIPSE_Status.el_GENERAL "" FLOAT64_IEEE LINEAR_FUNCTION_M1_T0_U1 1 100 0 0 ECU_ADDRESS 0x0 /end MEASUREMENT
/begin MEASUREMENT ETCSignals.ES910.ES910.CAN2.CAN2.NM_ELLIPSE_Status.Ellipse_Alive "" FLOAT64_IEEE LINEAR_FUNCTION_M1_T0_U16 1 100 0 0 ECU_ADDRESS 0x0 /end MEASUREMENT
/begin MEASUREMENT ETCSignals.ES910.ES910.CAN2.CAN2.AP_ELLIPSE_IMU_GYRO.el_GYRO_Z "" FLOAT64_IEEE LINEAR_FUNCTION_M1_T0_U17 1 100 0 0 ECU_ADDRESS 0x0 /end MEASUREMENT
/begin MEASUREMENT ETCSignals.ES910.ES910.CAN2.CAN2.AP_ELLIPSE_IMU_GYRO.el_GYRO_Y "" FLOAT64_IEEE LINEAR_FUNCTION_M1_T0_U17 1 100 0 0 ECU_ADDRESS 0x0 /end MEASUREMENT
/begin MEASUREMENT ETCSignals.ES910.ES910.CAN2.CAN2.AP_ELLIPSE_IMU_GYRO.el_GYRO_X "" FLOAT64_IEEE LINEAR_FUNCTION_M1_T0_U17 1 100 0 0 ECU_ADDRESS 0x0 /end MEASUREMENT
/begin MEASUREMENT ETCSignals.ES910.ES910.CAN2.CAN2.AP_ELLIPSE_SLIP_CURV.el_AUTO_STATUS "" FLOAT64_IEEE LINEAR_FUNCTION_M1_T0_U1 1 100 0 0 ECU_ADDRESS 0x0 /end MEASUREMENT
/begin MEASUREMENT ETCSignals.ES910.ES910.CAN2.CAN2.AP_ELLIPSE_SLIP_CURV.el_CurvatureRadius "" FLOAT64_IEEE LINEAR_FUNCTION_M1_T0_U18 1 100 0 0 ECU_ADDRESS 0x0 /end MEASUREMENT
/begin MEASUREMENT ETCSignals.ES910.ES910.CAN2.CAN2.AP_ELLIPSE_SLIP_CURV.el_SlipAngle "" FLOAT64_IEEE LINEAR_FUNCTION_M1_T0_U14 1 100 0 0 ECU_ADDRESS 0x0 /end MEASUREMENT
/begin MEASUREMENT ETCSignals.ES910.ES910.CAN2.CAN2.AP_ELLIPSE_SLIP_CURV.el_AngleTrack "" FLOAT64_IEEE LINEAR_FUNCTION_M1_T0_U14 1 100 0 0 ECU_ADDRESS 0x0 /end MEASUREMENT
/begin MEASUREMENT ETCSignals.ES910.ES910.CAN2.CAN2.MEAS_ETAS_Inverter_R_Data.Inv_R_TempMotor "" FLOAT64_IEEE LINEAR_FUNCTION_M1_T0_U1 1 100 -28 227 ECU_ADDRESS 0x0 /end MEASUREMENT
/begin MEASUREMENT ETCSignals.ES910.ES910.CAN2.CAN2.MEAS_ETAS_Inverter_R_Data.Inv_R_TempIGBT "" FLOAT64_IEEE LINEAR_FUNCTION_M1_T0_U1 1 100 -28 227 ECU_ADDRESS 0x0 /end MEASUREMENT
/begin MEASUREMENT ETCSignals.ES910.ES910.CAN2.CAN2.MEAS_ETAS_Inverter_R_Data.Inv_R_Speed "" FLOAT64_IEEE LINEAR_FUNCTION_M1_T0_U1 1 100 -5120 5080 ECU_ADDRESS 0x0 /end MEASUREMENT
/begin MEASUREMENT ETCSignals.ES910.ES910.CAN2.CAN2.MEAS_ETAS_Inverter_R_Data.Inv_R_Iq "" FLOAT64_IEEE LINEAR_FUNCTION_M1_T0_U1 1 100 -320 317.5 ECU_ADDRESS 0x0 /end MEASUREMENT
/begin MEASUREMENT ETCSignals.ES910.ES910.CAN2.CAN2.MEAS_ETAS_Inverter_R_Data.Inv_R_Icommand "" FLOAT64_IEEE LINEAR_FUNCTION_M1_T0_U1 1 100 -320 317.5 ECU_ADDRESS 0x0 /end MEASUREMENT
/begin MEASUREMENT ETCSignals.ES910.ES910.CAN2.CAN2.MEAS_ETAS_Inverter_R_Data.Inv_R_Iactual "" FLOAT64_IEEE LINEAR_FUNCTION_M1_T0_U1 1 100 -320 317.5 ECU_ADDRESS 0x0 /end MEASUREMENT
/begin MEASUREMENT ETCSignals.ES910.ES910.CAN2.CAN2.MEAS_ETAS_Inverter_L_Data.Inv_L_TempMotor "" FLOAT64_IEEE LINEAR_FUNCTION_M1_T0_U1 1 100 -28 227 ECU_ADDRESS 0x0 /end MEASUREMENT
/begin MEASUREMENT ETCSignals.ES910.ES910.CAN2.CAN2.MEAS_ETAS_Inverter_L_Data.Inv_L_TempIGBT "" FLOAT64_IEEE LINEAR_FUNCTION_M1_T0_U1 1 100 -28 227 ECU_ADDRESS 0x0 /end MEASUREMENT
/begin MEASUREMENT ETCSignals.ES910.ES910.CAN2.CAN2.MEAS_ETAS_Inverter_L_Data.Inv_L_Speed "" FLOAT64_IEEE LINEAR_FUNCTION_M1_T0_U1 1 100 -5120 5080 ECU_ADDRESS 0x0 /end MEASUREMENT
/begin MEASUREMENT ETCSignals.ES910.ES910.CAN2.CAN2.MEAS_ETAS_Inverter_L_Data.Inv_L_Iq "" FLOAT64_IEEE LINEAR_FUNCTION_M1_T0_U1 1 100 -320 317.5 ECU_ADDRESS 0x0 /end MEASUREMENT
/begin MEASUREMENT ETCSignals.ES910.ES910.CAN2.CAN2.MEAS_ETAS_Inverter_L_Data.Inv_L_Icommand "" FLOAT64_IEEE LINEAR_FUNCTION_M1_T0_U1 1 100 -320 317.5 ECU_ADDRESS 0x0 /end MEASUREMENT
/begin MEASUREMENT ETCSignals.ES910.ES910.CAN2.CAN2.MEAS_ETAS_Inverter_L_Data.Inv_L_Iactual "" FLOAT64_IEEE LINEAR_FUNCTION_M1_T0_U1 1 100 -320 317.5 ECU_ADDRESS 0x0 /end MEASUREMENT
/begin MEASUREMENT ETCSignals.ES910.ES910.CAN2.CAN2.MEAS_ETAS_VDCdata3.SUSP_R_R "" FLOAT64_IEEE LINEAR_FUNCTION_M1_T0_U19 1 100 -327.68 327.67 ECU_ADDRESS 0x0 /end MEASUREMENT
/begin MEASUREMENT ETCSignals.ES910.ES910.CAN2.CAN2.MEAS_ETAS_VDCdata3.SUSP_R_L "" FLOAT64_IEEE LINEAR_FUNCTION_M1_T0_U19 1 100 -327.68 327.67 ECU_ADDRESS 0x0 /end MEASUREMENT
/begin MEASUREMENT ETCSignals.ES910.ES910.CAN2.CAN2.MEAS_ETAS_VDCdata3.SUSP_F_R "" FLOAT64_IEEE LINEAR_FUNCTION_M1_T0_U19 1 100 -327.68 327.67 ECU_ADDRESS 0x0 /end MEASUREMENT
/begin MEASUREMENT ETCSignals.ES910.ES910.CAN2.CAN2.MEAS_ETAS_VDCdata3.SUSP_F_L "" FLOAT64_IEEE LINEAR_FUNCTION_M1_T0_U19 1 100 -327.68 327.67 ECU_ADDRESS 0x0 /end MEASUREMENT
/begin MEASUREMENT ETCSignals.ES910.ES910.CAN2.CAN2.MEAS_ETAS_VDCdata1.Torque_R "" FLOAT64_IEEE LINEAR_FUNCTION_M1_T0_U20 1 100 -254 254 ECU_ADDRESS 0x0 /end MEASUREMENT
/begin MEASUREMENT ETCSignals.ES910.ES910.CAN2.CAN2.MEAS_ETAS_VDCdata1.Torque_L "" FLOAT64_IEEE LINEAR_FUNCTION_M1_T0_U20 1 100 -256 254 ECU_ADDRESS 0x0 /end MEASUREMENT
/begin MEASUREMENT ETCSignals.ES910.ES910.CAN2.CAN2.MEAS_ETAS_VDCdata5.Handling "" FLOAT64_IEEE LINEAR_FUNCTION_M1_T0_U6 1 100 0 65535 ECU_ADDRESS 0x0 /end MEASUREMENT
/begin MEASUREMENT ETCSignals.ES910.ES910.CAN2.CAN2.MEAS_ETAS_VDCdata5.Mass "" FLOAT64_IEEE LINEAR_FUNCTION_M1_T0_U21 1 100 0 65535 ECU_ADDRESS 0x0 /end MEASUREMENT
/begin MEASUREMENT ETCSignals.ES910.ES910.CAN2.CAN2.MEAS_ETAS_VDCdata4.Throttle "" FLOAT64_IEEE LINEAR_FUNCTION_M1_T0_U22 1 100 0 255 ECU_ADDRESS 0x0 /end MEASUREMENT
/begin MEASUREMENT ETCSignals.ES910.ES910.CAN2.CAN2.MEAS_ETAS_VDCdata4.Max_Fx_RR "" FLOAT64_IEEE LINEAR_FUNCTION_M1_T0_U19 1 100 0 65535 ECU_ADDRESS 0x0 /end MEASUREMENT
/begin MEASUREMENT ETCSignals.ES910.ES910.CAN2.CAN2.MEAS_ETAS_VDCdata4.Max_Fx_RL "" FLOAT64_IEEE LINEAR_FUNCTION_M1_T0_U19 1 100 0 65535 ECU_ADDRESS 0x0 /end MEASUREMENT
/begin MEASUREMENT ETCSignals.ES910.ES910.CAN2.CAN2.MEAS_ETAS_VDCdata4.Fy_R "" FLOAT64_IEEE LINEAR_FUNCTION_M1_T0_U19 1 100 0 65535 ECU_ADDRESS 0x0 /end MEASUREMENT
/begin MEASUREMENT ETCSignals.ES910.ES910.CAN2.CAN2.MEAS_ETAS_VDCdata2.Max_Torque_RR "" FLOAT64_IEEE LINEAR_FUNCTION_M1_T0_U20 1 100 0 65535 ECU_ADDRESS 0x0 /end MEASUREMENT
/begin MEASUREMENT ETCSignals.ES910.ES910.CAN2.CAN2.MEAS_ETAS_VDCdata2.Max_Torque_RL "" FLOAT64_IEEE LINEAR_FUNCTION_M1_T0_U20 1 100 0 65535 ECU_ADDRESS 0x0 /end MEASUREMENT
/begin MEASUREMENT ETCSignals.ES910.ES910.CAN2.CAN2.MEAS_ETAS_VDCdata2.Torque_RRwc "" FLOAT64_IEEE LINEAR_FUNCTION_M1_T0_U20 1 100 0 65535 ECU_ADDRESS 0x0 /end MEASUREMENT
/begin MEASUREMENT ETCSignals.ES910.ES910.CAN2.CAN2.MEAS_ETAS_VDCdata2.Torque_RLwc "" FLOAT64_IEEE LINEAR_FUNCTION_M1_T0_U20 1 100 0 65535 ECU_ADDRESS 0x0 /end MEASUREMENT
/begin MEASUREMENT ETCSignals.ES910.ES910.CAN2.CAN2.AP_RECU_Data.Susp_R_R_Bits "" FLOAT64_IEEE LINEAR_FUNCTION_M1_T0_U7 1 100 0 0 ECU_ADDRESS 0x0 /end MEASUREMENT
/begin MEASUREMENT ETCSignals.ES910.ES910.CAN2.CAN2.AP_RECU_Data.Susp_R_L_Bits "" FLOAT64_IEEE LINEAR_FUNCTION_M1_T0_U7 1 100 0 0 ECU_ADDRESS 0x0 /end MEASUREMENT
/begin MEASUREMENT ETCSignals.ES910.ES910.CAN2.CAN2.NM_FECU_Keep_Alive.Front_Alive "" FLOAT64_IEEE LINEAR_FUNCTION_M1_T0_U1 1 100 0 0 ECU_ADDRESS 0x0 /end MEASUREMENT
/begin MEASUREMENT ETCSignals.ES910.ES910.CAN2.CAN2.NM_RECU_Keep_Alive.Rear_Alive "" FLOAT64_IEEE LINEAR_FUNCTION_M1_T0_U1 1 100 0 0 ECU_ADDRESS 0x0 /end MEASUREMENT
/begin MEASUREMENT ETCSignals.ES910.ES910.CAN2.CAN2.AP_FECU_Data2.BrakePressure_Bits "" FLOAT64_IEEE LINEAR_FUNCTION_M1_T0_U7 1 100 0 0 ECU_ADDRESS 0x0 /end MEASUREMENT
/begin MEASUREMENT ETCSignals.ES910.ES910.CAN2.CAN2.AP_FECU_Data2.Pitot_Bits "" FLOAT64_IEEE LINEAR_FUNCTION_M1_T0_U7 1 100 0 0 ECU_ADDRESS 0x0 /end MEASUREMENT
/begin MEASUREMENT ETCSignals.ES910.ES910.CAN2.CAN2.AP_FECU_Data2.Susp_F_R_Bits "" FLOAT64_IEEE LINEAR_FUNCTION_M1_T0_U7 1 100 0 0 ECU_ADDRESS 0x0 /end MEASUREMENT
/begin MEASUREMENT ETCSignals.ES910.ES910.CAN2.CAN2.AP_FECU_Data2.Susp_F_L_Bits "" FLOAT64_IEEE LINEAR_FUNCTION_M1_T0_U7 1 100 0 0 ECU_ADDRESS 0x0 /end MEASUREMENT
/begin MEASUREMENT ETCSignals.ES910.ES910.CAN2.CAN2.AP_FECU_Data1.SteeringSensor_Bits "" FLOAT64_IEEE LINEAR_FUNCTION_M1_T0_U7 1 100 0 0 ECU_ADDRESS 0x0 /end MEASUREMENT
/begin MEASUREMENT ETCSignals.ES910.ES910.CAN2.CAN2.AP_FECU_Data1.BrakeSensor_Bits "" FLOAT64_IEEE LINEAR_FUNCTION_M1_T0_U7 1 100 0 0 ECU_ADDRESS 0x0 /end MEASUREMENT
/begin MEASUREMENT ETCSignals.ES910.ES910.CAN2.CAN2.AP_FECU_Data1.APPS2_Bits "" FLOAT64_IEEE LINEAR_FUNCTION_M1_T0_U7 1 100 0 0 ECU_ADDRESS 0x0 /end MEASUREMENT
/begin MEASUREMENT ETCSignals.ES910.ES910.CAN2.CAN2.AP_FECU_Data1.APPS1_Bits "" FLOAT64_IEEE LINEAR_FUNCTION_M1_T0_U7 1 100 0 0 ECU_ADDRESS 0x0 /end MEASUREMENT
/begin MEASUREMENT ETCSignals.ES910.ES910.CAN2.CAN2.AP_ETAS_Synchronism.Sync_CAN2 "" FLOAT64_IEEE LINEAR_FUNCTION_M1_T0_U1 1 100 0 255 ECU_ADDRESS 0x0 /end MEASUREMENT
/begin CHARACTERISTIC ETCSignals.ES910.ES910.CAN1.CAN1.AP_ETAS_DashData1.Speed_calibrate "" VALUE 0x0 STANDARD_VALUE_R64 0.0 LINEAR_FUNCTION_M1_T0_U8 -128 127 MAX_REFRESH 6 1 /end CHARACTERISTIC
/begin CHARACTERISTIC ETCSignals.ES910.ES910.CAN1.CAN1.AP_ETAS_DashData1.Precharge_Voltage_calibrate "" VALUE 0x0 STANDARD_VALUE_R64 0.0 LINEAR_FUNCTION_M1_T0_U4 0 655.35 MAX_REFRESH 6 1 /end CHARACTERISTIC
/begin CHARACTERISTIC ETCSignals.ES910.ES910.CAN1.CAN1.AP_ETAS_DashData1.Precharge_Percentage_calibrate "" VALUE 0x0 STANDARD_VALUE_R64 0.0 LINEAR_FUNCTION_M1_T0_U9 0 100 MAX_REFRESH 6 1 /end CHARACTERISTIC
/begin CHARACTERISTIC ETCSignals.ES910.ES910.CAN1.CAN1.AP_ETAS_VDCParams2.VDC_Cte_SKF_calibrate "" VALUE 0x0 STANDARD_VALUE_R64 0.0 LINEAR_FUNCTION_M1_T0_U1 0 1 MAX_REFRESH 6 1 /end CHARACTERISTIC
/begin CHARACTERISTIC ETCSignals.ES910.ES910.CAN1.CAN1.AP_ETAS_VDCParams2.VDC_Cte_CKF_calibrate "" VALUE 0x0 STANDARD_VALUE_R64 0.0 LINEAR_FUNCTION_M1_T0_U1 0 1 MAX_REFRESH 6 1 /end CHARACTERISTIC
/begin CHARACTERISTIC ETCSignals.ES910.ES910.CAN1.CAN1.AP_ETAS_VDCParams.VDC_CKF_Initial_calibrate "" VALUE 0x0 STANDARD_VALUE_R64 0.0 LINEAR_FUNCTION_M1_T0_U6 0 1 MAX_REFRESH 6 1 /end CHARACTERISTIC
/begin CHARACTERISTIC ETCSignals.ES910.ES910.CAN1.CAN1.AP_ETAS_VDCParams.VDC_SKF_Initial_calibrate "" VALUE 0x0 STANDARD_VALUE_R64 0.0 LINEAR_FUNCTION_M1_T0_U6 0 1 MAX_REFRESH 6 1 /end CHARACTERISTIC
/begin CHARACTERISTIC ETCSignals.ES910.ES910.CAN1.CAN1.AP_ETAS_VDCParams.VDC_Power_Limit_calibrate "" VALUE 0x0 STANDARD_VALUE_R64 0.0 LINEAR_FUNCTION_M1_T0_U10 0 85 MAX_REFRESH 6 1 /end CHARACTERISTIC
/begin CHARACTERISTIC ETCSignals.ES910.ES910.CAN1.CAN1.AP_ETAS_VDCParams.VDC_Max_Regen_Motor_Tq_calibrate "" VALUE 0x0 STANDARD_VALUE_R64 0.0 LINEAR_FUNCTION_M1_T0_U1 0 10.2 MAX_REFRESH 6 1 /end CHARACTERISTIC
/begin CHARACTERISTIC ETCSignals.ES910.ES910.CAN1.CAN1.AP_ETAS_VDCParams.VDC_K_Reduction_Temperature_calibrate "" VALUE 0x0 STANDARD_VALUE_R64 0.0 LINEAR_FUNCTION_M1_T0_U1 0 1 MAX_REFRESH 6 1 /end CHARACTERISTIC
/begin CHARACTERISTIC ETCSignals.ES910.ES910.CAN1.CAN1.AP_ETAS_VDCParams.VDC_K_Reduction_P_calibrate "" VALUE 0x0 STANDARD_VALUE_R64 0.0 LINEAR_FUNCTION_M1_T0_U1 0 1 MAX_REFRESH 6 1 /end CHARACTERISTIC
/begin CHARACTERISTIC ETCSignals.ES910.ES910.CAN1.CAN1.AP_ETAS_VDCParams.VDC_APPS_Sat_Up_calibrate "" VALUE 0x0 STANDARD_VALUE_R64 0.0 LINEAR_FUNCTION_M1_T0_U6 0 1 MAX_REFRESH 6 1 /end CHARACTERISTIC
/begin CHARACTERISTIC ETCSignals.ES910.ES910.CAN1.CAN1.AP_ETAS_VDCParams.VDC_APPS_Sat_Down_calibrate "" VALUE 0x0 STANDARD_VALUE_R64 0.0 LINEAR_FUNCTION_M1_T0_U6 0 1 MAX_REFRESH 6 1 /end CHARACTERISTIC
/begin CHARACTERISTIC ETCSignals.ES910.ES910.CAN1.CAN1.AP_ETAS_Inverter_R_Rx.Inverter_R_RegID_calibrate "" VALUE 0x0 STANDARD_VALUE_R64 0.0 LINEAR_FUNCTION_M1_T0_U1 0 255 MAX_REFRESH 6 1 /end CHARACTERISTIC
/begin CHARACTERISTIC ETCSignals.ES910.ES910.CAN1.CAN1.AP_ETAS_Inverter_R_Rx.Inverter_R_b7tob0_calibrate "" VALUE 0x0 STANDARD_VALUE_R64 0.0 LINEAR_FUNCTION_M1_T0_U1 0 255 MAX_REFRESH 6 1 /end CHARACTERISTIC
/begin CHARACTERISTIC ETCSignals.ES910.ES910.CAN1.CAN1.AP_ETAS_Inverter_R_Rx.Inverter_R_b15tob8_calibrate "" VALUE 0x0 STANDARD_VALUE_R64 0.0 LINEAR_FUNCTION_M1_T0_U1 0 255 MAX_REFRESH 6 1 /end CHARACTERISTIC
/begin CHARACTERISTIC ETCSignals.ES910.ES910.CAN1.CAN1.AP_ETAS_Inverter_L_Rx.Inverter_L_RegID_calibrate "" VALUE 0x0 STANDARD_VALUE_R64 0.0 LINEAR_FUNCTION_M1_T0_U1 0 255 MAX_REFRESH 6 1 /end CHARACTERISTIC
/begin CHARACTERISTIC ETCSignals.ES910.ES910.CAN1.CAN1.AP_ETAS_Inverter_L_Rx.Inverter_L_b7tob0_calibrate "" VALUE 0x0 STANDARD_VALUE_R64 0.0 LINEAR_FUNCTION_M1_T0_U1 0 255 MAX_REFRESH 6 1 /end CHARACTERISTIC
/begin CHARACTERISTIC ETCSignals.ES910.ES910.CAN1.CAN1.AP_ETAS_Inverter_L_Rx.Inverter_L_b15tob8_calibrate "" VALUE 0x0 STANDARD_VALUE_R64 0.0 LINEAR_FUNCTION_M1_T0_U1 0 255 MAX_REFRESH 6 1 /end CHARACTERISTIC
/begin CHARACTERISTIC ETCSignals.ES910.ES910.CAN1.CAN1.AP_ETAS_CarState.Car_State_calibrate "" VALUE 0x0 STANDARD_VALUE_R64 0.0 LINEAR_FUNCTION_M1_T0_U1 0 21 MAX_REFRESH 6 1 /end CHARACTERISTIC
/begin CHARACTERISTIC ETCSignals.ES910.ES910.CAN1.CAN1.AP_ETAS_AIRsRequest.AIRs_Request_calibrate "" VALUE 0x0 STANDARD_VALUE_R64 0.0 LINEAR_FUNCTION_M1_T0_U1 0 7 MAX_REFRESH 6 1 /end CHARACTERISTIC
/begin CHARACTERISTIC ETCSignals.ES910.ES910.CAN1.CAN1.MEAS_ETAS_InternalVars.CriticalDisconnection_calibrate "" VALUE 0x0 STANDARD_VALUE_R64 0.0 LINEAR_FUNCTION_M1_T0_U2 0 1 MAX_REFRESH 6 1 /end CHARACTERISTIC
/begin CHARACTERISTIC ETCSignals.ES910.ES910.CAN1.CAN1.MEAS_ETAS_InternalVars.CurrentPathDisconnectionFlag_calibrate "" VALUE 0x0 STANDARD_VALUE_R64 0.0 LINEAR_FUNCTION_M1_T0_U2 0 1 MAX_REFRESH 6 1 /end CHARACTERISTIC
/begin CHARACTERISTIC ETCSignals.ES910.ES910.CAN1.CAN1.MEAS_ETAS_InternalVars.Car_OK_calibrate "" VALUE 0x0 STANDARD_VALUE_R64 0.0 LINEAR_FUNCTION_M1_T0_U2 0 1 MAX_REFRESH 6 1 /end CHARACTERISTIC
/begin CHARACTERISTIC ETCSignals.ES910.ES910.CAN1.CAN1.MEAS_ETAS_InternalVars.Power_calibrate "" VALUE 0x0 STANDARD_VALUE_R64 0.0 LINEAR_FUNCTION_M1_T0_U10 0 255 MAX_REFRESH 6 1 /end CHARACTERISTIC
/begin CHARACTERISTIC ETCSignals.ES910.ES910.CAN1.CAN1.MEAS_ETAS_InternalVars.Torque_OK_calibrate "" VALUE 0x0 STANDARD_VALUE_R64 0.0 LINEAR_FUNCTION_M1_T0_U2 0 1 MAX_REFRESH 6 1 /end CHARACTERISTIC
/begin CHARACTERISTIC ETCSignals.ES910.ES910.CAN1.CAN1.MEAS_ETAS_InternalVars.TV_Mode_calibrate "" VALUE 0x0 STANDARD_VALUE_R64 0.0 LINEAR_FUNCTION_M1_T0_U1 0 7 MAX_REFRESH 6 1 /end CHARACTERISTIC
/begin CHARACTERISTIC ETCSignals.ES910.ES910.CAN1.CAN1.MEAS_ETAS_InternalVars.Critical_Signal_Disconnection_calibrate "" VALUE 0x0 STANDARD_VALUE_R64 0.0 LINEAR_FUNCTION_M1_T0_U2 0 1 MAX_REFRESH 6 1 /end CHARACTERISTIC
/begin CHARACTERISTIC ETCSignals.ES910.ES910.CAN1.CAN1.MEAS_ETAS_InternalVars.Critical_CAN_Disconnection_calibrate "" VALUE 0x0 STANDARD_VALUE_R64 0.0 LINEAR_FUNCTION_M1_T0_U2 0 1 MAX_REFRESH 6 1 /end CHARACTERISTIC
/begin CHARACTERISTIC ETCSignals.ES910.ES910.CAN1.CAN1.MEAS_ETAS_InternalVars.APPS_Implausibility_calibrate "" VALUE 0x0 STANDARD_VALUE_R64 0.0 LINEAR_FUNCTION_M1_T0_U2 0 1 MAX_REFRESH 6 1 /end CHARACTERISTIC
/begin CHARACTERISTIC ETCSignals.ES910.ES910.CAN1.CAN1.NM_ETAS_Disconnections.Disconnection_Pitot_calibrate "" VALUE 0x0 STANDARD_VALUE_R64 0.0 LINEAR_FUNCTION_M1_T0_U2 0 1 MAX_REFRESH 6 1 /end CHARACTERISTIC
/begin CHARACTERISTIC ETCSignals.ES910.ES910.CAN1.CAN1.NM_ETAS_Disconnections.Disconnection_BrakePressure_calibrate "" VALUE 0x0 STANDARD_VALUE_R64 0.0 LINEAR_FUNCTION_M1_T0_U2 0 1 MAX_REFRESH 6 1 /end CHARACTERISTIC
/begin CHARACTERISTIC ETCSignals.ES910.ES910.CAN1.CAN1.NM_ETAS_Disconnections.Disconnection_DashBoard_calibrate "" VALUE 0x0 STANDARD_VALUE_R64 0.0 LINEAR_FUNCTION_M1_T0_U2 0 1 MAX_REFRESH 6 1 /end CHARACTERISTIC
/begin CHARACTERISTIC ETCSignals.ES910.ES910.CAN1.CAN1.NM_ETAS_Disconnections.Disconnection_BMS_calibrate "" VALUE 0x0 STANDARD_VALUE_R64 0.0 LINEAR_FUNCTION_M1_T0_U2 0 1 MAX_REFRESH 6 1 /end CHARACTERISTIC
/begin CHARACTERISTIC ETCSignals.ES910.ES910.CAN1.CAN1.NM_ETAS_Disconnections.Disconnection_Front_calibrate "" VALUE 0x0 STANDARD_VALUE_R64 0.0 LINEAR_FUNCTION_M1_T0_U2 0 1 MAX_REFRESH 6 1 /end CHARACTERISTIC
/begin CHARACTERISTIC ETCSignals.ES910.ES910.CAN1.CAN1.NM_ETAS_Disconnections.Disconnection_Rear_calibrate "" VALUE 0x0 STANDARD_VALUE_R64 0.0 LINEAR_FUNCTION_M1_T0_U2 0 1 MAX_REFRESH 6 1 /end CHARACTERISTIC
/begin CHARACTERISTIC ETCSignals.ES910.ES910.CAN1.CAN1.NM_ETAS_Disconnections.Disconnection_SteeringSensor_calibrate "" VALUE 0x0 STANDARD_VALUE_R64 0.0 LINEAR_FUNCTION_M1_T0_U2 0 1 MAX_REFRESH 6 1 /end CHARACTERISTIC
/begin CHARACTERISTIC ETCSignals.ES910.ES910.CAN1.CAN1.NM_ETAS_Disconnections.Disconnection_Susp_R_R_calibrate "" VALUE 0x0 STANDARD_VALUE_R64 0.0 LINEAR_FUNCTION_M1_T0_U2 0 1 MAX_REFRESH 6 1 /end CHARACTERISTIC
/begin CHARACTERISTIC ETCSignals.ES910.ES910.CAN1.CAN1.NM_ETAS_Disconnections.Disconnection_Susp_R_L_calibrate "" VALUE 0x0 STANDARD_VALUE_R64 0.0 LINEAR_FUNCTION_M1_T0_U2 0 1 MAX_REFRESH 6 1 /end CHARACTERISTIC
/begin CHARACTERISTIC ETCSignals.ES910.ES910.CAN1.CAN1.NM_ETAS_Disconnections.Disconnection_Susp_F_R_calibrate "" VALUE 0x0 STANDARD_VALUE_R64 0.0 LINEAR_FUNCTION_M1_T0_U2 0 1 MAX_REFRESH 6 1 /end CHARACTERISTIC
/begin CHARACTERISTIC ETCSignals.ES910.ES910.CAN1.CAN1.NM_ETAS_Disconnections.Disconnection_Susp_F_L_calibrate "" VALUE 0x0 STANDARD_VALUE_R64 0.0 LINEAR_FUNCTION_M1_T0_U2 0 1 MAX_REFRESH 6 1 /end CHARACTERISTIC
/begin CHARACTERISTIC ETCSignals.ES910.ES910.CAN1.CAN1.NM_ETAS_Disconnections.Disconnection_BrakePedal_calibrate "" VALUE 0x0 STANDARD_VALUE_R64 0.0 LINEAR_FUNCTION_M1_T0_U2 0 1 MAX_REFRESH 6 1 /end CHARACTERISTIC
/begin CHARACTERISTIC ETCSignals.ES910.ES910.CAN1.CAN1.NM_ETAS_Disconnections.Disconnection_APPS2_calibrate "" VALUE 0x0 STANDARD_VALUE_R64 0.0 LINEAR_FUNCTION_M1_T0_U2 0 1 MAX_REFRESH 6 1 /end CHARACTERISTIC
/begin CHARACTERISTIC ETCSignals.ES910.ES910.CAN1.CAN1.NM_ETAS_Disconnections.Disconnection_APPS1_calibrate "" VALUE 0x0 STANDARD_VALUE_R64 0.0 LINEAR_FUNCTION_M1_T0_U2 0 1 MAX_REFRESH 6 1 /end CHARACTERISTIC
/begin CHARACTERISTIC ETCSignals.ES910.ES910.CAN1.CAN1.NM_ETAS_Disconnections.Disconnection_Ellipse_calibrate "" VALUE 0x0 STANDARD_VALUE_R64 0.0 LINEAR_FUNCTION_M1_T0_U2 0 1 MAX_REFRESH 6 1 /end CHARACTERISTIC
/begin CHARACTERISTIC ETCSignals.ES910.ES910.CAN1.CAN1.AP_ETAS_DashData2.SteeringSensor_Value_calibrate "" VALUE 0x0 STANDARD_VALUE_R64 0.0 LINEAR_FUNCTION_M1_T0_U11 -128 127 MAX_REFRESH 6 1 /end CHARACTERISTIC
/begin CHARACTERISTIC ETCSignals.ES910.ES910.CAN1.CAN1.AP_ETAS_DashData2.SKF_actual_calibrate "" VALUE 0x0 STANDARD_VALUE_R64 0.0 LINEAR_FUNCTION_M1_T0_U1 0 25.5 MAX_REFRESH 6 1 /end CHARACTERISTIC
/begin CHARACTERISTIC ETCSignals.ES910.ES910.CAN1.CAN1.AP_ETAS_DashData2.CKF_actual_calibrate "" VALUE 0x0 STANDARD_VALUE_R64 0.0 LINEAR_FUNCTION_M1_T0_U1 0 25.5 MAX_REFRESH 6 1 /end CHARACTERISTIC
/begin CHARACTERISTIC ETCSignals.ES910.ES910.CAN1.CAN1.AP_ETAS_DashData2.BrakeSensor_Value_calibrate "" VALUE 0x0 STANDARD_VALUE_R64 0.0 LINEAR_FUNCTION_M1_T0_U9 0 1 MAX_REFRESH 6 1 /end CHARACTERISTIC
/begin CHARACTERISTIC ETCSignals.ES910.ES910.CAN1.CAN1.AP_ETAS_DashData2.APPS2_Value_calibrate "" VALUE 0x0 STANDARD_VALUE_R64 0.0 LINEAR_FUNCTION_M1_T0_U9 0 1 MAX_REFRESH 6 1 /end CHARACTERISTIC
/begin CHARACTERISTIC ETCSignals.ES910.ES910.CAN1.CAN1.AP_ETAS_DashData2.APPS1_Value_calibrate "" VALUE 0x0 STANDARD_VALUE_R64 0.0 LINEAR_FUNCTION_M1_T0_U9 0 1 MAX_REFRESH 6 1 /end CHARACTERISTIC
/begin CHARACTERISTIC ETCSignals.ES910.ES910.CAN1.CAN1.AP_ETAS_Synchronism.Sync_CAN1_calibrate "" VALUE 0x0 STANDARD_VALUE_R64 0.0 LINEAR_FUNCTION_M1_T0_U1 0 255 MAX_REFRESH 6 1 /end CHARACTERISTIC
/begin CHARACTERISTIC ETCSignals.ES910.ES910.CAN2.CAN2.AP_ETAS_BrakeLight.BrakeLight_Control_calibrate "" VALUE 0x0 STANDARD_VALUE_R64 0.0 LINEAR_FUNCTION_M1_T0_U2 0 1 MAX_REFRESH 6 1 /end CHARACTERISTIC
/begin CHARACTERISTIC ETCSignals.ES910.ES910.CAN2.CAN2.MEAS_ETAS_Inverter_R_Data.Inv_R_TempMotor_calibrate "" VALUE 0x0 STANDARD_VALUE_R64 0.0 LINEAR_FUNCTION_M1_T0_U1 -28 227 MAX_REFRESH 6 1 /end CHARACTERISTIC
/begin CHARACTERISTIC ETCSignals.ES910.ES910.CAN2.CAN2.MEAS_ETAS_Inverter_R_Data.Inv_R_TempIGBT_calibrate "" VALUE 0x0 STANDARD_VALUE_R64 0.0 LINEAR_FUNCTION_M1_T0_U1 -28 227 MAX_REFRESH 6 1 /end CHARACTERISTIC
/begin CHARACTERISTIC ETCSignals.ES910.ES910.CAN2.CAN2.MEAS_ETAS_Inverter_R_Data.Inv_R_Speed_calibrate "" VALUE 0x0 STANDARD_VALUE_R64 0.0 LINEAR_FUNCTION_M1_T0_U1 -5120 5080 MAX_REFRESH 6 1 /end CHARACTERISTIC
/begin CHARACTERISTIC ETCSignals.ES910.ES910.CAN2.CAN2.MEAS_ETAS_Inverter_R_Data.Inv_R_Iq_calibrate "" VALUE 0x0 STANDARD_VALUE_R64 0.0 LINEAR_FUNCTION_M1_T0_U1 -320 317.5 MAX_REFRESH 6 1 /end CHARACTERISTIC
/begin CHARACTERISTIC ETCSignals.ES910.ES910.CAN2.CAN2.MEAS_ETAS_Inverter_R_Data.Inv_R_Icommand_calibrate "" VALUE 0x0 STANDARD_VALUE_R64 0.0 LINEAR_FUNCTION_M1_T0_U1 -320 317.5 MAX_REFRESH 6 1 /end CHARACTERISTIC
/begin CHARACTERISTIC ETCSignals.ES910.ES910.CAN2.CAN2.MEAS_ETAS_Inverter_R_Data.Inv_R_Iactual_calibrate "" VALUE 0x0 STANDARD_VALUE_R64 0.0 LINEAR_FUNCTION_M1_T0_U1 -320 317.5 MAX_REFRESH 6 1 /end CHARACTERISTIC
/begin CHARACTERISTIC ETCSignals.ES910.ES910.CAN2.CAN2.MEAS_ETAS_Inverter_L_Data.Inv_L_TempMotor_calibrate "" VALUE 0x0 STANDARD_VALUE_R64 0.0 LINEAR_FUNCTION_M1_T0_U1 -28 227 MAX_REFRESH 6 1 /end CHARACTERISTIC
/begin CHARACTERISTIC ETCSignals.ES910.ES910.CAN2.CAN2.MEAS_ETAS_Inverter_L_Data.Inv_L_TempIGBT_calibrate "" VALUE 0x0 STANDARD_VALUE_R64 0.0 LINEAR_FUNCTION_M1_T0_U1 -28 227 MAX_REFRESH 6 1 /end CHARACTERISTIC
/begin CHARACTERISTIC ETCSignals.ES910.ES910.CAN2.CAN2.MEAS_ETAS_Inverter_L_Data.Inv_L_Speed_calibrate "" VALUE 0x0 STANDARD_VALUE_R64 0.0 LINEAR_FUNCTION_M1_T0_U1 -5120 5080 MAX_REFRESH 6 1 /end CHARACTERISTIC
/begin CHARACTERISTIC ETCSignals.ES910.ES910.CAN2.CAN2.MEAS_ETAS_Inverter_L_Data.Inv_L_Iq_calibrate "" VALUE 0x0 STANDARD_VALUE_R64 0.0 LINEAR_FUNCTION_M1_T0_U1 -320 317.5 MAX_REFRESH 6 1 /end CHARACTERISTIC
/begin CHARACTERISTIC ETCSignals.ES910.ES910.CAN2.CAN2.MEAS_ETAS_Inverter_L_Data.Inv_L_Icommand_calibrate "" VALUE 0x0 STANDARD_VALUE_R64 0.0 LINEAR_FUNCTION_M1_T0_U1 -320 317.5 MAX_REFRESH 6 1 /end CHARACTERISTIC
/begin CHARACTERISTIC ETCSignals.ES910.ES910.CAN2.CAN2.MEAS_ETAS_Inverter_L_Data.Inv_L_Iactual_calibrate "" VALUE 0x0 STANDARD_VALUE_R64 0.0 LINEAR_FUNCTION_M1_T0_U1 -320 317.5 MAX_REFRESH 6 1 /end CHARACTERISTIC
/begin CHARACTERISTIC ETCSignals.ES910.ES910.CAN2.CAN2.MEAS_ETAS_VDCdata3.SUSP_R_R_calibrate "" VALUE 0x0 STANDARD_VALUE_R64 0.0 LINEAR_FUNCTION_M1_T0_U19 -327.68 327.67 MAX_REFRESH 6 1 /end CHARACTERISTIC
/begin CHARACTERISTIC ETCSignals.ES910.ES910.CAN2.CAN2.MEAS_ETAS_VDCdata3.SUSP_R_L_calibrate "" VALUE 0x0 STANDARD_VALUE_R64 0.0 LINEAR_FUNCTION_M1_T0_U19 -327.68 327.67 MAX_REFRESH 6 1 /end CHARACTERISTIC
/begin CHARACTERISTIC ETCSignals.ES910.ES910.CAN2.CAN2.MEAS_ETAS_VDCdata3.SUSP_F_R_calibrate "" VALUE 0x0 STANDARD_VALUE_R64 0.0 LINEAR_FUNCTION_M1_T0_U19 -327.68 327.67 MAX_REFRESH 6 1 /end CHARACTERISTIC
/begin CHARACTERISTIC ETCSignals.ES910.ES910.CAN2.CAN2.MEAS_ETAS_VDCdata3.SUSP_F_L_calibrate "" VALUE 0x0 STANDARD_VALUE_R64 0.0 LINEAR_FUNCTION_M1_T0_U19 -327.68 327.67 MAX_REFRESH 6 1 /end CHARACTERISTIC
/begin CHARACTERISTIC ETCSignals.ES910.ES910.CAN2.CAN2.MEAS_ETAS_VDCdata1.Torque_R_calibrate "" VALUE 0x0 STANDARD_VALUE_R64 0.0 LINEAR_FUNCTION_M1_T0_U20 -254 254 MAX_REFRESH 6 1 /end CHARACTERISTIC
/begin CHARACTERISTIC ETCSignals.ES910.ES910.CAN2.CAN2.MEAS_ETAS_VDCdata1.Torque_L_calibrate "" VALUE 0x0 STANDARD_VALUE_R64 0.0 LINEAR_FUNCTION_M1_T0_U20 -256 254 MAX_REFRESH 6 1 /end CHARACTERISTIC
/begin CHARACTERISTIC ETCSignals.ES910.ES910.CAN2.CAN2.MEAS_ETAS_VDCdata5.Handling_calibrate "" VALUE 0x0 STANDARD_VALUE_R64 0.0 LINEAR_FUNCTION_M1_T0_U6 0 65535 MAX_REFRESH 6 1 /end CHARACTERISTIC
/begin CHARACTERISTIC ETCSignals.ES910.ES910.CAN2.CAN2.MEAS_ETAS_VDCdata5.Mass_calibrate "" VALUE 0x0 STANDARD_VALUE_R64 0.0 LINEAR_FUNCTION_M1_T0_U21 0 65535 MAX_REFRESH 6 1 /end CHARACTERISTIC
/begin CHARACTERISTIC ETCSignals.ES910.ES910.CAN2.CAN2.MEAS_ETAS_VDCdata4.Throttle_calibrate "" VALUE 0x0 STANDARD_VALUE_R64 0.0 LINEAR_FUNCTION_M1_T0_U22 0 255 MAX_REFRESH 6 1 /end CHARACTERISTIC
/begin CHARACTERISTIC ETCSignals.ES910.ES910.CAN2.CAN2.MEAS_ETAS_VDCdata4.Max_Fx_RR_calibrate "" VALUE 0x0 STANDARD_VALUE_R64 0.0 LINEAR_FUNCTION_M1_T0_U19 0 65535 MAX_REFRESH 6 1 /end CHARACTERISTIC
/begin CHARACTERISTIC ETCSignals.ES910.ES910.CAN2.CAN2.MEAS_ETAS_VDCdata4.Max_Fx_RL_calibrate "" VALUE 0x0 STANDARD_VALUE_R64 0.0 LINEAR_FUNCTION_M1_T0_U19 0 65535 MAX_REFRESH 6 1 /end CHARACTERISTIC
/begin CHARACTERISTIC ETCSignals.ES910.ES910.CAN2.CAN2.MEAS_ETAS_VDCdata4.Fy_R_calibrate "" VALUE 0x0 STANDARD_VALUE_R64 0.0 LINEAR_FUNCTION_M1_T0_U19 0 65535 MAX_REFRESH 6 1 /end CHARACTERISTIC
/begin CHARACTERISTIC ETCSignals.ES910.ES910.CAN2.CAN2.MEAS_ETAS_VDCdata2.Max_Torque_RR_calibrate "" VALUE 0x0 STANDARD_VALUE_R64 0.0 LINEAR_FUNCTION_M1_T0_U20 0 65535 MAX_REFRESH 6 1 /end CHARACTERISTIC
/begin CHARACTERISTIC ETCSignals.ES910.ES910.CAN2.CAN2.MEAS_ETAS_VDCdata2.Max_Torque_RL_calibrate "" VALUE 0x0 STANDARD_VALUE_R64 0.0 LINEAR_FUNCTION_M1_T0_U20 0 65535 MAX_REFRESH 6 1 /end CHARACTERISTIC
/begin CHARACTERISTIC ETCSignals.ES910.ES910.CAN2.CAN2.MEAS_ETAS_VDCdata2.Torque_RRwc_calibrate "" VALUE 0x0 STANDARD_VALUE_R64 0.0 LINEAR_FUNCTION_M1_T0_U20 0 65535 MAX_REFRESH 6 1 /end CHARACTERISTIC
/begin CHARACTERISTIC ETCSignals.ES910.ES910.CAN2.CAN2.MEAS_ETAS_VDCdata2.Torque_RLwc_calibrate "" VALUE 0x0 STANDARD_VALUE_R64 0.0 LINEAR_FUNCTION_M1_T0_U20 0 65535 MAX_REFRESH 6 1 /end CHARACTERISTIC
/begin CHARACTERISTIC ETCSignals.ES910.ES910.CAN2.CAN2.AP_ETAS_Synchronism.Sync_CAN2_calibrate "" VALUE 0x0 STANDARD_VALUE_R64 0.0 LINEAR_FUNCTION_M1_T0_U1 0 255 MAX_REFRESH 6 1 /end CHARACTERISTIC
/begin COMPU_METHOD LINEAR_FUNCTION_M1_T0_U1 "" RAT_FUNC "%8.4" "" COEFFS 0 1 0 0 0 1 /end COMPU_METHOD
/begin COMPU_METHOD LINEAR_FUNCTION_M1_T0_U2 "" RAT_FUNC "%8.4" "Bit" COEFFS 0 1 0 0 0 1 /end COMPU_METHOD
/begin COMPU_METHOD LINEAR_FUNCTION_M1_T0_U3 "" RAT_FUNC "%8.4" "A" COEFFS 0 1 0 0 0 1 /end COMPU_METHOD
/begin COMPU_METHOD LINEAR_FUNCTION_M1_T0_U4 "" RAT_FUNC "%8.4" "V" COEFFS 0 1 0 0 0 1 /end COMPU_METHOD
/begin COMPU_METHOD LINEAR_FUNCTION_M1_T0_U5 "" RAT_FUNC "%8.4" "┬║C" COEFFS 0 1 0 0 0 1 /end COMPU_METHOD
/begin COMPU_METHOD LINEAR_FUNCTION_M1_T0_U6 "" RAT_FUNC "%8.4" "-" COEFFS 0 1 0 0 0 1 /end COMPU_METHOD
/begin COMPU_METHOD LINEAR_FUNCTION_M1_T0_U7 "" RAT_FUNC "%8.4" "Bits" COEFFS 0 1 0 0 0 1 /end COMPU_METHOD
/begin COMPU_METHOD LINEAR_FUNCTION_M1_T0_U8 "" RAT_FUNC "%8.4" "km/h" COEFFS 0 1 0 0 0 1 /end COMPU_METHOD
/begin COMPU_METHOD LINEAR_FUNCTION_M1_T0_U9 "" RAT_FUNC "%8.4" "1%" COEFFS 0 1 0 0 0 1 /end COMPU_METHOD
/begin COMPU_METHOD LINEAR_FUNCTION_M1_T0_U10 "" RAT_FUNC "%8.4" "kW" COEFFS 0 1 0 0 0 1 /end COMPU_METHOD
/begin COMPU_METHOD LINEAR_FUNCTION_M1_T0_U11 "" RAT_FUNC "%8.4" "┬║" COEFFS 0 1 0 0 0 1 /end COMPU_METHOD
/begin COMPU_METHOD LINEAR_FUNCTION_M1_T0_U12 "" RAT_FUNC "%8.4" "┬░" COEFFS 0 1 0 0 0 1 /end COMPU_METHOD
/begin COMPU_METHOD LINEAR_FUNCTION_M1_T0_U13 "" RAT_FUNC "%8.4" "m.s-2" COEFFS 0 1 0 0 0 1 /end COMPU_METHOD
/begin COMPU_METHOD LINEAR_FUNCTION_M1_T0_U14 "" RAT_FUNC "%8.4" "rad" COEFFS 0 1 0 0 0 1 /end COMPU_METHOD
/begin COMPU_METHOD LINEAR_FUNCTION_M1_T0_U15 "" RAT_FUNC "%8.4" "m.s-1" COEFFS 0 1 0 0 0 1 /end COMPU_METHOD
/begin COMPU_METHOD LINEAR_FUNCTION_M1_T0_U16 "" RAT_FUNC "%8.4" "s" COEFFS 0 1 0 0 0 1 /end COMPU_METHOD
/begin COMPU_METHOD LINEAR_FUNCTION_M1_T0_U17 "" RAT_FUNC "%8.4" "rad.s-1" COEFFS 0 1 0 0 0 1 /end COMPU_METHOD
/begin COMPU_METHOD LINEAR_FUNCTION_M1_T0_U18 "" RAT_FUNC "%8.4" "m" COEFFS 0 1 0 0 0 1 /end COMPU_METHOD
/begin COMPU_METHOD LINEAR_FUNCTION_M1_T0_U19 "" RAT_FUNC "%8.4" "N" COEFFS 0 1 0 0 0 1 /end COMPU_METHOD
/begin COMPU_METHOD LINEAR_FUNCTION_M1_T0_U20 "" RAT_FUNC "%8.4" "Nm" COEFFS 0 1 0 0 0 1 /end COMPU_METHOD
/begin COMPU_METHOD LINEAR_FUNCTION_M1_T0_U21 "" RAT_FUNC "%8.4" "Kg" COEFFS 0 1 0 0 0 1 /end COMPU_METHOD
/begin COMPU_METHOD LINEAR_FUNCTION_M1_T0_U22 "" RAT_FUNC "%8.4" "%" COEFFS 0 1 0 0 0 1 /end COMPU_METHOD
/begin RECORD_LAYOUT STANDARD_VALUE_R64 FNC_VALUES 1 FLOAT64_IEEE COLUMN_DIR DIRECT /end RECORD_LAYOUT
/begin GROUP ETCSignals "" ROOT
 /begin REF_MEASUREMENT ETCSignals.ES910.ES910.CAN1.Presence.PresenceGroup.PresenceFlag ETCSignals.ES910.ES910.CAN1.CAN1.AP_BMS_SDC.Shutdown_PackageIntck ETCSignals.ES910.ES910.CAN1.CAN1.AP_BMS_SDC.Shutdown_IMD ETCSignals.ES910.ES910.CAN1.CAN1.AP_BMS_SDC.Shutdown_BMS ETCSignals.ES910.ES910.CAN1.CAN1.AP_CurrentSensor.ERROR ETCSignals.ES910.ES910.CAN1.CAN1.AP_CurrentSensor.Accumulator_Current ETCSignals.ES910.ES910.CAN1.CAN1.AP_BMS_Voltages.Lowest_CellVoltage ETCSignals.ES910.ES910.CAN1.CAN1.AP_BMS_Voltages.Highest_CellVoltage ETCSignals.ES910.ES910.CAN1.CAN1.AP_BMS_Voltages.Accumulator_Voltage ETCSignals.ES910.ES910.CAN1.CAN1.AP_BMS_ChargerParameters.Charger_MaxVoltage ETCSignals.ES910.ES910.CAN1.CAN1.AP_BMS_ChargerParameters.Charger_MaxCurrent ETCSignals.ES910.ES910.CAN1.CAN1.AP_BMS_BatteryTemperatures.Lowest_CellTemp ETCSignals.ES910.ES910.CAN1.CAN1.AP_BMS_BatteryTemperatures.Highest_CellTemp ETCSignals.ES910.ES910.CAN1.CAN1.AP_BMS_BatteryTemperatures.Average_CellTemp ETCSignals.ES910.ES910.CAN1.CAN1.AP_Inverter_R_Tx.Inv_R_RegID ETCSignals.ES910.ES910.CAN1.CAN1.AP_Inverter_R_Tx.Inv_R_RegID_M73_Inv_R_TempMotor ETCSignals.ES910.ES910.CAN1.CAN1.AP_Inverter_R_Tx.Inv_R_RegID_M74_Inv_R_TempIGBT ETCSignals.ES910.ES910.CAN1.CAN1.AP_Inverter_R_Tx.Inv_R_RegID_M48_Inv_R_Speed ETCSignals.ES910.ES910.CAN1.CAN1.AP_Inverter_R_Tx.Inv_R_RegID_M39_Inv_R_Iq ETCSignals.ES910.ES910.CAN1.CAN1.AP_Inverter_R_Tx.Inv_R_RegID_M38_Inv_R_Icommand ETCSignals.ES910.ES910.CAN1.CAN1.AP_Inverter_R_Tx.Inv_R_RegID_M32_Inv_R_Iactual ETCSignals.ES910.ES910.CAN1.CAN1.AP_Inverter_R_Tx.Inv_R_RegID_M232_Inv_R_Enable ETCSignals.ES910.ES910.CAN1.CAN1.AP_Inverter_R_Tx.Inv_R_RegID_M235_Inv_R_DCBus ETCSignals.ES910.ES910.CAN1.CAN1.AP_Inverter_L_Tx.Inv_L_RegID ETCSignals.ES910.ES910.CAN1.CAN1.AP_Inverter_L_Tx.Inv_L_RegID_M73_Inv_L_TempMotor ETCSignals.ES910.ES910.CAN1.CAN1.AP_Inverter_L_Tx.Inv_L_RegID_M74_Inv_L_TempIGBT ETCSignals.ES910.ES910.CAN1.CAN1.AP_Inverter_L_Tx.Inv_L_RegID_M48_Inv_L_Speed ETCSignals.ES910.ES910.CAN1.CAN1.AP_Inverter_L_Tx.Inv_L_RegID_M39_Inv_L_Iq ETCSignals.ES910.ES910.CAN1.CAN1.AP_Inverter_L_Tx.Inv_L_RegID_M38_Inv_L_Icommand ETCSignals.ES910.ES910.CAN1.CAN1.AP_Inverter_L_Tx.Inv_L_RegID_M32_Inv_L_Iactual ETCSignals.ES910.ES910.CAN1.CAN1.AP_Inverter_L_Tx.Inv_L_RegID_M232_Inv_L_Enable ETCSignals.ES910.ES910.CAN1.CAN1.AP_Inverter_L_Tx.Inv_L_RegID_M235_Inv_L_DCBus ETCSignals.ES910.ES910.CAN1.CAN1.AP_DASH_CustomMode.CustomMode_Identifier ETCSignals.ES910.ES910.CAN1.CAN1.AP_DASH_CustomMode.CustomMode_Data ETCSignals.ES910.ES910.CAN1.CAN1.AP_DASH_Mode.RacingMode ETCSignals.ES910.ES910.CAN1.CAN1.NM_BMS_Keep_Alive.BMS_Alive ETCSignals.ES910.ES910.CAN1.CAN1.AP_BMS_AIRs_State.AIRs_State ETCSignals.ES910.ES910.CAN1.CAN1.NM_DASH_Keep_Alive.Dash_Alive ETCSignals.ES910.ES910.CAN1.CAN1.AP_DASH_TorqueLockOn.Torque_LockOn ETCSignals.ES910.ES910.CAN1.CAN1.AP_DASH_PrechargeRequest.PrechargeRequest ETCSignals.ES910.ES910.CAN1.CAN1.AP_DASH_EnableDrive.EnableDrive_Order ETCSignals.ES910.ES910.CAN1.CAN1.AP_ETAS_DashData1.Speed ETCSignals.ES910.ES910.CAN1.CAN1.AP_ETAS_DashData1.Precharge_Voltage ETCSignals.ES910.ES910.CAN1.CAN1.AP_ETAS_DashData1.Precharge_Percentage ETCSignals.ES910.ES910.CAN1.CAN1.AP_ETAS_VDCParams2.VDC_Cte_SKF ETCSignals.ES910.ES910.CAN1.CAN1.AP_ETAS_VDCParams2.VDC_Cte_CKF ETCSignals.ES910.ES910.CAN1.CAN1.AP_ETAS_VDCParams.VDC_CKF_Initial ETCSignals.ES910.ES910.CAN1.CAN1.AP_ETAS_VDCParams.VDC_SKF_Initial ETCSignals.ES910.ES910.CAN1.CAN1.AP_ETAS_VDCParams.VDC_Power_Limit ETCSignals.ES910.ES910.CAN1.CAN1.AP_ETAS_VDCParams.VDC_Max_Regen_Motor_Tq ETCSignals.ES910.ES910.CAN1.CAN1.AP_ETAS_VDCParams.VDC_K_Reduction_Temperature ETCSignals.ES910.ES910.CAN1.CAN1.AP_ETAS_VDCParams.VDC_K_Reduction_P ETCSignals.ES910.ES910.CAN1.CAN1.AP_ETAS_VDCParams.VDC_APPS_Sat_Up ETCSignals.ES910.ES910.CAN1.CAN1.AP_ETAS_VDCParams.VDC_APPS_Sat_Down ETCSignals.ES910.ES910.CAN1.CAN1.AP_ETAS_Inverter_R_Rx.Inverter_R_RegID ETCSignals.ES910.ES910.CAN1.CAN1.AP_ETAS_Inverter_R_Rx.Inverter_R_b7tob0 ETCSignals.ES910.ES910.CAN1.CAN1.AP_ETAS_Inverter_R_Rx.Inverter_R_b15tob8 ETCSignals.ES910.ES910.CAN1.CAN1.AP_ETAS_Inverter_L_Rx.Inverter_L_RegID ETCSignals.ES910.ES910.CAN1.CAN1.AP_ETAS_Inverter_L_Rx.Inverter_L_b7tob0 ETCSignals.ES910.ES910.CAN1.CAN1.AP_ETAS_Inverter_L_Rx.Inverter_L_b15tob8 ETCSignals.ES910.ES910.CAN1.CAN1.AP_ETAS_CarState.Car_State ETCSignals.ES910.ES910.CAN1.CAN1.AP_ETAS_AIRsRequest.AIRs_Request ETCSignals.ES910.ES910.CAN1.CAN1.MEAS_ETAS_InternalVars.CriticalDisconnection ETCSignals.ES910.ES910.CAN1.CAN1.MEAS_ETAS_InternalVars.CurrentPathDisconnectionFlag ETCSignals.ES910.ES910.CAN1.CAN1.MEAS_ETAS_InternalVars.Car_OK ETCSignals.ES910.ES910.CAN1.CAN1.MEAS_ETAS_InternalVars.Power ETCSignals.ES910.ES910.CAN1.CAN1.MEAS_ETAS_InternalVars.Torque_OK ETCSignals.ES910.ES910.CAN1.CAN1.MEAS_ETAS_InternalVars.TV_Mode ETCSignals.ES910.ES910.CAN1.CAN1.MEAS_ETAS_InternalVars.Critical_Signal_Disconnection ETCSignals.ES910.ES910.CAN1.CAN1.MEAS_ETAS_InternalVars.Critical_CAN_Disconnection ETCSignals.ES910.ES910.CAN1.CAN1.MEAS_ETAS_InternalVars.APPS_Implausibility ETCSignals.ES910.ES910.CAN1.CAN1.NM_ETAS_Disconnections.Disconnection_Pitot ETCSignals.ES910.ES910.CAN1.CAN1.NM_ETAS_Disconnections.Disconnection_BrakePressure ETCSignals.ES910.ES910.CAN1.CAN1.NM_ETAS_Disconnections.Disconnection_DashBoard ETCSignals.ES910.ES910.CAN1.CAN1.NM_ETAS_Disconnections.Disconnection_BMS ETCSignals.ES910.ES910.CAN1.CAN1.NM_ETAS_Disconnections.Disconnection_Front ETCSignals.ES910.ES910.CAN1.CAN1.NM_ETAS_Disconnections.Disconnection_Rear ETCSignals.ES910.ES910.CAN1.CAN1.NM_ETAS_Disconnections.Disconnection_SteeringSensor ETCSignals.ES910.ES910.CAN1.CAN1.NM_ETAS_Disconnections.Disconnection_Susp_R_R ETCSignals.ES910.ES910.CAN1.CAN1.NM_ETAS_Disconnections.Disconnection_Susp_R_L ETCSignals.ES910.ES910.CAN1.CAN1.NM_ETAS_Disconnections.Disconnection_Susp_F_R ETCSignals.ES910.ES910.CAN1.CAN1.NM_ETAS_Disconnections.Disconnection_Susp_F_L ETCSignals.ES910.ES910.CAN1.CAN1.NM_ETAS_Disconnections.Disconnection_BrakePedal ETCSignals.ES910.ES910.CAN1.CAN1.NM_ETAS_Disconnections.Disconnection_APPS2 ETCSignals.ES910.ES910.CAN1.CAN1.NM_ETAS_Disconnections.Disconnection_APPS1 ETCSignals.ES910.ES910.CAN1.CAN1.NM_ETAS_Disconnections.Disconnection_Ellipse ETCSignals.ES910.ES910.CAN1.CAN1.AP_ETAS_DashData2.SteeringSensor_Value ETCSignals.ES910.ES910.CAN1.CAN1.AP_ETAS_DashData2.SKF_actual ETCSignals.ES910.ES910.CAN1.CAN1.AP_ETAS_DashData2.CKF_actual ETCSignals.ES910.ES910.CAN1.CAN1.AP_ETAS_DashData2.BrakeSensor_Value ETCSignals.ES910.ES910.CAN1.CAN1.AP_ETAS_DashData2.APPS2_Value ETCSignals.ES910.ES910.CAN1.CAN1.AP_ETAS_DashData2.APPS1_Value ETCSignals.ES910.ES910.CAN1.CAN1.AP_ETAS_Synchronism.Sync_CAN1 ETCSignals.ES910.ES910.CAN2.Presence.PresenceGroup.PresenceFlag ETCSignals.ES910.ES910.CAN2.CAN2.AP_ETAS_BrakeLight.BrakeLight_Control ETCSignals.ES910.ES910.CAN2.CAN2.MEAS_RECU_SDC.Shutdown_TSMS_TSMP ETCSignals.ES910.ES910.CAN2.CAN2.MEAS_RECU_SDC.Shutdown_HVD ETCSignals.ES910.ES910.CAN2.CAN2.MEAS_RECU_SDC.Shutdown_HVBox ETCSignals.ES910.ES910.CAN2.CAN2.MEAS_RECU_SDC.Shutdown_LeftTS ETCSignals.ES910.ES910.CAN2.CAN2.MEAS_RECU_SDC.Shutdown_RightTS ETCSignals.ES910.ES910.CAN2.CAN2.MEAS_FECU_SDC.Shutdown_SC_BOTS ETCSignals.ES910.ES910.CAN2.CAN2.MEAS_FECU_SDC.Shutdown_BSPD_Inertia ETCSignals.ES910.ES910.CAN2.CAN2.MEAS_FECU_SDC.Shutdown_Setas ETCSignals.ES910.ES910.CAN2.CAN2.AP_ELLIPSE_EKF_POS.el_LONGITUDE_EKF ETCSignals.ES910.ES910.CAN2.CAN2.AP_ELLIPSE_EKF_POS.el_LATITUDE_EKF ETCSignals.ES910.ES910.CAN2.CAN2.AP_ELLIPSE_IMU_ACCEL.el_ACCEL_Z ETCSignals.ES910.ES910.CAN2.CAN2.AP_ELLIPSE_IMU_ACCEL.el_ACCEL_Y ETCSignals.ES910.ES910.CAN2.CAN2.AP_ELLIPSE_IMU_ACCEL.el_ACCEL_X ETCSignals.ES910.ES910.CAN2.CAN2.AP_ELLIPSE_EKF_EULER.el_YAW ETCSignals.ES910.ES910.CAN2.CAN2.AP_ELLIPSE_EKF_EULER.el_PITCH ETCSignals.ES910.ES910.CAN2.CAN2.AP_ELLIPSE_EKF_EULER.el_ROLL ETCSignals.ES910.ES910.CAN2.CAN2.AP_ELLIPSE_EKF_VEL.el_Vel_Z ETCSignals.ES910.ES910.CAN2.CAN2.AP_ELLIPSE_EKF_VEL.el_Vel_Y ETCSignals.ES910.ES910.CAN2.CAN2.AP_ELLIPSE_EKF_VEL.el_Vel_X ETCSignals.ES910.ES910.CAN2.CAN2.NM_ELLIPSE_Status.el_CLOCK ETCSignals.ES910.ES910.CAN2.CAN2.NM_ELLIPSE_Status.el_GENERAL ETCSignals.ES910.ES910.CAN2.CAN2.NM_ELLIPSE_Status.Ellipse_Alive ETCSignals.ES910.ES910.CAN2.CAN2.AP_ELLIPSE_IMU_GYRO.el_GYRO_Z ETCSignals.ES910.ES910.CAN2.CAN2.AP_ELLIPSE_IMU_GYRO.el_GYRO_Y ETCSignals.ES910.ES910.CAN2.CAN2.AP_ELLIPSE_IMU_GYRO.el_GYRO_X ETCSignals.ES910.ES910.CAN2.CAN2.AP_ELLIPSE_SLIP_CURV.el_AUTO_STATUS ETCSignals.ES910.ES910.CAN2.CAN2.AP_ELLIPSE_SLIP_CURV.el_CurvatureRadius ETCSignals.ES910.ES910.CAN2.CAN2.AP_ELLIPSE_SLIP_CURV.el_SlipAngle ETCSignals.ES910.ES910.CAN2.CAN2.AP_ELLIPSE_SLIP_CURV.el_AngleTrack ETCSignals.ES910.ES910.CAN2.CAN2.MEAS_ETAS_Inverter_R_Data.Inv_R_TempMotor ETCSignals.ES910.ES910.CAN2.CAN2.MEAS_ETAS_Inverter_R_Data.Inv_R_TempIGBT ETCSignals.ES910.ES910.CAN2.CAN2.MEAS_ETAS_Inverter_R_Data.Inv_R_Speed ETCSignals.ES910.ES910.CAN2.CAN2.MEAS_ETAS_Inverter_R_Data.Inv_R_Iq ETCSignals.ES910.ES910.CAN2.CAN2.MEAS_ETAS_Inverter_R_Data.Inv_R_Icommand ETCSignals.ES910.ES910.CAN2.CAN2.MEAS_ETAS_Inverter_R_Data.Inv_R_Iactual ETCSignals.ES910.ES910.CAN2.CAN2.MEAS_ETAS_Inverter_L_Data.Inv_L_TempMotor ETCSignals.ES910.ES910.CAN2.CAN2.MEAS_ETAS_Inverter_L_Data.Inv_L_TempIGBT ETCSignals.ES910.ES910.CAN2.CAN2.MEAS_ETAS_Inverter_L_Data.Inv_L_Speed ETCSignals.ES910.ES910.CAN2.CAN2.MEAS_ETAS_Inverter_L_Data.Inv_L_Iq ETCSignals.ES910.ES910.CAN2.CAN2.MEAS_ETAS_Inverter_L_Data.Inv_L_Icommand ETCSignals.ES910.ES910.CAN2.CAN2.MEAS_ETAS_Inverter_L_Data.Inv_L_Iactual ETCSignals.ES910.ES910.CAN2.CAN2.MEAS_ETAS_VDCdata3.SUSP_R_R ETCSignals.ES910.ES910.CAN2.CAN2.MEAS_ETAS_VDCdata3.SUSP_R_L ETCSignals.ES910.ES910.CAN2.CAN2.MEAS_ETAS_VDCdata3.SUSP_F_R ETCSignals.ES910.ES910.CAN2.CAN2.MEAS_ETAS_VDCdata3.SUSP_F_L ETCSignals.ES910.ES910.CAN2.CAN2.MEAS_ETAS_VDCdata1.Torque_R ETCSignals.ES910.ES910.CAN2.CAN2.MEAS_ETAS_VDCdata1.Torque_L ETCSignals.ES910.ES910.CAN2.CAN2.MEAS_ETAS_VDCdata5.Handling ETCSignals.ES910.ES910.CAN2.CAN2.MEAS_ETAS_VDCdata5.Mass ETCSignals.ES910.ES910.CAN2.CAN2.MEAS_ETAS_VDCdata4.Throttle ETCSignals.ES910.ES910.CAN2.CAN2.MEAS_ETAS_VDCdata4.Max_Fx_RR ETCSignals.ES910.ES910.CAN2.CAN2.MEAS_ETAS_VDCdata4.Max_Fx_RL ETCSignals.ES910.ES910.CAN2.CAN2.MEAS_ETAS_VDCdata4.Fy_R ETCSignals.ES910.ES910.CAN2.CAN2.MEAS_ETAS_VDCdata2.Max_Torque_RR ETCSignals.ES910.ES910.CAN2.CAN2.MEAS_ETAS_VDCdata2.Max_Torque_RL ETCSignals.ES910.ES910.CAN2.CAN2.MEAS_ETAS_VDCdata2.Torque_RRwc ETCSignals.ES910.ES910.CAN2.CAN2.MEAS_ETAS_VDCdata2.Torque_RLwc ETCSignals.ES910.ES910.CAN2.CAN2.AP_RECU_Data.Susp_R_R_Bits ETCSignals.ES910.ES910.CAN2.CAN2.AP_RECU_Data.Susp_R_L_Bits ETCSignals.ES910.ES910.CAN2.CAN2.NM_FECU_Keep_Alive.Front_Alive ETCSignals.ES910.ES910.CAN2.CAN2.NM_RECU_Keep_Alive.Rear_Alive ETCSignals.ES910.ES910.CAN2.CAN2.AP_FECU_Data2.BrakePressure_Bits ETCSignals.ES910.ES910.CAN2.CAN2.AP_FECU_Data2.Pitot_Bits ETCSignals.ES910.ES910.CAN2.CAN2.AP_FECU_Data2.Susp_F_R_Bits ETCSignals.ES910.ES910.CAN2.CAN2.AP_FECU_Data2.Susp_F_L_Bits ETCSignals.ES910.ES910.CAN2.CAN2.AP_FECU_Data1.SteeringSensor_Bits ETCSignals.ES910.ES910.CAN2.CAN2.AP_FECU_Data1.BrakeSensor_Bits ETCSignals.ES910.ES910.CAN2.CAN2.AP_FECU_Data1.APPS2_Bits ETCSignals.ES910.ES910.CAN2.CAN2.AP_FECU_Data1.APPS1_Bits ETCSignals.ES910.ES910.CAN2.CAN2.AP_ETAS_Synchronism.Sync_CAN2 /end REF_MEASUREMENT
 /begin REF_CHARACTERISTIC ETCSignals.ES910.ES910.CAN1.CAN1.AP_ETAS_DashData1.Speed_calibrate ETCSignals.ES910.ES910.CAN1.CAN1.AP_ETAS_DashData1.Precharge_Voltage_calibrate ETCSignals.ES910.ES910.CAN1.CAN1.AP_ETAS_DashData1.Precharge_Percentage_calibrate ETCSignals.ES910.ES910.CAN1.CAN1.AP_ETAS_VDCParams2.VDC_Cte_SKF_calibrate ETCSignals.ES910.ES910.CAN1.CAN1.AP_ETAS_VDCParams2.VDC_Cte_CKF_calibrate ETCSignals.ES910.ES910.CAN1.CAN1.AP_ETAS_VDCParams.VDC_CKF_Initial_calibrate ETCSignals.ES910.ES910.CAN1.CAN1.AP_ETAS_VDCParams.VDC_SKF_Initial_calibrate ETCSignals.ES910.ES910.CAN1.CAN1.AP_ETAS_VDCParams.VDC_Power_Limit_calibrate ETCSignals.ES910.ES910.CAN1.CAN1.AP_ETAS_VDCParams.VDC_Max_Regen_Motor_Tq_calibrate ETCSignals.ES910.ES910.CAN1.CAN1.AP_ETAS_VDCParams.VDC_K_Reduction_Temperature_calibrate ETCSignals.ES910.ES910.CAN1.CAN1.AP_ETAS_VDCParams.VDC_K_Reduction_P_calibrate ETCSignals.ES910.ES910.CAN1.CAN1.AP_ETAS_VDCParams.VDC_APPS_Sat_Up_calibrate ETCSignals.ES910.ES910.CAN1.CAN1.AP_ETAS_VDCParams.VDC_APPS_Sat_Down_calibrate ETCSignals.ES910.ES910.CAN1.CAN1.AP_ETAS_Inverter_R_Rx.Inverter_R_RegID_calibrate ETCSignals.ES910.ES910.CAN1.CAN1.AP_ETAS_Inverter_R_Rx.Inverter_R_b7tob0_calibrate ETCSignals.ES910.ES910.CAN1.CAN1.AP_ETAS_Inverter_R_Rx.Inverter_R_b15tob8_calibrate ETCSignals.ES910.ES910.CAN1.CAN1.AP_ETAS_Inverter_L_Rx.Inverter_L_RegID_calibrate ETCSignals.ES910.ES910.CAN1.CAN1.AP_ETAS_Inverter_L_Rx.Inverter_L_b7tob0_calibrate ETCSignals.ES910.ES910.CAN1.CAN1.AP_ETAS_Inverter_L_Rx.Inverter_L_b15tob8_calibrate ETCSignals.ES910.ES910.CAN1.CAN1.AP_ETAS_CarState.Car_State_calibrate ETCSignals.ES910.ES910.CAN1.CAN1.AP_ETAS_AIRsRequest.AIRs_Request_calibrate ETCSignals.ES910.ES910.CAN1.CAN1.MEAS_ETAS_InternalVars.CriticalDisconnection_calibrate ETCSignals.ES910.ES910.CAN1.CAN1.MEAS_ETAS_InternalVars.CurrentPathDisconnectionFlag_calibrate ETCSignals.ES910.ES910.CAN1.CAN1.MEAS_ETAS_InternalVars.Car_OK_calibrate ETCSignals.ES910.ES910.CAN1.CAN1.MEAS_ETAS_InternalVars.Power_calibrate ETCSignals.ES910.ES910.CAN1.CAN1.MEAS_ETAS_InternalVars.Torque_OK_calibrate ETCSignals.ES910.ES910.CAN1.CAN1.MEAS_ETAS_InternalVars.TV_Mode_calibrate ETCSignals.ES910.ES910.CAN1.CAN1.MEAS_ETAS_InternalVars.Critical_Signal_Disconnection_calibrate ETCSignals.ES910.ES910.CAN1.CAN1.MEAS_ETAS_InternalVars.Critical_CAN_Disconnection_calibrate ETCSignals.ES910.ES910.CAN1.CAN1.MEAS_ETAS_InternalVars.APPS_Implausibility_calibrate ETCSignals.ES910.ES910.CAN1.CAN1.NM_ETAS_Disconnections.Disconnection_Pitot_calibrate ETCSignals.ES910.ES910.CAN1.CAN1.NM_ETAS_Disconnections.Disconnection_BrakePressure_calibrate ETCSignals.ES910.ES910.CAN1.CAN1.NM_ETAS_Disconnections.Disconnection_DashBoard_calibrate ETCSignals.ES910.ES910.CAN1.CAN1.NM_ETAS_Disconnections.Disconnection_BMS_calibrate ETCSignals.ES910.ES910.CAN1.CAN1.NM_ETAS_Disconnections.Disconnection_Front_calibrate ETCSignals.ES910.ES910.CAN1.CAN1.NM_ETAS_Disconnections.Disconnection_Rear_calibrate ETCSignals.ES910.ES910.CAN1.CAN1.NM_ETAS_Disconnections.Disconnection_SteeringSensor_calibrate ETCSignals.ES910.ES910.CAN1.CAN1.NM_ETAS_Disconnections.Disconnection_Susp_R_R_calibrate ETCSignals.ES910.ES910.CAN1.CAN1.NM_ETAS_Disconnections.Disconnection_Susp_R_L_calibrate ETCSignals.ES910.ES910.CAN1.CAN1.NM_ETAS_Disconnections.Disconnection_Susp_F_R_calibrate ETCSignals.ES910.ES910.CAN1.CAN1.NM_ETAS_Disconnections.Disconnection_Susp_F_L_calibrate ETCSignals.ES910.ES910.CAN1.CAN1.NM_ETAS_Disconnections.Disconnection_BrakePedal_calibrate ETCSignals.ES910.ES910.CAN1.CAN1.NM_ETAS_Disconnections.Disconnection_APPS2_calibrate ETCSignals.ES910.ES910.CAN1.CAN1.NM_ETAS_Disconnections.Disconnection_APPS1_calibrate ETCSignals.ES910.ES910.CAN1.CAN1.NM_ETAS_Disconnections.Disconnection_Ellipse_calibrate ETCSignals.ES910.ES910.CAN1.CAN1.AP_ETAS_DashData2.SteeringSensor_Value_calibrate ETCSignals.ES910.ES910.CAN1.CAN1.AP_ETAS_DashData2.SKF_actual_calibrate ETCSignals.ES910.ES910.CAN1.CAN1.AP_ETAS_DashData2.CKF_actual_calibrate ETCSignals.ES910.ES910.CAN1.CAN1.AP_ETAS_DashData2.BrakeSensor_Value_calibrate ETCSignals.ES910.ES910.CAN1.CAN1.AP_ETAS_DashData2.APPS2_Value_calibrate ETCSignals.ES910.ES910.CAN1.CAN1.AP_ETAS_DashData2.APPS1_Value_calibrate ETCSignals.ES910.ES910.CAN1.CAN1.AP_ETAS_Synchronism.Sync_CAN1_calibrate ETCSignals.ES910.ES910.CAN2.CAN2.AP_ETAS_BrakeLight.BrakeLight_Control_calibrate ETCSignals.ES910.ES910.CAN2.CAN2.MEAS_ETAS_Inverter_R_Data.Inv_R_TempMotor_calibrate ETCSignals.ES910.ES910.CAN2.CAN2.MEAS_ETAS_Inverter_R_Data.Inv_R_TempIGBT_calibrate ETCSignals.ES910.ES910.CAN2.CAN2.MEAS_ETAS_Inverter_R_Data.Inv_R_Speed_calibrate ETCSignals.ES910.ES910.CAN2.CAN2.MEAS_ETAS_Inverter_R_Data.Inv_R_Iq_calibrate ETCSignals.ES910.ES910.CAN2.CAN2.MEAS_ETAS_Inverter_R_Data.Inv_R_Icommand_calibrate ETCSignals.ES910.ES910.CAN2.CAN2.MEAS_ETAS_Inverter_R_Data.Inv_R_Iactual_calibrate ETCSignals.ES910.ES910.CAN2.CAN2.MEAS_ETAS_Inverter_L_Data.Inv_L_TempMotor_calibrate ETCSignals.ES910.ES910.CAN2.CAN2.MEAS_ETAS_Inverter_L_Data.Inv_L_TempIGBT_calibrate ETCSignals.ES910.ES910.CAN2.CAN2.MEAS_ETAS_Inverter_L_Data.Inv_L_Speed_calibrate ETCSignals.ES910.ES910.CAN2.CAN2.MEAS_ETAS_Inverter_L_Data.Inv_L_Iq_calibrate ETCSignals.ES910.ES910.CAN2.CAN2.MEAS_ETAS_Inverter_L_Data.Inv_L_Icommand_calibrate ETCSignals.ES910.ES910.CAN2.CAN2.MEAS_ETAS_Inverter_L_Data.Inv_L_Iactual_calibrate ETCSignals.ES910.ES910.CAN2.CAN2.MEAS_ETAS_VDCdata3.SUSP_R_R_calibrate ETCSignals.ES910.ES910.CAN2.CAN2.MEAS_ETAS_VDCdata3.SUSP_R_L_calibrate ETCSignals.ES910.ES910.CAN2.CAN2.MEAS_ETAS_VDCdata3.SUSP_F_R_calibrate ETCSignals.ES910.ES910.CAN2.CAN2.MEAS_ETAS_VDCdata3.SUSP_F_L_calibrate ETCSignals.ES910.ES910.CAN2.CAN2.MEAS_ETAS_VDCdata1.Torque_R_calibrate ETCSignals.ES910.ES910.CAN2.CAN2.MEAS_ETAS_VDCdata1.Torque_L_calibrate ETCSignals.ES910.ES910.CAN2.CAN2.MEAS_ETAS_VDCdata5.Handling_calibrate ETCSignals.ES910.ES910.CAN2.CAN2.MEAS_ETAS_VDCdata5.Mass_calibrate ETCSignals.ES910.ES910.CAN2.CAN2.MEAS_ETAS_VDCdata4.Throttle_calibrate ETCSignals.ES910.ES910.CAN2.CAN2.MEAS_ETAS_VDCdata4.Max_Fx_RR_calibrate ETCSignals.ES910.ES910.CAN2.CAN2.MEAS_ETAS_VDCdata4.Max_Fx_RL_calibrate ETCSignals.ES910.ES910.CAN2.CAN2.MEAS_ETAS_VDCdata4.Fy_R_calibrate ETCSignals.ES910.ES910.CAN2.CAN2.MEAS_ETAS_VDCdata2.Max_Torque_RR_calibrate ETCSignals.ES910.ES910.CAN2.CAN2.MEAS_ETAS_VDCdata2.Max_Torque_RL_calibrate ETCSignals.ES910.ES910.CAN2.CAN2.MEAS_ETAS_VDCdata2.Torque_RRwc_calibrate ETCSignals.ES910.ES910.CAN2.CAN2.MEAS_ETAS_VDCdata2.Torque_RLwc_calibrate ETCSignals.ES910.ES910.CAN2.CAN2.AP_ETAS_Synchronism.Sync_CAN2_calibrate /end REF_CHARACTERISTIC
 /begin SUB_GROUP ETCSignals.ES910 ETCSignals.ES910.ES910 ETCSignals.ES910.ES910.CAN1 ETCSignals.ES910.ES910.CAN1.Presence ETCSignals.ES910.ES910.CAN1.Presence.PresenceGroup ETCSignals.ES910.ES910.CAN1.CAN1 ETCSignals.ES910.ES910.CAN1.CAN1.AP_BMS_SDC ETCSignals.ES910.ES910.CAN1.CAN1.AP_CurrentSensor ETCSignals.ES910.ES910.CAN1.CAN1.AP_BMS_Voltages ETCSignals.ES910.ES910.CAN1.CAN1.AP_BMS_ChargerParameters ETCSignals.ES910.ES910.CAN1.CAN1.AP_BMS_BatteryTemperatures ETCSignals.ES910.ES910.CAN1.CAN1.AP_Inverter_R_Tx ETCSignals.ES910.ES910.CAN1.CAN1.AP_Inverter_L_Tx ETCSignals.ES910.ES910.CAN1.CAN1.AP_DASH_CustomMode ETCSignals.ES910.ES910.CAN1.CAN1.AP_DASH_Mode ETCSignals.ES910.ES910.CAN1.CAN1.NM_BMS_Keep_Alive ETCSignals.ES910.ES910.CAN1.CAN1.AP_BMS_AIRs_State ETCSignals.ES910.ES910.CAN1.CAN1.NM_DASH_Keep_Alive ETCSignals.ES910.ES910.CAN1.CAN1.AP_DASH_TorqueLockOn ETCSignals.ES910.ES910.CAN1.CAN1.AP_DASH_PrechargeRequest ETCSignals.ES910.ES910.CAN1.CAN1.AP_DASH_EnableDrive ETCSignals.ES910.ES910.CAN1.CAN1.AP_ETAS_DashData1 ETCSignals.ES910.ES910.CAN1.CAN1.AP_ETAS_VDCParams2 ETCSignals.ES910.ES910.CAN1.CAN1.AP_ETAS_VDCParams ETCSignals.ES910.ES910.CAN1.CAN1.AP_ETAS_Inverter_R_Rx ETCSignals.ES910.ES910.CAN1.CAN1.AP_ETAS_Inverter_L_Rx ETCSignals.ES910.ES910.CAN1.CAN1.AP_ETAS_CarState ETCSignals.ES910.ES910.CAN1.CAN1.AP_ETAS_AIRsRequest ETCSignals.ES910.ES910.CAN1.CAN1.MEAS_ETAS_InternalVars ETCSignals.ES910.ES910.CAN1.CAN1.NM_ETAS_Disconnections ETCSignals.ES910.ES910.CAN1.CAN1.AP_ETAS_DashData2 ETCSignals.ES910.ES910.CAN1.CAN1.AP_ETAS_Synchronism ETCSignals.ES910.ES910.CAN2 ETCSignals.ES910.ES910.CAN2.Presence ETCSignals.ES910.ES910.CAN2.Presence.PresenceGroup ETCSignals.ES910.ES910.CAN2.CAN2 ETCSignals.ES910.ES910.CAN2.CAN2.AP_ETAS_BrakeLight ETCSignals.ES910.ES910.CAN2.CAN2.MEAS_RECU_SDC ETCSignals.ES910.ES910.CAN2.CAN2.MEAS_FECU_SDC ETCSignals.ES910.ES910.CAN2.CAN2.AP_ELLIPSE_EKF_POS ETCSignals.ES910.ES910.CAN2.CAN2.AP_ELLIPSE_IMU_ACCEL ETCSignals.ES910.ES910.CAN2.CAN2.AP_ELLIPSE_EKF_EULER ETCSignals.ES910.ES910.CAN2.CAN2.AP_ELLIPSE_EKF_VEL ETCSignals.ES910.ES910.CAN2.CAN2.NM_ELLIPSE_Status ETCSignals.ES910.ES910.CAN2.CAN2.AP_ELLIPSE_IMU_GYRO ETCSignals.ES910.ES910.CAN2.CAN2.AP_ELLIPSE_SLIP_CURV ETCSignals.ES910.ES910.CAN2.CAN2.MEAS_ETAS_Inverter_R_Data ETCSignals.ES910.ES910.CAN2.CAN2.MEAS_ETAS_Inverter_L_Data ETCSignals.ES910.ES910.CAN2.CAN2.MEAS_ETAS_VDCdata3 ETCSignals.ES910.ES910.CAN2.CAN2.MEAS_ETAS_VDCdata1 ETCSignals.ES910.ES910.CAN2.CAN2.MEAS_ETAS_VDCdata5 ETCSignals.ES910.ES910.CAN2.CAN2.MEAS_ETAS_VDCdata4 ETCSignals.ES910.ES910.CAN2.CAN2.MEAS_ETAS_VDCdata2 ETCSignals.ES910.ES910.CAN2.CAN2.AP_RECU_Data ETCSignals.ES910.ES910.CAN2.CAN2.NM_FECU_Keep_Alive ETCSignals.ES910.ES910.CAN2.CAN2.NM_RECU_Keep_Alive ETCSignals.ES910.ES910.CAN2.CAN2.AP_FECU_Data2 ETCSignals.ES910.ES910.CAN2.CAN2.AP_FECU_Data1 ETCSignals.ES910.ES910.CAN2.CAN2.AP_ETAS_Synchronism /end SUB_GROUP
/end GROUP
/begin GROUP ETCSignals.ES910 ""
 /begin REF_MEASUREMENT ETCSignals.ES910.ES910.CAN1.Presence.PresenceGroup.PresenceFlag ETCSignals.ES910.ES910.CAN1.CAN1.AP_BMS_SDC.Shutdown_PackageIntck ETCSignals.ES910.ES910.CAN1.CAN1.AP_BMS_SDC.Shutdown_IMD ETCSignals.ES910.ES910.CAN1.CAN1.AP_BMS_SDC.Shutdown_BMS ETCSignals.ES910.ES910.CAN1.CAN1.AP_CurrentSensor.ERROR ETCSignals.ES910.ES910.CAN1.CAN1.AP_CurrentSensor.Accumulator_Current ETCSignals.ES910.ES910.CAN1.CAN1.AP_BMS_Voltages.Lowest_CellVoltage ETCSignals.ES910.ES910.CAN1.CAN1.AP_BMS_Voltages.Highest_CellVoltage ETCSignals.ES910.ES910.CAN1.CAN1.AP_BMS_Voltages.Accumulator_Voltage ETCSignals.ES910.ES910.CAN1.CAN1.AP_BMS_ChargerParameters.Charger_MaxVoltage ETCSignals.ES910.ES910.CAN1.CAN1.AP_BMS_ChargerParameters.Charger_MaxCurrent ETCSignals.ES910.ES910.CAN1.CAN1.AP_BMS_BatteryTemperatures.Lowest_CellTemp ETCSignals.ES910.ES910.CAN1.CAN1.AP_BMS_BatteryTemperatures.Highest_CellTemp ETCSignals.ES910.ES910.CAN1.CAN1.AP_BMS_BatteryTemperatures.Average_CellTemp ETCSignals.ES910.ES910.CAN1.CAN1.AP_Inverter_R_Tx.Inv_R_RegID ETCSignals.ES910.ES910.CAN1.CAN1.AP_Inverter_R_Tx.Inv_R_RegID_M73_Inv_R_TempMotor ETCSignals.ES910.ES910.CAN1.CAN1.AP_Inverter_R_Tx.Inv_R_RegID_M74_Inv_R_TempIGBT ETCSignals.ES910.ES910.CAN1.CAN1.AP_Inverter_R_Tx.Inv_R_RegID_M48_Inv_R_Speed ETCSignals.ES910.ES910.CAN1.CAN1.AP_Inverter_R_Tx.Inv_R_RegID_M39_Inv_R_Iq ETCSignals.ES910.ES910.CAN1.CAN1.AP_Inverter_R_Tx.Inv_R_RegID_M38_Inv_R_Icommand ETCSignals.ES910.ES910.CAN1.CAN1.AP_Inverter_R_Tx.Inv_R_RegID_M32_Inv_R_Iactual ETCSignals.ES910.ES910.CAN1.CAN1.AP_Inverter_R_Tx.Inv_R_RegID_M232_Inv_R_Enable ETCSignals.ES910.ES910.CAN1.CAN1.AP_Inverter_R_Tx.Inv_R_RegID_M235_Inv_R_DCBus ETCSignals.ES910.ES910.CAN1.CAN1.AP_Inverter_L_Tx.Inv_L_RegID ETCSignals.ES910.ES910.CAN1.CAN1.AP_Inverter_L_Tx.Inv_L_RegID_M73_Inv_L_TempMotor ETCSignals.ES910.ES910.CAN1.CAN1.AP_Inverter_L_Tx.Inv_L_RegID_M74_Inv_L_TempIGBT ETCSignals.ES910.ES910.CAN1.CAN1.AP_Inverter_L_Tx.Inv_L_RegID_M48_Inv_L_Speed ETCSignals.ES910.ES910.CAN1.CAN1.AP_Inverter_L_Tx.Inv_L_RegID_M39_Inv_L_Iq ETCSignals.ES910.ES910.CAN1.CAN1.AP_Inverter_L_Tx.Inv_L_RegID_M38_Inv_L_Icommand ETCSignals.ES910.ES910.CAN1.CAN1.AP_Inverter_L_Tx.Inv_L_RegID_M32_Inv_L_Iactual ETCSignals.ES910.ES910.CAN1.CAN1.AP_Inverter_L_Tx.Inv_L_RegID_M232_Inv_L_Enable ETCSignals.ES910.ES910.CAN1.CAN1.AP_Inverter_L_Tx.Inv_L_RegID_M235_Inv_L_DCBus ETCSignals.ES910.ES910.CAN1.CAN1.AP_DASH_CustomMode.CustomMode_Identifier ETCSignals.ES910.ES910.CAN1.CAN1.AP_DASH_CustomMode.CustomMode_Data ETCSignals.ES910.ES910.CAN1.CAN1.AP_DASH_Mode.RacingMode ETCSignals.ES910.ES910.CAN1.CAN1.NM_BMS_Keep_Alive.BMS_Alive ETCSignals.ES910.ES910.CAN1.CAN1.AP_BMS_AIRs_State.AIRs_State ETCSignals.ES910.ES910.CAN1.CAN1.NM_DASH_Keep_Alive.Dash_Alive ETCSignals.ES910.ES910.CAN1.CAN1.AP_DASH_TorqueLockOn.Torque_LockOn ETCSignals.ES910.ES910.CAN1.CAN1.AP_DASH_PrechargeRequest.PrechargeRequest ETCSignals.ES910.ES910.CAN1.CAN1.AP_DASH_EnableDrive.EnableDrive_Order ETCSignals.ES910.ES910.CAN1.CAN1.AP_ETAS_DashData1.Speed ETCSignals.ES910.ES910.CAN1.CAN1.AP_ETAS_DashData1.Precharge_Voltage ETCSignals.ES910.ES910.CAN1.CAN1.AP_ETAS_DashData1.Precharge_Percentage ETCSignals.ES910.ES910.CAN1.CAN1.AP_ETAS_VDCParams2.VDC_Cte_SKF ETCSignals.ES910.ES910.CAN1.CAN1.AP_ETAS_VDCParams2.VDC_Cte_CKF ETCSignals.ES910.ES910.CAN1.CAN1.AP_ETAS_VDCParams.VDC_CKF_Initial ETCSignals.ES910.ES910.CAN1.CAN1.AP_ETAS_VDCParams.VDC_SKF_Initial ETCSignals.ES910.ES910.CAN1.CAN1.AP_ETAS_VDCParams.VDC_Power_Limit ETCSignals.ES910.ES910.CAN1.CAN1.AP_ETAS_VDCParams.VDC_Max_Regen_Motor_Tq ETCSignals.ES910.ES910.CAN1.CAN1.AP_ETAS_VDCParams.VDC_K_Reduction_Temperature ETCSignals.ES910.ES910.CAN1.CAN1.AP_ETAS_VDCParams.VDC_K_Reduction_P ETCSignals.ES910.ES910.CAN1.CAN1.AP_ETAS_VDCParams.VDC_APPS_Sat_Up ETCSignals.ES910.ES910.CAN1.CAN1.AP_ETAS_VDCParams.VDC_APPS_Sat_Down ETCSignals.ES910.ES910.CAN1.CAN1.AP_ETAS_Inverter_R_Rx.Inverter_R_RegID ETCSignals.ES910.ES910.CAN1.CAN1.AP_ETAS_Inverter_R_Rx.Inverter_R_b7tob0 ETCSignals.ES910.ES910.CAN1.CAN1.AP_ETAS_Inverter_R_Rx.Inverter_R_b15tob8 ETCSignals.ES910.ES910.CAN1.CAN1.AP_ETAS_Inverter_L_Rx.Inverter_L_RegID ETCSignals.ES910.ES910.CAN1.CAN1.AP_ETAS_Inverter_L_Rx.Inverter_L_b7tob0 ETCSignals.ES910.ES910.CAN1.CAN1.AP_ETAS_Inverter_L_Rx.Inverter_L_b15tob8 ETCSignals.ES910.ES910.CAN1.CAN1.AP_ETAS_CarState.Car_State ETCSignals.ES910.ES910.CAN1.CAN1.AP_ETAS_AIRsRequest.AIRs_Request ETCSignals.ES910.ES910.CAN1.CAN1.MEAS_ETAS_InternalVars.CriticalDisconnection ETCSignals.ES910.ES910.CAN1.CAN1.MEAS_ETAS_InternalVars.CurrentPathDisconnectionFlag ETCSignals.ES910.ES910.CAN1.CAN1.MEAS_ETAS_InternalVars.Car_OK ETCSignals.ES910.ES910.CAN1.CAN1.MEAS_ETAS_InternalVars.Power ETCSignals.ES910.ES910.CAN1.CAN1.MEAS_ETAS_InternalVars.Torque_OK ETCSignals.ES910.ES910.CAN1.CAN1.MEAS_ETAS_InternalVars.TV_Mode ETCSignals.ES910.ES910.CAN1.CAN1.MEAS_ETAS_InternalVars.Critical_Signal_Disconnection ETCSignals.ES910.ES910.CAN1.CAN1.MEAS_ETAS_InternalVars.Critical_CAN_Disconnection ETCSignals.ES910.ES910.CAN1.CAN1.MEAS_ETAS_InternalVars.APPS_Implausibility ETCSignals.ES910.ES910.CAN1.CAN1.NM_ETAS_Disconnections.Disconnection_Pitot ETCSignals.ES910.ES910.CAN1.CAN1.NM_ETAS_Disconnections.Disconnection_BrakePressure ETCSignals.ES910.ES910.CAN1.CAN1.NM_ETAS_Disconnections.Disconnection_DashBoard ETCSignals.ES910.ES910.CAN1.CAN1.NM_ETAS_Disconnections.Disconnection_BMS ETCSignals.ES910.ES910.CAN1.CAN1.NM_ETAS_Disconnections.Disconnection_Front ETCSignals.ES910.ES910.CAN1.CAN1.NM_ETAS_Disconnections.Disconnection_Rear ETCSignals.ES910.ES910.CAN1.CAN1.NM_ETAS_Disconnections.Disconnection_SteeringSensor ETCSignals.ES910.ES910.CAN1.CAN1.NM_ETAS_Disconnections.Disconnection_Susp_R_R ETCSignals.ES910.ES910.CAN1.CAN1.NM_ETAS_Disconnections.Disconnection_Susp_R_L ETCSignals.ES910.ES910.CAN1.CAN1.NM_ETAS_Disconnections.Disconnection_Susp_F_R ETCSignals.ES910.ES910.CAN1.CAN1.NM_ETAS_Disconnections.Disconnection_Susp_F_L ETCSignals.ES910.ES910.CAN1.CAN1.NM_ETAS_Disconnections.Disconnection_BrakePedal ETCSignals.ES910.ES910.CAN1.CAN1.NM_ETAS_Disconnections.Disconnection_APPS2 ETCSignals.ES910.ES910.CAN1.CAN1.NM_ETAS_Disconnections.Disconnection_APPS1 ETCSignals.ES910.ES910.CAN1.CAN1.NM_ETAS_Disconnections.Disconnection_Ellipse ETCSignals.ES910.ES910.CAN1.CAN1.AP_ETAS_DashData2.SteeringSensor_Value ETCSignals.ES910.ES910.CAN1.CAN1.AP_ETAS_DashData2.SKF_actual ETCSignals.ES910.ES910.CAN1.CAN1.AP_ETAS_DashData2.CKF_actual ETCSignals.ES910.ES910.CAN1.CAN1.AP_ETAS_DashData2.BrakeSensor_Value ETCSignals.ES910.ES910.CAN1.CAN1.AP_ETAS_DashData2.APPS2_Value ETCSignals.ES910.ES910.CAN1.CAN1.AP_ETAS_DashData2.APPS1_Value ETCSignals.ES910.ES910.CAN1.CAN1.AP_ETAS_Synchronism.Sync_CAN1 ETCSignals.ES910.ES910.CAN2.Presence.PresenceGroup.PresenceFlag ETCSignals.ES910.ES910.CAN2.CAN2.AP_ETAS_BrakeLight.BrakeLight_Control ETCSignals.ES910.ES910.CAN2.CAN2.MEAS_RECU_SDC.Shutdown_TSMS_TSMP ETCSignals.ES910.ES910.CAN2.CAN2.MEAS_RECU_SDC.Shutdown_HVD ETCSignals.ES910.ES910.CAN2.CAN2.MEAS_RECU_SDC.Shutdown_HVBox ETCSignals.ES910.ES910.CAN2.CAN2.MEAS_RECU_SDC.Shutdown_LeftTS ETCSignals.ES910.ES910.CAN2.CAN2.MEAS_RECU_SDC.Shutdown_RightTS ETCSignals.ES910.ES910.CAN2.CAN2.MEAS_FECU_SDC.Shutdown_SC_BOTS ETCSignals.ES910.ES910.CAN2.CAN2.MEAS_FECU_SDC.Shutdown_BSPD_Inertia ETCSignals.ES910.ES910.CAN2.CAN2.MEAS_FECU_SDC.Shutdown_Setas ETCSignals.ES910.ES910.CAN2.CAN2.AP_ELLIPSE_EKF_POS.el_LONGITUDE_EKF ETCSignals.ES910.ES910.CAN2.CAN2.AP_ELLIPSE_EKF_POS.el_LATITUDE_EKF ETCSignals.ES910.ES910.CAN2.CAN2.AP_ELLIPSE_IMU_ACCEL.el_ACCEL_Z ETCSignals.ES910.ES910.CAN2.CAN2.AP_ELLIPSE_IMU_ACCEL.el_ACCEL_Y ETCSignals.ES910.ES910.CAN2.CAN2.AP_ELLIPSE_IMU_ACCEL.el_ACCEL_X ETCSignals.ES910.ES910.CAN2.CAN2.AP_ELLIPSE_EKF_EULER.el_YAW ETCSignals.ES910.ES910.CAN2.CAN2.AP_ELLIPSE_EKF_EULER.el_PITCH ETCSignals.ES910.ES910.CAN2.CAN2.AP_ELLIPSE_EKF_EULER.el_ROLL ETCSignals.ES910.ES910.CAN2.CAN2.AP_ELLIPSE_EKF_VEL.el_Vel_Z ETCSignals.ES910.ES910.CAN2.CAN2.AP_ELLIPSE_EKF_VEL.el_Vel_Y ETCSignals.ES910.ES910.CAN2.CAN2.AP_ELLIPSE_EKF_VEL.el_Vel_X ETCSignals.ES910.ES910.CAN2.CAN2.NM_ELLIPSE_Status.el_CLOCK ETCSignals.ES910.ES910.CAN2.CAN2.NM_ELLIPSE_Status.el_GENERAL ETCSignals.ES910.ES910.CAN2.CAN2.NM_ELLIPSE_Status.Ellipse_Alive ETCSignals.ES910.ES910.CAN2.CAN2.AP_ELLIPSE_IMU_GYRO.el_GYRO_Z ETCSignals.ES910.ES910.CAN2.CAN2.AP_ELLIPSE_IMU_GYRO.el_GYRO_Y ETCSignals.ES910.ES910.CAN2.CAN2.AP_ELLIPSE_IMU_GYRO.el_GYRO_X ETCSignals.ES910.ES910.CAN2.CAN2.AP_ELLIPSE_SLIP_CURV.el_AUTO_STATUS ETCSignals.ES910.ES910.CAN2.CAN2.AP_ELLIPSE_SLIP_CURV.el_CurvatureRadius ETCSignals.ES910.ES910.CAN2.CAN2.AP_ELLIPSE_SLIP_CURV.el_SlipAngle ETCSignals.ES910.ES910.CAN2.CAN2.AP_ELLIPSE_SLIP_CURV.el_AngleTrack ETCSignals.ES910.ES910.CAN2.CAN2.MEAS_ETAS_Inverter_R_Data.Inv_R_TempMotor ETCSignals.ES910.ES910.CAN2.CAN2.MEAS_ETAS_Inverter_R_Data.Inv_R_TempIGBT ETCSignals.ES910.ES910.CAN2.CAN2.MEAS_ETAS_Inverter_R_Data.Inv_R_Speed ETCSignals.ES910.ES910.CAN2.CAN2.MEAS_ETAS_Inverter_R_Data.Inv_R_Iq ETCSignals.ES910.ES910.CAN2.CAN2.MEAS_ETAS_Inverter_R_Data.Inv_R_Icommand ETCSignals.ES910.ES910.CAN2.CAN2.MEAS_ETAS_Inverter_R_Data.Inv_R_Iactual ETCSignals.ES910.ES910.CAN2.CAN2.MEAS_ETAS_Inverter_L_Data.Inv_L_TempMotor ETCSignals.ES910.ES910.CAN2.CAN2.MEAS_ETAS_Inverter_L_Data.Inv_L_TempIGBT ETCSignals.ES910.ES910.CAN2.CAN2.MEAS_ETAS_Inverter_L_Data.Inv_L_Speed ETCSignals.ES910.ES910.CAN2.CAN2.MEAS_ETAS_Inverter_L_Data.Inv_L_Iq ETCSignals.ES910.ES910.CAN2.CAN2.MEAS_ETAS_Inverter_L_Data.Inv_L_Icommand ETCSignals.ES910.ES910.CAN2.CAN2.MEAS_ETAS_Inverter_L_Data.Inv_L_Iactual ETCSignals.ES910.ES910.CAN2.CAN2.MEAS_ETAS_VDCdata3.SUSP_R_R ETCSignals.ES910.ES910.CAN2.CAN2.MEAS_ETAS_VDCdata3.SUSP_R_L ETCSignals.ES910.ES910.CAN2.CAN2.MEAS_ETAS_VDCdata3.SUSP_F_R ETCSignals.ES910.ES910.CAN2.CAN2.MEAS_ETAS_VDCdata3.SUSP_F_L ETCSignals.ES910.ES910.CAN2.CAN2.MEAS_ETAS_VDCdata1.Torque_R ETCSignals.ES910.ES910.CAN2.CAN2.MEAS_ETAS_VDCdata1.Torque_L ETCSignals.ES910.ES910.CAN2.CAN2.MEAS_ETAS_VDCdata5.Handling ETCSignals.ES910.ES910.CAN2.CAN2.MEAS_ETAS_VDCdata5.Mass ETCSignals.ES910.ES910.CAN2.CAN2.MEAS_ETAS_VDCdata4.Throttle ETCSignals.ES910.ES910.CAN2.CAN2.MEAS_ETAS_VDCdata4.Max_Fx_RR ETCSignals.ES910.ES910.CAN2.CAN2.MEAS_ETAS_VDCdata4.Max_Fx_RL ETCSignals.ES910.ES910.CAN2.CAN2.MEAS_ETAS_VDCdata4.Fy_R ETCSignals.ES910.ES910.CAN2.CAN2.MEAS_ETAS_VDCdata2.Max_Torque_RR ETCSignals.ES910.ES910.CAN2.CAN2.MEAS_ETAS_VDCdata2.Max_Torque_RL ETCSignals.ES910.ES910.CAN2.CAN2.MEAS_ETAS_VDCdata2.Torque_RRwc ETCSignals.ES910.ES910.CAN2.CAN2.MEAS_ETAS_VDCdata2.Torque_RLwc ETCSignals.ES910.ES910.CAN2.CAN2.AP_RECU_Data.Susp_R_R_Bits ETCSignals.ES910.ES910.CAN2.CAN2.AP_RECU_Data.Susp_R_L_Bits ETCSignals.ES910.ES910.CAN2.CAN2.NM_FECU_Keep_Alive.Front_Alive ETCSignals.ES910.ES910.CAN2.CAN2.NM_RECU_Keep_Alive.Rear_Alive ETCSignals.ES910.ES910.CAN2.CAN2.AP_FECU_Data2.BrakePressure_Bits ETCSignals.ES910.ES910.CAN2.CAN2.AP_FECU_Data2.Pitot_Bits ETCSignals.ES910.ES910.CAN2.CAN2.AP_FECU_Data2.Susp_F_R_Bits ETCSignals.ES910.ES910.CAN2.CAN2.AP_FECU_Data2.Susp_F_L_Bits ETCSignals.ES910.ES910.CAN2.CAN2.AP_FECU_Data1.SteeringSensor_Bits ETCSignals.ES910.ES910.CAN2.CAN2.AP_FECU_Data1.BrakeSensor_Bits ETCSignals.ES910.ES910.CAN2.CAN2.AP_FECU_Data1.APPS2_Bits ETCSignals.ES910.ES910.CAN2.CAN2.AP_FECU_Data1.APPS1_Bits ETCSignals.ES910.ES910.CAN2.CAN2.AP_ETAS_Synchronism.Sync_CAN2 /end REF_MEASUREMENT
 /begin REF_CHARACTERISTIC ETCSignals.ES910.ES910.CAN1.CAN1.AP_ETAS_DashData1.Speed_calibrate ETCSignals.ES910.ES910.CAN1.CAN1.AP_ETAS_DashData1.Precharge_Voltage_calibrate ETCSignals.ES910.ES910.CAN1.CAN1.AP_ETAS_DashData1.Precharge_Percentage_calibrate ETCSignals.ES910.ES910.CAN1.CAN1.AP_ETAS_VDCParams2.VDC_Cte_SKF_calibrate ETCSignals.ES910.ES910.CAN1.CAN1.AP_ETAS_VDCParams2.VDC_Cte_CKF_calibrate ETCSignals.ES910.ES910.CAN1.CAN1.AP_ETAS_VDCParams.VDC_CKF_Initial_calibrate ETCSignals.ES910.ES910.CAN1.CAN1.AP_ETAS_VDCParams.VDC_SKF_Initial_calibrate ETCSignals.ES910.ES910.CAN1.CAN1.AP_ETAS_VDCParams.VDC_Power_Limit_calibrate ETCSignals.ES910.ES910.CAN1.CAN1.AP_ETAS_VDCParams.VDC_Max_Regen_Motor_Tq_calibrate ETCSignals.ES910.ES910.CAN1.CAN1.AP_ETAS_VDCParams.VDC_K_Reduction_Temperature_calibrate ETCSignals.ES910.ES910.CAN1.CAN1.AP_ETAS_VDCParams.VDC_K_Reduction_P_calibrate ETCSignals.ES910.ES910.CAN1.CAN1.AP_ETAS_VDCParams.VDC_APPS_Sat_Up_calibrate ETCSignals.ES910.ES910.CAN1.CAN1.AP_ETAS_VDCParams.VDC_APPS_Sat_Down_calibrate ETCSignals.ES910.ES910.CAN1.CAN1.AP_ETAS_Inverter_R_Rx.Inverter_R_RegID_calibrate ETCSignals.ES910.ES910.CAN1.CAN1.AP_ETAS_Inverter_R_Rx.Inverter_R_b7tob0_calibrate ETCSignals.ES910.ES910.CAN1.CAN1.AP_ETAS_Inverter_R_Rx.Inverter_R_b15tob8_calibrate ETCSignals.ES910.ES910.CAN1.CAN1.AP_ETAS_Inverter_L_Rx.Inverter_L_RegID_calibrate ETCSignals.ES910.ES910.CAN1.CAN1.AP_ETAS_Inverter_L_Rx.Inverter_L_b7tob0_calibrate ETCSignals.ES910.ES910.CAN1.CAN1.AP_ETAS_Inverter_L_Rx.Inverter_L_b15tob8_calibrate ETCSignals.ES910.ES910.CAN1.CAN1.AP_ETAS_CarState.Car_State_calibrate ETCSignals.ES910.ES910.CAN1.CAN1.AP_ETAS_AIRsRequest.AIRs_Request_calibrate ETCSignals.ES910.ES910.CAN1.CAN1.MEAS_ETAS_InternalVars.CriticalDisconnection_calibrate ETCSignals.ES910.ES910.CAN1.CAN1.MEAS_ETAS_InternalVars.CurrentPathDisconnectionFlag_calibrate ETCSignals.ES910.ES910.CAN1.CAN1.MEAS_ETAS_InternalVars.Car_OK_calibrate ETCSignals.ES910.ES910.CAN1.CAN1.MEAS_ETAS_InternalVars.Power_calibrate ETCSignals.ES910.ES910.CAN1.CAN1.MEAS_ETAS_InternalVars.Torque_OK_calibrate ETCSignals.ES910.ES910.CAN1.CAN1.MEAS_ETAS_InternalVars.TV_Mode_calibrate ETCSignals.ES910.ES910.CAN1.CAN1.MEAS_ETAS_InternalVars.Critical_Signal_Disconnection_calibrate ETCSignals.ES910.ES910.CAN1.CAN1.MEAS_ETAS_InternalVars.Critical_CAN_Disconnection_calibrate ETCSignals.ES910.ES910.CAN1.CAN1.MEAS_ETAS_InternalVars.APPS_Implausibility_calibrate ETCSignals.ES910.ES910.CAN1.CAN1.NM_ETAS_Disconnections.Disconnection_Pitot_calibrate ETCSignals.ES910.ES910.CAN1.CAN1.NM_ETAS_Disconnections.Disconnection_BrakePressure_calibrate ETCSignals.ES910.ES910.CAN1.CAN1.NM_ETAS_Disconnections.Disconnection_DashBoard_calibrate ETCSignals.ES910.ES910.CAN1.CAN1.NM_ETAS_Disconnections.Disconnection_BMS_calibrate ETCSignals.ES910.ES910.CAN1.CAN1.NM_ETAS_Disconnections.Disconnection_Front_calibrate ETCSignals.ES910.ES910.CAN1.CAN1.NM_ETAS_Disconnections.Disconnection_Rear_calibrate ETCSignals.ES910.ES910.CAN1.CAN1.NM_ETAS_Disconnections.Disconnection_SteeringSensor_calibrate ETCSignals.ES910.ES910.CAN1.CAN1.NM_ETAS_Disconnections.Disconnection_Susp_R_R_calibrate ETCSignals.ES910.ES910.CAN1.CAN1.NM_ETAS_Disconnections.Disconnection_Susp_R_L_calibrate ETCSignals.ES910.ES910.CAN1.CAN1.NM_ETAS_Disconnections.Disconnection_Susp_F_R_calibrate ETCSignals.ES910.ES910.CAN1.CAN1.NM_ETAS_Disconnections.Disconnection_Susp_F_L_calibrate ETCSignals.ES910.ES910.CAN1.CAN1.NM_ETAS_Disconnections.Disconnection_BrakePedal_calibrate ETCSignals.ES910.ES910.CAN1.CAN1.NM_ETAS_Disconnections.Disconnection_APPS2_calibrate ETCSignals.ES910.ES910.CAN1.CAN1.NM_ETAS_Disconnections.Disconnection_APPS1_calibrate ETCSignals.ES910.ES910.CAN1.CAN1.NM_ETAS_Disconnections.Disconnection_Ellipse_calibrate ETCSignals.ES910.ES910.CAN1.CAN1.AP_ETAS_DashData2.SteeringSensor_Value_calibrate ETCSignals.ES910.ES910.CAN1.CAN1.AP_ETAS_DashData2.SKF_actual_calibrate ETCSignals.ES910.ES910.CAN1.CAN1.AP_ETAS_DashData2.CKF_actual_calibrate ETCSignals.ES910.ES910.CAN1.CAN1.AP_ETAS_DashData2.BrakeSensor_Value_calibrate ETCSignals.ES910.ES910.CAN1.CAN1.AP_ETAS_DashData2.APPS2_Value_calibrate ETCSignals.ES910.ES910.CAN1.CAN1.AP_ETAS_DashData2.APPS1_Value_calibrate ETCSignals.ES910.ES910.CAN1.CAN1.AP_ETAS_Synchronism.Sync_CAN1_calibrate ETCSignals.ES910.ES910.CAN2.CAN2.AP_ETAS_BrakeLight.BrakeLight_Control_calibrate ETCSignals.ES910.ES910.CAN2.CAN2.MEAS_ETAS_Inverter_R_Data.Inv_R_TempMotor_calibrate ETCSignals.ES910.ES910.CAN2.CAN2.MEAS_ETAS_Inverter_R_Data.Inv_R_TempIGBT_calibrate ETCSignals.ES910.ES910.CAN2.CAN2.MEAS_ETAS_Inverter_R_Data.Inv_R_Speed_calibrate ETCSignals.ES910.ES910.CAN2.CAN2.MEAS_ETAS_Inverter_R_Data.Inv_R_Iq_calibrate ETCSignals.ES910.ES910.CAN2.CAN2.MEAS_ETAS_Inverter_R_Data.Inv_R_Icommand_calibrate ETCSignals.ES910.ES910.CAN2.CAN2.MEAS_ETAS_Inverter_R_Data.Inv_R_Iactual_calibrate ETCSignals.ES910.ES910.CAN2.CAN2.MEAS_ETAS_Inverter_L_Data.Inv_L_TempMotor_calibrate ETCSignals.ES910.ES910.CAN2.CAN2.MEAS_ETAS_Inverter_L_Data.Inv_L_TempIGBT_calibrate ETCSignals.ES910.ES910.CAN2.CAN2.MEAS_ETAS_Inverter_L_Data.Inv_L_Speed_calibrate ETCSignals.ES910.ES910.CAN2.CAN2.MEAS_ETAS_Inverter_L_Data.Inv_L_Iq_calibrate ETCSignals.ES910.ES910.CAN2.CAN2.MEAS_ETAS_Inverter_L_Data.Inv_L_Icommand_calibrate ETCSignals.ES910.ES910.CAN2.CAN2.MEAS_ETAS_Inverter_L_Data.Inv_L_Iactual_calibrate ETCSignals.ES910.ES910.CAN2.CAN2.MEAS_ETAS_VDCdata3.SUSP_R_R_calibrate ETCSignals.ES910.ES910.CAN2.CAN2.MEAS_ETAS_VDCdata3.SUSP_R_L_calibrate ETCSignals.ES910.ES910.CAN2.CAN2.MEAS_ETAS_VDCdata3.SUSP_F_R_calibrate ETCSignals.ES910.ES910.CAN2.CAN2.MEAS_ETAS_VDCdata3.SUSP_F_L_calibrate ETCSignals.ES910.ES910.CAN2.CAN2.MEAS_ETAS_VDCdata1.Torque_R_calibrate ETCSignals.ES910.ES910.CAN2.CAN2.MEAS_ETAS_VDCdata1.Torque_L_calibrate ETCSignals.ES910.ES910.CAN2.CAN2.MEAS_ETAS_VDCdata5.Handling_calibrate ETCSignals.ES910.ES910.CAN2.CAN2.MEAS_ETAS_VDCdata5.Mass_calibrate ETCSignals.ES910.ES910.CAN2.CAN2.MEAS_ETAS_VDCdata4.Throttle_calibrate ETCSignals.ES910.ES910.CAN2.CAN2.MEAS_ETAS_VDCdata4.Max_Fx_RR_calibrate ETCSignals.ES910.ES910.CAN2.CAN2.MEAS_ETAS_VDCdata4.Max_Fx_RL_calibrate ETCSignals.ES910.ES910.CAN2.CAN2.MEAS_ETAS_VDCdata4.Fy_R_calibrate ETCSignals.ES910.ES910.CAN2.CAN2.MEAS_ETAS_VDCdata2.Max_Torque_RR_calibrate ETCSignals.ES910.ES910.CAN2.CAN2.MEAS_ETAS_VDCdata2.Max_Torque_RL_calibrate ETCSignals.ES910.ES910.CAN2.CAN2.MEAS_ETAS_VDCdata2.Torque_RRwc_calibrate ETCSignals.ES910.ES910.CAN2.CAN2.MEAS_ETAS_VDCdata2.Torque_RLwc_calibrate ETCSignals.ES910.ES910.CAN2.CAN2.AP_ETAS_Synchronism.Sync_CAN2_calibrate /end REF_CHARACTERISTIC
/end GROUP
/begin GROUP ETCSignals.ES910.ES910 ""
 /begin REF_MEASUREMENT ETCSignals.ES910.ES910.CAN1.Presence.PresenceGroup.PresenceFlag ETCSignals.ES910.ES910.CAN1.CAN1.AP_BMS_SDC.Shutdown_PackageIntck ETCSignals.ES910.ES910.CAN1.CAN1.AP_BMS_SDC.Shutdown_IMD ETCSignals.ES910.ES910.CAN1.CAN1.AP_BMS_SDC.Shutdown_BMS ETCSignals.ES910.ES910.CAN1.CAN1.AP_CurrentSensor.ERROR ETCSignals.ES910.ES910.CAN1.CAN1.AP_CurrentSensor.Accumulator_Current ETCSignals.ES910.ES910.CAN1.CAN1.AP_BMS_Voltages.Lowest_CellVoltage ETCSignals.ES910.ES910.CAN1.CAN1.AP_BMS_Voltages.Highest_CellVoltage ETCSignals.ES910.ES910.CAN1.CAN1.AP_BMS_Voltages.Accumulator_Voltage ETCSignals.ES910.ES910.CAN1.CAN1.AP_BMS_ChargerParameters.Charger_MaxVoltage ETCSignals.ES910.ES910.CAN1.CAN1.AP_BMS_ChargerParameters.Charger_MaxCurrent ETCSignals.ES910.ES910.CAN1.CAN1.AP_BMS_BatteryTemperatures.Lowest_CellTemp ETCSignals.ES910.ES910.CAN1.CAN1.AP_BMS_BatteryTemperatures.Highest_CellTemp ETCSignals.ES910.ES910.CAN1.CAN1.AP_BMS_BatteryTemperatures.Average_CellTemp ETCSignals.ES910.ES910.CAN1.CAN1.AP_Inverter_R_Tx.Inv_R_RegID ETCSignals.ES910.ES910.CAN1.CAN1.AP_Inverter_R_Tx.Inv_R_RegID_M73_Inv_R_TempMotor ETCSignals.ES910.ES910.CAN1.CAN1.AP_Inverter_R_Tx.Inv_R_RegID_M74_Inv_R_TempIGBT ETCSignals.ES910.ES910.CAN1.CAN1.AP_Inverter_R_Tx.Inv_R_RegID_M48_Inv_R_Speed ETCSignals.ES910.ES910.CAN1.CAN1.AP_Inverter_R_Tx.Inv_R_RegID_M39_Inv_R_Iq ETCSignals.ES910.ES910.CAN1.CAN1.AP_Inverter_R_Tx.Inv_R_RegID_M38_Inv_R_Icommand ETCSignals.ES910.ES910.CAN1.CAN1.AP_Inverter_R_Tx.Inv_R_RegID_M32_Inv_R_Iactual ETCSignals.ES910.ES910.CAN1.CAN1.AP_Inverter_R_Tx.Inv_R_RegID_M232_Inv_R_Enable ETCSignals.ES910.ES910.CAN1.CAN1.AP_Inverter_R_Tx.Inv_R_RegID_M235_Inv_R_DCBus ETCSignals.ES910.ES910.CAN1.CAN1.AP_Inverter_L_Tx.Inv_L_RegID ETCSignals.ES910.ES910.CAN1.CAN1.AP_Inverter_L_Tx.Inv_L_RegID_M73_Inv_L_TempMotor ETCSignals.ES910.ES910.CAN1.CAN1.AP_Inverter_L_Tx.Inv_L_RegID_M74_Inv_L_TempIGBT ETCSignals.ES910.ES910.CAN1.CAN1.AP_Inverter_L_Tx.Inv_L_RegID_M48_Inv_L_Speed ETCSignals.ES910.ES910.CAN1.CAN1.AP_Inverter_L_Tx.Inv_L_RegID_M39_Inv_L_Iq ETCSignals.ES910.ES910.CAN1.CAN1.AP_Inverter_L_Tx.Inv_L_RegID_M38_Inv_L_Icommand ETCSignals.ES910.ES910.CAN1.CAN1.AP_Inverter_L_Tx.Inv_L_RegID_M32_Inv_L_Iactual ETCSignals.ES910.ES910.CAN1.CAN1.AP_Inverter_L_Tx.Inv_L_RegID_M232_Inv_L_Enable ETCSignals.ES910.ES910.CAN1.CAN1.AP_Inverter_L_Tx.Inv_L_RegID_M235_Inv_L_DCBus ETCSignals.ES910.ES910.CAN1.CAN1.AP_DASH_CustomMode.CustomMode_Identifier ETCSignals.ES910.ES910.CAN1.CAN1.AP_DASH_CustomMode.CustomMode_Data ETCSignals.ES910.ES910.CAN1.CAN1.AP_DASH_Mode.RacingMode ETCSignals.ES910.ES910.CAN1.CAN1.NM_BMS_Keep_Alive.BMS_Alive ETCSignals.ES910.ES910.CAN1.CAN1.AP_BMS_AIRs_State.AIRs_State ETCSignals.ES910.ES910.CAN1.CAN1.NM_DASH_Keep_Alive.Dash_Alive ETCSignals.ES910.ES910.CAN1.CAN1.AP_DASH_TorqueLockOn.Torque_LockOn ETCSignals.ES910.ES910.CAN1.CAN1.AP_DASH_PrechargeRequest.PrechargeRequest ETCSignals.ES910.ES910.CAN1.CAN1.AP_DASH_EnableDrive.EnableDrive_Order ETCSignals.ES910.ES910.CAN1.CAN1.AP_ETAS_DashData1.Speed ETCSignals.ES910.ES910.CAN1.CAN1.AP_ETAS_DashData1.Precharge_Voltage ETCSignals.ES910.ES910.CAN1.CAN1.AP_ETAS_DashData1.Precharge_Percentage ETCSignals.ES910.ES910.CAN1.CAN1.AP_ETAS_VDCParams2.VDC_Cte_SKF ETCSignals.ES910.ES910.CAN1.CAN1.AP_ETAS_VDCParams2.VDC_Cte_CKF ETCSignals.ES910.ES910.CAN1.CAN1.AP_ETAS_VDCParams.VDC_CKF_Initial ETCSignals.ES910.ES910.CAN1.CAN1.AP_ETAS_VDCParams.VDC_SKF_Initial ETCSignals.ES910.ES910.CAN1.CAN1.AP_ETAS_VDCParams.VDC_Power_Limit ETCSignals.ES910.ES910.CAN1.CAN1.AP_ETAS_VDCParams.VDC_Max_Regen_Motor_Tq ETCSignals.ES910.ES910.CAN1.CAN1.AP_ETAS_VDCParams.VDC_K_Reduction_Temperature ETCSignals.ES910.ES910.CAN1.CAN1.AP_ETAS_VDCParams.VDC_K_Reduction_P ETCSignals.ES910.ES910.CAN1.CAN1.AP_ETAS_VDCParams.VDC_APPS_Sat_Up ETCSignals.ES910.ES910.CAN1.CAN1.AP_ETAS_VDCParams.VDC_APPS_Sat_Down ETCSignals.ES910.ES910.CAN1.CAN1.AP_ETAS_Inverter_R_Rx.Inverter_R_RegID ETCSignals.ES910.ES910.CAN1.CAN1.AP_ETAS_Inverter_R_Rx.Inverter_R_b7tob0 ETCSignals.ES910.ES910.CAN1.CAN1.AP_ETAS_Inverter_R_Rx.Inverter_R_b15tob8 ETCSignals.ES910.ES910.CAN1.CAN1.AP_ETAS_Inverter_L_Rx.Inverter_L_RegID ETCSignals.ES910.ES910.CAN1.CAN1.AP_ETAS_Inverter_L_Rx.Inverter_L_b7tob0 ETCSignals.ES910.ES910.CAN1.CAN1.AP_ETAS_Inverter_L_Rx.Inverter_L_b15tob8 ETCSignals.ES910.ES910.CAN1.CAN1.AP_ETAS_CarState.Car_State ETCSignals.ES910.ES910.CAN1.CAN1.AP_ETAS_AIRsRequest.AIRs_Request ETCSignals.ES910.ES910.CAN1.CAN1.MEAS_ETAS_InternalVars.CriticalDisconnection ETCSignals.ES910.ES910.CAN1.CAN1.MEAS_ETAS_InternalVars.CurrentPathDisconnectionFlag ETCSignals.ES910.ES910.CAN1.CAN1.MEAS_ETAS_InternalVars.Car_OK ETCSignals.ES910.ES910.CAN1.CAN1.MEAS_ETAS_InternalVars.Power ETCSignals.ES910.ES910.CAN1.CAN1.MEAS_ETAS_InternalVars.Torque_OK ETCSignals.ES910.ES910.CAN1.CAN1.MEAS_ETAS_InternalVars.TV_Mode ETCSignals.ES910.ES910.CAN1.CAN1.MEAS_ETAS_InternalVars.Critical_Signal_Disconnection ETCSignals.ES910.ES910.CAN1.CAN1.MEAS_ETAS_InternalVars.Critical_CAN_Disconnection ETCSignals.ES910.ES910.CAN1.CAN1.MEAS_ETAS_InternalVars.APPS_Implausibility ETCSignals.ES910.ES910.CAN1.CAN1.NM_ETAS_Disconnections.Disconnection_Pitot ETCSignals.ES910.ES910.CAN1.CAN1.NM_ETAS_Disconnections.Disconnection_BrakePressure ETCSignals.ES910.ES910.CAN1.CAN1.NM_ETAS_Disconnections.Disconnection_DashBoard ETCSignals.ES910.ES910.CAN1.CAN1.NM_ETAS_Disconnections.Disconnection_BMS ETCSignals.ES910.ES910.CAN1.CAN1.NM_ETAS_Disconnections.Disconnection_Front ETCSignals.ES910.ES910.CAN1.CAN1.NM_ETAS_Disconnections.Disconnection_Rear ETCSignals.ES910.ES910.CAN1.CAN1.NM_ETAS_Disconnections.Disconnection_SteeringSensor ETCSignals.ES910.ES910.CAN1.CAN1.NM_ETAS_Disconnections.Disconnection_Susp_R_R ETCSignals.ES910.ES910.CAN1.CAN1.NM_ETAS_Disconnections.Disconnection_Susp_R_L ETCSignals.ES910.ES910.CAN1.CAN1.NM_ETAS_Disconnections.Disconnection_Susp_F_R ETCSignals.ES910.ES910.CAN1.CAN1.NM_ETAS_Disconnections.Disconnection_Susp_F_L ETCSignals.ES910.ES910.CAN1.CAN1.NM_ETAS_Disconnections.Disconnection_BrakePedal ETCSignals.ES910.ES910.CAN1.CAN1.NM_ETAS_Disconnections.Disconnection_APPS2 ETCSignals.ES910.ES910.CAN1.CAN1.NM_ETAS_Disconnections.Disconnection_APPS1 ETCSignals.ES910.ES910.CAN1.CAN1.NM_ETAS_Disconnections.Disconnection_Ellipse ETCSignals.ES910.ES910.CAN1.CAN1.AP_ETAS_DashData2.SteeringSensor_Value ETCSignals.ES910.ES910.CAN1.CAN1.AP_ETAS_DashData2.SKF_actual ETCSignals.ES910.ES910.CAN1.CAN1.AP_ETAS_DashData2.CKF_actual ETCSignals.ES910.ES910.CAN1.CAN1.AP_ETAS_DashData2.BrakeSensor_Value ETCSignals.ES910.ES910.CAN1.CAN1.AP_ETAS_DashData2.APPS2_Value ETCSignals.ES910.ES910.CAN1.CAN1.AP_ETAS_DashData2.APPS1_Value ETCSignals.ES910.ES910.CAN1.CAN1.AP_ETAS_Synchronism.Sync_CAN1 ETCSignals.ES910.ES910.CAN2.Presence.PresenceGroup.PresenceFlag ETCSignals.ES910.ES910.CAN2.CAN2.AP_ETAS_BrakeLight.BrakeLight_Control ETCSignals.ES910.ES910.CAN2.CAN2.MEAS_RECU_SDC.Shutdown_TSMS_TSMP ETCSignals.ES910.ES910.CAN2.CAN2.MEAS_RECU_SDC.Shutdown_HVD ETCSignals.ES910.ES910.CAN2.CAN2.MEAS_RECU_SDC.Shutdown_HVBox ETCSignals.ES910.ES910.CAN2.CAN2.MEAS_RECU_SDC.Shutdown_LeftTS ETCSignals.ES910.ES910.CAN2.CAN2.MEAS_RECU_SDC.Shutdown_RightTS ETCSignals.ES910.ES910.CAN2.CAN2.MEAS_FECU_SDC.Shutdown_SC_BOTS ETCSignals.ES910.ES910.CAN2.CAN2.MEAS_FECU_SDC.Shutdown_BSPD_Inertia ETCSignals.ES910.ES910.CAN2.CAN2.MEAS_FECU_SDC.Shutdown_Setas ETCSignals.ES910.ES910.CAN2.CAN2.AP_ELLIPSE_EKF_POS.el_LONGITUDE_EKF ETCSignals.ES910.ES910.CAN2.CAN2.AP_ELLIPSE_EKF_POS.el_LATITUDE_EKF ETCSignals.ES910.ES910.CAN2.CAN2.AP_ELLIPSE_IMU_ACCEL.el_ACCEL_Z ETCSignals.ES910.ES910.CAN2.CAN2.AP_ELLIPSE_IMU_ACCEL.el_ACCEL_Y ETCSignals.ES910.ES910.CAN2.CAN2.AP_ELLIPSE_IMU_ACCEL.el_ACCEL_X ETCSignals.ES910.ES910.CAN2.CAN2.AP_ELLIPSE_EKF_EULER.el_YAW ETCSignals.ES910.ES910.CAN2.CAN2.AP_ELLIPSE_EKF_EULER.el_PITCH ETCSignals.ES910.ES910.CAN2.CAN2.AP_ELLIPSE_EKF_EULER.el_ROLL ETCSignals.ES910.ES910.CAN2.CAN2.AP_ELLIPSE_EKF_VEL.el_Vel_Z ETCSignals.ES910.ES910.CAN2.CAN2.AP_ELLIPSE_EKF_VEL.el_Vel_Y ETCSignals.ES910.ES910.CAN2.CAN2.AP_ELLIPSE_EKF_VEL.el_Vel_X ETCSignals.ES910.ES910.CAN2.CAN2.NM_ELLIPSE_Status.el_CLOCK ETCSignals.ES910.ES910.CAN2.CAN2.NM_ELLIPSE_Status.el_GENERAL ETCSignals.ES910.ES910.CAN2.CAN2.NM_ELLIPSE_Status.Ellipse_Alive ETCSignals.ES910.ES910.CAN2.CAN2.AP_ELLIPSE_IMU_GYRO.el_GYRO_Z ETCSignals.ES910.ES910.CAN2.CAN2.AP_ELLIPSE_IMU_GYRO.el_GYRO_Y ETCSignals.ES910.ES910.CAN2.CAN2.AP_ELLIPSE_IMU_GYRO.el_GYRO_X ETCSignals.ES910.ES910.CAN2.CAN2.AP_ELLIPSE_SLIP_CURV.el_AUTO_STATUS ETCSignals.ES910.ES910.CAN2.CAN2.AP_ELLIPSE_SLIP_CURV.el_CurvatureRadius ETCSignals.ES910.ES910.CAN2.CAN2.AP_ELLIPSE_SLIP_CURV.el_SlipAngle ETCSignals.ES910.ES910.CAN2.CAN2.AP_ELLIPSE_SLIP_CURV.el_AngleTrack ETCSignals.ES910.ES910.CAN2.CAN2.MEAS_ETAS_Inverter_R_Data.Inv_R_TempMotor ETCSignals.ES910.ES910.CAN2.CAN2.MEAS_ETAS_Inverter_R_Data.Inv_R_TempIGBT ETCSignals.ES910.ES910.CAN2.CAN2.MEAS_ETAS_Inverter_R_Data.Inv_R_Speed ETCSignals.ES910.ES910.CAN2.CAN2.MEAS_ETAS_Inverter_R_Data.Inv_R_Iq ETCSignals.ES910.ES910.CAN2.CAN2.MEAS_ETAS_Inverter_R_Data.Inv_R_Icommand ETCSignals.ES910.ES910.CAN2.CAN2.MEAS_ETAS_Inverter_R_Data.Inv_R_Iactual ETCSignals.ES910.ES910.CAN2.CAN2.MEAS_ETAS_Inverter_L_Data.Inv_L_TempMotor ETCSignals.ES910.ES910.CAN2.CAN2.MEAS_ETAS_Inverter_L_Data.Inv_L_TempIGBT ETCSignals.ES910.ES910.CAN2.CAN2.MEAS_ETAS_Inverter_L_Data.Inv_L_Speed ETCSignals.ES910.ES910.CAN2.CAN2.MEAS_ETAS_Inverter_L_Data.Inv_L_Iq ETCSignals.ES910.ES910.CAN2.CAN2.MEAS_ETAS_Inverter_L_Data.Inv_L_Icommand ETCSignals.ES910.ES910.CAN2.CAN2.MEAS_ETAS_Inverter_L_Data.Inv_L_Iactual ETCSignals.ES910.ES910.CAN2.CAN2.MEAS_ETAS_VDCdata3.SUSP_R_R ETCSignals.ES910.ES910.CAN2.CAN2.MEAS_ETAS_VDCdata3.SUSP_R_L ETCSignals.ES910.ES910.CAN2.CAN2.MEAS_ETAS_VDCdata3.SUSP_F_R ETCSignals.ES910.ES910.CAN2.CAN2.MEAS_ETAS_VDCdata3.SUSP_F_L ETCSignals.ES910.ES910.CAN2.CAN2.MEAS_ETAS_VDCdata1.Torque_R ETCSignals.ES910.ES910.CAN2.CAN2.MEAS_ETAS_VDCdata1.Torque_L ETCSignals.ES910.ES910.CAN2.CAN2.MEAS_ETAS_VDCdata5.Handling ETCSignals.ES910.ES910.CAN2.CAN2.MEAS_ETAS_VDCdata5.Mass ETCSignals.ES910.ES910.CAN2.CAN2.MEAS_ETAS_VDCdata4.Throttle ETCSignals.ES910.ES910.CAN2.CAN2.MEAS_ETAS_VDCdata4.Max_Fx_RR ETCSignals.ES910.ES910.CAN2.CAN2.MEAS_ETAS_VDCdata4.Max_Fx_RL ETCSignals.ES910.ES910.CAN2.CAN2.MEAS_ETAS_VDCdata4.Fy_R ETCSignals.ES910.ES910.CAN2.CAN2.MEAS_ETAS_VDCdata2.Max_Torque_RR ETCSignals.ES910.ES910.CAN2.CAN2.MEAS_ETAS_VDCdata2.Max_Torque_RL ETCSignals.ES910.ES910.CAN2.CAN2.MEAS_ETAS_VDCdata2.Torque_RRwc ETCSignals.ES910.ES910.CAN2.CAN2.MEAS_ETAS_VDCdata2.Torque_RLwc ETCSignals.ES910.ES910.CAN2.CAN2.AP_RECU_Data.Susp_R_R_Bits ETCSignals.ES910.ES910.CAN2.CAN2.AP_RECU_Data.Susp_R_L_Bits ETCSignals.ES910.ES910.CAN2.CAN2.NM_FECU_Keep_Alive.Front_Alive ETCSignals.ES910.ES910.CAN2.CAN2.NM_RECU_Keep_Alive.Rear_Alive ETCSignals.ES910.ES910.CAN2.CAN2.AP_FECU_Data2.BrakePressure_Bits ETCSignals.ES910.ES910.CAN2.CAN2.AP_FECU_Data2.Pitot_Bits ETCSignals.ES910.ES910.CAN2.CAN2.AP_FECU_Data2.Susp_F_R_Bits ETCSignals.ES910.ES910.CAN2.CAN2.AP_FECU_Data2.Susp_F_L_Bits ETCSignals.ES910.ES910.CAN2.CAN2.AP_FECU_Data1.SteeringSensor_Bits ETCSignals.ES910.ES910.CAN2.CAN2.AP_FECU_Data1.BrakeSensor_Bits ETCSignals.ES910.ES910.CAN2.CAN2.AP_FECU_Data1.APPS2_Bits ETCSignals.ES910.ES910.CAN2.CAN2.AP_FECU_Data1.APPS1_Bits ETCSignals.ES910.ES910.CAN2.CAN2.AP_ETAS_Synchronism.Sync_CAN2 /end REF_MEASUREMENT
 /begin REF_CHARACTERISTIC ETCSignals.ES910.ES910.CAN1.CAN1.AP_ETAS_DashData1.Speed_calibrate ETCSignals.ES910.ES910.CAN1.CAN1.AP_ETAS_DashData1.Precharge_Voltage_calibrate ETCSignals.ES910.ES910.CAN1.CAN1.AP_ETAS_DashData1.Precharge_Percentage_calibrate ETCSignals.ES910.ES910.CAN1.CAN1.AP_ETAS_VDCParams2.VDC_Cte_SKF_calibrate ETCSignals.ES910.ES910.CAN1.CAN1.AP_ETAS_VDCParams2.VDC_Cte_CKF_calibrate ETCSignals.ES910.ES910.CAN1.CAN1.AP_ETAS_VDCParams.VDC_CKF_Initial_calibrate ETCSignals.ES910.ES910.CAN1.CAN1.AP_ETAS_VDCParams.VDC_SKF_Initial_calibrate ETCSignals.ES910.ES910.CAN1.CAN1.AP_ETAS_VDCParams.VDC_Power_Limit_calibrate ETCSignals.ES910.ES910.CAN1.CAN1.AP_ETAS_VDCParams.VDC_Max_Regen_Motor_Tq_calibrate ETCSignals.ES910.ES910.CAN1.CAN1.AP_ETAS_VDCParams.VDC_K_Reduction_Temperature_calibrate ETCSignals.ES910.ES910.CAN1.CAN1.AP_ETAS_VDCParams.VDC_K_Reduction_P_calibrate ETCSignals.ES910.ES910.CAN1.CAN1.AP_ETAS_VDCParams.VDC_APPS_Sat_Up_calibrate ETCSignals.ES910.ES910.CAN1.CAN1.AP_ETAS_VDCParams.VDC_APPS_Sat_Down_calibrate ETCSignals.ES910.ES910.CAN1.CAN1.AP_ETAS_Inverter_R_Rx.Inverter_R_RegID_calibrate ETCSignals.ES910.ES910.CAN1.CAN1.AP_ETAS_Inverter_R_Rx.Inverter_R_b7tob0_calibrate ETCSignals.ES910.ES910.CAN1.CAN1.AP_ETAS_Inverter_R_Rx.Inverter_R_b15tob8_calibrate ETCSignals.ES910.ES910.CAN1.CAN1.AP_ETAS_Inverter_L_Rx.Inverter_L_RegID_calibrate ETCSignals.ES910.ES910.CAN1.CAN1.AP_ETAS_Inverter_L_Rx.Inverter_L_b7tob0_calibrate ETCSignals.ES910.ES910.CAN1.CAN1.AP_ETAS_Inverter_L_Rx.Inverter_L_b15tob8_calibrate ETCSignals.ES910.ES910.CAN1.CAN1.AP_ETAS_CarState.Car_State_calibrate ETCSignals.ES910.ES910.CAN1.CAN1.AP_ETAS_AIRsRequest.AIRs_Request_calibrate ETCSignals.ES910.ES910.CAN1.CAN1.MEAS_ETAS_InternalVars.CriticalDisconnection_calibrate ETCSignals.ES910.ES910.CAN1.CAN1.MEAS_ETAS_InternalVars.CurrentPathDisconnectionFlag_calibrate ETCSignals.ES910.ES910.CAN1.CAN1.MEAS_ETAS_InternalVars.Car_OK_calibrate ETCSignals.ES910.ES910.CAN1.CAN1.MEAS_ETAS_InternalVars.Power_calibrate ETCSignals.ES910.ES910.CAN1.CAN1.MEAS_ETAS_InternalVars.Torque_OK_calibrate ETCSignals.ES910.ES910.CAN1.CAN1.MEAS_ETAS_InternalVars.TV_Mode_calibrate ETCSignals.ES910.ES910.CAN1.CAN1.MEAS_ETAS_InternalVars.Critical_Signal_Disconnection_calibrate ETCSignals.ES910.ES910.CAN1.CAN1.MEAS_ETAS_InternalVars.Critical_CAN_Disconnection_calibrate ETCSignals.ES910.ES910.CAN1.CAN1.MEAS_ETAS_InternalVars.APPS_Implausibility_calibrate ETCSignals.ES910.ES910.CAN1.CAN1.NM_ETAS_Disconnections.Disconnection_Pitot_calibrate ETCSignals.ES910.ES910.CAN1.CAN1.NM_ETAS_Disconnections.Disconnection_BrakePressure_calibrate ETCSignals.ES910.ES910.CAN1.CAN1.NM_ETAS_Disconnections.Disconnection_DashBoard_calibrate ETCSignals.ES910.ES910.CAN1.CAN1.NM_ETAS_Disconnections.Disconnection_BMS_calibrate ETCSignals.ES910.ES910.CAN1.CAN1.NM_ETAS_Disconnections.Disconnection_Front_calibrate ETCSignals.ES910.ES910.CAN1.CAN1.NM_ETAS_Disconnections.Disconnection_Rear_calibrate ETCSignals.ES910.ES910.CAN1.CAN1.NM_ETAS_Disconnections.Disconnection_SteeringSensor_calibrate ETCSignals.ES910.ES910.CAN1.CAN1.NM_ETAS_Disconnections.Disconnection_Susp_R_R_calibrate ETCSignals.ES910.ES910.CAN1.CAN1.NM_ETAS_Disconnections.Disconnection_Susp_R_L_calibrate ETCSignals.ES910.ES910.CAN1.CAN1.NM_ETAS_Disconnections.Disconnection_Susp_F_R_calibrate ETCSignals.ES910.ES910.CAN1.CAN1.NM_ETAS_Disconnections.Disconnection_Susp_F_L_calibrate ETCSignals.ES910.ES910.CAN1.CAN1.NM_ETAS_Disconnections.Disconnection_BrakePedal_calibrate ETCSignals.ES910.ES910.CAN1.CAN1.NM_ETAS_Disconnections.Disconnection_APPS2_calibrate ETCSignals.ES910.ES910.CAN1.CAN1.NM_ETAS_Disconnections.Disconnection_APPS1_calibrate ETCSignals.ES910.ES910.CAN1.CAN1.NM_ETAS_Disconnections.Disconnection_Ellipse_calibrate ETCSignals.ES910.ES910.CAN1.CAN1.AP_ETAS_DashData2.SteeringSensor_Value_calibrate ETCSignals.ES910.ES910.CAN1.CAN1.AP_ETAS_DashData2.SKF_actual_calibrate ETCSignals.ES910.ES910.CAN1.CAN1.AP_ETAS_DashData2.CKF_actual_calibrate ETCSignals.ES910.ES910.CAN1.CAN1.AP_ETAS_DashData2.BrakeSensor_Value_calibrate ETCSignals.ES910.ES910.CAN1.CAN1.AP_ETAS_DashData2.APPS2_Value_calibrate ETCSignals.ES910.ES910.CAN1.CAN1.AP_ETAS_DashData2.APPS1_Value_calibrate ETCSignals.ES910.ES910.CAN1.CAN1.AP_ETAS_Synchronism.Sync_CAN1_calibrate ETCSignals.ES910.ES910.CAN2.CAN2.AP_ETAS_BrakeLight.BrakeLight_Control_calibrate ETCSignals.ES910.ES910.CAN2.CAN2.MEAS_ETAS_Inverter_R_Data.Inv_R_TempMotor_calibrate ETCSignals.ES910.ES910.CAN2.CAN2.MEAS_ETAS_Inverter_R_Data.Inv_R_TempIGBT_calibrate ETCSignals.ES910.ES910.CAN2.CAN2.MEAS_ETAS_Inverter_R_Data.Inv_R_Speed_calibrate ETCSignals.ES910.ES910.CAN2.CAN2.MEAS_ETAS_Inverter_R_Data.Inv_R_Iq_calibrate ETCSignals.ES910.ES910.CAN2.CAN2.MEAS_ETAS_Inverter_R_Data.Inv_R_Icommand_calibrate ETCSignals.ES910.ES910.CAN2.CAN2.MEAS_ETAS_Inverter_R_Data.Inv_R_Iactual_calibrate ETCSignals.ES910.ES910.CAN2.CAN2.MEAS_ETAS_Inverter_L_Data.Inv_L_TempMotor_calibrate ETCSignals.ES910.ES910.CAN2.CAN2.MEAS_ETAS_Inverter_L_Data.Inv_L_TempIGBT_calibrate ETCSignals.ES910.ES910.CAN2.CAN2.MEAS_ETAS_Inverter_L_Data.Inv_L_Speed_calibrate ETCSignals.ES910.ES910.CAN2.CAN2.MEAS_ETAS_Inverter_L_Data.Inv_L_Iq_calibrate ETCSignals.ES910.ES910.CAN2.CAN2.MEAS_ETAS_Inverter_L_Data.Inv_L_Icommand_calibrate ETCSignals.ES910.ES910.CAN2.CAN2.MEAS_ETAS_Inverter_L_Data.Inv_L_Iactual_calibrate ETCSignals.ES910.ES910.CAN2.CAN2.MEAS_ETAS_VDCdata3.SUSP_R_R_calibrate ETCSignals.ES910.ES910.CAN2.CAN2.MEAS_ETAS_VDCdata3.SUSP_R_L_calibrate ETCSignals.ES910.ES910.CAN2.CAN2.MEAS_ETAS_VDCdata3.SUSP_F_R_calibrate ETCSignals.ES910.ES910.CAN2.CAN2.MEAS_ETAS_VDCdata3.SUSP_F_L_calibrate ETCSignals.ES910.ES910.CAN2.CAN2.MEAS_ETAS_VDCdata1.Torque_R_calibrate ETCSignals.ES910.ES910.CAN2.CAN2.MEAS_ETAS_VDCdata1.Torque_L_calibrate ETCSignals.ES910.ES910.CAN2.CAN2.MEAS_ETAS_VDCdata5.Handling_calibrate ETCSignals.ES910.ES910.CAN2.CAN2.MEAS_ETAS_VDCdata5.Mass_calibrate ETCSignals.ES910.ES910.CAN2.CAN2.MEAS_ETAS_VDCdata4.Throttle_calibrate ETCSignals.ES910.ES910.CAN2.CAN2.MEAS_ETAS_VDCdata4.Max_Fx_RR_calibrate ETCSignals.ES910.ES910.CAN2.CAN2.MEAS_ETAS_VDCdata4.Max_Fx_RL_calibrate ETCSignals.ES910.ES910.CAN2.CAN2.MEAS_ETAS_VDCdata4.Fy_R_calibrate ETCSignals.ES910.ES910.CAN2.CAN2.MEAS_ETAS_VDCdata2.Max_Torque_RR_calibrate ETCSignals.ES910.ES910.CAN2.CAN2.MEAS_ETAS_VDCdata2.Max_Torque_RL_calibrate ETCSignals.ES910.ES910.CAN2.CAN2.MEAS_ETAS_VDCdata2.Torque_RRwc_calibrate ETCSignals.ES910.ES910.CAN2.CAN2.MEAS_ETAS_VDCdata2.Torque_RLwc_calibrate ETCSignals.ES910.ES910.CAN2.CAN2.AP_ETAS_Synchronism.Sync_CAN2_calibrate /end REF_CHARACTERISTIC
/end GROUP
/begin GROUP ETCSignals.ES910.ES910.CAN1 ""
 /begin REF_MEASUREMENT ETCSignals.ES910.ES910.CAN1.Presence.PresenceGroup.PresenceFlag ETCSignals.ES910.ES910.CAN1.CAN1.AP_BMS_SDC.Shutdown_PackageIntck ETCSignals.ES910.ES910.CAN1.CAN1.AP_BMS_SDC.Shutdown_IMD ETCSignals.ES910.ES910.CAN1.CAN1.AP_BMS_SDC.Shutdown_BMS ETCSignals.ES910.ES910.CAN1.CAN1.AP_CurrentSensor.ERROR ETCSignals.ES910.ES910.CAN1.CAN1.AP_CurrentSensor.Accumulator_Current ETCSignals.ES910.ES910.CAN1.CAN1.AP_BMS_Voltages.Lowest_CellVoltage ETCSignals.ES910.ES910.CAN1.CAN1.AP_BMS_Voltages.Highest_CellVoltage ETCSignals.ES910.ES910.CAN1.CAN1.AP_BMS_Voltages.Accumulator_Voltage ETCSignals.ES910.ES910.CAN1.CAN1.AP_BMS_ChargerParameters.Charger_MaxVoltage ETCSignals.ES910.ES910.CAN1.CAN1.AP_BMS_ChargerParameters.Charger_MaxCurrent ETCSignals.ES910.ES910.CAN1.CAN1.AP_BMS_BatteryTemperatures.Lowest_CellTemp ETCSignals.ES910.ES910.CAN1.CAN1.AP_BMS_BatteryTemperatures.Highest_CellTemp ETCSignals.ES910.ES910.CAN1.CAN1.AP_BMS_BatteryTemperatures.Average_CellTemp ETCSignals.ES910.ES910.CAN1.CAN1.AP_Inverter_R_Tx.Inv_R_RegID ETCSignals.ES910.ES910.CAN1.CAN1.AP_Inverter_R_Tx.Inv_R_RegID_M73_Inv_R_TempMotor ETCSignals.ES910.ES910.CAN1.CAN1.AP_Inverter_R_Tx.Inv_R_RegID_M74_Inv_R_TempIGBT ETCSignals.ES910.ES910.CAN1.CAN1.AP_Inverter_R_Tx.Inv_R_RegID_M48_Inv_R_Speed ETCSignals.ES910.ES910.CAN1.CAN1.AP_Inverter_R_Tx.Inv_R_RegID_M39_Inv_R_Iq ETCSignals.ES910.ES910.CAN1.CAN1.AP_Inverter_R_Tx.Inv_R_RegID_M38_Inv_R_Icommand ETCSignals.ES910.ES910.CAN1.CAN1.AP_Inverter_R_Tx.Inv_R_RegID_M32_Inv_R_Iactual ETCSignals.ES910.ES910.CAN1.CAN1.AP_Inverter_R_Tx.Inv_R_RegID_M232_Inv_R_Enable ETCSignals.ES910.ES910.CAN1.CAN1.AP_Inverter_R_Tx.Inv_R_RegID_M235_Inv_R_DCBus ETCSignals.ES910.ES910.CAN1.CAN1.AP_Inverter_L_Tx.Inv_L_RegID ETCSignals.ES910.ES910.CAN1.CAN1.AP_Inverter_L_Tx.Inv_L_RegID_M73_Inv_L_TempMotor ETCSignals.ES910.ES910.CAN1.CAN1.AP_Inverter_L_Tx.Inv_L_RegID_M74_Inv_L_TempIGBT ETCSignals.ES910.ES910.CAN1.CAN1.AP_Inverter_L_Tx.Inv_L_RegID_M48_Inv_L_Speed ETCSignals.ES910.ES910.CAN1.CAN1.AP_Inverter_L_Tx.Inv_L_RegID_M39_Inv_L_Iq ETCSignals.ES910.ES910.CAN1.CAN1.AP_Inverter_L_Tx.Inv_L_RegID_M38_Inv_L_Icommand ETCSignals.ES910.ES910.CAN1.CAN1.AP_Inverter_L_Tx.Inv_L_RegID_M32_Inv_L_Iactual ETCSignals.ES910.ES910.CAN1.CAN1.AP_Inverter_L_Tx.Inv_L_RegID_M232_Inv_L_Enable ETCSignals.ES910.ES910.CAN1.CAN1.AP_Inverter_L_Tx.Inv_L_RegID_M235_Inv_L_DCBus ETCSignals.ES910.ES910.CAN1.CAN1.AP_DASH_CustomMode.CustomMode_Identifier ETCSignals.ES910.ES910.CAN1.CAN1.AP_DASH_CustomMode.CustomMode_Data ETCSignals.ES910.ES910.CAN1.CAN1.AP_DASH_Mode.RacingMode ETCSignals.ES910.ES910.CAN1.CAN1.NM_BMS_Keep_Alive.BMS_Alive ETCSignals.ES910.ES910.CAN1.CAN1.AP_BMS_AIRs_State.AIRs_State ETCSignals.ES910.ES910.CAN1.CAN1.NM_DASH_Keep_Alive.Dash_Alive ETCSignals.ES910.ES910.CAN1.CAN1.AP_DASH_TorqueLockOn.Torque_LockOn ETCSignals.ES910.ES910.CAN1.CAN1.AP_DASH_PrechargeRequest.PrechargeRequest ETCSignals.ES910.ES910.CAN1.CAN1.AP_DASH_EnableDrive.EnableDrive_Order ETCSignals.ES910.ES910.CAN1.CAN1.AP_ETAS_DashData1.Speed ETCSignals.ES910.ES910.CAN1.CAN1.AP_ETAS_DashData1.Precharge_Voltage ETCSignals.ES910.ES910.CAN1.CAN1.AP_ETAS_DashData1.Precharge_Percentage ETCSignals.ES910.ES910.CAN1.CAN1.AP_ETAS_VDCParams2.VDC_Cte_SKF ETCSignals.ES910.ES910.CAN1.CAN1.AP_ETAS_VDCParams2.VDC_Cte_CKF ETCSignals.ES910.ES910.CAN1.CAN1.AP_ETAS_VDCParams.VDC_CKF_Initial ETCSignals.ES910.ES910.CAN1.CAN1.AP_ETAS_VDCParams.VDC_SKF_Initial ETCSignals.ES910.ES910.CAN1.CAN1.AP_ETAS_VDCParams.VDC_Power_Limit ETCSignals.ES910.ES910.CAN1.CAN1.AP_ETAS_VDCParams.VDC_Max_Regen_Motor_Tq ETCSignals.ES910.ES910.CAN1.CAN1.AP_ETAS_VDCParams.VDC_K_Reduction_Temperature ETCSignals.ES910.ES910.CAN1.CAN1.AP_ETAS_VDCParams.VDC_K_Reduction_P ETCSignals.ES910.ES910.CAN1.CAN1.AP_ETAS_VDCParams.VDC_APPS_Sat_Up ETCSignals.ES910.ES910.CAN1.CAN1.AP_ETAS_VDCParams.VDC_APPS_Sat_Down ETCSignals.ES910.ES910.CAN1.CAN1.AP_ETAS_Inverter_R_Rx.Inverter_R_RegID ETCSignals.ES910.ES910.CAN1.CAN1.AP_ETAS_Inverter_R_Rx.Inverter_R_b7tob0 ETCSignals.ES910.ES910.CAN1.CAN1.AP_ETAS_Inverter_R_Rx.Inverter_R_b15tob8 ETCSignals.ES910.ES910.CAN1.CAN1.AP_ETAS_Inverter_L_Rx.Inverter_L_RegID ETCSignals.ES910.ES910.CAN1.CAN1.AP_ETAS_Inverter_L_Rx.Inverter_L_b7tob0 ETCSignals.ES910.ES910.CAN1.CAN1.AP_ETAS_Inverter_L_Rx.Inverter_L_b15tob8 ETCSignals.ES910.ES910.CAN1.CAN1.AP_ETAS_CarState.Car_State ETCSignals.ES910.ES910.CAN1.CAN1.AP_ETAS_AIRsRequest.AIRs_Request ETCSignals.ES910.ES910.CAN1.CAN1.MEAS_ETAS_InternalVars.CriticalDisconnection ETCSignals.ES910.ES910.CAN1.CAN1.MEAS_ETAS_InternalVars.CurrentPathDisconnectionFlag ETCSignals.ES910.ES910.CAN1.CAN1.MEAS_ETAS_InternalVars.Car_OK ETCSignals.ES910.ES910.CAN1.CAN1.MEAS_ETAS_InternalVars.Power ETCSignals.ES910.ES910.CAN1.CAN1.MEAS_ETAS_InternalVars.Torque_OK ETCSignals.ES910.ES910.CAN1.CAN1.MEAS_ETAS_InternalVars.TV_Mode ETCSignals.ES910.ES910.CAN1.CAN1.MEAS_ETAS_InternalVars.Critical_Signal_Disconnection ETCSignals.ES910.ES910.CAN1.CAN1.MEAS_ETAS_InternalVars.Critical_CAN_Disconnection ETCSignals.ES910.ES910.CAN1.CAN1.MEAS_ETAS_InternalVars.APPS_Implausibility ETCSignals.ES910.ES910.CAN1.CAN1.NM_ETAS_Disconnections.Disconnection_Pitot ETCSignals.ES910.ES910.CAN1.CAN1.NM_ETAS_Disconnections.Disconnection_BrakePressure ETCSignals.ES910.ES910.CAN1.CAN1.NM_ETAS_Disconnections.Disconnection_DashBoard ETCSignals.ES910.ES910.CAN1.CAN1.NM_ETAS_Disconnections.Disconnection_BMS ETCSignals.ES910.ES910.CAN1.CAN1.NM_ETAS_Disconnections.Disconnection_Front ETCSignals.ES910.ES910.CAN1.CAN1.NM_ETAS_Disconnections.Disconnection_Rear ETCSignals.ES910.ES910.CAN1.CAN1.NM_ETAS_Disconnections.Disconnection_SteeringSensor ETCSignals.ES910.ES910.CAN1.CAN1.NM_ETAS_Disconnections.Disconnection_Susp_R_R ETCSignals.ES910.ES910.CAN1.CAN1.NM_ETAS_Disconnections.Disconnection_Susp_R_L ETCSignals.ES910.ES910.CAN1.CAN1.NM_ETAS_Disconnections.Disconnection_Susp_F_R ETCSignals.ES910.ES910.CAN1.CAN1.NM_ETAS_Disconnections.Disconnection_Susp_F_L ETCSignals.ES910.ES910.CAN1.CAN1.NM_ETAS_Disconnections.Disconnection_BrakePedal ETCSignals.ES910.ES910.CAN1.CAN1.NM_ETAS_Disconnections.Disconnection_APPS2 ETCSignals.ES910.ES910.CAN1.CAN1.NM_ETAS_Disconnections.Disconnection_APPS1 ETCSignals.ES910.ES910.CAN1.CAN1.NM_ETAS_Disconnections.Disconnection_Ellipse ETCSignals.ES910.ES910.CAN1.CAN1.AP_ETAS_DashData2.SteeringSensor_Value ETCSignals.ES910.ES910.CAN1.CAN1.AP_ETAS_DashData2.SKF_actual ETCSignals.ES910.ES910.CAN1.CAN1.AP_ETAS_DashData2.CKF_actual ETCSignals.ES910.ES910.CAN1.CAN1.AP_ETAS_DashData2.BrakeSensor_Value ETCSignals.ES910.ES910.CAN1.CAN1.AP_ETAS_DashData2.APPS2_Value ETCSignals.ES910.ES910.CAN1.CAN1.AP_ETAS_DashData2.APPS1_Value ETCSignals.ES910.ES910.CAN1.CAN1.AP_ETAS_Synchronism.Sync_CAN1 /end REF_MEASUREMENT
 /begin REF_CHARACTERISTIC ETCSignals.ES910.ES910.CAN1.CAN1.AP_ETAS_DashData1.Speed_calibrate ETCSignals.ES910.ES910.CAN1.CAN1.AP_ETAS_DashData1.Precharge_Voltage_calibrate ETCSignals.ES910.ES910.CAN1.CAN1.AP_ETAS_DashData1.Precharge_Percentage_calibrate ETCSignals.ES910.ES910.CAN1.CAN1.AP_ETAS_VDCParams2.VDC_Cte_SKF_calibrate ETCSignals.ES910.ES910.CAN1.CAN1.AP_ETAS_VDCParams2.VDC_Cte_CKF_calibrate ETCSignals.ES910.ES910.CAN1.CAN1.AP_ETAS_VDCParams.VDC_CKF_Initial_calibrate ETCSignals.ES910.ES910.CAN1.CAN1.AP_ETAS_VDCParams.VDC_SKF_Initial_calibrate ETCSignals.ES910.ES910.CAN1.CAN1.AP_ETAS_VDCParams.VDC_Power_Limit_calibrate ETCSignals.ES910.ES910.CAN1.CAN1.AP_ETAS_VDCParams.VDC_Max_Regen_Motor_Tq_calibrate ETCSignals.ES910.ES910.CAN1.CAN1.AP_ETAS_VDCParams.VDC_K_Reduction_Temperature_calibrate ETCSignals.ES910.ES910.CAN1.CAN1.AP_ETAS_VDCParams.VDC_K_Reduction_P_calibrate ETCSignals.ES910.ES910.CAN1.CAN1.AP_ETAS_VDCParams.VDC_APPS_Sat_Up_calibrate ETCSignals.ES910.ES910.CAN1.CAN1.AP_ETAS_VDCParams.VDC_APPS_Sat_Down_calibrate ETCSignals.ES910.ES910.CAN1.CAN1.AP_ETAS_Inverter_R_Rx.Inverter_R_RegID_calibrate ETCSignals.ES910.ES910.CAN1.CAN1.AP_ETAS_Inverter_R_Rx.Inverter_R_b7tob0_calibrate ETCSignals.ES910.ES910.CAN1.CAN1.AP_ETAS_Inverter_R_Rx.Inverter_R_b15tob8_calibrate ETCSignals.ES910.ES910.CAN1.CAN1.AP_ETAS_Inverter_L_Rx.Inverter_L_RegID_calibrate ETCSignals.ES910.ES910.CAN1.CAN1.AP_ETAS_Inverter_L_Rx.Inverter_L_b7tob0_calibrate ETCSignals.ES910.ES910.CAN1.CAN1.AP_ETAS_Inverter_L_Rx.Inverter_L_b15tob8_calibrate ETCSignals.ES910.ES910.CAN1.CAN1.AP_ETAS_CarState.Car_State_calibrate ETCSignals.ES910.ES910.CAN1.CAN1.AP_ETAS_AIRsRequest.AIRs_Request_calibrate ETCSignals.ES910.ES910.CAN1.CAN1.MEAS_ETAS_InternalVars.CriticalDisconnection_calibrate ETCSignals.ES910.ES910.CAN1.CAN1.MEAS_ETAS_InternalVars.CurrentPathDisconnectionFlag_calibrate ETCSignals.ES910.ES910.CAN1.CAN1.MEAS_ETAS_InternalVars.Car_OK_calibrate ETCSignals.ES910.ES910.CAN1.CAN1.MEAS_ETAS_InternalVars.Power_calibrate ETCSignals.ES910.ES910.CAN1.CAN1.MEAS_ETAS_InternalVars.Torque_OK_calibrate ETCSignals.ES910.ES910.CAN1.CAN1.MEAS_ETAS_InternalVars.TV_Mode_calibrate ETCSignals.ES910.ES910.CAN1.CAN1.MEAS_ETAS_InternalVars.Critical_Signal_Disconnection_calibrate ETCSignals.ES910.ES910.CAN1.CAN1.MEAS_ETAS_InternalVars.Critical_CAN_Disconnection_calibrate ETCSignals.ES910.ES910.CAN1.CAN1.MEAS_ETAS_InternalVars.APPS_Implausibility_calibrate ETCSignals.ES910.ES910.CAN1.CAN1.NM_ETAS_Disconnections.Disconnection_Pitot_calibrate ETCSignals.ES910.ES910.CAN1.CAN1.NM_ETAS_Disconnections.Disconnection_BrakePressure_calibrate ETCSignals.ES910.ES910.CAN1.CAN1.NM_ETAS_Disconnections.Disconnection_DashBoard_calibrate ETCSignals.ES910.ES910.CAN1.CAN1.NM_ETAS_Disconnections.Disconnection_BMS_calibrate ETCSignals.ES910.ES910.CAN1.CAN1.NM_ETAS_Disconnections.Disconnection_Front_calibrate ETCSignals.ES910.ES910.CAN1.CAN1.NM_ETAS_Disconnections.Disconnection_Rear_calibrate ETCSignals.ES910.ES910.CAN1.CAN1.NM_ETAS_Disconnections.Disconnection_SteeringSensor_calibrate ETCSignals.ES910.ES910.CAN1.CAN1.NM_ETAS_Disconnections.Disconnection_Susp_R_R_calibrate ETCSignals.ES910.ES910.CAN1.CAN1.NM_ETAS_Disconnections.Disconnection_Susp_R_L_calibrate ETCSignals.ES910.ES910.CAN1.CAN1.NM_ETAS_Disconnections.Disconnection_Susp_F_R_calibrate ETCSignals.ES910.ES910.CAN1.CAN1.NM_ETAS_Disconnections.Disconnection_Susp_F_L_calibrate ETCSignals.ES910.ES910.CAN1.CAN1.NM_ETAS_Disconnections.Disconnection_BrakePedal_calibrate ETCSignals.ES910.ES910.CAN1.CAN1.NM_ETAS_Disconnections.Disconnection_APPS2_calibrate ETCSignals.ES910.ES910.CAN1.CAN1.NM_ETAS_Disconnections.Disconnection_APPS1_calibrate ETCSignals.ES910.ES910.CAN1.CAN1.NM_ETAS_Disconnections.Disconnection_Ellipse_calibrate ETCSignals.ES910.ES910.CAN1.CAN1.AP_ETAS_DashData2.SteeringSensor_Value_calibrate ETCSignals.ES910.ES910.CAN1.CAN1.AP_ETAS_DashData2.SKF_actual_calibrate ETCSignals.ES910.ES910.CAN1.CAN1.AP_ETAS_DashData2.CKF_actual_calibrate ETCSignals.ES910.ES910.CAN1.CAN1.AP_ETAS_DashData2.BrakeSensor_Value_calibrate ETCSignals.ES910.ES910.CAN1.CAN1.AP_ETAS_DashData2.APPS2_Value_calibrate ETCSignals.ES910.ES910.CAN1.CAN1.AP_ETAS_DashData2.APPS1_Value_calibrate ETCSignals.ES910.ES910.CAN1.CAN1.AP_ETAS_Synchronism.Sync_CAN1_calibrate /end REF_CHARACTERISTIC
/end GROUP
/begin GROUP ETCSignals.ES910.ES910.CAN1.Presence ""
 /begin REF_MEASUREMENT ETCSignals.ES910.ES910.CAN1.Presence.PresenceGroup.PresenceFlag /end REF_MEASUREMENT
/end GROUP
/begin GROUP ETCSignals.ES910.ES910.CAN1.Presence.PresenceGroup ""
 /begin REF_MEASUREMENT ETCSignals.ES910.ES910.CAN1.Presence.PresenceGroup.PresenceFlag /end REF_MEASUREMENT
/end GROUP
/begin GROUP ETCSignals.ES910.ES910.CAN1.CAN1 ""
 /begin REF_MEASUREMENT ETCSignals.ES910.ES910.CAN1.CAN1.AP_BMS_SDC.Shutdown_PackageIntck ETCSignals.ES910.ES910.CAN1.CAN1.AP_BMS_SDC.Shutdown_IMD ETCSignals.ES910.ES910.CAN1.CAN1.AP_BMS_SDC.Shutdown_BMS ETCSignals.ES910.ES910.CAN1.CAN1.AP_CurrentSensor.ERROR ETCSignals.ES910.ES910.CAN1.CAN1.AP_CurrentSensor.Accumulator_Current ETCSignals.ES910.ES910.CAN1.CAN1.AP_BMS_Voltages.Lowest_CellVoltage ETCSignals.ES910.ES910.CAN1.CAN1.AP_BMS_Voltages.Highest_CellVoltage ETCSignals.ES910.ES910.CAN1.CAN1.AP_BMS_Voltages.Accumulator_Voltage ETCSignals.ES910.ES910.CAN1.CAN1.AP_BMS_ChargerParameters.Charger_MaxVoltage ETCSignals.ES910.ES910.CAN1.CAN1.AP_BMS_ChargerParameters.Charger_MaxCurrent ETCSignals.ES910.ES910.CAN1.CAN1.AP_BMS_BatteryTemperatures.Lowest_CellTemp ETCSignals.ES910.ES910.CAN1.CAN1.AP_BMS_BatteryTemperatures.Highest_CellTemp ETCSignals.ES910.ES910.CAN1.CAN1.AP_BMS_BatteryTemperatures.Average_CellTemp ETCSignals.ES910.ES910.CAN1.CAN1.AP_Inverter_R_Tx.Inv_R_RegID ETCSignals.ES910.ES910.CAN1.CAN1.AP_Inverter_R_Tx.Inv_R_RegID_M73_Inv_R_TempMotor ETCSignals.ES910.ES910.CAN1.CAN1.AP_Inverter_R_Tx.Inv_R_RegID_M74_Inv_R_TempIGBT ETCSignals.ES910.ES910.CAN1.CAN1.AP_Inverter_R_Tx.Inv_R_RegID_M48_Inv_R_Speed ETCSignals.ES910.ES910.CAN1.CAN1.AP_Inverter_R_Tx.Inv_R_RegID_M39_Inv_R_Iq ETCSignals.ES910.ES910.CAN1.CAN1.AP_Inverter_R_Tx.Inv_R_RegID_M38_Inv_R_Icommand ETCSignals.ES910.ES910.CAN1.CAN1.AP_Inverter_R_Tx.Inv_R_RegID_M32_Inv_R_Iactual ETCSignals.ES910.ES910.CAN1.CAN1.AP_Inverter_R_Tx.Inv_R_RegID_M232_Inv_R_Enable ETCSignals.ES910.ES910.CAN1.CAN1.AP_Inverter_R_Tx.Inv_R_RegID_M235_Inv_R_DCBus ETCSignals.ES910.ES910.CAN1.CAN1.AP_Inverter_L_Tx.Inv_L_RegID ETCSignals.ES910.ES910.CAN1.CAN1.AP_Inverter_L_Tx.Inv_L_RegID_M73_Inv_L_TempMotor ETCSignals.ES910.ES910.CAN1.CAN1.AP_Inverter_L_Tx.Inv_L_RegID_M74_Inv_L_TempIGBT ETCSignals.ES910.ES910.CAN1.CAN1.AP_Inverter_L_Tx.Inv_L_RegID_M48_Inv_L_Speed ETCSignals.ES910.ES910.CAN1.CAN1.AP_Inverter_L_Tx.Inv_L_RegID_M39_Inv_L_Iq ETCSignals.ES910.ES910.CAN1.CAN1.AP_Inverter_L_Tx.Inv_L_RegID_M38_Inv_L_Icommand ETCSignals.ES910.ES910.CAN1.CAN1.AP_Inverter_L_Tx.Inv_L_RegID_M32_Inv_L_Iactual ETCSignals.ES910.ES910.CAN1.CAN1.AP_Inverter_L_Tx.Inv_L_RegID_M232_Inv_L_Enable ETCSignals.ES910.ES910.CAN1.CAN1.AP_Inverter_L_Tx.Inv_L_RegID_M235_Inv_L_DCBus ETCSignals.ES910.ES910.CAN1.CAN1.AP_DASH_CustomMode.CustomMode_Identifier ETCSignals.ES910.ES910.CAN1.CAN1.AP_DASH_CustomMode.CustomMode_Data ETCSignals.ES910.ES910.CAN1.CAN1.AP_DASH_Mode.RacingMode ETCSignals.ES910.ES910.CAN1.CAN1.NM_BMS_Keep_Alive.BMS_Alive ETCSignals.ES910.ES910.CAN1.CAN1.AP_BMS_AIRs_State.AIRs_State ETCSignals.ES910.ES910.CAN1.CAN1.NM_DASH_Keep_Alive.Dash_Alive ETCSignals.ES910.ES910.CAN1.CAN1.AP_DASH_TorqueLockOn.Torque_LockOn ETCSignals.ES910.ES910.CAN1.CAN1.AP_DASH_PrechargeRequest.PrechargeRequest ETCSignals.ES910.ES910.CAN1.CAN1.AP_DASH_EnableDrive.EnableDrive_Order ETCSignals.ES910.ES910.CAN1.CAN1.AP_ETAS_DashData1.Speed ETCSignals.ES910.ES910.CAN1.CAN1.AP_ETAS_DashData1.Precharge_Voltage ETCSignals.ES910.ES910.CAN1.CAN1.AP_ETAS_DashData1.Precharge_Percentage ETCSignals.ES910.ES910.CAN1.CAN1.AP_ETAS_VDCParams2.VDC_Cte_SKF ETCSignals.ES910.ES910.CAN1.CAN1.AP_ETAS_VDCParams2.VDC_Cte_CKF ETCSignals.ES910.ES910.CAN1.CAN1.AP_ETAS_VDCParams.VDC_CKF_Initial ETCSignals.ES910.ES910.CAN1.CAN1.AP_ETAS_VDCParams.VDC_SKF_Initial ETCSignals.ES910.ES910.CAN1.CAN1.AP_ETAS_VDCParams.VDC_Power_Limit ETCSignals.ES910.ES910.CAN1.CAN1.AP_ETAS_VDCParams.VDC_Max_Regen_Motor_Tq ETCSignals.ES910.ES910.CAN1.CAN1.AP_ETAS_VDCParams.VDC_K_Reduction_Temperature ETCSignals.ES910.ES910.CAN1.CAN1.AP_ETAS_VDCParams.VDC_K_Reduction_P ETCSignals.ES910.ES910.CAN1.CAN1.AP_ETAS_VDCParams.VDC_APPS_Sat_Up ETCSignals.ES910.ES910.CAN1.CAN1.AP_ETAS_VDCParams.VDC_APPS_Sat_Down ETCSignals.ES910.ES910.CAN1.CAN1.AP_ETAS_Inverter_R_Rx.Inverter_R_RegID ETCSignals.ES910.ES910.CAN1.CAN1.AP_ETAS_Inverter_R_Rx.Inverter_R_b7tob0 ETCSignals.ES910.ES910.CAN1.CAN1.AP_ETAS_Inverter_R_Rx.Inverter_R_b15tob8 ETCSignals.ES910.ES910.CAN1.CAN1.AP_ETAS_Inverter_L_Rx.Inverter_L_RegID ETCSignals.ES910.ES910.CAN1.CAN1.AP_ETAS_Inverter_L_Rx.Inverter_L_b7tob0 ETCSignals.ES910.ES910.CAN1.CAN1.AP_ETAS_Inverter_L_Rx.Inverter_L_b15tob8 ETCSignals.ES910.ES910.CAN1.CAN1.AP_ETAS_CarState.Car_State ETCSignals.ES910.ES910.CAN1.CAN1.AP_ETAS_AIRsRequest.AIRs_Request ETCSignals.ES910.ES910.CAN1.CAN1.MEAS_ETAS_InternalVars.CriticalDisconnection ETCSignals.ES910.ES910.CAN1.CAN1.MEAS_ETAS_InternalVars.CurrentPathDisconnectionFlag ETCSignals.ES910.ES910.CAN1.CAN1.MEAS_ETAS_InternalVars.Car_OK ETCSignals.ES910.ES910.CAN1.CAN1.MEAS_ETAS_InternalVars.Power ETCSignals.ES910.ES910.CAN1.CAN1.MEAS_ETAS_InternalVars.Torque_OK ETCSignals.ES910.ES910.CAN1.CAN1.MEAS_ETAS_InternalVars.TV_Mode ETCSignals.ES910.ES910.CAN1.CAN1.MEAS_ETAS_InternalVars.Critical_Signal_Disconnection ETCSignals.ES910.ES910.CAN1.CAN1.MEAS_ETAS_InternalVars.Critical_CAN_Disconnection ETCSignals.ES910.ES910.CAN1.CAN1.MEAS_ETAS_InternalVars.APPS_Implausibility ETCSignals.ES910.ES910.CAN1.CAN1.NM_ETAS_Disconnections.Disconnection_Pitot ETCSignals.ES910.ES910.CAN1.CAN1.NM_ETAS_Disconnections.Disconnection_BrakePressure ETCSignals.ES910.ES910.CAN1.CAN1.NM_ETAS_Disconnections.Disconnection_DashBoard ETCSignals.ES910.ES910.CAN1.CAN1.NM_ETAS_Disconnections.Disconnection_BMS ETCSignals.ES910.ES910.CAN1.CAN1.NM_ETAS_Disconnections.Disconnection_Front ETCSignals.ES910.ES910.CAN1.CAN1.NM_ETAS_Disconnections.Disconnection_Rear ETCSignals.ES910.ES910.CAN1.CAN1.NM_ETAS_Disconnections.Disconnection_SteeringSensor ETCSignals.ES910.ES910.CAN1.CAN1.NM_ETAS_Disconnections.Disconnection_Susp_R_R ETCSignals.ES910.ES910.CAN1.CAN1.NM_ETAS_Disconnections.Disconnection_Susp_R_L ETCSignals.ES910.ES910.CAN1.CAN1.NM_ETAS_Disconnections.Disconnection_Susp_F_R ETCSignals.ES910.ES910.CAN1.CAN1.NM_ETAS_Disconnections.Disconnection_Susp_F_L ETCSignals.ES910.ES910.CAN1.CAN1.NM_ETAS_Disconnections.Disconnection_BrakePedal ETCSignals.ES910.ES910.CAN1.CAN1.NM_ETAS_Disconnections.Disconnection_APPS2 ETCSignals.ES910.ES910.CAN1.CAN1.NM_ETAS_Disconnections.Disconnection_APPS1 ETCSignals.ES910.ES910.CAN1.CAN1.NM_ETAS_Disconnections.Disconnection_Ellipse ETCSignals.ES910.ES910.CAN1.CAN1.AP_ETAS_DashData2.SteeringSensor_Value ETCSignals.ES910.ES910.CAN1.CAN1.AP_ETAS_DashData2.SKF_actual ETCSignals.ES910.ES910.CAN1.CAN1.AP_ETAS_DashData2.CKF_actual ETCSignals.ES910.ES910.CAN1.CAN1.AP_ETAS_DashData2.BrakeSensor_Value ETCSignals.ES910.ES910.CAN1.CAN1.AP_ETAS_DashData2.APPS2_Value ETCSignals.ES910.ES910.CAN1.CAN1.AP_ETAS_DashData2.APPS1_Value ETCSignals.ES910.ES910.CAN1.CAN1.AP_ETAS_Synchronism.Sync_CAN1 /end REF_MEASUREMENT
 /begin REF_CHARACTERISTIC ETCSignals.ES910.ES910.CAN1.CAN1.AP_ETAS_DashData1.Speed_calibrate ETCSignals.ES910.ES910.CAN1.CAN1.AP_ETAS_DashData1.Precharge_Voltage_calibrate ETCSignals.ES910.ES910.CAN1.CAN1.AP_ETAS_DashData1.Precharge_Percentage_calibrate ETCSignals.ES910.ES910.CAN1.CAN1.AP_ETAS_VDCParams2.VDC_Cte_SKF_calibrate ETCSignals.ES910.ES910.CAN1.CAN1.AP_ETAS_VDCParams2.VDC_Cte_CKF_calibrate ETCSignals.ES910.ES910.CAN1.CAN1.AP_ETAS_VDCParams.VDC_CKF_Initial_calibrate ETCSignals.ES910.ES910.CAN1.CAN1.AP_ETAS_VDCParams.VDC_SKF_Initial_calibrate ETCSignals.ES910.ES910.CAN1.CAN1.AP_ETAS_VDCParams.VDC_Power_Limit_calibrate ETCSignals.ES910.ES910.CAN1.CAN1.AP_ETAS_VDCParams.VDC_Max_Regen_Motor_Tq_calibrate ETCSignals.ES910.ES910.CAN1.CAN1.AP_ETAS_VDCParams.VDC_K_Reduction_Temperature_calibrate ETCSignals.ES910.ES910.CAN1.CAN1.AP_ETAS_VDCParams.VDC_K_Reduction_P_calibrate ETCSignals.ES910.ES910.CAN1.CAN1.AP_ETAS_VDCParams.VDC_APPS_Sat_Up_calibrate ETCSignals.ES910.ES910.CAN1.CAN1.AP_ETAS_VDCParams.VDC_APPS_Sat_Down_calibrate ETCSignals.ES910.ES910.CAN1.CAN1.AP_ETAS_Inverter_R_Rx.Inverter_R_RegID_calibrate ETCSignals.ES910.ES910.CAN1.CAN1.AP_ETAS_Inverter_R_Rx.Inverter_R_b7tob0_calibrate ETCSignals.ES910.ES910.CAN1.CAN1.AP_ETAS_Inverter_R_Rx.Inverter_R_b15tob8_calibrate ETCSignals.ES910.ES910.CAN1.CAN1.AP_ETAS_Inverter_L_Rx.Inverter_L_RegID_calibrate ETCSignals.ES910.ES910.CAN1.CAN1.AP_ETAS_Inverter_L_Rx.Inverter_L_b7tob0_calibrate ETCSignals.ES910.ES910.CAN1.CAN1.AP_ETAS_Inverter_L_Rx.Inverter_L_b15tob8_calibrate ETCSignals.ES910.ES910.CAN1.CAN1.AP_ETAS_CarState.Car_State_calibrate ETCSignals.ES910.ES910.CAN1.CAN1.AP_ETAS_AIRsRequest.AIRs_Request_calibrate ETCSignals.ES910.ES910.CAN1.CAN1.MEAS_ETAS_InternalVars.CriticalDisconnection_calibrate ETCSignals.ES910.ES910.CAN1.CAN1.MEAS_ETAS_InternalVars.CurrentPathDisconnectionFlag_calibrate ETCSignals.ES910.ES910.CAN1.CAN1.MEAS_ETAS_InternalVars.Car_OK_calibrate ETCSignals.ES910.ES910.CAN1.CAN1.MEAS_ETAS_InternalVars.Power_calibrate ETCSignals.ES910.ES910.CAN1.CAN1.MEAS_ETAS_InternalVars.Torque_OK_calibrate ETCSignals.ES910.ES910.CAN1.CAN1.MEAS_ETAS_InternalVars.TV_Mode_calibrate ETCSignals.ES910.ES910.CAN1.CAN1.MEAS_ETAS_InternalVars.Critical_Signal_Disconnection_calibrate ETCSignals.ES910.ES910.CAN1.CAN1.MEAS_ETAS_InternalVars.Critical_CAN_Disconnection_calibrate ETCSignals.ES910.ES910.CAN1.CAN1.MEAS_ETAS_InternalVars.APPS_Implausibility_calibrate ETCSignals.ES910.ES910.CAN1.CAN1.NM_ETAS_Disconnections.Disconnection_Pitot_calibrate ETCSignals.ES910.ES910.CAN1.CAN1.NM_ETAS_Disconnections.Disconnection_BrakePressure_calibrate ETCSignals.ES910.ES910.CAN1.CAN1.NM_ETAS_Disconnections.Disconnection_DashBoard_calibrate ETCSignals.ES910.ES910.CAN1.CAN1.NM_ETAS_Disconnections.Disconnection_BMS_calibrate ETCSignals.ES910.ES910.CAN1.CAN1.NM_ETAS_Disconnections.Disconnection_Front_calibrate ETCSignals.ES910.ES910.CAN1.CAN1.NM_ETAS_Disconnections.Disconnection_Rear_calibrate ETCSignals.ES910.ES910.CAN1.CAN1.NM_ETAS_Disconnections.Disconnection_SteeringSensor_calibrate ETCSignals.ES910.ES910.CAN1.CAN1.NM_ETAS_Disconnections.Disconnection_Susp_R_R_calibrate ETCSignals.ES910.ES910.CAN1.CAN1.NM_ETAS_Disconnections.Disconnection_Susp_R_L_calibrate ETCSignals.ES910.ES910.CAN1.CAN1.NM_ETAS_Disconnections.Disconnection_Susp_F_R_calibrate ETCSignals.ES910.ES910.CAN1.CAN1.NM_ETAS_Disconnections.Disconnection_Susp_F_L_calibrate ETCSignals.ES910.ES910.CAN1.CAN1.NM_ETAS_Disconnections.Disconnection_BrakePedal_calibrate ETCSignals.ES910.ES910.CAN1.CAN1.NM_ETAS_Disconnections.Disconnection_APPS2_calibrate ETCSignals.ES910.ES910.CAN1.CAN1.NM_ETAS_Disconnections.Disconnection_APPS1_calibrate ETCSignals.ES910.ES910.CAN1.CAN1.NM_ETAS_Disconnections.Disconnection_Ellipse_calibrate ETCSignals.ES910.ES910.CAN1.CAN1.AP_ETAS_DashData2.SteeringSensor_Value_calibrate ETCSignals.ES910.ES910.CAN1.CAN1.AP_ETAS_DashData2.SKF_actual_calibrate ETCSignals.ES910.ES910.CAN1.CAN1.AP_ETAS_DashData2.CKF_actual_calibrate ETCSignals.ES910.ES910.CAN1.CAN1.AP_ETAS_DashData2.BrakeSensor_Value_calibrate ETCSignals.ES910.ES910.CAN1.CAN1.AP_ETAS_DashData2.APPS2_Value_calibrate ETCSignals.ES910.ES910.CAN1.CAN1.AP_ETAS_DashData2.APPS1_Value_calibrate ETCSignals.ES910.ES910.CAN1.CAN1.AP_ETAS_Synchronism.Sync_CAN1_calibrate /end REF_CHARACTERISTIC
/end GROUP
/begin GROUP ETCSignals.ES910.ES910.CAN1.CAN1.AP_BMS_SDC ""
 /begin REF_MEASUREMENT ETCSignals.ES910.ES910.CAN1.CAN1.AP_BMS_SDC.Shutdown_PackageIntck ETCSignals.ES910.ES910.CAN1.CAN1.AP_BMS_SDC.Shutdown_IMD ETCSignals.ES910.ES910.CAN1.CAN1.AP_BMS_SDC.Shutdown_BMS /end REF_MEASUREMENT
/end GROUP
/begin GROUP ETCSignals.ES910.ES910.CAN1.CAN1.AP_CurrentSensor ""
 /begin REF_MEASUREMENT ETCSignals.ES910.ES910.CAN1.CAN1.AP_CurrentSensor.ERROR ETCSignals.ES910.ES910.CAN1.CAN1.AP_CurrentSensor.Accumulator_Current /end REF_MEASUREMENT
/end GROUP
/begin GROUP ETCSignals.ES910.ES910.CAN1.CAN1.AP_BMS_Voltages ""
 /begin REF_MEASUREMENT ETCSignals.ES910.ES910.CAN1.CAN1.AP_BMS_Voltages.Lowest_CellVoltage ETCSignals.ES910.ES910.CAN1.CAN1.AP_BMS_Voltages.Highest_CellVoltage ETCSignals.ES910.ES910.CAN1.CAN1.AP_BMS_Voltages.Accumulator_Voltage /end REF_MEASUREMENT
/end GROUP
/begin GROUP ETCSignals.ES910.ES910.CAN1.CAN1.AP_BMS_ChargerParameters ""
 /begin REF_MEASUREMENT ETCSignals.ES910.ES910.CAN1.CAN1.AP_BMS_ChargerParameters.Charger_MaxVoltage ETCSignals.ES910.ES910.CAN1.CAN1.AP_BMS_ChargerParameters.Charger_MaxCurrent /end REF_MEASUREMENT
/end GROUP
/begin GROUP ETCSignals.ES910.ES910.CAN1.CAN1.AP_BMS_BatteryTemperatures ""
 /begin REF_MEASUREMENT ETCSignals.ES910.ES910.CAN1.CAN1.AP_BMS_BatteryTemperatures.Lowest_CellTemp ETCSignals.ES910.ES910.CAN1.CAN1.AP_BMS_BatteryTemperatures.Highest_CellTemp ETCSignals.ES910.ES910.CAN1.CAN1.AP_BMS_BatteryTemperatures.Average_CellTemp /end REF_MEASUREMENT
/end GROUP
/begin GROUP ETCSignals.ES910.ES910.CAN1.CAN1.AP_Inverter_R_Tx ""
 /begin REF_MEASUREMENT ETCSignals.ES910.ES910.CAN1.CAN1.AP_Inverter_R_Tx.Inv_R_RegID ETCSignals.ES910.ES910.CAN1.CAN1.AP_Inverter_R_Tx.Inv_R_RegID_M73_Inv_R_TempMotor ETCSignals.ES910.ES910.CAN1.CAN1.AP_Inverter_R_Tx.Inv_R_RegID_M74_Inv_R_TempIGBT ETCSignals.ES910.ES910.CAN1.CAN1.AP_Inverter_R_Tx.Inv_R_RegID_M48_Inv_R_Speed ETCSignals.ES910.ES910.CAN1.CAN1.AP_Inverter_R_Tx.Inv_R_RegID_M39_Inv_R_Iq ETCSignals.ES910.ES910.CAN1.CAN1.AP_Inverter_R_Tx.Inv_R_RegID_M38_Inv_R_Icommand ETCSignals.ES910.ES910.CAN1.CAN1.AP_Inverter_R_Tx.Inv_R_RegID_M32_Inv_R_Iactual ETCSignals.ES910.ES910.CAN1.CAN1.AP_Inverter_R_Tx.Inv_R_RegID_M232_Inv_R_Enable ETCSignals.ES910.ES910.CAN1.CAN1.AP_Inverter_R_Tx.Inv_R_RegID_M235_Inv_R_DCBus /end REF_MEASUREMENT
/end GROUP
/begin GROUP ETCSignals.ES910.ES910.CAN1.CAN1.AP_Inverter_L_Tx ""
 /begin REF_MEASUREMENT ETCSignals.ES910.ES910.CAN1.CAN1.AP_Inverter_L_Tx.Inv_L_RegID ETCSignals.ES910.ES910.CAN1.CAN1.AP_Inverter_L_Tx.Inv_L_RegID_M73_Inv_L_TempMotor ETCSignals.ES910.ES910.CAN1.CAN1.AP_Inverter_L_Tx.Inv_L_RegID_M74_Inv_L_TempIGBT ETCSignals.ES910.ES910.CAN1.CAN1.AP_Inverter_L_Tx.Inv_L_RegID_M48_Inv_L_Speed ETCSignals.ES910.ES910.CAN1.CAN1.AP_Inverter_L_Tx.Inv_L_RegID_M39_Inv_L_Iq ETCSignals.ES910.ES910.CAN1.CAN1.AP_Inverter_L_Tx.Inv_L_RegID_M38_Inv_L_Icommand ETCSignals.ES910.ES910.CAN1.CAN1.AP_Inverter_L_Tx.Inv_L_RegID_M32_Inv_L_Iactual ETCSignals.ES910.ES910.CAN1.CAN1.AP_Inverter_L_Tx.Inv_L_RegID_M232_Inv_L_Enable ETCSignals.ES910.ES910.CAN1.CAN1.AP_Inverter_L_Tx.Inv_L_RegID_M235_Inv_L_DCBus /end REF_MEASUREMENT
/end GROUP
/begin GROUP ETCSignals.ES910.ES910.CAN1.CAN1.AP_DASH_CustomMode ""
 /begin REF_MEASUREMENT ETCSignals.ES910.ES910.CAN1.CAN1.AP_DASH_CustomMode.CustomMode_Identifier ETCSignals.ES910.ES910.CAN1.CAN1.AP_DASH_CustomMode.CustomMode_Data /end REF_MEASUREMENT
/end GROUP
/begin GROUP ETCSignals.ES910.ES910.CAN1.CAN1.AP_DASH_Mode "" /begin REF_MEASUREMENT ETCSignals.ES910.ES910.CAN1.CAN1.AP_DASH_Mode.RacingMode /end REF_MEASUREMENT /end GROUP
/begin GROUP ETCSignals.ES910.ES910.CAN1.CAN1.NM_BMS_Keep_Alive ""
 /begin REF_MEASUREMENT ETCSignals.ES910.ES910.CAN1.CAN1.NM_BMS_Keep_Alive.BMS_Alive /end REF_MEASUREMENT
/end GROUP
/begin GROUP ETCSignals.ES910.ES910.CAN1.CAN1.AP_BMS_AIRs_State ""
 /begin REF_MEASUREMENT ETCSignals.ES910.ES910.CAN1.CAN1.AP_BMS_AIRs_State.AIRs_State /end REF_MEASUREMENT
/end GROUP
/begin GROUP ETCSignals.ES910.ES910.CAN1.CAN1.NM_DASH_Keep_Alive ""
 /begin REF_MEASUREMENT ETCSignals.ES910.ES910.CAN1.CAN1.NM_DASH_Keep_Alive.Dash_Alive /end REF_MEASUREMENT
/end GROUP
/begin GROUP ETCSignals.ES910.ES910.CAN1.CAN1.AP_DASH_TorqueLockOn ""
 /begin REF_MEASUREMENT ETCSignals.ES910.ES910.CAN1.CAN1.AP_DASH_TorqueLockOn.Torque_LockOn /end REF_MEASUREMENT
/end GROUP
/begin GROUP ETCSignals.ES910.ES910.CAN1.CAN1.AP_DASH_PrechargeRequest ""
 /begin REF_MEASUREMENT ETCSignals.ES910.ES910.CAN1.CAN1.AP_DASH_PrechargeRequest.PrechargeRequest /end REF_MEASUREMENT
/end GROUP
/begin GROUP ETCSignals.ES910.ES910.CAN1.CAN1.AP_DASH_EnableDrive ""
 /begin REF_MEASUREMENT ETCSignals.ES910.ES910.CAN1.CAN1.AP_DASH_EnableDrive.EnableDrive_Order /end REF_MEASUREMENT
/end GROUP
/begin GROUP ETCSignals.ES910.ES910.CAN1.CAN1.AP_ETAS_DashData1 ""
 /begin REF_MEASUREMENT ETCSignals.ES910.ES910.CAN1.CAN1.AP_ETAS_DashData1.Speed ETCSignals.ES910.ES910.CAN1.CAN1.AP_ETAS_DashData1.Precharge_Voltage ETCSignals.ES910.ES910.CAN1.CAN1.AP_ETAS_DashData1.Precharge_Percentage /end REF_MEASUREMENT
 /begin REF_CHARACTERISTIC ETCSignals.ES910.ES910.CAN1.CAN1.AP_ETAS_DashData1.Speed_calibrate ETCSignals.ES910.ES910.CAN1.CAN1.AP_ETAS_DashData1.Precharge_Voltage_calibrate ETCSignals.ES910.ES910.CAN1.CAN1.AP_ETAS_DashData1.Precharge_Percentage_calibrate /end REF_CHARACTERISTIC
/end GROUP
/begin GROUP ETCSignals.ES910.ES910.CAN1.CAN1.AP_ETAS_VDCParams2 ""
 /begin REF_MEASUREMENT ETCSignals.ES910.ES910.CAN1.CAN1.AP_ETAS_VDCParams2.VDC_Cte_SKF ETCSignals.ES910.ES910.CAN1.CAN1.AP_ETAS_VDCParams2.VDC_Cte_CKF /end REF_MEASUREMENT
 /begin REF_CHARACTERISTIC ETCSignals.ES910.ES910.CAN1.CAN1.AP_ETAS_VDCParams2.VDC_Cte_SKF_calibrate ETCSignals.ES910.ES910.CAN1.CAN1.AP_ETAS_VDCParams2.VDC_Cte_CKF_calibrate /end REF_CHARACTERISTIC
/end GROUP
/begin GROUP ETCSignals.ES910.ES910.CAN1.CAN1.AP_ETAS_VDCParams ""
 /begin REF_MEASUREMENT ETCSignals.ES910.ES910.CAN1.CAN1.AP_ETAS_VDCParams.VDC_CKF_Initial ETCSignals.ES910.ES910.CAN1.CAN1.AP_ETAS_VDCParams.VDC_SKF_Initial ETCSignals.ES910.ES910.CAN1.CAN1.AP_ETAS_VDCParams.VDC_Power_Limit ETCSignals.ES910.ES910.CAN1.CAN1.AP_ETAS_VDCParams.VDC_Max_Regen_Motor_Tq ETCSignals.ES910.ES910.CAN1.CAN1.AP_ETAS_VDCParams.VDC_K_Reduction_Temperature ETCSignals.ES910.ES910.CAN1.CAN1.AP_ETAS_VDCParams.VDC_K_Reduction_P ETCSignals.ES910.ES910.CAN1.CAN1.AP_ETAS_VDCParams.VDC_APPS_Sat_Up ETCSignals.ES910.ES910.CAN1.CAN1.AP_ETAS_VDCParams.VDC_APPS_Sat_Down /end REF_MEASUREMENT
 /begin REF_CHARACTERISTIC ETCSignals.ES910.ES910.CAN1.CAN1.AP_ETAS_VDCParams.VDC_CKF_Initial_calibrate ETCSignals.ES910.ES910.CAN1.CAN1.AP_ETAS_VDCParams.VDC_SKF_Initial_calibrate ETCSignals.ES910.ES910.CAN1.CAN1.AP_ETAS_VDCParams.VDC_Power_Limit_calibrate ETCSignals.ES910.ES910.CAN1.CAN1.AP_ETAS_VDCParams.VDC_Max_Regen_Motor_Tq_calibrate ETCSignals.ES910.ES910.CAN1.CAN1.AP_ETAS_VDCParams.VDC_K_Reduction_Temperature_calibrate ETCSignals.ES910.ES910.CAN1.CAN1.AP_ETAS_VDCParams.VDC_K_Reduction_P_calibrate ETCSignals.ES910.ES910.CAN1.CAN1.AP_ETAS_VDCParams.VDC_APPS_Sat_Up_calibrate ETCSignals.ES910.ES910.CAN1.CAN1.AP_ETAS_VDCParams.VDC_APPS_Sat_Down_calibrate /end REF_CHARACTERISTIC
/end GROUP
/begin GROUP ETCSignals.ES910.ES910.CAN1.CAN1.AP_ETAS_Inverter_R_Rx ""
 /begin REF_MEASUREMENT ETCSignals.ES910.ES910.CAN1.CAN1.AP_ETAS_Inverter_R_Rx.Inverter_R_RegID ETCSignals.ES910.ES910.CAN1.CAN1.AP_ETAS_Inverter_R_Rx.Inverter_R_b7tob0 ETCSignals.ES910.ES910.CAN1.CAN1.AP_ETAS_Inverter_R_Rx.Inverter_R_b15tob8 /end REF_MEASUREMENT
 /begin REF_CHARACTERISTIC ETCSignals.ES910.ES910.CAN1.CAN1.AP_ETAS_Inverter_R_Rx.Inverter_R_RegID_calibrate ETCSignals.ES910.ES910.CAN1.CAN1.AP_ETAS_Inverter_R_Rx.Inverter_R_b7tob0_calibrate ETCSignals.ES910.ES910.CAN1.CAN1.AP_ETAS_Inverter_R_Rx.Inverter_R_b15tob8_calibrate /end REF_CHARACTERISTIC
/end GROUP
/begin GROUP ETCSignals.ES910.ES910.CAN1.CAN1.AP_ETAS_Inverter_L_Rx ""
 /begin REF_MEASUREMENT ETCSignals.ES910.ES910.CAN1.CAN1.AP_ETAS_Inverter_L_Rx.Inverter_L_RegID ETCSignals.ES910.ES910.CAN1.CAN1.AP_ETAS_Inverter_L_Rx.Inverter_L_b7tob0 ETCSignals.ES910.ES910.CAN1.CAN1.AP_ETAS_Inverter_L_Rx.Inverter_L_b15tob8 /end REF_MEASUREMENT
 /begin REF_CHARACTERISTIC ETCSignals.ES910.ES910.CAN1.CAN1.AP_ETAS_Inverter_L_Rx.Inverter_L_RegID_calibrate ETCSignals.ES910.ES910.CAN1.CAN1.AP_ETAS_Inverter_L_Rx.Inverter_L_b7tob0_calibrate ETCSignals.ES910.ES910.CAN1.CAN1.AP_ETAS_Inverter_L_Rx.Inverter_L_b15tob8_calibrate /end REF_CHARACTERISTIC
/end GROUP
/begin GROUP ETCSignals.ES910.ES910.CAN1.CAN1.AP_ETAS_CarState ""
 /begin REF_MEASUREMENT ETCSignals.ES910.ES910.CAN1.CAN1.AP_ETAS_CarState.Car_State /end REF_MEASUREMENT
 /begin REF_CHARACTERISTIC ETCSignals.ES910.ES910.CAN1.CAN1.AP_ETAS_CarState.Car_State_calibrate /end REF_CHARACTERISTIC
/end GROUP
/begin GROUP ETCSignals.ES910.ES910.CAN1.CAN1.AP_ETAS_AIRsRequest ""
 /begin REF_MEASUREMENT ETCSignals.ES910.ES910.CAN1.CAN1.AP_ETAS_AIRsRequest.AIRs_Request /end REF_MEASUREMENT
 /begin REF_CHARACTERISTIC ETCSignals.ES910.ES910.CAN1.CAN1.AP_ETAS_AIRsRequest.AIRs_Request_calibrate /end REF_CHARACTERISTIC
/end GROUP
/begin GROUP ETCSignals.ES910.ES910.CAN1.CAN1.MEAS_ETAS_InternalVars ""
 /begin REF_MEASUREMENT ETCSignals.ES910.ES910.CAN1.CAN1.MEAS_ETAS_InternalVars.CriticalDisconnection ETCSignals.ES910.ES910.CAN1.CAN1.MEAS_ETAS_InternalVars.CurrentPathDisconnectionFlag ETCSignals.ES910.ES910.CAN1.CAN1.MEAS_ETAS_InternalVars.Car_OK ETCSignals.ES910.ES910.CAN1.CAN1.MEAS_ETAS_InternalVars.Power ETCSignals.ES910.ES910.CAN1.CAN1.MEAS_ETAS_InternalVars.Torque_OK ETCSignals.ES910.ES910.CAN1.CAN1.MEAS_ETAS_InternalVars.TV_Mode ETCSignals.ES910.ES910.CAN1.CAN1.MEAS_ETAS_InternalVars.Critical_Signal_Disconnection ETCSignals.ES910.ES910.CAN1.CAN1.MEAS_ETAS_InternalVars.Critical_CAN_Disconnection ETCSignals.ES910.ES910.CAN1.CAN1.MEAS_ETAS_InternalVars.APPS_Implausibility /end REF_MEASUREMENT
 /begin REF_CHARACTERISTIC ETCSignals.ES910.ES910.CAN1.CAN1.MEAS_ETAS_InternalVars.CriticalDisconnection_calibrate ETCSignals.ES910.ES910.CAN1.CAN1.MEAS_ETAS_InternalVars.CurrentPathDisconnectionFlag_calibrate ETCSignals.ES910.ES910.CAN1.CAN1.MEAS_ETAS_InternalVars.Car_OK_calibrate ETCSignals.ES910.ES910.CAN1.CAN1.MEAS_ETAS_InternalVars.Power_calibrate ETCSignals.ES910.ES910.CAN1.CAN1.MEAS_ETAS_InternalVars.Torque_OK_calibrate ETCSignals.ES910.ES910.CAN1.CAN1.MEAS_ETAS_InternalVars.TV_Mode_calibrate ETCSignals.ES910.ES910.CAN1.CAN1.MEAS_ETAS_InternalVars.Critical_Signal_Disconnection_calibrate ETCSignals.ES910.ES910.CAN1.CAN1.MEAS_ETAS_InternalVars.Critical_CAN_Disconnection_calibrate ETCSignals.ES910.ES910.CAN1.CAN1.MEAS_ETAS_InternalVars.APPS_Implausibility_calibrate /end REF_CHARACTERISTIC
/end GROUP
/begin GROUP ETCSignals.ES910.ES910.CAN1.CAN1.NM_ETAS_Disconnections ""
 /begin REF_MEASUREMENT ETCSignals.ES910.ES910.CAN1.CAN1.NM_ETAS_Disconnections.Disconnection_Pitot ETCSignals.ES910.ES910.CAN1.CAN1.NM_ETAS_Disconnections.Disconnection_BrakePressure ETCSignals.ES910.ES910.CAN1.CAN1.NM_ETAS_Disconnections.Disconnection_DashBoard ETCSignals.ES910.ES910.CAN1.CAN1.NM_ETAS_Disconnections.Disconnection_BMS ETCSignals.ES910.ES910.CAN1.CAN1.NM_ETAS_Disconnections.Disconnection_Front ETCSignals.ES910.ES910.CAN1.CAN1.NM_ETAS_Disconnections.Disconnection_Rear ETCSignals.ES910.ES910.CAN1.CAN1.NM_ETAS_Disconnections.Disconnection_SteeringSensor ETCSignals.ES910.ES910.CAN1.CAN1.NM_ETAS_Disconnections.Disconnection_Susp_R_R ETCSignals.ES910.ES910.CAN1.CAN1.NM_ETAS_Disconnections.Disconnection_Susp_R_L ETCSignals.ES910.ES910.CAN1.CAN1.NM_ETAS_Disconnections.Disconnection_Susp_F_R ETCSignals.ES910.ES910.CAN1.CAN1.NM_ETAS_Disconnections.Disconnection_Susp_F_L ETCSignals.ES910.ES910.CAN1.CAN1.NM_ETAS_Disconnections.Disconnection_BrakePedal ETCSignals.ES910.ES910.CAN1.CAN1.NM_ETAS_Disconnections.Disconnection_APPS2 ETCSignals.ES910.ES910.CAN1.CAN1.NM_ETAS_Disconnections.Disconnection_APPS1 ETCSignals.ES910.ES910.CAN1.CAN1.NM_ETAS_Disconnections.Disconnection_Ellipse /end REF_MEASUREMENT
 /begin REF_CHARACTERISTIC ETCSignals.ES910.ES910.CAN1.CAN1.NM_ETAS_Disconnections.Disconnection_Pitot_calibrate ETCSignals.ES910.ES910.CAN1.CAN1.NM_ETAS_Disconnections.Disconnection_BrakePressure_calibrate ETCSignals.ES910.ES910.CAN1.CAN1.NM_ETAS_Disconnections.Disconnection_DashBoard_calibrate ETCSignals.ES910.ES910.CAN1.CAN1.NM_ETAS_Disconnections.Disconnection_BMS_calibrate ETCSignals.ES910.ES910.CAN1.CAN1.NM_ETAS_Disconnections.Disconnection_Front_calibrate ETCSignals.ES910.ES910.CAN1.CAN1.NM_ETAS_Disconnections.Disconnection_Rear_calibrate ETCSignals.ES910.ES910.CAN1.CAN1.NM_ETAS_Disconnections.Disconnection_SteeringSensor_calibrate ETCSignals.ES910.ES910.CAN1.CAN1.NM_ETAS_Disconnections.Disconnection_Susp_R_R_calibrate ETCSignals.ES910.ES910.CAN1.CAN1.NM_ETAS_Disconnections.Disconnection_Susp_R_L_calibrate ETCSignals.ES910.ES910.CAN1.CAN1.NM_ETAS_Disconnections.Disconnection_Susp_F_R_calibrate ETCSignals.ES910.ES910.CAN1.CAN1.NM_ETAS_Disconnections.Disconnection_Susp_F_L_calibrate ETCSignals.ES910.ES910.CAN1.CAN1.NM_ETAS_Disconnections.Disconnection_BrakePedal_calibrate ETCSignals.ES910.ES910.CAN1.CAN1.NM_ETAS_Disconnections.Disconnection_APPS2_calibrate ETCSignals.ES910.ES910.CAN1.CAN1.NM_ETAS_Disconnections.Disconnection_APPS1_calibrate ETCSignals.ES910.ES910.CAN1.CAN1.NM_ETAS_Disconnections.Disconnection_Ellipse_calibrate /end REF_CHARACTERISTIC
/end GROUP
/begin GROUP ETCSignals.ES910.ES910.CAN1.CAN1.AP_ETAS_DashData2 ""
 /begin REF_MEASUREMENT ETCSignals.ES910.ES910.CAN1.CAN1.AP_ETAS_DashData2.SteeringSensor_Value ETCSignals.ES910.ES910.CAN1.CAN1.AP_ETAS_DashData2.SKF_actual ETCSignals.ES910.ES910.CAN1.CAN1.AP_ETAS_DashData2.CKF_actual ETCSignals.ES910.ES910.CAN1.CAN1.AP_ETAS_DashData2.BrakeSensor_Value ETCSignals.ES910.ES910.CAN1.CAN1.AP_ETAS_DashData2.APPS2_Value ETCSignals.ES910.ES910.CAN1.CAN1.AP_ETAS_DashData2.APPS1_Value /end REF_MEASUREMENT
 /begin REF_CHARACTERISTIC ETCSignals.ES910.ES910.CAN1.CAN1.AP_ETAS_DashData2.SteeringSensor_Value_calibrate ETCSignals.ES910.ES910.CAN1.CAN1.AP_ETAS_DashData2.SKF_actual_calibrate ETCSignals.ES910.ES910.CAN1.CAN1.AP_ETAS_DashData2.CKF_actual_calibrate ETCSignals.ES910.ES910.CAN1.CAN1.AP_ETAS_DashData2.BrakeSensor_Value_calibrate ETCSignals.ES910.ES910.CAN1.CAN1.AP_ETAS_DashData2.APPS2_Value_calibrate ETCSignals.ES910.ES910.CAN1.CAN1.AP_ETAS_DashData2.APPS1_Value_calibrate /end REF_CHARACTERISTIC
/end GROUP
/begin GROUP ETCSignals.ES910.ES910.CAN1.CAN1.AP_ETAS_Synchronism ""
 /begin REF_MEASUREMENT ETCSignals.ES910.ES910.CAN1.CAN1.AP_ETAS_Synchronism.Sync_CAN1 /end REF_MEASUREMENT
 /begin REF_CHARACTERISTIC ETCSignals.ES910.ES910.CAN1.CAN1.AP_ETAS_Synchronism.Sync_CAN1_calibrate /end REF_CHARACTERISTIC
/end GROUP
/begin GROUP ETCSignals.ES910.ES910.CAN2 ""
 /begin REF_MEASUREMENT ETCSignals.ES910.ES910.CAN2.Presence.PresenceGroup.PresenceFlag ETCSignals.ES910.ES910.CAN2.CAN2.AP_ETAS_BrakeLight.BrakeLight_Control ETCSignals.ES910.ES910.CAN2.CAN2.MEAS_RECU_SDC.Shutdown_TSMS_TSMP ETCSignals.ES910.ES910.CAN2.CAN2.MEAS_RECU_SDC.Shutdown_HVD ETCSignals.ES910.ES910.CAN2.CAN2.MEAS_RECU_SDC.Shutdown_HVBox ETCSignals.ES910.ES910.CAN2.CAN2.MEAS_RECU_SDC.Shutdown_LeftTS ETCSignals.ES910.ES910.CAN2.CAN2.MEAS_RECU_SDC.Shutdown_RightTS ETCSignals.ES910.ES910.CAN2.CAN2.MEAS_FECU_SDC.Shutdown_SC_BOTS ETCSignals.ES910.ES910.CAN2.CAN2.MEAS_FECU_SDC.Shutdown_BSPD_Inertia ETCSignals.ES910.ES910.CAN2.CAN2.MEAS_FECU_SDC.Shutdown_Setas ETCSignals.ES910.ES910.CAN2.CAN2.AP_ELLIPSE_EKF_POS.el_LONGITUDE_EKF ETCSignals.ES910.ES910.CAN2.CAN2.AP_ELLIPSE_EKF_POS.el_LATITUDE_EKF ETCSignals.ES910.ES910.CAN2.CAN2.AP_ELLIPSE_IMU_ACCEL.el_ACCEL_Z ETCSignals.ES910.ES910.CAN2.CAN2.AP_ELLIPSE_IMU_ACCEL.el_ACCEL_Y ETCSignals.ES910.ES910.CAN2.CAN2.AP_ELLIPSE_IMU_ACCEL.el_ACCEL_X ETCSignals.ES910.ES910.CAN2.CAN2.AP_ELLIPSE_EKF_EULER.el_YAW ETCSignals.ES910.ES910.CAN2.CAN2.AP_ELLIPSE_EKF_EULER.el_PITCH ETCSignals.ES910.ES910.CAN2.CAN2.AP_ELLIPSE_EKF_EULER.el_ROLL ETCSignals.ES910.ES910.CAN2.CAN2.AP_ELLIPSE_EKF_VEL.el_Vel_Z ETCSignals.ES910.ES910.CAN2.CAN2.AP_ELLIPSE_EKF_VEL.el_Vel_Y ETCSignals.ES910.ES910.CAN2.CAN2.AP_ELLIPSE_EKF_VEL.el_Vel_X ETCSignals.ES910.ES910.CAN2.CAN2.NM_ELLIPSE_Status.el_CLOCK ETCSignals.ES910.ES910.CAN2.CAN2.NM_ELLIPSE_Status.el_GENERAL ETCSignals.ES910.ES910.CAN2.CAN2.NM_ELLIPSE_Status.Ellipse_Alive ETCSignals.ES910.ES910.CAN2.CAN2.AP_ELLIPSE_IMU_GYRO.el_GYRO_Z ETCSignals.ES910.ES910.CAN2.CAN2.AP_ELLIPSE_IMU_GYRO.el_GYRO_Y ETCSignals.ES910.ES910.CAN2.CAN2.AP_ELLIPSE_IMU_GYRO.el_GYRO_X ETCSignals.ES910.ES910.CAN2.CAN2.AP_ELLIPSE_SLIP_CURV.el_AUTO_STATUS ETCSignals.ES910.ES910.CAN2.CAN2.AP_ELLIPSE_SLIP_CURV.el_CurvatureRadius ETCSignals.ES910.ES910.CAN2.CAN2.AP_ELLIPSE_SLIP_CURV.el_SlipAngle ETCSignals.ES910.ES910.CAN2.CAN2.AP_ELLIPSE_SLIP_CURV.el_AngleTrack ETCSignals.ES910.ES910.CAN2.CAN2.MEAS_ETAS_Inverter_R_Data.Inv_R_TempMotor ETCSignals.ES910.ES910.CAN2.CAN2.MEAS_ETAS_Inverter_R_Data.Inv_R_TempIGBT ETCSignals.ES910.ES910.CAN2.CAN2.MEAS_ETAS_Inverter_R_Data.Inv_R_Speed ETCSignals.ES910.ES910.CAN2.CAN2.MEAS_ETAS_Inverter_R_Data.Inv_R_Iq ETCSignals.ES910.ES910.CAN2.CAN2.MEAS_ETAS_Inverter_R_Data.Inv_R_Icommand ETCSignals.ES910.ES910.CAN2.CAN2.MEAS_ETAS_Inverter_R_Data.Inv_R_Iactual ETCSignals.ES910.ES910.CAN2.CAN2.MEAS_ETAS_Inverter_L_Data.Inv_L_TempMotor ETCSignals.ES910.ES910.CAN2.CAN2.MEAS_ETAS_Inverter_L_Data.Inv_L_TempIGBT ETCSignals.ES910.ES910.CAN2.CAN2.MEAS_ETAS_Inverter_L_Data.Inv_L_Speed ETCSignals.ES910.ES910.CAN2.CAN2.MEAS_ETAS_Inverter_L_Data.Inv_L_Iq ETCSignals.ES910.ES910.CAN2.CAN2.MEAS_ETAS_Inverter_L_Data.Inv_L_Icommand ETCSignals.ES910.ES910.CAN2.CAN2.MEAS_ETAS_Inverter_L_Data.Inv_L_Iactual ETCSignals.ES910.ES910.CAN2.CAN2.MEAS_ETAS_VDCdata3.SUSP_R_R ETCSignals.ES910.ES910.CAN2.CAN2.MEAS_ETAS_VDCdata3.SUSP_R_L ETCSignals.ES910.ES910.CAN2.CAN2.MEAS_ETAS_VDCdata3.SUSP_F_R ETCSignals.ES910.ES910.CAN2.CAN2.MEAS_ETAS_VDCdata3.SUSP_F_L ETCSignals.ES910.ES910.CAN2.CAN2.MEAS_ETAS_VDCdata1.Torque_R ETCSignals.ES910.ES910.CAN2.CAN2.MEAS_ETAS_VDCdata1.Torque_L ETCSignals.ES910.ES910.CAN2.CAN2.MEAS_ETAS_VDCdata5.Handling ETCSignals.ES910.ES910.CAN2.CAN2.MEAS_ETAS_VDCdata5.Mass ETCSignals.ES910.ES910.CAN2.CAN2.MEAS_ETAS_VDCdata4.Throttle ETCSignals.ES910.ES910.CAN2.CAN2.MEAS_ETAS_VDCdata4.Max_Fx_RR ETCSignals.ES910.ES910.CAN2.CAN2.MEAS_ETAS_VDCdata4.Max_Fx_RL ETCSignals.ES910.ES910.CAN2.CAN2.MEAS_ETAS_VDCdata4.Fy_R ETCSignals.ES910.ES910.CAN2.CAN2.MEAS_ETAS_VDCdata2.Max_Torque_RR ETCSignals.ES910.ES910.CAN2.CAN2.MEAS_ETAS_VDCdata2.Max_Torque_RL ETCSignals.ES910.ES910.CAN2.CAN2.MEAS_ETAS_VDCdata2.Torque_RRwc ETCSignals.ES910.ES910.CAN2.CAN2.MEAS_ETAS_VDCdata2.Torque_RLwc ETCSignals.ES910.ES910.CAN2.CAN2.AP_RECU_Data.Susp_R_R_Bits ETCSignals.ES910.ES910.CAN2.CAN2.AP_RECU_Data.Susp_R_L_Bits ETCSignals.ES910.ES910.CAN2.CAN2.NM_FECU_Keep_Alive.Front_Alive ETCSignals.ES910.ES910.CAN2.CAN2.NM_RECU_Keep_Alive.Rear_Alive ETCSignals.ES910.ES910.CAN2.CAN2.AP_FECU_Data2.BrakePressure_Bits ETCSignals.ES910.ES910.CAN2.CAN2.AP_FECU_Data2.Pitot_Bits ETCSignals.ES910.ES910.CAN2.CAN2.AP_FECU_Data2.Susp_F_R_Bits ETCSignals.ES910.ES910.CAN2.CAN2.AP_FECU_Data2.Susp_F_L_Bits ETCSignals.ES910.ES910.CAN2.CAN2.AP_FECU_Data1.SteeringSensor_Bits ETCSignals.ES910.ES910.CAN2.CAN2.AP_FECU_Data1.BrakeSensor_Bits ETCSignals.ES910.ES910.CAN2.CAN2.AP_FECU_Data1.APPS2_Bits ETCSignals.ES910.ES910.CAN2.CAN2.AP_FECU_Data1.APPS1_Bits ETCSignals.ES910.ES910.CAN2.CAN2.AP_ETAS_Synchronism.Sync_CAN2 /end REF_MEASUREMENT
 /begin REF_CHARACTERISTIC ETCSignals.ES910.ES910.CAN2.CAN2.AP_ETAS_BrakeLight.BrakeLight_Control_calibrate ETCSignals.ES910.ES910.CAN2.CAN2.MEAS_ETAS_Inverter_R_Data.Inv_R_TempMotor_calibrate ETCSignals.ES910.ES910.CAN2.CAN2.MEAS_ETAS_Inverter_R_Data.Inv_R_TempIGBT_calibrate ETCSignals.ES910.ES910.CAN2.CAN2.MEAS_ETAS_Inverter_R_Data.Inv_R_Speed_calibrate ETCSignals.ES910.ES910.CAN2.CAN2.MEAS_ETAS_Inverter_R_Data.Inv_R_Iq_calibrate ETCSignals.ES910.ES910.CAN2.CAN2.MEAS_ETAS_Inverter_R_Data.Inv_R_Icommand_calibrate ETCSignals.ES910.ES910.CAN2.CAN2.MEAS_ETAS_Inverter_R_Data.Inv_R_Iactual_calibrate ETCSignals.ES910.ES910.CAN2.CAN2.MEAS_ETAS_Inverter_L_Data.Inv_L_TempMotor_calibrate ETCSignals.ES910.ES910.CAN2.CAN2.MEAS_ETAS_Inverter_L_Data.Inv_L_TempIGBT_calibrate ETCSignals.ES910.ES910.CAN2.CAN2.MEAS_ETAS_Inverter_L_Data.Inv_L_Speed_calibrate ETCSignals.ES910.ES910.CAN2.CAN2.MEAS_ETAS_Inverter_L_Data.Inv_L_Iq_calibrate ETCSignals.ES910.ES910.CAN2.CAN2.MEAS_ETAS_Inverter_L_Data.Inv_L_Icommand_calibrate ETCSignals.ES910.ES910.CAN2.CAN2.MEAS_ETAS_Inverter_L_Data.Inv_L_Iactual_calibrate ETCSignals.ES910.ES910.CAN2.CAN2.MEAS_ETAS_VDCdata3.SUSP_R_R_calibrate ETCSignals.ES910.ES910.CAN2.CAN2.MEAS_ETAS_VDCdata3.SUSP_R_L_calibrate ETCSignals.ES910.ES910.CAN2.CAN2.MEAS_ETAS_VDCdata3.SUSP_F_R_calibrate ETCSignals.ES910.ES910.CAN2.CAN2.MEAS_ETAS_VDCdata3.SUSP_F_L_calibrate ETCSignals.ES910.ES910.CAN2.CAN2.MEAS_ETAS_VDCdata1.Torque_R_calibrate ETCSignals.ES910.ES910.CAN2.CAN2.MEAS_ETAS_VDCdata1.Torque_L_calibrate ETCSignals.ES910.ES910.CAN2.CAN2.MEAS_ETAS_VDCdata5.Handling_calibrate ETCSignals.ES910.ES910.CAN2.CAN2.MEAS_ETAS_VDCdata5.Mass_calibrate ETCSignals.ES910.ES910.CAN2.CAN2.MEAS_ETAS_VDCdata4.Throttle_calibrate ETCSignals.ES910.ES910.CAN2.CAN2.MEAS_ETAS_VDCdata4.Max_Fx_RR_calibrate ETCSignals.ES910.ES910.CAN2.CAN2.MEAS_ETAS_VDCdata4.Max_Fx_RL_calibrate ETCSignals.ES910.ES910.CAN2.CAN2.MEAS_ETAS_VDCdata4.Fy_R_calibrate ETCSignals.ES910.ES910.CAN2.CAN2.MEAS_ETAS_VDCdata2.Max_Torque_RR_calibrate ETCSignals.ES910.ES910.CAN2.CAN2.MEAS_ETAS_VDCdata2.Max_Torque_RL_calibrate ETCSignals.ES910.ES910.CAN2.CAN2.MEAS_ETAS_VDCdata2.Torque_RRwc_calibrate ETCSignals.ES910.ES910.CAN2.CAN2.MEAS_ETAS_VDCdata2.Torque_RLwc_calibrate ETCSignals.ES910.ES910.CAN2.CAN2.AP_ETAS_Synchronism.Sync_CAN2_calibrate /end REF_CHARACTERISTIC
/end GROUP
/begin GROUP ETCSignals.ES910.ES910.CAN2.Presence ""
 /begin REF_MEASUREMENT ETCSignals.ES910.ES910.CAN2.Presence.PresenceGroup.PresenceFlag /end REF_MEASUREMENT
/end GROUP
/begin GROUP ETCSignals.ES910.ES910.CAN2.Presence.PresenceGroup ""
 /begin REF_MEASUREMENT ETCSignals.ES910.ES910.CAN2.Presence.PresenceGroup.PresenceFlag /end REF_MEASUREMENT
/end GROUP
/begin GROUP ETCSignals.ES910.ES910.CAN2.CAN2 ""
 /begin REF_MEASUREMENT ETCSignals.ES910.ES910.CAN2.CAN2.AP_ETAS_BrakeLight.BrakeLight_Control ETCSignals.ES910.ES910.CAN2.CAN2.MEAS_RECU_SDC.Shutdown_TSMS_TSMP ETCSignals.ES910.ES910.CAN2.CAN2.MEAS_RECU_SDC.Shutdown_HVD ETCSignals.ES910.ES910.CAN2.CAN2.MEAS_RECU_SDC.Shutdown_HVBox ETCSignals.ES910.ES910.CAN2.CAN2.MEAS_RECU_SDC.Shutdown_LeftTS ETCSignals.ES910.ES910.CAN2.CAN2.MEAS_RECU_SDC.Shutdown_RightTS ETCSignals.ES910.ES910.CAN2.CAN2.MEAS_FECU_SDC.Shutdown_SC_BOTS ETCSignals.ES910.ES910.CAN2.CAN2.MEAS_FECU_SDC.Shutdown_BSPD_Inertia ETCSignals.ES910.ES910.CAN2.CAN2.MEAS_FECU_SDC.Shutdown_Setas ETCSignals.ES910.ES910.CAN2.CAN2.AP_ELLIPSE_EKF_POS.el_LONGITUDE_EKF ETCSignals.ES910.ES910.CAN2.CAN2.AP_ELLIPSE_EKF_POS.el_LATITUDE_EKF ETCSignals.ES910.ES910.CAN2.CAN2.AP_ELLIPSE_IMU_ACCEL.el_ACCEL_Z ETCSignals.ES910.ES910.CAN2.CAN2.AP_ELLIPSE_IMU_ACCEL.el_ACCEL_Y ETCSignals.ES910.ES910.CAN2.CAN2.AP_ELLIPSE_IMU_ACCEL.el_ACCEL_X ETCSignals.ES910.ES910.CAN2.CAN2.AP_ELLIPSE_EKF_EULER.el_YAW ETCSignals.ES910.ES910.CAN2.CAN2.AP_ELLIPSE_EKF_EULER.el_PITCH ETCSignals.ES910.ES910.CAN2.CAN2.AP_ELLIPSE_EKF_EULER.el_ROLL ETCSignals.ES910.ES910.CAN2.CAN2.AP_ELLIPSE_EKF_VEL.el_Vel_Z ETCSignals.ES910.ES910.CAN2.CAN2.AP_ELLIPSE_EKF_VEL.el_Vel_Y ETCSignals.ES910.ES910.CAN2.CAN2.AP_ELLIPSE_EKF_VEL.el_Vel_X ETCSignals.ES910.ES910.CAN2.CAN2.NM_ELLIPSE_Status.el_CLOCK ETCSignals.ES910.ES910.CAN2.CAN2.NM_ELLIPSE_Status.el_GENERAL ETCSignals.ES910.ES910.CAN2.CAN2.NM_ELLIPSE_Status.Ellipse_Alive ETCSignals.ES910.ES910.CAN2.CAN2.AP_ELLIPSE_IMU_GYRO.el_GYRO_Z ETCSignals.ES910.ES910.CAN2.CAN2.AP_ELLIPSE_IMU_GYRO.el_GYRO_Y ETCSignals.ES910.ES910.CAN2.CAN2.AP_ELLIPSE_IMU_GYRO.el_GYRO_X ETCSignals.ES910.ES910.CAN2.CAN2.AP_ELLIPSE_SLIP_CURV.el_AUTO_STATUS ETCSignals.ES910.ES910.CAN2.CAN2.AP_ELLIPSE_SLIP_CURV.el_CurvatureRadius ETCSignals.ES910.ES910.CAN2.CAN2.AP_ELLIPSE_SLIP_CURV.el_SlipAngle ETCSignals.ES910.ES910.CAN2.CAN2.AP_ELLIPSE_SLIP_CURV.el_AngleTrack ETCSignals.ES910.ES910.CAN2.CAN2.MEAS_ETAS_Inverter_R_Data.Inv_R_TempMotor ETCSignals.ES910.ES910.CAN2.CAN2.MEAS_ETAS_Inverter_R_Data.Inv_R_TempIGBT ETCSignals.ES910.ES910.CAN2.CAN2.MEAS_ETAS_Inverter_R_Data.Inv_R_Speed ETCSignals.ES910.ES910.CAN2.CAN2.MEAS_ETAS_Inverter_R_Data.Inv_R_Iq ETCSignals.ES910.ES910.CAN2.CAN2.MEAS_ETAS_Inverter_R_Data.Inv_R_Icommand ETCSignals.ES910.ES910.CAN2.CAN2.MEAS_ETAS_Inverter_R_Data.Inv_R_Iactual ETCSignals.ES910.ES910.CAN2.CAN2.MEAS_ETAS_Inverter_L_Data.Inv_L_TempMotor ETCSignals.ES910.ES910.CAN2.CAN2.MEAS_ETAS_Inverter_L_Data.Inv_L_TempIGBT ETCSignals.ES910.ES910.CAN2.CAN2.MEAS_ETAS_Inverter_L_Data.Inv_L_Speed ETCSignals.ES910.ES910.CAN2.CAN2.MEAS_ETAS_Inverter_L_Data.Inv_L_Iq ETCSignals.ES910.ES910.CAN2.CAN2.MEAS_ETAS_Inverter_L_Data.Inv_L_Icommand ETCSignals.ES910.ES910.CAN2.CAN2.MEAS_ETAS_Inverter_L_Data.Inv_L_Iactual ETCSignals.ES910.ES910.CAN2.CAN2.MEAS_ETAS_VDCdata3.SUSP_R_R ETCSignals.ES910.ES910.CAN2.CAN2.MEAS_ETAS_VDCdata3.SUSP_R_L ETCSignals.ES910.ES910.CAN2.CAN2.MEAS_ETAS_VDCdata3.SUSP_F_R ETCSignals.ES910.ES910.CAN2.CAN2.MEAS_ETAS_VDCdata3.SUSP_F_L ETCSignals.ES910.ES910.CAN2.CAN2.MEAS_ETAS_VDCdata1.Torque_R ETCSignals.ES910.ES910.CAN2.CAN2.MEAS_ETAS_VDCdata1.Torque_L ETCSignals.ES910.ES910.CAN2.CAN2.MEAS_ETAS_VDCdata5.Handling ETCSignals.ES910.ES910.CAN2.CAN2.MEAS_ETAS_VDCdata5.Mass ETCSignals.ES910.ES910.CAN2.CAN2.MEAS_ETAS_VDCdata4.Throttle ETCSignals.ES910.ES910.CAN2.CAN2.MEAS_ETAS_VDCdata4.Max_Fx_RR ETCSignals.ES910.ES910.CAN2.CAN2.MEAS_ETAS_VDCdata4.Max_Fx_RL ETCSignals.ES910.ES910.CAN2.CAN2.MEAS_ETAS_VDCdata4.Fy_R ETCSignals.ES910.ES910.CAN2.CAN2.MEAS_ETAS_VDCdata2.Max_Torque_RR ETCSignals.ES910.ES910.CAN2.CAN2.MEAS_ETAS_VDCdata2.Max_Torque_RL ETCSignals.ES910.ES910.CAN2.CAN2.MEAS_ETAS_VDCdata2.Torque_RRwc ETCSignals.ES910.ES910.CAN2.CAN2.MEAS_ETAS_VDCdata2.Torque_RLwc ETCSignals.ES910.ES910.CAN2.CAN2.AP_RECU_Data.Susp_R_R_Bits ETCSignals.ES910.ES910.CAN2.CAN2.AP_RECU_Data.Susp_R_L_Bits ETCSignals.ES910.ES910.CAN2.CAN2.NM_FECU_Keep_Alive.Front_Alive ETCSignals.ES910.ES910.CAN2.CAN2.NM_RECU_Keep_Alive.Rear_Alive ETCSignals.ES910.ES910.CAN2.CAN2.AP_FECU_Data2.BrakePressure_Bits ETCSignals.ES910.ES910.CAN2.CAN2.AP_FECU_Data2.Pitot_Bits ETCSignals.ES910.ES910.CAN2.CAN2.AP_FECU_Data2.Susp_F_R_Bits ETCSignals.ES910.ES910.CAN2.CAN2.AP_FECU_Data2.Susp_F_L_Bits ETCSignals.ES910.ES910.CAN2.CAN2.AP_FECU_Data1.SteeringSensor_Bits ETCSignals.ES910.ES910.CAN2.CAN2.AP_FECU_Data1.BrakeSensor_Bits ETCSignals.ES910.ES910.CAN2.CAN2.AP_FECU_Data1.APPS2_Bits ETCSignals.ES910.ES910.CAN2.CAN2.AP_FECU_Data1.APPS1_Bits ETCSignals.ES910.ES910.CAN2.CAN2.AP_ETAS_Synchronism.Sync_CAN2 /end REF_MEASUREMENT
 /begin REF_CHARACTERISTIC ETCSignals.ES910.ES910.CAN2.CAN2.AP_ETAS_BrakeLight.BrakeLight_Control_calibrate ETCSignals.ES910.ES910.CAN2.CAN2.MEAS_ETAS_Inverter_R_Data.Inv_R_TempMotor_calibrate ETCSignals.ES910.ES910.CAN2.CAN2.MEAS_ETAS_Inverter_R_Data.Inv_R_TempIGBT_calibrate ETCSignals.ES910.ES910.CAN2.CAN2.MEAS_ETAS_Inverter_R_Data.Inv_R_Speed_calibrate ETCSignals.ES910.ES910.CAN2.CAN2.MEAS_ETAS_Inverter_R_Data.Inv_R_Iq_calibrate ETCSignals.ES910.ES910.CAN2.CAN2.MEAS_ETAS_Inverter_R_Data.Inv_R_Icommand_calibrate ETCSignals.ES910.ES910.CAN2.CAN2.MEAS_ETAS_Inverter_R_Data.Inv_R_Iactual_calibrate ETCSignals.ES910.ES910.CAN2.CAN2.MEAS_ETAS_Inverter_L_Data.Inv_L_TempMotor_calibrate ETCSignals.ES910.ES910.CAN2.CAN2.MEAS_ETAS_Inverter_L_Data.Inv_L_TempIGBT_calibrate ETCSignals.ES910.ES910.CAN2.CAN2.MEAS_ETAS_Inverter_L_Data.Inv_L_Speed_calibrate ETCSignals.ES910.ES910.CAN2.CAN2.MEAS_ETAS_Inverter_L_Data.Inv_L_Iq_calibrate ETCSignals.ES910.ES910.CAN2.CAN2.MEAS_ETAS_Inverter_L_Data.Inv_L_Icommand_calibrate ETCSignals.ES910.ES910.CAN2.CAN2.MEAS_ETAS_Inverter_L_Data.Inv_L_Iactual_calibrate ETCSignals.ES910.ES910.CAN2.CAN2.MEAS_ETAS_VDCdata3.SUSP_R_R_calibrate ETCSignals.ES910.ES910.CAN2.CAN2.MEAS_ETAS_VDCdata3.SUSP_R_L_calibrate ETCSignals.ES910.ES910.CAN2.CAN2.MEAS_ETAS_VDCdata3.SUSP_F_R_calibrate ETCSignals.ES910.ES910.CAN2.CAN2.MEAS_ETAS_VDCdata3.SUSP_F_L_calibrate ETCSignals.ES910.ES910.CAN2.CAN2.MEAS_ETAS_VDCdata1.Torque_R_calibrate ETCSignals.ES910.ES910.CAN2.CAN2.MEAS_ETAS_VDCdata1.Torque_L_calibrate ETCSignals.ES910.ES910.CAN2.CAN2.MEAS_ETAS_VDCdata5.Handling_calibrate ETCSignals.ES910.ES910.CAN2.CAN2.MEAS_ETAS_VDCdata5.Mass_calibrate ETCSignals.ES910.ES910.CAN2.CAN2.MEAS_ETAS_VDCdata4.Throttle_calibrate ETCSignals.ES910.ES910.CAN2.CAN2.MEAS_ETAS_VDCdata4.Max_Fx_RR_calibrate ETCSignals.ES910.ES910.CAN2.CAN2.MEAS_ETAS_VDCdata4.Max_Fx_RL_calibrate ETCSignals.ES910.ES910.CAN2.CAN2.MEAS_ETAS_VDCdata4.Fy_R_calibrate ETCSignals.ES910.ES910.CAN2.CAN2.MEAS_ETAS_VDCdata2.Max_Torque_RR_calibrate ETCSignals.ES910.ES910.CAN2.CAN2.MEAS_ETAS_VDCdata2.Max_Torque_RL_calibrate ETCSignals.ES910.ES910.CAN2.CAN2.MEAS_ETAS_VDCdata2.Torque_RRwc_calibrate ETCSignals.ES910.ES910.CAN2.CAN2.MEAS_ETAS_VDCdata2.Torque_RLwc_calibrate ETCSignals.ES910.ES910.CAN2.CAN2.AP_ETAS_Synchronism.Sync_CAN2_calibrate /end REF_CHARACTERISTIC
/end GROUP
/begin GROUP ETCSignals.ES910.ES910.CAN2.CAN2.AP_ETAS_BrakeLight ""
 /begin REF_MEASUREMENT ETCSignals.ES910.ES910.CAN2.CAN2.AP_ETAS_BrakeLight.BrakeLight_Control /end REF_MEASUREMENT
 /begin REF_CHARACTERISTIC ETCSignals.ES910.ES910.CAN2.CAN2.AP_ETAS_BrakeLight.BrakeLight_Control_calibrate /end REF_CHARACTERISTIC
/end GROUP
/begin GROUP ETCSignals.ES910.ES910.CAN2.CAN2.MEAS_RECU_SDC ""
 /begin REF_MEASUREMENT ETCSignals.ES910.ES910.CAN2.CAN2.MEAS_RECU_SDC.Shutdown_TSMS_TSMP ETCSignals.ES910.ES910.CAN2.CAN2.MEAS_RECU_SDC.Shutdown_HVD ETCSignals.ES910.ES910.CAN2.CAN2.MEAS_RECU_SDC.Shutdown_HVBox ETCSignals.ES910.ES910.CAN2.CAN2.MEAS_RECU_SDC.Shutdown_LeftTS ETCSignals.ES910.ES910.CAN2.CAN2.MEAS_RECU_SDC.Shutdown_RightTS /end REF_MEASUREMENT
/end GROUP
/begin GROUP ETCSignals.ES910.ES910.CAN2.CAN2.MEAS_FECU_SDC ""
 /begin REF_MEASUREMENT ETCSignals.ES910.ES910.CAN2.CAN2.MEAS_FECU_SDC.Shutdown_SC_BOTS ETCSignals.ES910.ES910.CAN2.CAN2.MEAS_FECU_SDC.Shutdown_BSPD_Inertia ETCSignals.ES910.ES910.CAN2.CAN2.MEAS_FECU_SDC.Shutdown_Setas /end REF_MEASUREMENT
/end GROUP
/begin GROUP ETCSignals.ES910.ES910.CAN2.CAN2.AP_ELLIPSE_EKF_POS ""
 /begin REF_MEASUREMENT ETCSignals.ES910.ES910.CAN2.CAN2.AP_ELLIPSE_EKF_POS.el_LONGITUDE_EKF ETCSignals.ES910.ES910.CAN2.CAN2.AP_ELLIPSE_EKF_POS.el_LATITUDE_EKF /end REF_MEASUREMENT
/end GROUP
/begin GROUP ETCSignals.ES910.ES910.CAN2.CAN2.AP_ELLIPSE_IMU_ACCEL ""
 /begin REF_MEASUREMENT ETCSignals.ES910.ES910.CAN2.CAN2.AP_ELLIPSE_IMU_ACCEL.el_ACCEL_Z ETCSignals.ES910.ES910.CAN2.CAN2.AP_ELLIPSE_IMU_ACCEL.el_ACCEL_Y ETCSignals.ES910.ES910.CAN2.CAN2.AP_ELLIPSE_IMU_ACCEL.el_ACCEL_X /end REF_MEASUREMENT
/end GROUP
/begin GROUP ETCSignals.ES910.ES910.CAN2.CAN2.AP_ELLIPSE_EKF_EULER ""
 /begin REF_MEASUREMENT ETCSignals.ES910.ES910.CAN2.CAN2.AP_ELLIPSE_EKF_EULER.el_YAW ETCSignals.ES910.ES910.CAN2.CAN2.AP_ELLIPSE_EKF_EULER.el_PITCH ETCSignals.ES910.ES910.CAN2.CAN2.AP_ELLIPSE_EKF_EULER.el_ROLL /end REF_MEASUREMENT
/end GROUP
/begin GROUP ETCSignals.ES910.ES910.CAN2.CAN2.AP_ELLIPSE_EKF_VEL ""
 /begin REF_MEASUREMENT ETCSignals.ES910.ES910.CAN2.CAN2.AP_ELLIPSE_EKF_VEL.el_Vel_Z ETCSignals.ES910.ES910.CAN2.CAN2.AP_ELLIPSE_EKF_VEL.el_Vel_Y ETCSignals.ES910.ES910.CAN2.CAN2.AP_ELLIPSE_EKF_VEL.el_Vel_X /end REF_MEASUREMENT
/end GROUP
/begin GROUP ETCSignals.ES910.ES910.CAN2.CAN2.NM_ELLIPSE_Status ""
 /begin REF_MEASUREMENT ETCSignals.ES910.ES910.CAN2.CAN2.NM_ELLIPSE_Status.el_CLOCK ETCSignals.ES910.ES910.CAN2.CAN2.NM_ELLIPSE_Status.el_GENERAL ETCSignals.ES910.ES910.CAN2.CAN2.NM_ELLIPSE_Status.Ellipse_Alive /end REF_MEASUREMENT
/end GROUP
/begin GROUP ETCSignals.ES910.ES910.CAN2.CAN2.AP_ELLIPSE_IMU_GYRO ""
 /begin REF_MEASUREMENT ETCSignals.ES910.ES910.CAN2.CAN2.AP_ELLIPSE_IMU_GYRO.el_GYRO_Z ETCSignals.ES910.ES910.CAN2.CAN2.AP_ELLIPSE_IMU_GYRO.el_GYRO_Y ETCSignals.ES910.ES910.CAN2.CAN2.AP_ELLIPSE_IMU_GYRO.el_GYRO_X /end REF_MEASUREMENT
/end GROUP
/begin GROUP ETCSignals.ES910.ES910.CAN2.CAN2.AP_ELLIPSE_SLIP_CURV ""
 /begin REF_MEASUREMENT ETCSignals.ES910.ES910.CAN2.CAN2.AP_ELLIPSE_SLIP_CURV.el_AUTO_STATUS ETCSignals.ES910.ES910.CAN2.CAN2.AP_ELLIPSE_SLIP_CURV.el_CurvatureRadius ETCSignals.ES910.ES910.CAN2.CAN2.AP_ELLIPSE_SLIP_CURV.el_SlipAngle ETCSignals.ES910.ES910.CAN2.CAN2.AP_ELLIPSE_SLIP_CURV.el_AngleTrack /end REF_MEASUREMENT
/end GROUP
/begin GROUP ETCSignals.ES910.ES910.CAN2.CAN2.MEAS_ETAS_Inverter_R_Data ""
 /begin REF_MEASUREMENT ETCSignals.ES910.ES910.CAN2.CAN2.MEAS_ETAS_Inverter_R_Data.Inv_R_TempMotor ETCSignals.ES910.ES910.CAN2.CAN2.MEAS_ETAS_Inverter_R_Data.Inv_R_TempIGBT ETCSignals.ES910.ES910.CAN2.CAN2.MEAS_ETAS_Inverter_R_Data.Inv_R_Speed ETCSignals.ES910.ES910.CAN2.CAN2.MEAS_ETAS_Inverter_R_Data.Inv_R_Iq ETCSignals.ES910.ES910.CAN2.CAN2.MEAS_ETAS_Inverter_R_Data.Inv_R_Icommand ETCSignals.ES910.ES910.CAN2.CAN2.MEAS_ETAS_Inverter_R_Data.Inv_R_Iactual /end REF_MEASUREMENT
 /begin REF_CHARACTERISTIC ETCSignals.ES910.ES910.CAN2.CAN2.MEAS_ETAS_Inverter_R_Data.Inv_R_TempMotor_calibrate ETCSignals.ES910.ES910.CAN2.CAN2.MEAS_ETAS_Inverter_R_Data.Inv_R_TempIGBT_calibrate ETCSignals.ES910.ES910.CAN2.CAN2.MEAS_ETAS_Inverter_R_Data.Inv_R_Speed_calibrate ETCSignals.ES910.ES910.CAN2.CAN2.MEAS_ETAS_Inverter_R_Data.Inv_R_Iq_calibrate ETCSignals.ES910.ES910.CAN2.CAN2.MEAS_ETAS_Inverter_R_Data.Inv_R_Icommand_calibrate ETCSignals.ES910.ES910.CAN2.CAN2.MEAS_ETAS_Inverter_R_Data.Inv_R_Iactual_calibrate /end REF_CHARACTERISTIC
/end GROUP
/begin GROUP ETCSignals.ES910.ES910.CAN2.CAN2.MEAS_ETAS_Inverter_L_Data ""
 /begin REF_MEASUREMENT ETCSignals.ES910.ES910.CAN2.CAN2.MEAS_ETAS_Inverter_L_Data.Inv_L_TempMotor ETCSignals.ES910.ES910.CAN2.CAN2.MEAS_ETAS_Inverter_L_Data.Inv_L_TempIGBT ETCSignals.ES910.ES910.CAN2.CAN2.MEAS_ETAS_Inverter_L_Data.Inv_L_Speed ETCSignals.ES910.ES910.CAN2.CAN2.MEAS_ETAS_Inverter_L_Data.Inv_L_Iq ETCSignals.ES910.ES910.CAN2.CAN2.MEAS_ETAS_Inverter_L_Data.Inv_L_Icommand ETCSignals.ES910.ES910.CAN2.CAN2.MEAS_ETAS_Inverter_L_Data.Inv_L_Iactual /end REF_MEASUREMENT
 /begin REF_CHARACTERISTIC ETCSignals.ES910.ES910.CAN2.CAN2.MEAS_ETAS_Inverter_L_Data.Inv_L_TempMotor_calibrate ETCSignals.ES910.ES910.CAN2.CAN2.MEAS_ETAS_Inverter_L_Data.Inv_L_TempIGBT_calibrate ETCSignals.ES910.ES910.CAN2.CAN2.MEAS_ETAS_Inverter_L_Data.Inv_L_Speed_calibrate ETCSignals.ES910.ES910.CAN2.CAN2.MEAS_ETAS_Inverter_L_Data.Inv_L_Iq_calibrate ETCSignals.ES910.ES910.CAN2.CAN2.MEAS_ETAS_Inverter_L_Data.Inv_L_Icommand_calibrate ETCSignals.ES910.ES910.CAN2.CAN2.MEAS_ETAS_Inverter_L_Data.Inv_L_Iactual_calibrate /end REF_CHARACTERISTIC
/end GROUP
/begin GROUP ETCSignals.ES910.ES910.CAN2.CAN2.MEAS_ETAS_VDCdata3 ""
 /begin REF_MEASUREMENT ETCSignals.ES910.ES910.CAN2.CAN2.MEAS_ETAS_VDCdata3.SUSP_R_R ETCSignals.ES910.ES910.CAN2.CAN2.MEAS_ETAS_VDCdata3.SUSP_R_L ETCSignals.ES910.ES910.CAN2.CAN2.MEAS_ETAS_VDCdata3.SUSP_F_R ETCSignals.ES910.ES910.CAN2.CAN2.MEAS_ETAS_VDCdata3.SUSP_F_L /end REF_MEASUREMENT
 /begin REF_CHARACTERISTIC ETCSignals.ES910.ES910.CAN2.CAN2.MEAS_ETAS_VDCdata3.SUSP_R_R_calibrate ETCSignals.ES910.ES910.CAN2.CAN2.MEAS_ETAS_VDCdata3.SUSP_R_L_calibrate ETCSignals.ES910.ES910.CAN2.CAN2.MEAS_ETAS_VDCdata3.SUSP_F_R_calibrate ETCSignals.ES910.ES910.CAN2.CAN2.MEAS_ETAS_VDCdata3.SUSP_F_L_calibrate /end REF_CHARACTERISTIC
/end GROUP
/begin GROUP ETCSignals.ES910.ES910.CAN2.CAN2.MEAS_ETAS_VDCdata1 ""
 /begin REF_MEASUREMENT ETCSignals.ES910.ES910.CAN2.CAN2.MEAS_ETAS_VDCdata1.Torque_R ETCSignals.ES910.ES910.CAN2.CAN2.MEAS_ETAS_VDCdata1.Torque_L /end REF_MEASUREMENT
 /begin REF_CHARACTERISTIC ETCSignals.ES910.ES910.CAN2.CAN2.MEAS_ETAS_VDCdata1.Torque_R_calibrate ETCSignals.ES910.ES910.CAN2.CAN2.MEAS_ETAS_VDCdata1.Torque_L_calibrate /end REF_CHARACTERISTIC
/end GROUP
/begin GROUP ETCSignals.ES910.ES910.CAN2.CAN2.MEAS_ETAS_VDCdata5 ""
 /begin REF_MEASUREMENT ETCSignals.ES910.ES910.CAN2.CAN2.MEAS_ETAS_VDCdata5.Handling ETCSignals.ES910.ES910.CAN2.CAN2.MEAS_ETAS_VDCdata5.Mass /end REF_MEASUREMENT
 /begin REF_CHARACTERISTIC ETCSignals.ES910.ES910.CAN2.CAN2.MEAS_ETAS_VDCdata5.Handling_calibrate ETCSignals.ES910.ES910.CAN2.CAN2.MEAS_ETAS_VDCdata5.Mass_calibrate /end REF_CHARACTERISTIC
/end GROUP
/begin GROUP ETCSignals.ES910.ES910.CAN2.CAN2.MEAS_ETAS_VDCdata4 ""
 /begin REF_MEASUREMENT ETCSignals.ES910.ES910.CAN2.CAN2.MEAS_ETAS_VDCdata4.Throttle ETCSignals.ES910.ES910.CAN2.CAN2.MEAS_ETAS_VDCdata4.Max_Fx_RR ETCSignals.ES910.ES910.CAN2.CAN2.MEAS_ETAS_VDCdata4.Max_Fx_RL ETCSignals.ES910.ES910.CAN2.CAN2.MEAS_ETAS_VDCdata4.Fy_R /end REF_MEASUREMENT
 /begin REF_CHARACTERISTIC ETCSignals.ES910.ES910.CAN2.CAN2.MEAS_ETAS_VDCdata4.Throttle_calibrate ETCSignals.ES910.ES910.CAN2.CAN2.MEAS_ETAS_VDCdata4.Max_Fx_RR_calibrate ETCSignals.ES910.ES910.CAN2.CAN2.MEAS_ETAS_VDCdata4.Max_Fx_RL_calibrate ETCSignals.ES910.ES910.CAN2.CAN2.MEAS_ETAS_VDCdata4.Fy_R_calibrate /end REF_CHARACTERISTIC
/end GROUP
/begin GROUP ETCSignals.ES910.ES910.CAN2.CAN2.MEAS_ETAS_VDCdata2 ""
 /begin REF_MEASUREMENT ETCSignals.ES910.ES910.CAN2.CAN2.MEAS_ETAS_VDCdata2.Max_Torque_RR ETCSignals.ES910.ES910.CAN2.CAN2.MEAS_ETAS_VDCdata2.Max_Torque_RL ETCSignals.ES910.ES910.CAN2.CAN2.MEAS_ETAS_VDCdata2.Torque_RRwc ETCSignals.ES910.ES910.CAN2.CAN2.MEAS_ETAS_VDCdata2.Torque_RLwc /end REF_MEASUREMENT
 /begin REF_CHARACTERISTIC ETCSignals.ES910.ES910.CAN2.CAN2.MEAS_ETAS_VDCdata2.Max_Torque_RR_calibrate ETCSignals.ES910.ES910.CAN2.CAN2.MEAS_ETAS_VDCdata2.Max_Torque_RL_calibrate ETCSignals.ES910.ES910.CAN2.CAN2.MEAS_ETAS_VDCdata2.Torque_RRwc_calibrate ETCSignals.ES910.ES910.CAN2.CAN2.MEAS_ETAS_VDCdata2.Torque_RLwc_calibrate /end REF_CHARACTERISTIC
/end GROUP
/begin GROUP ETCSignals.ES910.ES910.CAN2.CAN2.AP_RECU_Data ""
 /begin REF_MEASUREMENT ETCSignals.ES910.ES910.CAN2.CAN2.AP_RECU_Data.Susp_R_R_Bits ETCSignals.ES910.ES910.CAN2.CAN2.AP_RECU_Data.Susp_R_L_Bits /end REF_MEASUREMENT
/end GROUP
/begin GROUP ETCSignals.ES910.ES910.CAN2.CAN2.NM_FECU_Keep_Alive ""
 /begin REF_MEASUREMENT ETCSignals.ES910.ES910.CAN2.CAN2.NM_FECU_Keep_Alive.Front_Alive /end REF_MEASUREMENT
/end GROUP
/begin GROUP ETCSignals.ES910.ES910.CAN2.CAN2.NM_RECU_Keep_Alive ""
 /begin REF_MEASUREMENT ETCSignals.ES910.ES910.CAN2.CAN2.NM_RECU_Keep_Alive.Rear_Alive /end REF_MEASUREMENT
/end GROUP
/begin GROUP ETCSignals.ES910.ES910.CAN2.CAN2.AP_FECU_Data2 ""
 /begin REF_MEASUREMENT ETCSignals.ES910.ES910.CAN2.CAN2.AP_FECU_Data2.BrakePressure_Bits ETCSignals.ES910.ES910.CAN2.CAN2.AP_FECU_Data2.Pitot_Bits ETCSignals.ES910.ES910.CAN2.CAN2.AP_FECU_Data2.Susp_F_R_Bits ETCSignals.ES910.ES910.CAN2.CAN2.AP_FECU_Data2.Susp_F_L_Bits /end REF_MEASUREMENT
/end GROUP
/begin GROUP ETCSignals.ES910.ES910.CAN2.CAN2.AP_FECU_Data1 ""
 /begin REF_MEASUREMENT ETCSignals.ES910.ES910.CAN2.CAN2.AP_FECU_Data1.SteeringSensor_Bits ETCSignals.ES910.ES910.CAN2.CAN2.AP_FECU_Data1.BrakeSensor_Bits ETCSignals.ES910.ES910.CAN2.CAN2.AP_FECU_Data1.APPS2_Bits ETCSignals.ES910.ES910.CAN2.CAN2.AP_FECU_Data1.APPS1_Bits /end REF_MEASUREMENT
/end GROUP
/begin GROUP ETCSignals.ES910.ES910.CAN2.CAN2.AP_ETAS_Synchronism ""
 /begin REF_MEASUREMENT ETCSignals.ES910.ES910.CAN2.CAN2.AP_ETAS_Synchronism.Sync_CAN2 /end REF_MEASUREMENT
 /begin REF_CHARACTERISTIC ETCSignals.ES910.ES910.CAN2.CAN2.AP_ETAS_Synchronism.Sync_CAN2_calibrate /end REF_CHARACTERISTIC
/end GROUP
/end MODULE
/end PROJECT
